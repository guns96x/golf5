ASAP2_VERSION 1 3
/begin PROJECT X447 "EDC16U34"
/begin HEADER "" VERSION "VAA1" PROJECT_NO X447 /end HEADER
/begin MODULE DIM ""
/begin MOD_COMMON "" BYTE_ORDER MSB_FIRST ALIGNMENT_BYTE 1 ALIGNMENT_WORD 2 ALIGNMENT_LONG 4 ALIGNMENT_FLOAT32_IEEE 4 /end MOD_COMMON
/begin CHARACTERISTIC AirbCD_DebCrashCrCtlDef_C "Entprellzeit für Fehlerpfad Abschaltung CrCtl durch airbag" VALUE 0x1C4858 Kw_Wu16 655350.0 Time_ms 0.00 655350.0 FORMAT "%8.1" /end CHARACTERISTIC
/begin CHARACTERISTIC AirbCD_DebCrashCrCtlOk_C "Entprellzeit für Fehlerpfad Abschaltung CrCtl durch Airbag" VALUE 0x1C485A Kw_Wu16 655350.0 Time_ms 0.00 655350.0 FORMAT "%8.1" /end CHARACTERISTIC
/begin CHARACTERISTIC AirbCD_DebCrashFCMDef_C "Entprellzeit für FCM Fehlerzugang der Airbaginformation" VALUE 0x1C485C Kw_Wu16 655350.0 Time_ms 0.00 655350.0 FORMAT "%8.1" /end CHARACTERISTIC
/begin CHARACTERISTIC AirbCD_DebCrashFCMOk_C "Entprellzeit für FCM Fehlerzugang der Airbaginformation" VALUE 0x1C485E Kw_Wu16 655350.0 Time_ms 0.00 655350.0 FORMAT "%8.1" /end CHARACTERISTIC
/begin CHARACTERISTIC AirbCD_DebCrashPSPDef_C "Entprellzeit für Fehlerpfad Abschaltung PSP durch Airbag" VALUE 0x1C4860 Kw_Wu16 655350.0 Time_ms 0.00 655350.0 FORMAT "%8.1" /end CHARACTERISTIC
/begin CHARACTERISTIC AirbCD_DebCrashPSPOk_C "Entprellzeit für Fehlerpfad Abschaltung PSP durch Airbag" VALUE 0x1C4862 Kw_Wu16 655350.0 Time_ms 0.00 655350.0 FORMAT "%8.1" /end CHARACTERISTIC
/begin CHARACTERISTIC AirbCD_tiDebNeg_C "Entprellzeit für negative Schwelle der Motorstillstandserkennung" VALUE 0x1C4864 Kw_Wu16 2000.000 TimeDeb 0.00 2000.000 FORMAT "%8.3" EXTENDED_LIMITS 0.00 655350.0 /end CHARACTERISTIC
/begin CHARACTERISTIC AirbCD_tiDebPos_C "Entprellzeit für Fehlerpfad tatsächlicher Crash" VALUE 0x1C4866 Kw_Wu16 2000.000 TimeDeb 0.00 2000.000 FORMAT "%8.3" EXTENDED_LIMITS 0.00 655350.0 /end CHARACTERISTIC
/begin CHARACTERISTIC AirbCD_nEngThresMin_C "Min Motor Drehzahl" VALUE 0x1C4868 Kw_Wu16 6000.000 EngN 0.00 6000.000 FORMAT "%8.3" EXTENDED_LIMITS 0.00 65535.00 /end CHARACTERISTIC
/begin CHARACTERISTIC AirbCD_nEngThresStrtMax_C "Max Motor Drehzahl für ein Startversuch" VALUE 0x1C486A Kw_Wu16 6000.000 EngN 0.00 6000.000 FORMAT "%8.3" EXTENDED_LIMITS 0.00 65535.00 /end CHARACTERISTIC
/begin CHARACTERISTIC AirbCD_nEngThresStrtMin_C "Min Motor Drehzahl für ein Startversuch" VALUE 0x1C486C Kw_Wu16 6000.000 EngN 0.00 6000.000 FORMAT "%8.3" EXTENDED_LIMITS 0.00 65535.00 /end CHARACTERISTIC
/begin CHARACTERISTIC AirCtl_APCorRgn_CUR "Kennlinie für Atmosphärendruckkorrekturwert Regenerations-betrieb" CURVE 0x1C61CC Kl_Xs16_Ws16 3000.000 AirMassPerCyl -1500.000 1500.000 FORMAT "%8.3" EXTENDED_LIMITS -3276.800 3276.700
 /begin AXIS_DESCR STD_AXIS APSCD_pVal Pres_hPa 4 0.00 3500.000 FORMAT "%8.3" EXTENDED_LIMITS -32768.00 32767.00 DEPOSIT ABSOLUTE /end AXIS_DESCR
/end CHARACTERISTIC
/begin CHARACTERISTIC AirCtl_APCor_CUR "Kennlinie für Atmosphärendruckkorrektur" CURVE 0x1C61DE Kl_Xs16_Ws16 3000.000 AirMassPerCyl -1500.000 1500.000 FORMAT "%8.3" EXTENDED_LIMITS -3276.800 3276.700
 /begin AXIS_DESCR STD_AXIS APSCD_pVal Pres_hPa 4 0.00 3500.000 FORMAT "%8.3" EXTENDED_LIMITS -32768.00 32767.00 DEPOSIT ABSOLUTE /end AXIS_DESCR
/end CHARACTERISTIC
/begin CHARACTERISTIC AirCtl_ATCorRgn_MAP "Kennfeld für drehzahl und lufttemperaturabhängige Korrektur im Regenerationsbetrieb" MAP 0x1C61F0 Kf_Xs16_Ys16_Ws16 7.999878 Fact -4.000000 3.999878 FORMAT "%8.6"
 /begin AXIS_DESCR STD_AXIS Eng_nAvrg EngN 2 0.00 6000.000 FORMAT "%8.3" EXTENDED_LIMITS -32768.00 32767.00 DEPOSIT ABSOLUTE /end AXIS_DESCR
 /begin AXIS_DESCR STD_AXIS IATSCD_tAir Temp_Cels 2 -50.14000 199.8600 FORMAT "%8.4" EXTENDED_LIMITS -3549.940 3003.560 DEPOSIT ABSOLUTE /end AXIS_DESCR
/end CHARACTERISTIC
/begin CHARACTERISTIC AirCtl_ATCor_MAP "Kennfeld für drehzahl- und lufttemperaturabhängige Korrektur" MAP 0x1C6204 Kf_Xs16_Ys16_Ws16 7.999878 Fact -4.000000 3.999878 FORMAT "%8.6"
 /begin AXIS_DESCR STD_AXIS Eng_nAvrg EngN 2 0.00 6000.000 FORMAT "%8.3" EXTENDED_LIMITS -32768.00 32767.00 DEPOSIT ABSOLUTE /end AXIS_DESCR
 /begin AXIS_DESCR STD_AXIS IATSCD_tAir Temp_Cels 8 -50.14000 199.8600 FORMAT "%8.4" EXTENDED_LIMITS -3549.940 3003.560 DEPOSIT ABSOLUTE /end AXIS_DESCR
/end CHARACTERISTIC
/begin CHARACTERISTIC AirCtl_CTCorRgn_CUR " Kennlinie für Kühlwassertemperaturkorrekturwert im Regenerationsbetrieb" CURVE 0x1C623C Kl_Xs16_Ws16 7.999878 Fact -4.000000 3.999878 FORMAT "%8.6"
 /begin AXIS_DESCR STD_AXIS AirCtl_qDes InjMass 5 0.00 327.6700 FORMAT "%8.4" EXTENDED_LIMITS -327.6800 327.6700 DEPOSIT ABSOLUTE /end AXIS_DESCR
/end CHARACTERISTIC
/begin CHARACTERISTIC AirCtl_CTCor_CUR "Kennlinie für Kühlwassertemperaturkorrektur für ARF" CURVE 0x1C6252 Kl_Xs16_Ws16 7.999878 Fact -4.000000 3.999878 FORMAT "%8.6"
 /begin AXIS_DESCR STD_AXIS AirCtl_qDes InjMass 5 0.00 327.6700 FORMAT "%8.4" EXTENDED_LIMITS -327.6800 327.6700 DEPOSIT ABSOLUTE /end AXIS_DESCR
/end CHARACTERISTIC
/begin CHARACTERISTIC AirCtl_dqDesThr_C "Schwellwert der Wunschmengenänderungsgeschwindigkeit" VALUE 0x1C4870 Kw_Ws16 3160.000 InjMassPerSec_20ms -160.0000 3000.000 FORMAT "%8.3" EXTENDED_LIMITS -16384.00 16383.50 /end CHARACTERISTIC
/begin CHARACTERISTIC AirCtl_drBPAThr_C "Schwellwert der Tastverhältnisänderungsgeschwindigkeit von PCR_rBPACD" VALUE 0x1C4872 Kw_Ws16 32700.00 PrcPerSec_20ms -16350.00 16350.00 FORMAT "%8.2" EXTENDED_LIMITS -16384.00 16383.50 /end CHARACTERISTIC
/begin CHARACTERISTIC AirCtl_dRmpSlpCtlBase_C "Rampensteigung der Rampe in der Basis Steuerwert Berechnung" VALUE 0x1C49A8 Kw_Wu32 100000.000000 Rmp 0.00 100000.000000 FORMAT "%13.6" EXTENDED_LIMITS 0.00 65535999.9847 /end CHARACTERISTIC
/begin CHARACTERISTIC AirCtl_dRmpSlpDesBase_C "Rampensteigung der Rampe in der Basis Sollwertberechnung" VALUE 0x1C6268 Kw_Wu32 100000.000000 Rmp 0.00 100000.000000 FORMAT "%13.6" EXTENDED_LIMITS 0.00 65535999.9847 /end CHARACTERISTIC
/begin CHARACTERISTIC AirCtl_drOvrRunAtcpHi_C "Obere Grenze für Erkennung des erwarteten Schubs" VALUE 0x1C626C Kw_Ws16 32767.50 PrcPerSec_20ms -16384.00 16383.50 FORMAT "%8.2" /end CHARACTERISTIC
/begin CHARACTERISTIC AirCtl_drOvrRunAtcpLo_C "Untere Grenze für Erkennung des erwarteten Schubs" VALUE 0x1C626E Kw_Ws16 32767.50 PrcPerSec_20ms -16384.00 16383.50 FORMAT "%8.2" /end CHARACTERISTIC
/begin CHARACTERISTIC AirCtl_DT1CoNeg_C "Verzögerungszeitkonstante der dyn. Sollwertbildung bei kaltem Motor und negativem Wert des DT1-Ausgang" VALUE 0x1C6270 Kw_Wu32 4294.9663 TimeDelay_s 0.0010000001 4294.9673 FORMAT "%9.4" EXTENDED_LIMITS 0.0000010000000 4294.9673 /end CHARACTERISTIC
/begin CHARACTERISTIC AirCtl_DT1_C "Zeitkonstante des DT1-Glieds bei der ARF" VALUE 0x1C7AE0 Kw_Wu32 4294.9663 TimeDelay_s 0.0010000001 4294.9673 FORMAT "%9.4" EXTENDED_LIMITS 0.0000010000000 4294.9673 /end CHARACTERISTIC
/begin CHARACTERISTIC AirCtl_DKd_C "Grundwert der Verstärkung des DT1-Glieds bei Kleinsignalen" VALUE 0x1C7AE4 Kw_Ws32 100.000000000 Kd_InjMass2Prc -50.0000000000 50.0000000000 FORMAT "%13.10" EXTENDED_LIMITS -32768.0000000 32767.9999847 /end CHARACTERISTIC
/begin CHARACTERISTIC AirCtl_DKdPos_C "Grundwert der Verstärkung des DT1-Glieds bei positiven Großsignalen" VALUE 0x1C7AE8 Kw_Ws32 100.000000000 Kd_InjMass2Prc -50.0000000000 50.0000000000 FORMAT "%13.10" EXTENDED_LIMITS -32768.0000000 32767.9999847 /end CHARACTERISTIC
/begin CHARACTERISTIC AirCtl_DKdNeg_C "Grundwert der Verstärkung des DT1-Glieds bei negativen Großsignalen" VALUE 0x1C7AEC Kw_Ws32 100.000000000 Kd_InjMass2Prc -50.0000000000 50.0000000000 FORMAT "%13.10" EXTENDED_LIMITS -32768.0000000 32767.9999847 /end CHARACTERISTIC
/begin CHARACTERISTIC AirCtl_dqDWinPos_C "obere Kleinsignalgrenze für das DT1- Glied" VALUE 0x1C7AF0 Kw_Ws16 16383.50 InjMassPerSec_20ms 0.00 16383.50 FORMAT "%8.2" EXTENDED_LIMITS -16384.00 16383.50 /end CHARACTERISTIC
/begin CHARACTERISTIC AirCtl_dqDWinNeg_C "untere Kleinsignalgrenze für das DT1- Glied" VALUE 0x1C7AF2 Kw_Ws16 16384.00 InjMassPerSec_20ms -16384.00 0.00 FORMAT "%8.2" EXTENDED_LIMITS -16384.00 16383.50 /end CHARACTERISTIC
/begin CHARACTERISTIC AirCtl_DT1WmNeg_C "Verzögerungszeitkonstante der dyn. Sollwertbildung bei warmem Motor und negativem Wert des DT1-Ausgangs" VALUE 0x1C6274 Kw_Wu32 4294.9663 TimeDelay_s 0.0010000001 4294.9673 FORMAT "%9.4" EXTENDED_LIMITS 0.0000010000000 4294.9673 /end CHARACTERISTIC
/begin CHARACTERISTIC AirCtl_dtrqSmkLim_C "Verrringerung des Begrenzungsmoments bei CrCtl/ACC" VALUE 0x1C8D38 Kw_Ws16 1000.000 Trq 0.00 1000.000 FORMAT "%8.3" EXTENDED_LIMITS -3276.800 3276.700 /end CHARACTERISTIC
/begin CHARACTERISTIC AirCtl_DT1CoPos_C "Verzögerungszeitkonstante der dyn. Sollwertbildung bei kaltem Motor und positivem Wert des DT1-Ausgang" VALUE 0x1C6278 Kw_Wu32 4294.9663 TimeDelay_s 0.0010000001 4294.9673 FORMAT "%9.4" EXTENDED_LIMITS 0.0000010000000 4294.9673 /end CHARACTERISTIC
/begin CHARACTERISTIC AirCtl_DKdCo_C "Kleinsignalverstärkung der dyn. Sollwertbildung bei kaltem Motor" VALUE 0x1C627C Kw_Ws32 65535.9999847 Kd -32768.0000000 32767.9999847 FORMAT "%13.7" /end CHARACTERISTIC
/begin CHARACTERISTIC AirCtl_DKdPosCo_C "positive Großsignalverstärkung der dyn. Sollwertbildung bei kaltem Motor" VALUE 0x1C6280 Kw_Ws32 65535.9999847 Kd -32768.0000000 32767.9999847 FORMAT "%13.7" /end CHARACTERISTIC
/begin CHARACTERISTIC AirCtl_DKdNegCo_C "negative Großsignalverstärkung der dyn. Sollwertbildung bei kaltem Motor" VALUE 0x1C6284 Kw_Ws32 65535.9999847 Kd -32768.0000000 32767.9999847 FORMAT "%13.7" /end CHARACTERISTIC
/begin CHARACTERISTIC AirCtl_dqDWinPosCo_C "positive Kleinsignalgrenze bei kaltem Motor" VALUE 0x1C6288 Kw_Ws16 163835.0 AirMassPerTime_20ms 0.00 163835.0 FORMAT "%8.1" EXTENDED_LIMITS -163840.0 163835.0 /end CHARACTERISTIC
/begin CHARACTERISTIC AirCtl_dqDWinNegCo_C "negative Kleinsignalgrenze bei kaltem Motor" VALUE 0x1C628A Kw_Ws16 163840.0 AirMassPerTime_20ms -163840.0 0.00 FORMAT "%8.1" EXTENDED_LIMITS -163840.0 163835.0 /end CHARACTERISTIC
/begin CHARACTERISTIC AirCtl_DT1WmPos_C "Verzögerungszeitkonstante der dyn. Sollwertbildung bei warmem Motor und positivem Wert des DT1-Ausgangs" VALUE 0x1C628C Kw_Wu32 4294.9663 TimeDelay_s 0.0010000001 4294.9673 FORMAT "%9.4" EXTENDED_LIMITS 0.0000010000000 4294.9673 /end CHARACTERISTIC
/begin CHARACTERISTIC AirCtl_DKdWm_C "Kleinsignalverstärkung der dyn. Sollwertbildung bei warmem Motor" VALUE 0x1C6290 Kw_Ws32 65535.9999847 Kd -32768.0000000 32767.9999847 FORMAT "%13.7" /end CHARACTERISTIC
/begin CHARACTERISTIC AirCtl_DKdPosWm_C "positive Großsignalverstärkung der dyn. Sollwertbildung bei warmem Motor" VALUE 0x1C6294 Kw_Ws32 65535.9999847 Kd -32768.0000000 32767.9999847 FORMAT "%13.7" /end CHARACTERISTIC
/begin CHARACTERISTIC AirCtl_DKdNegWm_C "negative Großsignalverstärkung der dyn. Sollwertbildung bei warmem Motor" VALUE 0x1C6298 Kw_Ws32 65535.9999847 Kd -32768.0000000 32767.9999847 FORMAT "%13.7" /end CHARACTERISTIC
/begin CHARACTERISTIC AirCtl_dqDWinPosWm_C "positive Kleinsignalgrenze bei warmem Motor" VALUE 0x1C629C Kw_Ws16 163835.0 AirMassPerTime_20ms 0.00 163835.0 FORMAT "%8.1" EXTENDED_LIMITS -163840.0 163835.0 /end CHARACTERISTIC
/begin CHARACTERISTIC AirCtl_dqDWinNegWm_C "negative Kleinsignalgrenze bei warmem Motor" VALUE 0x1C629E Kw_Ws16 163840.0 AirMassPerTime_20ms -163840.0 0.00 FORMAT "%8.1" EXTENDED_LIMITS -163840.0 163835.0 /end CHARACTERISTIC
/begin CHARACTERISTIC AirCtl_facATCor_MAP "Korrekturkennfeld für Umgebungstemperatur" MAP 0x1C49AC Kf_Xs16_Ys16_Ws16 7.999878 Fact -4.000000 3.999878 FORMAT "%8.6"
 /begin AXIS_DESCR STD_AXIS Eng_nAvrg EngN 2 0.00 6000.000 FORMAT "%8.3" EXTENDED_LIMITS -32768.00 32767.00 DEPOSIT ABSOLUTE /end AXIS_DESCR
 /begin AXIS_DESCR STD_AXIS IATSCD_tAir Temp_Cels 8 -50.14000 199.8600 FORMAT "%8.4" EXTENDED_LIMITS -3549.940 3003.560 DEPOSIT ABSOLUTE /end AXIS_DESCR
/end CHARACTERISTIC
/begin CHARACTERISTIC AirCtl_facATParAd_CUR "lufttemperaturabhängiger Faktor für Parameteradaption" CURVE 0x1C7AF4 Kl_Xs16_Ws16 3.000000 Fact1 0.00 3.000000 FORMAT "%8.6" EXTENDED_LIMITS -256.0000 255.9922
 /begin AXIS_DESCR STD_AXIS IATSCD_tAir Temp_Cels 16 -100.1400 199.8600 FORMAT "%8.4" EXTENDED_LIMITS -3549.940 3003.560 DEPOSIT ABSOLUTE /end AXIS_DESCR
/end CHARACTERISTIC
/begin CHARACTERISTIC AirCtl_facBPAHold_CUR "drehzahlabhängiger Korrekturfaktor der maximalen Zeit der LDR-Abschaltung" CURVE 0x1C4874 Kl_Xs16_Ws16 3.270020 Fact 0.00 3.270020 FORMAT "%8.6" EXTENDED_LIMITS -4.000000 3.999878
 /begin AXIS_DESCR STD_AXIS Eng_nAvrg EngN 8 0.00 6500.000 FORMAT "%8.3" EXTENDED_LIMITS -32768.00 32767.00 DEPOSIT ABSOLUTE /end AXIS_DESCR
/end CHARACTERISTIC
/begin CHARACTERISTIC AirCtl_facCtlRgn1_CUR "Kurve für die Berechnung der Steuergröße im Regenerationsbetrieb 1" CURVE 0x1C49E4 Kl_Xs16_Ws16 7.999878 Fact -4.000000 3.999878 FORMAT "%8.6"
 /begin AXIS_DESCR STD_AXIS APSCD_pVal Pres_hPa 2 0.00 3500.000 FORMAT "%8.3" EXTENDED_LIMITS -32768.00 32767.00 DEPOSIT ABSOLUTE /end AXIS_DESCR
/end CHARACTERISTIC
/begin CHARACTERISTIC AirCtl_facCtlRgn2_CUR "Kurve für die Berechnung der Steuergröße im Regenerationsbetrieb 2" CURVE 0x1C49EE Kl_Xs16_Ws16 7.999878 Fact -4.000000 3.999878 FORMAT "%8.6"
 /begin AXIS_DESCR STD_AXIS APSCD_pVal Pres_hPa 2 0.00 3500.000 FORMAT "%8.3" EXTENDED_LIMITS -32768.00 32767.00 DEPOSIT ABSOLUTE /end AXIS_DESCR
/end CHARACTERISTIC
/begin CHARACTERISTIC AirCtl_facCtlRgn3_CUR "atmosphärendruckabhängige Steuerwertauswahl Regenerationsstufe 3" CURVE 0x1C49F8 Kl_Xs16_Ws16 7.999878 Fact -4.000000 3.999878 FORMAT "%8.6"
 /begin AXIS_DESCR STD_AXIS APSCD_pVal Pres_hPa 2 0.00 3500.000 FORMAT "%8.3" EXTENDED_LIMITS -32768.00 32767.00 DEPOSIT ABSOLUTE /end AXIS_DESCR
/end CHARACTERISTIC
/begin CHARACTERISTIC AirCtl_facCtlValRgnPT1_CUR "Korrekturfactor für Dämpfung der Drosselklappe" CURVE 0x1C4A02 Kl_Xs16_Ws16 7.999878 Fact -4.000000 3.999878 FORMAT "%8.6"
 /begin AXIS_DESCR STD_AXIS APSCD_pVal Pres_hPa 8 0.00 3500.000 FORMAT "%8.3" EXTENDED_LIMITS -32768.00 32767.00 DEPOSIT ABSOLUTE /end AXIS_DESCR
/end CHARACTERISTIC
/begin CHARACTERISTIC AirCtl_facDesRgn1_CUR "Kurve für die Berechnung des Luftmassensollwertes im Regenerationsbetrieb 1" CURVE 0x1C62A0 Kl_Xs16_Ws16 7.999878 Fact -4.000000 3.999878 FORMAT "%8.6"
 /begin AXIS_DESCR STD_AXIS APSCD_pVal Pres_hPa 2 0.00 3500.000 FORMAT "%8.3" EXTENDED_LIMITS -32768.00 32767.00 DEPOSIT ABSOLUTE /end AXIS_DESCR
/end CHARACTERISTIC
/begin CHARACTERISTIC AirCtl_facDesRgn2_CUR "Kurve für die Berechnung des Luftmassensollwertes im Regenerationsbetrieb 2" CURVE 0x1C62AA Kl_Xs16_Ws16 7.999878 Fact -4.000000 3.999878 FORMAT "%8.6"
 /begin AXIS_DESCR STD_AXIS APSCD_pVal Pres_hPa 2 0.00 3500.000 FORMAT "%8.3" EXTENDED_LIMITS -32768.00 32767.00 DEPOSIT ABSOLUTE /end AXIS_DESCR
/end CHARACTERISTIC
/begin CHARACTERISTIC AirCtl_facDesRgn3_CUR "atmosphärendruckabhängige Sollwertauswahl Regenerationsstufe 3" CURVE 0x1C62B4 Kl_Xs16_Ws16 7.999878 Fact -4.000000 3.999878 FORMAT "%8.6"
 /begin AXIS_DESCR STD_AXIS APSCD_pVal Pres_hPa 2 0.00 3500.000 FORMAT "%8.3" EXTENDED_LIMITS -32768.00 32767.00 DEPOSIT ABSOLUTE /end AXIS_DESCR
/end CHARACTERISTIC
/begin CHARACTERISTIC AirCtl_facDesValRgnPT1_CUR "Korrekturfaktor für Dämpfung der Drosselklappe" CURVE 0x1C62BE Kl_Xs16_Ws16 7.999878 Fact -4.000000 3.999878 FORMAT "%8.6"
 /begin AXIS_DESCR STD_AXIS APSCD_pVal Pres_hPa 8 0.00 3500.000 FORMAT "%8.3" EXTENDED_LIMITS -32768.00 32767.00 DEPOSIT ABSOLUTE /end AXIS_DESCR
/end CHARACTERISTIC
/begin CHARACTERISTIC AirCtl_facEGROpnLpCor2_CUR "Faktor für die Temperaturkorrektur basierend auf der Temperatur nach OxiCat" CURVE 0x1C7B36 Kl_Xs16_Ws16 1.000000 Fact 0.00 1.000000 FORMAT "%8.6" EXTENDED_LIMITS -4.000000 3.999878
 /begin AXIS_DESCR STD_AXIS PFlt_tOxiPst Temp_Cels 8 -50.14000 999.8600 FORMAT "%8.4" EXTENDED_LIMITS -3549.940 3003.560 DEPOSIT ABSOLUTE /end AXIS_DESCR
/end CHARACTERISTIC
/begin CHARACTERISTIC AirCtl_facGovRgnRmpEGR_CUR "Kurve für die Rampenformung EGR für die Partikelfilter Regeneration" CURVE 0x1C7B58 Kl_Xs16_Ws16 1.000000 EGTSwt_S16 0.00 1.000000 FORMAT "%8.6" EXTENDED_LIMITS -2.000000 1.999939
 /begin AXIS_DESCR STD_AXIS AirCtl_facGovRgnRmp_mp EGTSwt_S16 8 0.00 1.000000 FORMAT "%8.6" EXTENDED_LIMITS -2.000000 1.999939 DEPOSIT ABSOLUTE /end AXIS_DESCR
/end CHARACTERISTIC
/begin CHARACTERISTIC AirCtl_facGovRgnRmpTVA_CUR "Kurve für die Rampenformung TVA für die Partikelfilter Regeneration" CURVE 0x1C7B7A Kl_Xs16_Ws16 1.000000 EGTSwt_S16 0.00 1.000000 FORMAT "%8.6" EXTENDED_LIMITS -2.000000 1.999939
 /begin AXIS_DESCR STD_AXIS AirCtl_facGovRgnRmp_mp EGTSwt_S16 8 0.00 1.000000 FORMAT "%8.6" EXTENDED_LIMITS -2.000000 1.999939 DEPOSIT ABSOLUTE /end AXIS_DESCR
/end CHARACTERISTIC
/begin CHARACTERISTIC AirCtl_facILimCorRgn1_MAP "Einspritzmengenabhängiges Korrekturkennfeld der I-Limitierung für Regenerationsstufe 1" MAP 0x1C7B9C Kf_Xs16_Ys16_Ws16 7.999878 Fact -4.000000 3.999878 FORMAT "%8.6"
 /begin AXIS_DESCR STD_AXIS Eng_nAvrg EngN 8 0.00 6000.000 FORMAT "%8.3" EXTENDED_LIMITS -32768.00 32767.00 DEPOSIT ABSOLUTE /end AXIS_DESCR
 /begin AXIS_DESCR STD_AXIS InjCtl_qRaw InjMass 8 0.00 327.6700 FORMAT "%8.4" EXTENDED_LIMITS -327.6800 327.6700 DEPOSIT ABSOLUTE /end AXIS_DESCR
/end CHARACTERISTIC
/begin CHARACTERISTIC AirCtl_facILimCorRgn2_MAP "Einspritzmengenabhängiges Korrekturkennfeld der I-Limitierung für Regenerationsstufe 2" MAP 0x1C7C40 Kf_Xs16_Ys16_Ws16 7.999878 Fact -4.000000 3.999878 FORMAT "%8.6"
 /begin AXIS_DESCR STD_AXIS Eng_nAvrg EngN 8 0.00 6000.000 FORMAT "%8.3" EXTENDED_LIMITS -32768.00 32767.00 DEPOSIT ABSOLUTE /end AXIS_DESCR
 /begin AXIS_DESCR STD_AXIS InjCtl_qRaw InjMass 8 0.00 327.6700 FORMAT "%8.4" EXTENDED_LIMITS -327.6800 327.6700 DEPOSIT ABSOLUTE /end AXIS_DESCR
/end CHARACTERISTIC
/begin CHARACTERISTIC AirCtl_facILimCorRgn3_MAP "Einspritzmengenabhängiges Korrekturkennfeld der I-Limitierung für Regenerationsstufe 3" MAP 0x1C7CE4 Kf_Xs16_Ys16_Ws16 7.999878 Fact -4.000000 3.999878 FORMAT "%8.6"
 /begin AXIS_DESCR STD_AXIS Eng_nAvrg EngN 8 0.00 6000.000 FORMAT "%8.3" EXTENDED_LIMITS -32768.00 32767.00 DEPOSIT ABSOLUTE /end AXIS_DESCR
 /begin AXIS_DESCR STD_AXIS InjCtl_qRaw InjMass 8 0.00 327.6700 FORMAT "%8.4" EXTENDED_LIMITS -327.6800 327.6700 DEPOSIT ABSOLUTE /end AXIS_DESCR
/end CHARACTERISTIC
/begin CHARACTERISTIC AirCtl_facILimCor_MAP "Einspritzmengenabhängiges Korrekturkennfeld der I-Limitierung" MAP 0x1C7D88 Kf_Xs16_Ys16_Ws16 7.999878 Fact -4.000000 3.999878 FORMAT "%8.6"
 /begin AXIS_DESCR STD_AXIS Eng_nAvrg EngN 8 0.00 6000.000 FORMAT "%8.3" EXTENDED_LIMITS -32768.00 32767.00 DEPOSIT ABSOLUTE /end AXIS_DESCR
 /begin AXIS_DESCR STD_AXIS InjCtl_qRaw InjMass 8 0.00 327.6700 FORMAT "%8.4" EXTENDED_LIMITS -327.6800 327.6700 DEPOSIT ABSOLUTE /end AXIS_DESCR
/end CHARACTERISTIC
/begin CHARACTERISTIC AirCtl_facLmbdDes_C "WunschKorrektionsfaktor für AirCtl_rLmbdRec_mp" VALUE 0x1C7E2C Kw_Ws16 8.000000 Fact -4.000000 4.000000 FORMAT "%8.6" EXTENDED_LIMITS -4.000000 3.999878 /end CHARACTERISTIC
/begin CHARACTERISTIC AirCtl_facLmbdRecCorRgn1_MAP "Lambdareziprokkorrekturkennfeld für Regenerationsstufe 1" MAP 0x1C7E2E Kf_Xs16_Ys16_Ws16 7.999878 Fact -4.000000 3.999878 FORMAT "%8.6"
 /begin AXIS_DESCR STD_AXIS Eng_nAvrg EngN 8 0.00 6000.000 FORMAT "%8.3" EXTENDED_LIMITS -32768.00 32767.00 DEPOSIT ABSOLUTE /end AXIS_DESCR
 /begin AXIS_DESCR STD_AXIS InjCtl_qRaw InjMass 8 0.00 327.6700 FORMAT "%8.4" EXTENDED_LIMITS -327.6800 327.6700 DEPOSIT ABSOLUTE /end AXIS_DESCR
/end CHARACTERISTIC
/begin CHARACTERISTIC AirCtl_facLmbdRecCorRgn2_MAP "Lambdareziprokkorrekturkennfeld für Regenerationsstufe 2" MAP 0x1C7ED2 Kf_Xs16_Ys16_Ws16 7.999878 Fact -4.000000 3.999878 FORMAT "%8.6"
 /begin AXIS_DESCR STD_AXIS Eng_nAvrg EngN 8 0.00 6000.000 FORMAT "%8.3" EXTENDED_LIMITS -32768.00 32767.00 DEPOSIT ABSOLUTE /end AXIS_DESCR
 /begin AXIS_DESCR STD_AXIS InjCtl_qRaw InjMass 8 0.00 327.6700 FORMAT "%8.4" EXTENDED_LIMITS -327.6800 327.6700 DEPOSIT ABSOLUTE /end AXIS_DESCR
/end CHARACTERISTIC
/begin CHARACTERISTIC AirCtl_facLmbdRecCorRgn3_MAP "Lambdareziprokkorrekturkennfeld für Regenerationsstufe 3" MAP 0x1C7F76 Kf_Xs16_Ys16_Ws16 7.999878 Fact -4.000000 3.999878 FORMAT "%8.6"
 /begin AXIS_DESCR STD_AXIS Eng_nAvrg EngN 8 0.00 6000.000 FORMAT "%8.3" EXTENDED_LIMITS -32768.00 32767.00 DEPOSIT ABSOLUTE /end AXIS_DESCR
 /begin AXIS_DESCR STD_AXIS InjCtl_qRaw InjMass 8 0.00 327.6700 FORMAT "%8.4" EXTENDED_LIMITS -327.6800 327.6700 DEPOSIT ABSOLUTE /end AXIS_DESCR
/end CHARACTERISTIC
/begin CHARACTERISTIC AirCtl_facLmbdRecCor_MAP "Lambdareziprokkorrekturkennfeld" MAP 0x1C801A Kf_Xs16_Ys16_Ws16 7.999878 Fact -4.000000 3.999878 FORMAT "%8.6"
 /begin AXIS_DESCR STD_AXIS Eng_nAvrg EngN 8 0.00 6000.000 FORMAT "%8.3" EXTENDED_LIMITS -32768.00 32767.00 DEPOSIT ABSOLUTE /end AXIS_DESCR
 /begin AXIS_DESCR STD_AXIS InjCtl_qRaw InjMass 8 0.00 327.6700 FORMAT "%8.4" EXTENDED_LIMITS -327.6800 327.6700 DEPOSIT ABSOLUTE /end AXIS_DESCR
/end CHARACTERISTIC
/begin CHARACTERISTIC AirCtl_facMaxDevCorRgn_MAP "Faktor für maximale Luftmassenabweichung im Regenerationsmodus" MAP 0x1C8D3A Kf_Xs16_Ys16_Ws16 3.270020 Fact 0.00 3.270020 FORMAT "%8.6" EXTENDED_LIMITS -4.000000 3.999878
 /begin AXIS_DESCR STD_AXIS Eng_nAvrg EngN 16 0.00 6000.000 FORMAT "%8.3" EXTENDED_LIMITS -32768.00 32767.00 DEPOSIT ABSOLUTE /end AXIS_DESCR
 /begin AXIS_DESCR STD_AXIS AirCtl_qMon InjMass 13 0.00 327.6700 FORMAT "%8.4" EXTENDED_LIMITS -327.6800 327.6700 DEPOSIT ABSOLUTE /end AXIS_DESCR
/end CHARACTERISTIC
/begin CHARACTERISTIC AirCtl_facMaxDevCor_MAP "Luftmassenabhängiger Korrekturfaktor der maximalen Regelabweichung" MAP 0x1C8F18 Kf_Xs16_Ys16_Ws16 3.270020 Fact 0.00 3.270020 FORMAT "%8.6" EXTENDED_LIMITS -4.000000 3.999878
 /begin AXIS_DESCR STD_AXIS Eng_nAvrg EngN 16 0.00 6000.000 FORMAT "%8.3" EXTENDED_LIMITS -32768.00 32767.00 DEPOSIT ABSOLUTE /end AXIS_DESCR
 /begin AXIS_DESCR STD_AXIS AirCtl_qMon InjMass 13 0.00 327.6700 FORMAT "%8.4" EXTENDED_LIMITS -327.6800 327.6700 DEPOSIT ABSOLUTE /end AXIS_DESCR
/end CHARACTERISTIC
/begin CHARACTERISTIC AirCtl_facMaxDevTempCorRgn_CUR "Temperaturabhängige Luftmassenkorrektur der maximalen Regelabweichung" CURVE 0x1C90F6 Kl_Xs16_Ws16 1.000000 Fact 0.00 1.000000 FORMAT "%8.6" EXTENDED_LIMITS -4.000000 3.999878
 /begin AXIS_DESCR STD_AXIS IATSCD_tAir Temp_Cels 8 -50.14000 199.8600 FORMAT "%8.4" EXTENDED_LIMITS -3549.940 3003.560 DEPOSIT ABSOLUTE /end AXIS_DESCR
/end CHARACTERISTIC
/begin CHARACTERISTIC AirCtl_facMaxDevTempCor_CUR "Lufttemperatur abhängiger Korrekturfaktor der maximalen Regelabweichung" CURVE 0x1C9118 Kl_Xs16_Ws16 1.000000 Fact 0.00 1.000000 FORMAT "%8.6" EXTENDED_LIMITS -4.000000 3.999878
 /begin AXIS_DESCR STD_AXIS IATSCD_tAir Temp_Cels 8 -50.14000 199.8600 FORMAT "%8.4" EXTENDED_LIMITS -3549.940 3003.560 DEPOSIT ABSOLUTE /end AXIS_DESCR
/end CHARACTERISTIC
/begin CHARACTERISTIC AirCtl_facMinDevCorRgn_MAP "Faktor für die minimale Luftmassenabweichung im Regenerationsmodus" MAP 0x1C913A Kf_Xs16_Ys16_Ws16 3.270020 Fact 0.00 3.270020 FORMAT "%8.6" EXTENDED_LIMITS -4.000000 3.999878
 /begin AXIS_DESCR STD_AXIS Eng_nAvrg EngN 16 0.00 6000.000 FORMAT "%8.3" EXTENDED_LIMITS -32768.00 32767.00 DEPOSIT ABSOLUTE /end AXIS_DESCR
 /begin AXIS_DESCR STD_AXIS AirCtl_qMon InjMass 13 0.00 327.6700 FORMAT "%8.4" EXTENDED_LIMITS -327.6800 327.6700 DEPOSIT ABSOLUTE /end AXIS_DESCR
/end CHARACTERISTIC
/begin CHARACTERISTIC AirCtl_facMinDevCor_MAP "Luftmassenabhängiger Korrekturfaktor der minimalen Regelabweichung" MAP 0x1C9318 Kf_Xs16_Ys16_Ws16 3.270020 Fact 0.00 3.270020 FORMAT "%8.6" EXTENDED_LIMITS -4.000000 3.999878
 /begin AXIS_DESCR STD_AXIS Eng_nAvrg EngN 16 0.00 6000.000 FORMAT "%8.3" EXTENDED_LIMITS -32768.00 32767.00 DEPOSIT ABSOLUTE /end AXIS_DESCR
 /begin AXIS_DESCR STD_AXIS AirCtl_qMon InjMass 13 0.00 327.6700 FORMAT "%8.4" EXTENDED_LIMITS -327.6800 327.6700 DEPOSIT ABSOLUTE /end AXIS_DESCR
/end CHARACTERISTIC
/begin CHARACTERISTIC AirCtl_facMinDevTempCorRgn_CUR "Temperaturabhängiger Faktor für die minimale Regelabweichung im Regenerationsmodus" CURVE 0x1C94F6 Kl_Xs16_Ws16 1.000000 Fact 0.00 1.000000 FORMAT "%8.6" EXTENDED_LIMITS -4.000000 3.999878
 /begin AXIS_DESCR STD_AXIS IATSCD_tAir Temp_Cels 8 -50.14000 199.8600 FORMAT "%8.4" EXTENDED_LIMITS -3549.940 3003.560 DEPOSIT ABSOLUTE /end AXIS_DESCR
/end CHARACTERISTIC
/begin CHARACTERISTIC AirCtl_facMinDevTempCor_CUR "Lufttemperatur abhängiger Korrekturfaktor der minimalen Regelabweichung" CURVE 0x1C9518 Kl_Xs16_Ws16 1.000000 Fact 0.00 1.000000 FORMAT "%8.6" EXTENDED_LIMITS -4.000000 3.999878
 /begin AXIS_DESCR STD_AXIS IATSCD_tAir Temp_Cels 8 -50.14000 199.8600 FORMAT "%8.4" EXTENDED_LIMITS -3549.940 3003.560 DEPOSIT ABSOLUTE /end AXIS_DESCR
/end CHARACTERISTIC
/begin CHARACTERISTIC AirCtl_facNQAPCor_MAP "Korrekturkennfeld über Drehzahl und Menge" MAP 0x1C4A24 Kf_Xs16_Ys16_Ws16 7.999878 Fact -4.000000 3.999878 FORMAT "%8.6"
 /begin AXIS_DESCR STD_AXIS Eng_nAvrg EngN 8 0.00 6000.000 FORMAT "%8.3" EXTENDED_LIMITS -32768.00 32767.00 DEPOSIT ABSOLUTE /end AXIS_DESCR
 /begin AXIS_DESCR STD_AXIS AirCtl_qDes InjMass 8 0.00 327.6700 FORMAT "%8.4" EXTENDED_LIMITS -327.6800 327.6700 DEPOSIT ABSOLUTE /end AXIS_DESCR
/end CHARACTERISTIC
/begin CHARACTERISTIC AirCtl_facNQParAd_MAP "Kennfeld für Parameteradaption für ARF" MAP 0x1C80BE Kf_Xs16_Ys16_Ws16 20.00000 Fact1 0.00 20.00000 FORMAT "%8.5" EXTENDED_LIMITS -256.0000 255.9922
 /begin AXIS_DESCR STD_AXIS Eng_nAvrg EngN 10 0.00 8000.000 FORMAT "%8.3" EXTENDED_LIMITS -32768.00 32767.00 DEPOSIT ABSOLUTE /end AXIS_DESCR
 /begin AXIS_DESCR STD_AXIS InjCtl_qCurr InjMass 10 0.00 100.0000 FORMAT "%8.4" EXTENDED_LIMITS -327.6800 327.6700 DEPOSIT ABSOLUTE /end AXIS_DESCR
/end CHARACTERISTIC
/begin CHARACTERISTIC AirCtl_IKi_C "Grundwert der I-Verstärkung des PI-Reglers bei Kleinsignalen" VALUE 0x1C81B4 Kw_Wu32 4.99999150634 Ki_Ampc2Prc 0.00 4.99999150634 FORMAT "%13.11" EXTENDED_LIMITS 0.00 99999.9999767 /end CHARACTERISTIC
/begin CHARACTERISTIC AirCtl_IKiPos_C "Grundwert der I-Verstärkung des PI-Reglers bei positiven Großsignalen" VALUE 0x1C81B8 Kw_Wu32 4.99999150634 Ki_Ampc2Prc 0.00 4.99999150634 FORMAT "%13.11" EXTENDED_LIMITS 0.00 99999.9999767 /end CHARACTERISTIC
/begin CHARACTERISTIC AirCtl_IKiNeg_C "Grundwert der I-Verstärkung des PI-Reglers bei negativen Großsignalen" VALUE 0x1C81BC Kw_Wu32 4.99999150634 Ki_Ampc2Prc 0.00 4.99999150634 FORMAT "%13.11" EXTENDED_LIMITS 0.00 99999.9999767 /end CHARACTERISTIC
/begin CHARACTERISTIC AirCtl_mIWinPos_C "obere Kleinsignalgrenze für den I-Kanal des PI-Reglers" VALUE 0x1C81C0 Kw_Ws16 1500.000 AirMassPerCyl 0.00 1500.000 FORMAT "%8.3" EXTENDED_LIMITS -3276.800 3276.700 /end CHARACTERISTIC
/begin CHARACTERISTIC AirCtl_mIWinNeg_C "untere Kleinsignalgrenze für den I-Kanal des PI-Reglers" VALUE 0x1C81C2 Kw_Ws16 1500.000 AirMassPerCyl -1500.000 0.00 FORMAT "%8.3" EXTENDED_LIMITS -3276.800 3276.700 /end CHARACTERISTIC
/begin CHARACTERISTIC AirCtl_m2rDKd_C "Differentialer Faktor des DT1-Giedes für die dynamische Dämpfung" VALUE 0x1C81C4 Kw_Ws32 300.000000000 Kd_Ampc2Prc -150.000000000 150.000000000 FORMAT "%13.9" EXTENDED_LIMITS -3276.80000000 3276.79999847 /end CHARACTERISTIC
/begin CHARACTERISTIC AirCtl_mAirCBVHysHi_CUR "obere drehzahlabhängige Luftmassenschwellwertkennlinie für EGR Kühler Bypass" CURVE 0x1C48D0 Kl_Xs16_Ws16 2000.000 AirMassPerCyl 0.00 2000.000 FORMAT "%8.3" EXTENDED_LIMITS -3276.800 3276.700
 /begin AXIS_DESCR STD_AXIS Eng_nAvrg EngN 8 0.00 6000.000 FORMAT "%8.3" EXTENDED_LIMITS -32768.00 32767.00 DEPOSIT ABSOLUTE /end AXIS_DESCR
/end CHARACTERISTIC
/begin CHARACTERISTIC AirCtl_mAirCBVHysLo_CUR "untere drehzahlabhängige Luftmassenschwellwertkennlinie für EGR Kühler Bypass" CURVE 0x1C48F2 Kl_Xs16_Ws16 2000.000 AirMassPerCyl 0.00 2000.000 FORMAT "%8.3" EXTENDED_LIMITS -3276.800 3276.700
 /begin AXIS_DESCR STD_AXIS Eng_nAvrg EngN 8 0.00 6000.000 FORMAT "%8.3" EXTENDED_LIMITS -32768.00 32767.00 DEPOSIT ABSOLUTE /end AXIS_DESCR
/end CHARACTERISTIC
/begin CHARACTERISTIC AirCtl_mAPCorAfterStrt_CUR "Atmosphärendruckkorrektur" CURVE 0x1C62E0 Kl_Xs16_Ws16 3000.000 AirMassPerCyl -1500.000 1500.000 FORMAT "%8.3" EXTENDED_LIMITS -3276.800 3276.700
 /begin AXIS_DESCR STD_AXIS APSCD_pVal Pres_hPa 6 0.00 3500.000 FORMAT "%8.3" EXTENDED_LIMITS -32768.00 32767.00 DEPOSIT ABSOLUTE /end AXIS_DESCR
/end CHARACTERISTIC
/begin CHARACTERISTIC AirCtl_MaxTrmVal_C "maximaler ARF-Abgleichwert" VALUE 0x1C62FA Kw_Ws16 3000.000 AirMassPerCyl -1500.000 1500.000 FORMAT "%8.3" EXTENDED_LIMITS -3276.800 3276.700 /end CHARACTERISTIC
/begin CHARACTERISTIC AirCtl_mCorAfterStart_C "Rampenendwert nach erreichen der Umdrehungszählerschwelle" VALUE 0x1C62FC Kw_Ws16 3000.000 AirMassPerCyl -1500.000 1500.000 FORMAT "%8.3" EXTENDED_LIMITS -3276.800 3276.700 /end CHARACTERISTIC
/begin CHARACTERISTIC AirCtl_mCorStrt_C "Vorgabewert während des Startvorgangs" VALUE 0x1C62FE Kw_Ws16 3000.000 AirMassPerCyl -1500.000 1500.000 FORMAT "%8.3" EXTENDED_LIMITS -3276.800 3276.700 /end CHARACTERISTIC
/begin CHARACTERISTIC AirCtl_mCor_CUR "Drehzahlkorrektur der Sollwertberechnung" CURVE 0x1C6300 Kl_Xs16_Ws16 1500.000 AirMassPerCyl 0.00 1500.000 FORMAT "%8.3" EXTENDED_LIMITS -3276.800 3276.700
 /begin AXIS_DESCR STD_AXIS Eng_nAvrg EngN 4 0.00 6000.000 FORMAT "%8.3" EXTENDED_LIMITS -32768.00 32767.00 DEPOSIT ABSOLUTE /end AXIS_DESCR
/end CHARACTERISTIC
/begin CHARACTERISTIC AirCtl_mDesBase0_MAP "Kennfeld zur Ermittlung des stationären Basissollwerts für ARF ohne VE für Gang 1, 2, Rückgang sowie bei Leerlauf" MAP 0x1C6312 Kf_Xs16_Ys16_Ws16 3000.000 AirMassPerCyl -1500.000 1500.000 FORMAT "%8.3" EXTENDED_LIMITS -3276.800 3276.700
 /begin AXIS_DESCR STD_AXIS Eng_nAvrg EngN 16 0.00 6000.000 FORMAT "%8.3" EXTENDED_LIMITS -32768.00 32767.00 DEPOSIT ABSOLUTE /end AXIS_DESCR
 /begin AXIS_DESCR STD_AXIS AirCtl_qDes InjMass 16 0.00 327.6700 FORMAT "%8.4" EXTENDED_LIMITS -327.6800 327.6700 DEPOSIT ABSOLUTE /end AXIS_DESCR
/end CHARACTERISTIC
/begin CHARACTERISTIC AirCtl_mDesBase1_MAP "Kennfeld zur Ermittlung des stationären Basissollwerts für ARF ohne VE für Gang 3 und 4" MAP 0x1C6556 Kf_Xs16_Ys16_Ws16 3000.000 AirMassPerCyl -1500.000 1500.000 FORMAT "%8.3" EXTENDED_LIMITS -3276.800 3276.700
 /begin AXIS_DESCR STD_AXIS Eng_nAvrg EngN 16 0.00 6000.000 FORMAT "%8.3" EXTENDED_LIMITS -32768.00 32767.00 DEPOSIT ABSOLUTE /end AXIS_DESCR
 /begin AXIS_DESCR STD_AXIS AirCtl_qDes InjMass 16 0.00 327.6700 FORMAT "%8.4" EXTENDED_LIMITS -327.6800 327.6700 DEPOSIT ABSOLUTE /end AXIS_DESCR
/end CHARACTERISTIC
/begin CHARACTERISTIC AirCtl_mDesBase2_MAP "Kennfeld zur Ermittlung des stationären Basissollwerts für ARF ohne VE für Gang 5 und 6" MAP 0x1C679A Kf_Xs16_Ys16_Ws16 3000.000 AirMassPerCyl -1500.000 1500.000 FORMAT "%8.3" EXTENDED_LIMITS -3276.800 3276.700
 /begin AXIS_DESCR STD_AXIS Eng_nAvrg EngN 16 0.00 6000.000 FORMAT "%8.3" EXTENDED_LIMITS -32768.00 32767.00 DEPOSIT ABSOLUTE /end AXIS_DESCR
 /begin AXIS_DESCR STD_AXIS AirCtl_qDes InjMass 16 0.00 327.6700 FORMAT "%8.4" EXTENDED_LIMITS -327.6800 327.6700 DEPOSIT ABSOLUTE /end AXIS_DESCR
/end CHARACTERISTIC
/begin CHARACTERISTIC AirCtl_mDesBasePil_MAP "Zweites Kennfeld zur Bestimmung des stationären Basissoll-wertes" MAP 0x1C69DE Kf_Xs16_Ys16_Ws16 3000.000 AirMassPerCyl -1500.000 1500.000 FORMAT "%8.3" EXTENDED_LIMITS -3276.800 3276.700
 /begin AXIS_DESCR STD_AXIS Eng_nAvrg EngN 2 0.00 6000.000 FORMAT "%8.3" EXTENDED_LIMITS -32768.00 32767.00 DEPOSIT ABSOLUTE /end AXIS_DESCR
 /begin AXIS_DESCR STD_AXIS AirCtl_qDes InjMass 2 0.00 327.6700 FORMAT "%8.4" EXTENDED_LIMITS -327.6800 327.6700 DEPOSIT ABSOLUTE /end AXIS_DESCR
/end CHARACTERISTIC
/begin CHARACTERISTIC AirCtl_mDesRgn1a_MAP "Kennfeld für den Luftmassensollwert A der Partikelfilterregeneration 1" MAP 0x1C69F2 Kf_Xs16_Ys16_Ws16 3000.000 AirMassPerCyl -1500.000 1500.000 FORMAT "%8.3" EXTENDED_LIMITS -3276.800 3276.700
 /begin AXIS_DESCR STD_AXIS Eng_nAvrg EngN 16 0.00 6000.000 FORMAT "%8.3" EXTENDED_LIMITS -32768.00 32767.00 DEPOSIT ABSOLUTE /end AXIS_DESCR
 /begin AXIS_DESCR STD_AXIS AirCtl_qDes InjMass 16 0.00 327.6700 FORMAT "%8.4" EXTENDED_LIMITS -327.6800 327.6700 DEPOSIT ABSOLUTE /end AXIS_DESCR
/end CHARACTERISTIC
/begin CHARACTERISTIC AirCtl_mDesRgn1b_MAP "Kennfeld für den Luftmassensollwert B der Partikelfilterregeneration 1" MAP 0x1C6C36 Kf_Xs16_Ys16_Ws16 3000.000 AirMassPerCyl -1500.000 1500.000 FORMAT "%8.3" EXTENDED_LIMITS -3276.800 3276.700
 /begin AXIS_DESCR STD_AXIS Eng_nAvrg EngN 16 0.00 6000.000 FORMAT "%8.3" EXTENDED_LIMITS -32768.00 32767.00 DEPOSIT ABSOLUTE /end AXIS_DESCR
 /begin AXIS_DESCR STD_AXIS AirCtl_qDes InjMass 16 0.00 327.6700 FORMAT "%8.4" EXTENDED_LIMITS -327.6800 327.6700 DEPOSIT ABSOLUTE /end AXIS_DESCR
/end CHARACTERISTIC
/begin CHARACTERISTIC AirCtl_mDesRgn2a_MAP "Kennfeld für den Luftmassensollwert A der Partikelfilterregeneration 2" MAP 0x1C6E7A Kf_Xs16_Ys16_Ws16 3000.000 AirMassPerCyl -1500.000 1500.000 FORMAT "%8.3" EXTENDED_LIMITS -3276.800 3276.700
 /begin AXIS_DESCR STD_AXIS Eng_nAvrg EngN 16 0.00 6000.000 FORMAT "%8.3" EXTENDED_LIMITS -32768.00 32767.00 DEPOSIT ABSOLUTE /end AXIS_DESCR
 /begin AXIS_DESCR STD_AXIS AirCtl_qDes InjMass 16 0.00 327.6700 FORMAT "%8.4" EXTENDED_LIMITS -327.6800 327.6700 DEPOSIT ABSOLUTE /end AXIS_DESCR
/end CHARACTERISTIC
/begin CHARACTERISTIC AirCtl_mDesRgn2b_MAP "Kennfeld für den Luftmassensollwert B der Partikelfilterregeneration 2" MAP 0x1C70BE Kf_Xs16_Ys16_Ws16 3000.000 AirMassPerCyl -1500.000 1500.000 FORMAT "%8.3" EXTENDED_LIMITS -3276.800 3276.700
 /begin AXIS_DESCR STD_AXIS Eng_nAvrg EngN 16 0.00 6000.000 FORMAT "%8.3" EXTENDED_LIMITS -32768.00 32767.00 DEPOSIT ABSOLUTE /end AXIS_DESCR
 /begin AXIS_DESCR STD_AXIS AirCtl_qDes InjMass 16 0.00 327.6700 FORMAT "%8.4" EXTENDED_LIMITS -327.6800 327.6700 DEPOSIT ABSOLUTE /end AXIS_DESCR
/end CHARACTERISTIC
/begin CHARACTERISTIC AirCtl_mDesRgn3a_MAP "Sollwert Regenerationsstufe 3 bei Atmosphärendruck ""a""" MAP 0x1C7302 Kf_Xs16_Ys16_Ws16 3000.000 AirMassPerCyl -1500.000 1500.000 FORMAT "%8.3" EXTENDED_LIMITS -3276.800 3276.700
 /begin AXIS_DESCR STD_AXIS Eng_nAvrg EngN 16 0.00 6000.000 FORMAT "%8.3" EXTENDED_LIMITS -32768.00 32767.00 DEPOSIT ABSOLUTE /end AXIS_DESCR
 /begin AXIS_DESCR STD_AXIS AirCtl_qDes InjMass 16 0.00 327.6700 FORMAT "%8.4" EXTENDED_LIMITS -327.6800 327.6700 DEPOSIT ABSOLUTE /end AXIS_DESCR
/end CHARACTERISTIC
/begin CHARACTERISTIC AirCtl_mDesRgn3b_MAP "Sollwert Regenerationsstufe 3 bei Atmosphärendruck ""b""" MAP 0x1C7546 Kf_Xs16_Ys16_Ws16 3000.000 AirMassPerCyl -1500.000 1500.000 FORMAT "%8.3" EXTENDED_LIMITS -3276.800 3276.700
 /begin AXIS_DESCR STD_AXIS Eng_nAvrg EngN 16 0.00 6000.000 FORMAT "%8.3" EXTENDED_LIMITS -32768.00 32767.00 DEPOSIT ABSOLUTE /end AXIS_DESCR
 /begin AXIS_DESCR STD_AXIS AirCtl_qDes InjMass 16 0.00 327.6700 FORMAT "%8.4" EXTENDED_LIMITS -327.6800 327.6700 DEPOSIT ABSOLUTE /end AXIS_DESCR
/end CHARACTERISTIC
/begin CHARACTERISTIC AirCtl_mDesShtrp_CUR "AGR Soll-Luftmasse während ShortTrip-Test AGR-Reglerabweichung" CURVE 0x1C778A Kl_Xs16_Ws16 6553.500 AirMassPerCyl -3276.800 3276.700 FORMAT "%8.3"
 /begin AXIS_DESCR STD_AXIS APSCD_pVal Pres_hPa 6 0.00 3500.000 FORMAT "%8.3" EXTENDED_LIMITS -32768.00 32767.00 DEPOSIT ABSOLUTE /end AXIS_DESCR
/end CHARACTERISTIC
/begin CHARACTERISTIC AirCtl_mGovDevMax_C "Obere Grenze von AirCtl_mGovDev um AirCtl_rOutDDyn_mp zu setzten" VALUE 0x1C81C8 Kw_Ws16 6553.500 AirMassPerCyl -3276.800 3276.700 FORMAT "%8.3" /end CHARACTERISTIC
/begin CHARACTERISTIC AirCtl_mGovDevMin_C "Untere Grenze von AirCtl_mGovDev um AirCtl_rOutDDyn_mp zu setzten" VALUE 0x1C81CA Kw_Ws16 6553.500 AirMassPerCyl -3276.800 3276.700 FORMAT "%8.3" /end CHARACTERISTIC
/begin CHARACTERISTIC AirCtl_MinTrmVal_C "minimaler ARF-Abgleichwert" VALUE 0x1C77A4 Kw_Ws16 3000.000 AirMassPerCyl -1500.000 1500.000 FORMAT "%8.3" EXTENDED_LIMITS -3276.800 3276.700 /end CHARACTERISTIC
/begin CHARACTERISTIC AirCtl_mMaxDesVal_C "maximaler Luftmassensollwert" VALUE 0x1C77A6 Kw_Ws16 1500.000 AirMassPerCyl 0.00 1500.000 FORMAT "%8.3" EXTENDED_LIMITS -3276.800 3276.700 /end CHARACTERISTIC
/begin CHARACTERISTIC AirCtl_mMaxDevRgn_MAP "Maximale Luftmassenabweichung im Regenerationsmodus" MAP 0x1C953A Kf_Xs16_Ys16_Ws16 2000.000 AirMassPerCyl 0.00 2000.000 FORMAT "%8.3" EXTENDED_LIMITS -3276.800 3276.700
 /begin AXIS_DESCR STD_AXIS Eng_nAvrg EngN 16 0.00 6000.000 FORMAT "%8.3" EXTENDED_LIMITS -32768.00 32767.00 DEPOSIT ABSOLUTE /end AXIS_DESCR
 /begin AXIS_DESCR STD_AXIS AirCtl_mDesVal AirMassPerCyl 13 0.00 2000.000 FORMAT "%8.3" EXTENDED_LIMITS -3276.800 3276.700 DEPOSIT ABSOLUTE /end AXIS_DESCR
/end CHARACTERISTIC
/begin CHARACTERISTIC AirCtl_mMaxDevShtrp_CUR "Maximale (positive) AGR-Reglerabweichung während ShortTrip-Test AGR-Reglerabweichung" CURVE 0x1C9718 Kl_Xs16_Ws16 2000.000 AirMassPerCyl 0.00 2000.000 FORMAT "%8.3" EXTENDED_LIMITS -3276.800 3276.700
 /begin AXIS_DESCR STD_AXIS APSCD_pVal Pres_hPa 6 0.00 3500.000 FORMAT "%8.3" EXTENDED_LIMITS -32768.00 32767.00 DEPOSIT ABSOLUTE /end AXIS_DESCR
/end CHARACTERISTIC
/begin CHARACTERISTIC AirCtl_mMaxDev_MAP "Kennfeld der Grenzen für Erkennung bleibender Regelabweichung" MAP 0x1C9732 Kf_Xs16_Ys16_Ws16 2000.000 AirMassPerCyl 0.00 2000.000 FORMAT "%8.3" EXTENDED_LIMITS -3276.800 3276.700
 /begin AXIS_DESCR STD_AXIS Eng_nAvrg EngN 16 0.00 6000.000 FORMAT "%8.3" EXTENDED_LIMITS -32768.00 32767.00 DEPOSIT ABSOLUTE /end AXIS_DESCR
 /begin AXIS_DESCR STD_AXIS AirCtl_mDesVal AirMassPerCyl 13 0.00 2000.000 FORMAT "%8.3" EXTENDED_LIMITS -3276.800 3276.700 DEPOSIT ABSOLUTE /end AXIS_DESCR
/end CHARACTERISTIC
/begin CHARACTERISTIC AirCtl_mMinDesVal_C "minimaler Luftmassensollwert" VALUE 0x1C77A8 Kw_Ws16 1500.000 AirMassPerCyl 0.00 1500.000 FORMAT "%8.3" EXTENDED_LIMITS -3276.800 3276.700 /end CHARACTERISTIC
/begin CHARACTERISTIC AirCtl_mMinDevRgn_MAP "Minimale Luftmassenabweichung im Regenerationsbetrieb" MAP 0x1C9910 Kf_Xs16_Ys16_Ws16 2000.000 AirMassPerCyl -2000.000 0.00 FORMAT "%8.3" EXTENDED_LIMITS -3276.800 3276.700
 /begin AXIS_DESCR STD_AXIS Eng_nAvrg EngN 16 0.00 6000.000 FORMAT "%8.3" EXTENDED_LIMITS -32768.00 32767.00 DEPOSIT ABSOLUTE /end AXIS_DESCR
 /begin AXIS_DESCR STD_AXIS AirCtl_mDesVal AirMassPerCyl 13 0.00 2000.000 FORMAT "%8.3" EXTENDED_LIMITS -3276.800 3276.700 DEPOSIT ABSOLUTE /end AXIS_DESCR
/end CHARACTERISTIC
/begin CHARACTERISTIC AirCtl_mMinDevShtrp_CUR "Minimale (negative) AGR-Reglerabweichung während ShortTrip-Test AGR-Reglerabweichung" CURVE 0x1C9AEE Kl_Xs16_Ws16 2000.000 AirMassPerCyl -2000.000 0.00 FORMAT "%8.3" EXTENDED_LIMITS -3276.800 3276.700
 /begin AXIS_DESCR STD_AXIS APSCD_pVal Pres_hPa 6 0.00 3500.000 FORMAT "%8.3" EXTENDED_LIMITS -32768.00 32767.00 DEPOSIT ABSOLUTE /end AXIS_DESCR
/end CHARACTERISTIC
/begin CHARACTERISTIC AirCtl_mMinDev_MAP "Kennfeld der Grenzen für Erkennung bleibender Regelabweichung" MAP 0x1C9B08 Kf_Xs16_Ys16_Ws16 2000.000 AirMassPerCyl -2000.000 0.00 FORMAT "%8.3" EXTENDED_LIMITS -3276.800 3276.700
 /begin AXIS_DESCR STD_AXIS Eng_nAvrg EngN 16 0.00 6000.000 FORMAT "%8.3" EXTENDED_LIMITS -32768.00 32767.00 DEPOSIT ABSOLUTE /end AXIS_DESCR
 /begin AXIS_DESCR STD_AXIS AirCtl_mDesVal AirMassPerCyl 13 0.00 2000.000 FORMAT "%8.3" EXTENDED_LIMITS -3276.800 3276.700 DEPOSIT ABSOLUTE /end AXIS_DESCR
/end CHARACTERISTIC
/begin CHARACTERISTIC AirCtl_mMonOffDevRgn_C "Label zur Überwachungsdeaktivierungs auf Grund von unrealistischen Regelabweichungen im Regenerationsmodus" VALUE 0x1C9CE6 Kw_Ws16 3276.700 AirMassPerCyl 0.00 3276.700 FORMAT "%8.3" EXTENDED_LIMITS -3276.800 3276.700 /end CHARACTERISTIC
/begin CHARACTERISTIC AirCtl_mMonOffDev_C "Schwelle für erlaubte Regelabweichung, ab der keine Überwachung stattfindet" VALUE 0x1C9CE8 Kw_Ws16 3276.700 AirMassPerCyl 0.00 3276.700 FORMAT "%8.3" EXTENDED_LIMITS -3276.800 3276.700 /end CHARACTERISTIC
/begin CHARACTERISTIC AirCtl_dmRampStepUp_C "Schrittweite der Rampe in steigender Richtung" VALUE 0x1C77AC Kw_Wu32 1494.99969482 RmpAirMassPerCyl 5.00030517578 1500.00000000 FORMAT "%13.8" EXTENDED_LIMITS 0.00 6553599.99847 /end CHARACTERISTIC
/begin CHARACTERISTIC AirCtl_dmRampStepDown_C "Schrittweite der Rampe in fallender Richtung" VALUE 0x1C77B0 Kw_Wu32 1494.99969482 RmpAirMassPerCyl 5.00030517578 1500.00000000 FORMAT "%13.8" EXTENDED_LIMITS 0.00 6553599.99847 /end CHARACTERISTIC
/begin CHARACTERISTIC AirCtl_nHealHi_C "obere Drehzahlgrenze des Heilungsbereichs" VALUE 0x1C9CEA Kw_Ws16 6000.000 EngN 0.00 6000.000 FORMAT "%8.3" EXTENDED_LIMITS -32768.00 32767.00 /end CHARACTERISTIC
/begin CHARACTERISTIC AirCtl_nHealLo_C "untere Drehzahlgrenze des Heilungsbereichs" VALUE 0x1C9CEC Kw_Ws16 6000.000 EngN 0.00 6000.000 FORMAT "%8.3" EXTENDED_LIMITS -32768.00 32767.00 /end CHARACTERISTIC
/begin CHARACTERISTIC AirCtl_nHealRgnHi_C "Obere Schwelle des Regelabweichungs-Heilungsbereichs" VALUE 0x1C9CEE Kw_Ws16 6000.000 EngN 0.00 6000.000 FORMAT "%8.3" EXTENDED_LIMITS -32768.00 32767.00 /end CHARACTERISTIC
/begin CHARACTERISTIC AirCtl_nHealRgnLo_C "Untere Drehzahlschwelle des Regelabweichungs-Heilbereichs" VALUE 0x1C9CF0 Kw_Ws16 6000.000 EngN 0.00 6000.000 FORMAT "%8.3" EXTENDED_LIMITS -32768.00 32767.00 /end CHARACTERISTIC
/begin CHARACTERISTIC AirCtl_nLI_C "Drehzahlgrenze für Leerlauferkennung" VALUE 0x1C9CF2 Kw_Ws16 6000.000 EngN 0.00 6000.000 FORMAT "%8.3" EXTENDED_LIMITS -32768.00 32767.00 /end CHARACTERISTIC
/begin CHARACTERISTIC AirCtl_nOvrRunDel_CUR "untere Drehzahschwelle zur Schuberkennung" CURVE 0x1C9CF4 Kl_Xs16_Ws16 6000.000 EngN 0.00 6000.000 FORMAT "%8.3" EXTENDED_LIMITS -32768.00 32767.00
 /begin AXIS_DESCR STD_AXIS Eng_tEng Temp_Cels 10 -50.14000 199.8600 FORMAT "%8.4" EXTENDED_LIMITS -3549.940 3003.560 DEPOSIT ABSOLUTE /end AXIS_DESCR
/end CHARACTERISTIC
/begin CHARACTERISTIC AirCtl_nOvrRun_CUR "Kenninie für Schubüberwachung" CURVE 0x1C9D1E Kl_Xs16_Ws16 6000.000 EngN 0.00 6000.000 FORMAT "%8.3" EXTENDED_LIMITS -32768.00 32767.00
 /begin AXIS_DESCR STD_AXIS Eng_tEng Temp_Cels 10 -50.14000 199.8600 FORMAT "%8.4" EXTENDED_LIMITS -3549.940 3003.560 DEPOSIT ABSOLUTE /end AXIS_DESCR
/end CHARACTERISTIC
/begin CHARACTERISTIC AirCtl_NQAPCorRgn_MAP "Kennfeld für drehzahl und mengenabhängige Atmosphärendruckkorrektur im Regenerationsbetrieb" MAP 0x1C77B4 Kf_Xs16_Ys16_Ws16 7.999878 Fact -4.000000 3.999878 FORMAT "%8.6"
 /begin AXIS_DESCR STD_AXIS Eng_nAvrg EngN 8 0.00 6000.000 FORMAT "%8.3" EXTENDED_LIMITS -32768.00 32767.00 DEPOSIT ABSOLUTE /end AXIS_DESCR
 /begin AXIS_DESCR STD_AXIS AirCtl_qDes InjMass 8 0.00 327.6700 FORMAT "%8.4" EXTENDED_LIMITS -327.6800 327.6700 DEPOSIT ABSOLUTE /end AXIS_DESCR
/end CHARACTERISTIC
/begin CHARACTERISTIC AirCtl_NQAPCor_MAP "Kennfeld für Luftdruckkorrektur für ARF" MAP 0x1C7858 Kf_Xs16_Ys16_Ws16 7.999878 Fact -4.000000 3.999878 FORMAT "%8.6"
 /begin AXIS_DESCR STD_AXIS Eng_nAvrg EngN 8 0.00 6000.000 FORMAT "%8.3" EXTENDED_LIMITS -32768.00 32767.00 DEPOSIT ABSOLUTE /end AXIS_DESCR
 /begin AXIS_DESCR STD_AXIS AirCtl_qDes InjMass 8 0.00 327.6700 FORMAT "%8.4" EXTENDED_LIMITS -327.6800 327.6700 DEPOSIT ABSOLUTE /end AXIS_DESCR
/end CHARACTERISTIC
/begin CHARACTERISTIC AirCtl_NQCTCorRgn1_MAP "Kennfeld für drehzahl und motortemperaturabhängige Kühlwassertemperaturkorrektur ohne VE" MAP 0x1C78FC Kf_Xs16_Ys16_Ws16 3000.000 AirMassPerCyl -1500.000 1500.000 FORMAT "%8.3" EXTENDED_LIMITS -3276.800 3276.700
 /begin AXIS_DESCR STD_AXIS Eng_nAvrg EngN 2 0.00 6000.000 FORMAT "%8.3" EXTENDED_LIMITS -32768.00 32767.00 DEPOSIT ABSOLUTE /end AXIS_DESCR
 /begin AXIS_DESCR STD_AXIS Eng_tEng Temp_Cels 2 -50.14000 199.8600 FORMAT "%8.4" EXTENDED_LIMITS -3549.940 3003.560 DEPOSIT ABSOLUTE /end AXIS_DESCR
/end CHARACTERISTIC
/begin CHARACTERISTIC AirCtl_NQCTCorRgn2_MAP "Kennfeld für drehzahl und motortemperaturabhängige Kühlwassertemperaturkorrektur ohne VE" MAP 0x1C7910 Kf_Xs16_Ys16_Ws16 3000.000 AirMassPerCyl -1500.000 1500.000 FORMAT "%8.3" EXTENDED_LIMITS -3276.800 3276.700
 /begin AXIS_DESCR STD_AXIS Eng_nAvrg EngN 2 0.00 6000.000 FORMAT "%8.3" EXTENDED_LIMITS -32768.00 32767.00 DEPOSIT ABSOLUTE /end AXIS_DESCR
 /begin AXIS_DESCR STD_AXIS Eng_tEng Temp_Cels 2 -50.14000 199.8600 FORMAT "%8.4" EXTENDED_LIMITS -3549.940 3003.560 DEPOSIT ABSOLUTE /end AXIS_DESCR
/end CHARACTERISTIC
/begin CHARACTERISTIC AirCtl_NQCTCorRgn3_MAP "Kennfeld für drehzahl und motortemperaturabhängige Kühlwassertemperaturkorrektur ohne VE" MAP 0x1C7924 Kf_Xs16_Ys16_Ws16 3000.000 AirMassPerCyl -1500.000 1500.000 FORMAT "%8.3" EXTENDED_LIMITS -3276.800 3276.700
 /begin AXIS_DESCR STD_AXIS Eng_nAvrg EngN 2 0.00 6000.000 FORMAT "%8.3" EXTENDED_LIMITS -32768.00 32767.00 DEPOSIT ABSOLUTE /end AXIS_DESCR
 /begin AXIS_DESCR STD_AXIS Eng_tEng Temp_Cels 2 -50.14000 199.8600 FORMAT "%8.4" EXTENDED_LIMITS -3549.940 3003.560 DEPOSIT ABSOLUTE /end AXIS_DESCR
/end CHARACTERISTIC
/begin CHARACTERISTIC AirCtl_NQCTCor_MAP "Kennfeld für Kühlwassertemperaturkorrektur für ARF ohne VE" MAP 0x1C7938 Kf_Xs16_Ys16_Ws16 3000.000 AirMassPerCyl -1500.000 1500.000 FORMAT "%8.3" EXTENDED_LIMITS -3276.800 3276.700
 /begin AXIS_DESCR STD_AXIS Eng_nAvrg EngN 10 0.00 6000.000 FORMAT "%8.3" EXTENDED_LIMITS -32768.00 32767.00 DEPOSIT ABSOLUTE /end AXIS_DESCR
 /begin AXIS_DESCR STD_AXIS Eng_tEng Temp_Cels 8 -50.14000 199.8600 FORMAT "%8.4" EXTENDED_LIMITS -3549.940 3003.560 DEPOSIT ABSOLUTE /end AXIS_DESCR
/end CHARACTERISTIC
/begin CHARACTERISTIC AirCtl_nWinHi_C "obere Grenze des Drehzahlfensters" VALUE 0x1C4896 Kw_Ws16 6500.000 EngN 0.00 6500.000 FORMAT "%8.3" EXTENDED_LIMITS -32768.00 32767.00 /end CHARACTERISTIC
/begin CHARACTERISTIC AirCtl_nWinLow_C "untere Grenze des Drehzahlfensters" VALUE 0x1C4898 Kw_Ws16 6500.000 EngN 0.00 6500.000 FORMAT "%8.3" EXTENDED_LIMITS -32768.00 32767.00 /end CHARACTERISTIC
/begin CHARACTERISTIC AirCtl_tiOvrRunAtcpDT1_C "DT1-Timeconstant for expected overrun detection" VALUE 0x1C7A00 Kw_Wu32 4294.9673 TimeDelay_s 0.0000010000000 4294.9673 FORMAT "%9.4" /end CHARACTERISTIC
/begin CHARACTERISTIC AirCtl_kdOvrRunAtcpDT1_C "DT1-Konstante für Erkennung des erwarteten Schubs" VALUE 0x1C7A04 Kw_Ws32 4294967295.00 OneToOne -2147483648.00 2147483647.00 FORMAT "%13.2" /end CHARACTERISTIC
/begin CHARACTERISTIC AirCtl_pAirHiNS_C "Oberer Luftdruck-Hysteresen-Schwellwert im Anti-Kaudern Fall" VALUE 0x1C9D48 Kw_Ws16 65535.00 Pres_hPa -32768.00 32767.00 FORMAT "%8.2" /end CHARACTERISTIC
/begin CHARACTERISTIC AirCtl_pAirHi_C "obere Hysteresegrenze für Atmosphärendrucküberwachung" VALUE 0x1C9D4A Kw_Ws16 65535.00 Pres_hPa -32768.00 32767.00 FORMAT "%8.2" /end CHARACTERISTIC
/begin CHARACTERISTIC AirCtl_pAirLoNS_C "Unterer Luftdruck-Hysteresen-Schwellwert im Anti-Kaudern Fall" VALUE 0x1C9D4C Kw_Ws16 65535.00 Pres_hPa -32768.00 32767.00 FORMAT "%8.2" /end CHARACTERISTIC
/begin CHARACTERISTIC AirCtl_pAirLo_C "untere Hysteresegrenze für Atmosphärendrucküberwachung" VALUE 0x1C9D4E Kw_Ws16 65535.00 Pres_hPa -32768.00 32767.00 FORMAT "%8.2" /end CHARACTERISTIC
/begin CHARACTERISTIC AirCtl_pCor_MAP "Ansauglufttemperatur-korrigierter Atmospherendruck" MAP 0x1C4AC8 Kf_Xs16_Ys16_Ws16 3500.000 Pres_hPa 0.00 3500.000 FORMAT "%8.3" EXTENDED_LIMITS -32768.00 32767.00
 /begin AXIS_DESCR STD_AXIS APSCD_pVal Pres_hPa 16 0.00 3500.000 FORMAT "%8.3" EXTENDED_LIMITS -32768.00 32767.00 DEPOSIT ABSOLUTE /end AXIS_DESCR
 /begin AXIS_DESCR STD_AXIS IATSCD_tAir Temp_Cels 10 -50.14000 199.8600 FORMAT "%8.4" EXTENDED_LIMITS -3549.940 3003.560 DEPOSIT ABSOLUTE /end AXIS_DESCR
/end CHARACTERISTIC
/begin CHARACTERISTIC AirCtl_PKp_C "Grundwert der P-Verstärkung des PI-Reglers bei Kleinsignalen" VALUE 0x1C81CC Kw_Wu32 10.0000000000 Kp_Ampc2Prc 0.00 10.0000000000 FORMAT "%13.10" EXTENDED_LIMITS 0.00 6553.59999847 /end CHARACTERISTIC
/begin CHARACTERISTIC AirCtl_PKpPos_C "Grundwert der P-Verstärkung des PI-Reglers bei positiven Großsignalen" VALUE 0x1C81D0 Kw_Wu32 10.0000000000 Kp_Ampc2Prc 0.00 10.0000000000 FORMAT "%13.10" EXTENDED_LIMITS 0.00 6553.59999847 /end CHARACTERISTIC
/begin CHARACTERISTIC AirCtl_PKpNeg_C "Grundwert der P-Verstärkung des PI-Reglers bei negativen Großsignalen" VALUE 0x1C81D4 Kw_Wu32 10.0000000000 Kp_Ampc2Prc 0.00 10.0000000000 FORMAT "%13.10" EXTENDED_LIMITS 0.00 6553.59999847 /end CHARACTERISTIC
/begin CHARACTERISTIC AirCtl_mPWinPos_C "obere Kleinsignalgrenze für den P-Kanal des PI-Reglers" VALUE 0x1C81D8 Kw_Ws16 1500.000 AirMassPerCyl 0.00 1500.000 FORMAT "%8.3" EXTENDED_LIMITS -3276.800 3276.700 /end CHARACTERISTIC
/begin CHARACTERISTIC AirCtl_mPWinNeg_C "untere Kleinsignalgrenze für den P-Kanal des PI-Reglers" VALUE 0x1C81DA Kw_Ws16 1500.000 AirMassPerCyl -1500.000 0.00 FORMAT "%8.3" EXTENDED_LIMITS -3276.800 3276.700 /end CHARACTERISTIC
/begin CHARACTERISTIC AirCtl_qCBVHysHi_CUR "obere drehzahlabhängige Einspritzmengenschwellwertkennlinie zur Schuberkennung für EGR-Kühler Bypass" CURVE 0x1C4914 Kl_Xs16_Ws16 327.6700 InjMass 0.00 327.6700 FORMAT "%8.4" EXTENDED_LIMITS -327.6800 327.6700
 /begin AXIS_DESCR STD_AXIS Eng_nAvrg EngN 16 0.00 6000.000 FORMAT "%8.3" EXTENDED_LIMITS -32768.00 32767.00 DEPOSIT ABSOLUTE /end AXIS_DESCR
/end CHARACTERISTIC
/begin CHARACTERISTIC AirCtl_qCBVHysLo_CUR "untere drehzahlabhängige Einspritzmengenschwellwertkennlinie zur Schuberkennung für EGR-Kühler Bypass" CURVE 0x1C4956 Kl_Xs16_Ws16 327.6700 InjMass 0.00 327.6700 FORMAT "%8.4" EXTENDED_LIMITS -327.6800 327.6700
 /begin AXIS_DESCR STD_AXIS Eng_nAvrg EngN 16 0.00 6000.000 FORMAT "%8.3" EXTENDED_LIMITS -32768.00 32767.00 DEPOSIT ABSOLUTE /end AXIS_DESCR
/end CHARACTERISTIC
/begin CHARACTERISTIC AirCtl_qCurrMax_C "obere Grenze des Bereichs der aktuellen Wunschmenge" VALUE 0x1C489A Kw_Ws16 70.00000 InjMass 0.00 70.00000 FORMAT "%8.5" EXTENDED_LIMITS -327.6800 327.6700 /end CHARACTERISTIC
/begin CHARACTERISTIC AirCtl_qCurrMin_C "untere Grenze des Bereichs der aktuellen Wunschmenge" VALUE 0x1C489C Kw_Ws16 70.00000 InjMass 0.00 70.00000 FORMAT "%8.5" EXTENDED_LIMITS -327.6800 327.6700 /end CHARACTERISTIC
/begin CHARACTERISTIC AirCtl_qGovOff_CUR "Kennlinie für untere Schwelle der Abschalthysterese" CURVE 0x1C81DC Kl_Xs16_Ws16 327.6700 InjMass 0.00 327.6700 FORMAT "%8.4" EXTENDED_LIMITS -327.6800 327.6700
 /begin AXIS_DESCR STD_AXIS Eng_nAvrg EngN 10 0.00 6000.000 FORMAT "%8.3" EXTENDED_LIMITS -32768.00 32767.00 DEPOSIT ABSOLUTE /end AXIS_DESCR
/end CHARACTERISTIC
/begin CHARACTERISTIC AirCtl_qGovOn_CUR "Kennlinie für obere Schwelle der Abschalthysterese" CURVE 0x1C8206 Kl_Xs16_Ws16 327.6700 InjMass 0.00 327.6700 FORMAT "%8.4" EXTENDED_LIMITS -327.6800 327.6700
 /begin AXIS_DESCR STD_AXIS Eng_nAvrg EngN 10 0.00 6000.000 FORMAT "%8.3" EXTENDED_LIMITS -32768.00 32767.00 DEPOSIT ABSOLUTE /end AXIS_DESCR
/end CHARACTERISTIC
/begin CHARACTERISTIC AirCtl_qGovRgn1Off_CUR "Kennlinie für untere Schwelle der Abschalthysterese bei Regenerationsbetrieb 1" CURVE 0x1C8230 Kl_Xs16_Ws16 327.6700 InjMass 0.00 327.6700 FORMAT "%8.4" EXTENDED_LIMITS -327.6800 327.6700
 /begin AXIS_DESCR STD_AXIS Eng_nAvrg EngN 10 0.00 6000.000 FORMAT "%8.3" EXTENDED_LIMITS -32768.00 32767.00 DEPOSIT ABSOLUTE /end AXIS_DESCR
/end CHARACTERISTIC
/begin CHARACTERISTIC AirCtl_qGovRgn1On_CUR "Kennlinie für obere Schwelle der Abschalthysterese bei Regenerationsbetrieb 1" CURVE 0x1C825A Kl_Xs16_Ws16 327.6700 InjMass 0.00 327.6700 FORMAT "%8.4" EXTENDED_LIMITS -327.6800 327.6700
 /begin AXIS_DESCR STD_AXIS Eng_nAvrg EngN 10 0.00 6000.000 FORMAT "%8.3" EXTENDED_LIMITS -32768.00 32767.00 DEPOSIT ABSOLUTE /end AXIS_DESCR
/end CHARACTERISTIC
/begin CHARACTERISTIC AirCtl_qGovRgn2Off_CUR "Kennlinie für untere Schwelle der Abschalthysterese bei Regenerationsbetrieb 2" CURVE 0x1C8284 Kl_Xs16_Ws16 327.6700 InjMass 0.00 327.6700 FORMAT "%8.4" EXTENDED_LIMITS -327.6800 327.6700
 /begin AXIS_DESCR STD_AXIS Eng_nAvrg EngN 10 0.00 6000.000 FORMAT "%8.3" EXTENDED_LIMITS -32768.00 32767.00 DEPOSIT ABSOLUTE /end AXIS_DESCR
/end CHARACTERISTIC
/begin CHARACTERISTIC AirCtl_qGovRgn2On_CUR "Kennlinie für obere Schwelle der Abschalthysterese bei Regenerationsbetrieb 2" CURVE 0x1C82AE Kl_Xs16_Ws16 327.6700 InjMass 0.00 327.6700 FORMAT "%8.4" EXTENDED_LIMITS -327.6800 327.6700
 /begin AXIS_DESCR STD_AXIS Eng_nAvrg EngN 10 0.00 6000.000 FORMAT "%8.3" EXTENDED_LIMITS -32768.00 32767.00 DEPOSIT ABSOLUTE /end AXIS_DESCR
/end CHARACTERISTIC
/begin CHARACTERISTIC AirCtl_qHealHi_C "obere Mengengrenze des Heilungsbereichs" VALUE 0x1C9D50 Kw_Ws16 327.6700 InjMass 0.00 327.6700 FORMAT "%8.4" EXTENDED_LIMITS -327.6800 327.6700 /end CHARACTERISTIC
/begin CHARACTERISTIC AirCtl_qHealLo_C "untere Mengengrenze des Heilungsbereichs" VALUE 0x1C9D52 Kw_Ws16 327.6700 InjMass 0.00 327.6700 FORMAT "%8.4" EXTENDED_LIMITS -327.6800 327.6700 /end CHARACTERISTIC
/begin CHARACTERISTIC AirCtl_qHealRgnHi_C "Oberer Einspritzmengenschwellwert des Regelabweichungs-Heilungsbereichs im Regenerationsbetrieb" VALUE 0x1C9D54 Kw_Ws16 327.6700 InjMass 0.00 327.6700 FORMAT "%8.4" EXTENDED_LIMITS -327.6800 327.6700 /end CHARACTERISTIC
/begin CHARACTERISTIC AirCtl_qHealRgnLo_C "Untere Einspritzmengenschwelle des Regelabweichungs-Heilungsbereichs im Regenerationsbetrieb" VALUE 0x1C9D56 Kw_Ws16 327.6700 InjMass 0.00 327.6700 FORMAT "%8.4" EXTENDED_LIMITS -327.6800 327.6700 /end CHARACTERISTIC
/begin CHARACTERISTIC AirCtl_qHigh1_CUR "Kennlinie für obere Hysteresegrenze für Abschaltung bei großer Einspritzmenge und EGT-Status gleich der Maske" CURVE 0x1C9D58 Kl_Xs16_Ws16 327.6700 InjMass 0.00 327.6700 FORMAT "%8.4" EXTENDED_LIMITS -327.6800 327.6700
 /begin AXIS_DESCR STD_AXIS Eng_nAvrg EngN 20 0.00 6000.000 FORMAT "%8.3" EXTENDED_LIMITS -32768.00 32767.00 DEPOSIT ABSOLUTE /end AXIS_DESCR
/end CHARACTERISTIC
/begin CHARACTERISTIC AirCtl_qHigh_CUR "Kennlinie für obere Hysteresegrenze für Abschaltung bei großer Einspritzmenge" CURVE 0x1C9DAA Kl_Xs16_Ws16 327.6700 InjMass 0.00 327.6700 FORMAT "%8.4" EXTENDED_LIMITS -327.6800 327.6700
 /begin AXIS_DESCR STD_AXIS Eng_nAvrg EngN 20 0.00 6000.000 FORMAT "%8.3" EXTENDED_LIMITS -32768.00 32767.00 DEPOSIT ABSOLUTE /end AXIS_DESCR
/end CHARACTERISTIC
/begin CHARACTERISTIC AirCtl_qLdDet_CUR "Kennlinie zur Lasterkennung" CURVE 0x1C82D8 Kl_Xs16_Ws16 327.6700 InjMass 0.00 327.6700 FORMAT "%8.4" EXTENDED_LIMITS -327.6800 327.6700
 /begin AXIS_DESCR STD_AXIS Eng_nAvrg EngN 4 0.00 6000.000 FORMAT "%8.3" EXTENDED_LIMITS -32768.00 32767.00 DEPOSIT ABSOLUTE /end AXIS_DESCR
/end CHARACTERISTIC
/begin CHARACTERISTIC AirCtl_qLow_CUR "Kennlinie für untere Hysteresegrenze für Abschaltung bei großer Einspritzmenge" CURVE 0x1C9DFC Kl_Xs16_Ws16 327.6700 InjMass 0.00 327.6700 FORMAT "%8.4" EXTENDED_LIMITS -327.6800 327.6700
 /begin AXIS_DESCR STD_AXIS Eng_nAvrg EngN 20 0.00 6000.000 FORMAT "%8.3" EXTENDED_LIMITS -32768.00 32767.00 DEPOSIT ABSOLUTE /end AXIS_DESCR
/end CHARACTERISTIC
/begin CHARACTERISTIC AirCtl_qMiddle1_CUR "Kennlinie für obere Hysteresegrenze für Abschaltung bei mittlerer Einspritzmenge und EGT-Status gleich der Maske" CURVE 0x1C9E4E Kl_Xs16_Ws16 327.6700 InjMass 0.00 327.6700 FORMAT "%8.4" EXTENDED_LIMITS -327.6800 327.6700
 /begin AXIS_DESCR STD_AXIS Eng_nAvrg EngN 20 0.00 6000.000 FORMAT "%8.3" EXTENDED_LIMITS -32768.00 32767.00 DEPOSIT ABSOLUTE /end AXIS_DESCR
/end CHARACTERISTIC
/begin CHARACTERISTIC AirCtl_qMiddle_CUR "untere Hystereseschwelle für Mengenüberwachung" CURVE 0x1C9EA0 Kl_Xs16_Ws16 327.6700 InjMass 0.00 327.6700 FORMAT "%8.4" EXTENDED_LIMITS -327.6800 327.6700
 /begin AXIS_DESCR STD_AXIS Eng_nAvrg EngN 20 0.00 6000.000 FORMAT "%8.3" EXTENDED_LIMITS -32768.00 32767.00 DEPOSIT ABSOLUTE /end AXIS_DESCR
/end CHARACTERISTIC
/begin CHARACTERISTIC AirCtl_qMonMaxNS_C "Maximale Einspritzmenge für die Anti-Kaudern-maßnahme" VALUE 0x1C9EF2 Kw_Ws16 327.6700 InjMass 0.00 327.6700 FORMAT "%8.4" EXTENDED_LIMITS -327.6800 327.6700 /end CHARACTERISTIC
/begin CHARACTERISTIC AirCtl_qOvrRun_C "untere Mengengrenze für Schubabschaltung" VALUE 0x1C9EF4 Kw_Ws16 327.6700 InjMass 0.00 327.6700 FORMAT "%8.4" EXTENDED_LIMITS -327.6800 327.6700 /end CHARACTERISTIC
/begin CHARACTERISTIC AirCtl_qRpOilCorr_CUR "Einspritzmengen Korrektur für RME" CURVE 0x1C7A98 Kl_Xs16_Ws16 327.6700 InjMass 0.00 327.6700 FORMAT "%8.4" EXTENDED_LIMITS -327.6800 327.6700
 /begin AXIS_DESCR STD_AXIS InjCtl_qRaw InjMass 16 0.00 327.6700 FORMAT "%8.4" EXTENDED_LIMITS -327.6800 327.6700 DEPOSIT ABSOLUTE /end AXIS_DESCR
/end CHARACTERISTIC
/begin CHARACTERISTIC AirCtl_rAPCor_CUR "Korrekturkennlinie über Umgebungsdruck" CURVE 0x1C4C40 Kl_Xs16_Ws16 655.3500 Prc -327.6800 327.6700 FORMAT "%8.4"
 /begin AXIS_DESCR STD_AXIS APSCD_pVal Pres_hPa 4 0.00 3500.000 FORMAT "%8.3" EXTENDED_LIMITS -32768.00 32767.00 DEPOSIT ABSOLUTE /end AXIS_DESCR
/end CHARACTERISTIC
/begin CHARACTERISTIC AirCtl_rAPCor_MAP "Atmosphärendruck- und drehzahlabhängiger Korrekturwert von AirCtl_rCtlVal" MAP 0x1C4C52 Kf_Xs16_Ys16_Ws16 100.0000 Prc 0.00 100.0000 FORMAT "%8.4" EXTENDED_LIMITS -327.6800 327.6700
 /begin AXIS_DESCR STD_AXIS Eng_nAvrg EngN 10 0.00 6000.000 FORMAT "%8.3" EXTENDED_LIMITS -32768.00 32767.00 DEPOSIT ABSOLUTE /end AXIS_DESCR
 /begin AXIS_DESCR STD_AXIS AirCtl_pCor Pres_hPa 4 0.00 3500.000 FORMAT "%8.3" EXTENDED_LIMITS -32768.00 32767.00 DEPOSIT ABSOLUTE /end AXIS_DESCR
/end CHARACTERISTIC
/begin CHARACTERISTIC AirCtl_rCtlBase0_MAP "Kennfeld für den Basiswert der parallelen Steuerung für Gang 1, 2 und Rückgang sowie bei Leerlauf" MAP 0x1C4CC2 Kf_Xs16_Ys16_Ws16 100.0000 Prc 0.00 100.0000 FORMAT "%8.4" EXTENDED_LIMITS -327.6800 327.6700
 /begin AXIS_DESCR STD_AXIS Eng_nAvrg EngN 16 0.00 6000.000 FORMAT "%8.3" EXTENDED_LIMITS -32768.00 32767.00 DEPOSIT ABSOLUTE /end AXIS_DESCR
 /begin AXIS_DESCR STD_AXIS AirCtl_qCtl InjMass 13 0.00 327.6700 FORMAT "%8.4" EXTENDED_LIMITS -327.6800 327.6700 DEPOSIT ABSOLUTE /end AXIS_DESCR
/end CHARACTERISTIC
/begin CHARACTERISTIC AirCtl_rCtlBase1_MAP "Kennfeld für Basisistwert der parallelen Steuerung für Gang 3 und 4" MAP 0x1C4EA0 Kf_Xs16_Ys16_Ws16 100.0000 Prc 0.00 100.0000 FORMAT "%8.4" EXTENDED_LIMITS -327.6800 327.6700
 /begin AXIS_DESCR STD_AXIS Eng_nAvrg EngN 16 0.00 6000.000 FORMAT "%8.3" EXTENDED_LIMITS -32768.00 32767.00 DEPOSIT ABSOLUTE /end AXIS_DESCR
 /begin AXIS_DESCR STD_AXIS AirCtl_qCtl InjMass 13 0.00 327.6700 FORMAT "%8.4" EXTENDED_LIMITS -327.6800 327.6700 DEPOSIT ABSOLUTE /end AXIS_DESCR
/end CHARACTERISTIC
/begin CHARACTERISTIC AirCtl_rCtlBase2_MAP "Kennfeld für Basisistwert der parallelen Steuerung für Gang 5 und 6" MAP 0x1C507E Kf_Xs16_Ys16_Ws16 100.0000 Prc 0.00 100.0000 FORMAT "%8.4" EXTENDED_LIMITS -327.6800 327.6700
 /begin AXIS_DESCR STD_AXIS Eng_nAvrg EngN 16 0.00 6000.000 FORMAT "%8.3" EXTENDED_LIMITS -32768.00 32767.00 DEPOSIT ABSOLUTE /end AXIS_DESCR
 /begin AXIS_DESCR STD_AXIS AirCtl_qCtl InjMass 13 0.00 327.6700 FORMAT "%8.4" EXTENDED_LIMITS -327.6800 327.6700 DEPOSIT ABSOLUTE /end AXIS_DESCR
/end CHARACTERISTIC
/begin CHARACTERISTIC AirCtl_rThresPointLow_C "Unterer Schwellwert der Hysterese des Steueranteils" VALUE 0x1C82EA Kw_Ws16 100.0000 Prc 0.00 100.0000 FORMAT "%8.4" EXTENDED_LIMITS -327.6800 327.6700 /end CHARACTERISTIC
/begin CHARACTERISTIC AirCtl_rThresPointHigh_C "Oberer Schwellwert der Hysterese des Steueranteils" VALUE 0x1C82EC Kw_Ws16 100.0000 Prc 0.00 100.0000 FORMAT "%8.4" EXTENDED_LIMITS -327.6800 327.6700 /end CHARACTERISTIC
/begin CHARACTERISTIC AirCtl_YLow_C "Ausgangswert der Steuerungshysterese bei LOW" VALUE 0x1C82EE Kw_Ws16 100.0000 Prc 0.00 100.0000 FORMAT "%8.4" EXTENDED_LIMITS -327.6800 327.6700 /end CHARACTERISTIC
/begin CHARACTERISTIC AirCtl_YHigh_C "Ausgangswert der Steuerungshysterese bei HIGH" VALUE 0x1C82F0 Kw_Ws16 100.0000 Prc 0.00 100.0000 FORMAT "%8.4" EXTENDED_LIMITS -327.6800 327.6700 /end CHARACTERISTIC
/begin CHARACTERISTIC AirCtl_rCtlRgn1a_MAP "Kennfeld für den Steuerungswert  A der Partikelfilterregeneration 1" MAP 0x1C525C Kf_Xs16_Ys16_Ws16 655.3500 Prc -327.6800 327.6700 FORMAT "%8.4"
 /begin AXIS_DESCR STD_AXIS Eng_nAvrg EngN 16 0.00 6000.000 FORMAT "%8.3" EXTENDED_LIMITS -32768.00 32767.00 DEPOSIT ABSOLUTE /end AXIS_DESCR
 /begin AXIS_DESCR STD_AXIS AirCtl_qCtl InjMass 16 0.00 327.6700 FORMAT "%8.4" EXTENDED_LIMITS -327.6800 327.6700 DEPOSIT ABSOLUTE /end AXIS_DESCR
/end CHARACTERISTIC
/begin CHARACTERISTIC AirCtl_rCtlRgn1b_MAP "Kennfeld für den Steuerungswert  B der Partikelfilterregeneration 1" MAP 0x1C54A0 Kf_Xs16_Ys16_Ws16 655.3500 Prc -327.6800 327.6700 FORMAT "%8.4"
 /begin AXIS_DESCR STD_AXIS Eng_nAvrg EngN 16 0.00 6000.000 FORMAT "%8.3" EXTENDED_LIMITS -32768.00 32767.00 DEPOSIT ABSOLUTE /end AXIS_DESCR
 /begin AXIS_DESCR STD_AXIS AirCtl_qCtl InjMass 16 0.00 327.6700 FORMAT "%8.4" EXTENDED_LIMITS -327.6800 327.6700 DEPOSIT ABSOLUTE /end AXIS_DESCR
/end CHARACTERISTIC
/begin CHARACTERISTIC AirCtl_rCtlRgn2a_MAP "Kennfeld für den Steuerungswert  A der Partikelfilterregeneration 2" MAP 0x1C56E4 Kf_Xs16_Ys16_Ws16 655.3500 Prc -327.6800 327.6700 FORMAT "%8.4"
 /begin AXIS_DESCR STD_AXIS Eng_nAvrg EngN 16 0.00 6000.000 FORMAT "%8.3" EXTENDED_LIMITS -32768.00 32767.00 DEPOSIT ABSOLUTE /end AXIS_DESCR
 /begin AXIS_DESCR STD_AXIS AirCtl_qCtl InjMass 16 0.00 327.6700 FORMAT "%8.4" EXTENDED_LIMITS -327.6800 327.6700 DEPOSIT ABSOLUTE /end AXIS_DESCR
/end CHARACTERISTIC
/begin CHARACTERISTIC AirCtl_rCtlRgn2b_MAP "Kennfeld für den Steuerungswert  B der Partikelfilterregeneration 2" MAP 0x1C5928 Kf_Xs16_Ys16_Ws16 655.3500 Prc -327.6800 327.6700 FORMAT "%8.4"
 /begin AXIS_DESCR STD_AXIS Eng_nAvrg EngN 16 0.00 6000.000 FORMAT "%8.3" EXTENDED_LIMITS -32768.00 32767.00 DEPOSIT ABSOLUTE /end AXIS_DESCR
 /begin AXIS_DESCR STD_AXIS AirCtl_qCtl InjMass 16 0.00 327.6700 FORMAT "%8.4" EXTENDED_LIMITS -327.6800 327.6700 DEPOSIT ABSOLUTE /end AXIS_DESCR
/end CHARACTERISTIC
/begin CHARACTERISTIC AirCtl_rCtlRgn3a_MAP "Steuerwert Regenerationsstufe 3 bei Atmosphärendruck ""a""" MAP 0x1C5B6C Kf_Xs16_Ys16_Ws16 655.3500 Prc -327.6800 327.6700 FORMAT "%8.4"
 /begin AXIS_DESCR STD_AXIS Eng_nAvrg EngN 16 0.00 6000.000 FORMAT "%8.3" EXTENDED_LIMITS -32768.00 32767.00 DEPOSIT ABSOLUTE /end AXIS_DESCR
 /begin AXIS_DESCR STD_AXIS AirCtl_qCtl InjMass 16 0.00 327.6700 FORMAT "%8.4" EXTENDED_LIMITS -327.6800 327.6700 DEPOSIT ABSOLUTE /end AXIS_DESCR
/end CHARACTERISTIC
/begin CHARACTERISTIC AirCtl_rCtlRgn3b_MAP "Steuerwert Regenerationsstufe 3 bei Atmosphärendruck ""b""" MAP 0x1C5DB0 Kf_Xs16_Ys16_Ws16 655.3500 Prc -327.6800 327.6700 FORMAT "%8.4"
 /begin AXIS_DESCR STD_AXIS Eng_nAvrg EngN 16 0.00 6000.000 FORMAT "%8.3" EXTENDED_LIMITS -32768.00 32767.00 DEPOSIT ABSOLUTE /end AXIS_DESCR
 /begin AXIS_DESCR STD_AXIS AirCtl_qCtl InjMass 16 0.00 327.6700 FORMAT "%8.4" EXTENDED_LIMITS -327.6800 327.6700 DEPOSIT ABSOLUTE /end AXIS_DESCR
/end CHARACTERISTIC
/begin CHARACTERISTIC AirCtl_rEGRDflBPDem_C "Vorgabewert für Stellgröße des ARF-Ventils bei Abschaltursache Ladedruckanforderung" VALUE 0x1C9EF6 Kw_Ws16 300.0000 Prc -100.0000 200.0000 FORMAT "%8.4" EXTENDED_LIMITS -327.6800 327.6700 /end CHARACTERISTIC
/begin CHARACTERISTIC AirCtl_rEGRDflBPLoDet_C "Vorgabewert für Stellgröße des ARF-Ventils bei Abschaltursache Saugrohrunterdruck" VALUE 0x1C9EF8 Kw_Ws16 300.0000 Prc -100.0000 200.0000 FORMAT "%8.4" EXTENDED_LIMITS -327.6800 327.6700 /end CHARACTERISTIC
/begin CHARACTERISTIC AirCtl_rEGRDflClsd_C "Vorgabewert fuer AGR Ventil im Nachlauf und Motor aus" VALUE 0x1C9EFA Kw_Ws16 300.0000 Prc -100.0000 200.0000 FORMAT "%8.4" EXTENDED_LIMITS -327.6800 327.6700 /end CHARACTERISTIC
/begin CHARACTERISTIC AirCtl_rEGRDflEngPrt_C "Vorgabewert für Stellgröße des ARF-Ventils bei Abschaltursache Überdrehzahlerkennung" VALUE 0x1C9EFC Kw_Ws16 300.0000 Prc -100.0000 200.0000 FORMAT "%8.4" EXTENDED_LIMITS -327.6800 327.6700 /end CHARACTERISTIC
/begin CHARACTERISTIC AirCtl_rEGRDflGearShft_C "Vorgabewert für Stellgröße des ARF-Ventils bei Abschaltursache Schaltvorgang" VALUE 0x1C9EFE Kw_Ws16 100.0000 Prc 0.00 100.0000 FORMAT "%8.4" EXTENDED_LIMITS -327.6800 327.6700 /end CHARACTERISTIC
/begin CHARACTERISTIC AirCtl_rEGRDflLoAirTemp_C "Vorgabewert für Stellgröße des ARF-Ventils bei Abschaltursache zu niedrige Lufttemperatur" VALUE 0x1C9F00 Kw_Ws16 100.0000 Prc 0.00 100.0000 FORMAT "%8.4" EXTENDED_LIMITS -327.6800 327.6700 /end CHARACTERISTIC
/begin CHARACTERISTIC AirCtl_rEGRDflLogin_C "VGW für Stellgröße des AGF -Ventils bei Abschaltung durch Login" VALUE 0x1C9F02 Kw_Ws16 100.0000 Prc 0.00 100.0000 FORMAT "%8.4" EXTENDED_LIMITS -327.6800 327.6700 /end CHARACTERISTIC
/begin CHARACTERISTIC AirCtl_rEGRDflOvrRun_C "Vorgabewert für Stellgröße des ARF-Ventils bei Abschaltursache Schubbetrieb" VALUE 0x1C9F04 Kw_Ws16 100.0000 Prc 0.00 100.0000 FORMAT "%8.4" EXTENDED_LIMITS -327.6800 327.6700 /end CHARACTERISTIC
/begin CHARACTERISTIC AirCtl_rEGRDflRgnShOff_C "Vorgabewert für Stellgröße des ARF-Ventils bei Abschaltursache Abgasnachbehandlung" VALUE 0x1C9F06 Kw_Ws16 300.0000 Prc -100.0000 200.0000 FORMAT "%8.4" EXTENDED_LIMITS -327.6800 327.6700 /end CHARACTERISTIC
/begin CHARACTERISTIC AirCtl_rEGRDflShOffCo_C "Vorgabewert für Stellgröße des ARF-Ventils bei Abschaltanforderung durch Abschaltkoordinator" VALUE 0x1C9F08 Kw_Ws16 300.0000 Prc -100.0000 200.0000 FORMAT "%8.4" EXTENDED_LIMITS -327.6800 327.6700 /end CHARACTERISTIC
/begin CHARACTERISTIC AirCtl_rEGRDflShOff_C "Vorgabewert für Stellgröße des ARF-Ventils bei Abschaltung" VALUE 0x1C9F0A Kw_Ws16 100.0000 Prc 0.00 100.0000 FORMAT "%8.4" EXTENDED_LIMITS -327.6800 327.6700 /end CHARACTERISTIC
/begin CHARACTERISTIC AirCtl_rEGRDflVlvShOff_C "Default-Stellgroesse fuer Abgasrückführung bei EGR-Ventilschutz" VALUE 0x1C9F0C Kw_Ws16 300.0000 Prc -100.0000 200.0000 FORMAT "%8.4" EXTENDED_LIMITS -327.6800 327.6700 /end CHARACTERISTIC
/begin CHARACTERISTIC AirCtl_rEGRGearChngRgn_MAP "EGR Stellerwert während der Anti-Kaudern-Gangwechselerkennung und Partikelfilterregeneration" MAP 0x1C9F0E Kf_Xs16_Ys16_Ws16 100.0000 Prc 0.00 100.0000 FORMAT "%8.4" EXTENDED_LIMITS -327.6800 327.6700
 /begin AXIS_DESCR STD_AXIS PCR_nAvrgFrz EngN 6 0.00 6000.000 FORMAT "%8.3" EXTENDED_LIMITS -32768.00 32767.00 DEPOSIT ABSOLUTE /end AXIS_DESCR
 /begin AXIS_DESCR STD_AXIS PCR_rBPAPRatFrz Fact 6 0.00 3.000000 FORMAT "%8.6" EXTENDED_LIMITS -4.000000 3.999878 DEPOSIT ABSOLUTE /end AXIS_DESCR
/end CHARACTERISTIC
/begin CHARACTERISTIC AirCtl_rEGRGearChng_MAP "EGR Stellerwert während der Anti-Kaudern-Gangwechselerkennung" MAP 0x1C9F72 Kf_Xs16_Ys16_Ws16 100.0000 Prc 0.00 100.0000 FORMAT "%8.4" EXTENDED_LIMITS -327.6800 327.6700
 /begin AXIS_DESCR STD_AXIS PCR_nAvrgFrz EngN 6 0.00 6000.000 FORMAT "%8.3" EXTENDED_LIMITS -32768.00 32767.00 DEPOSIT ABSOLUTE /end AXIS_DESCR
 /begin AXIS_DESCR STD_AXIS PCR_rBPAPRatFrz Fact 6 0.00 3.000000 FORMAT "%8.6" EXTENDED_LIMITS -4.000000 3.999878 DEPOSIT ABSOLUTE /end AXIS_DESCR
/end CHARACTERISTIC
/begin CHARACTERISTIC AirCtl_rEGRMax_C "Maximales Tastverhältnis von AirCtl_rEGR der Ladedruckanforderung" VALUE 0x1C489E Kw_Ws16 400.0000 DtyCyc -200.0000 200.0000 FORMAT "%8.4" EXTENDED_LIMITS -327.6800 327.6700 /end CHARACTERISTIC
/begin CHARACTERISTIC AirCtl_rEGROvrRunRgn_MAP "EGR Stellerwert während der Anti-Kaudern-Schuberkennung und Partikelfilterregeneration" MAP 0x1C9FD6 Kf_Xs16_Ys16_Ws16 100.0000 Prc 0.00 100.0000 FORMAT "%8.4" EXTENDED_LIMITS -327.6800 327.6700
 /begin AXIS_DESCR STD_AXIS PCR_nAvrgFrz EngN 6 0.00 6000.000 FORMAT "%8.3" EXTENDED_LIMITS -32768.00 32767.00 DEPOSIT ABSOLUTE /end AXIS_DESCR
 /begin AXIS_DESCR STD_AXIS PCR_rBPAPRatFrz Fact 6 0.00 3.000000 FORMAT "%8.6" EXTENDED_LIMITS -4.000000 3.999878 DEPOSIT ABSOLUTE /end AXIS_DESCR
/end CHARACTERISTIC
/begin CHARACTERISTIC AirCtl_rEGROvrRun_C "vorläufiger Wert für das EGR im Fall der Schuberkennung bei der Anti-Kaudern-Maßnahme" VALUE 0x1CA03A Kw_Ws16 100.0000 Prc 0.00 100.0000 FORMAT "%8.4" EXTENDED_LIMITS -327.6800 327.6700 /end CHARACTERISTIC
/begin CHARACTERISTIC AirCtl_rEGROvrRun_MAP "EGR Stellerwert während der Anti-Kaudern-Schuberkennung" MAP 0x1CA03C Kf_Xs16_Ys16_Ws16 100.0000 Prc 0.00 100.0000 FORMAT "%8.4" EXTENDED_LIMITS -327.6800 327.6700
 /begin AXIS_DESCR STD_AXIS PCR_nAvrgFrz EngN 6 0.00 6000.000 FORMAT "%8.3" EXTENDED_LIMITS -32768.00 32767.00 DEPOSIT ABSOLUTE /end AXIS_DESCR
 /begin AXIS_DESCR STD_AXIS PCR_rBPAPRatFrz Fact 6 0.00 3.000000 FORMAT "%8.6" EXTENDED_LIMITS -4.000000 3.999878 DEPOSIT ABSOLUTE /end AXIS_DESCR
/end CHARACTERISTIC
/begin CHARACTERISTIC AirCtl_rEGR_MAP "Kennfeld für Abgasrückführventilstellgröße" MAP 0x1C82F2 Kf_Xs16_Ys16_Ws16 300.0000 Prc -100.0000 200.0000 FORMAT "%8.4" EXTENDED_LIMITS -327.6800 327.6700
 /begin AXIS_DESCR STD_AXIS Eng_nAvrg EngN 10 0.00 6000.000 FORMAT "%8.3" EXTENDED_LIMITS -32768.00 32767.00 DEPOSIT ABSOLUTE /end AXIS_DESCR
 /begin AXIS_DESCR STD_AXIS AirCtl_rGovOut_mp Prc 10 -327.6800 327.6700 FORMAT "%8.4" DEPOSIT ABSOLUTE /end AXIS_DESCR
/end CHARACTERISTIC
/begin CHARACTERISTIC AirCtl_RevThres_CUR "Kühlmitteltemperaturabhängiger Schwellwert für den Umdrehungszähler seit Startabwurf" CURVE 0x1C7A08 Kl_Xs16_Ws16 32760.00 OneToOne 0.00 32760.00 FORMAT "%8.2" EXTENDED_LIMITS -32768.00 32767.00
 /begin AXIS_DESCR STD_AXIS AirCtl_tRevThres_mp Temp_Cels 8 -50.14000 149.8600 FORMAT "%8.4" EXTENDED_LIMITS -3549.940 3003.560 DEPOSIT ABSOLUTE /end AXIS_DESCR
/end CHARACTERISTIC
/begin CHARACTERISTIC AirCtl_RgnDT1_C "Zeitkonstante des DT1-Glieds bei der ARF für Partikelfilter Regeneration" VALUE 0x1C83E8 Kw_Wu32 4294.9663 TimeDelay_s 0.0010000001 4294.9673 FORMAT "%9.4" EXTENDED_LIMITS 0.0000010000000 4294.9673 /end CHARACTERISTIC
/begin CHARACTERISTIC AirCtl_RgnDKd_C "Grundwert der Verstärkung des DT1-Glieds bei Kleinsignalen für Partikelfilter Regeneration" VALUE 0x1C83EC Kw_Ws32 100.000000000 Kd_InjMass2Prc -50.0000000000 50.0000000000 FORMAT "%13.10" EXTENDED_LIMITS -32768.0000000 32767.9999847 /end CHARACTERISTIC
/begin CHARACTERISTIC AirCtl_RgnDKdPos_C "Grundwert der Verstärkung des DT1-Glieds bei positiven Großsignalen für partikelfilter Regeneration" VALUE 0x1C83F0 Kw_Ws32 100.000000000 Kd_InjMass2Prc -50.0000000000 50.0000000000 FORMAT "%13.10" EXTENDED_LIMITS -32768.0000000 32767.9999847 /end CHARACTERISTIC
/begin CHARACTERISTIC AirCtl_RgnDKdNeg_C "Grundwert der Verstärkung des DT1-Glieds bei negativen Großsignalen für Partikelfilter Regeneration" VALUE 0x1C83F4 Kw_Ws32 100.000000000 Kd_InjMass2Prc -50.0000000000 50.0000000000 FORMAT "%13.10" EXTENDED_LIMITS -32768.0000000 32767.9999847 /end CHARACTERISTIC
/begin CHARACTERISTIC AirCtl_dqRgnDWinPos_C "obere Kleinsignalgrenze für das DT1- Glied für Partikelfilter Regeneration" VALUE 0x1C83F8 Kw_Ws16 16383.50 InjMassPerSec_20ms 0.00 16383.50 FORMAT "%8.2" EXTENDED_LIMITS -16384.00 16383.50 /end CHARACTERISTIC
/begin CHARACTERISTIC AirCtl_dqRgnDWinNeg_C "untere Kleinsignalgrenze für das DT1- Glied für Partikelfilter Regeneration" VALUE 0x1C83FA Kw_Ws16 16384.00 InjMassPerSec_20ms -16384.00 0.00 FORMAT "%8.2" EXTENDED_LIMITS -16384.00 16383.50 /end CHARACTERISTIC
/begin CHARACTERISTIC AirCtl_RgnIKi_C "Grundwert der I-Verstärkung des PI-Reglers bei Kleinsignalen für Partikelfilter Regeneration" VALUE 0x1C83FC Kw_Wu32 4.99999150634 Ki_Ampc2Prc 0.00 4.99999150634 FORMAT "%13.11" EXTENDED_LIMITS 0.00 99999.9999767 /end CHARACTERISTIC
/begin CHARACTERISTIC AirCtl_RgnIKiPos_C "Grundwert der I-Verstärkung des PI-Reglers bei positiven Großsignalen für Partikelfilter Regeneration" VALUE 0x1C8400 Kw_Wu32 4.99999150634 Ki_Ampc2Prc 0.00 4.99999150634 FORMAT "%13.11" EXTENDED_LIMITS 0.00 99999.9999767 /end CHARACTERISTIC
/begin CHARACTERISTIC AirCtl_RgnIKiNeg_C "Grundwert der I-Verstärkung des PI-Reglers bei negativen Großsignalen für Partikelfilter Regeneration" VALUE 0x1C8404 Kw_Wu32 4.99999150634 Ki_Ampc2Prc 0.00 4.99999150634 FORMAT "%13.11" EXTENDED_LIMITS 0.00 99999.9999767 /end CHARACTERISTIC
/begin CHARACTERISTIC AirCtl_mRgnIWinPos_C "obere Kleinsignalgrenze für den I-Kanal des PI-Reglers für Partikelfilter Regeneration" VALUE 0x1C8408 Kw_Ws16 1500.000 AirMassPerCyl 0.00 1500.000 FORMAT "%8.3" EXTENDED_LIMITS -3276.800 3276.700 /end CHARACTERISTIC
/begin CHARACTERISTIC AirCtl_mRgnIWinNeg_C "untere Kleinsignalgrenze für den I-Kanal des PI-Reglers für Partikelfilter Regeneration" VALUE 0x1C840A Kw_Ws16 1500.000 AirMassPerCyl -1500.000 0.00 FORMAT "%8.3" EXTENDED_LIMITS -3276.800 3276.700 /end CHARACTERISTIC
/begin CHARACTERISTIC AirCtl_RgnPKp_C "Grundwert der P-Verstärkung des PI-Reglers bei Kleinsignalen für Partikelfilter Regeneration" VALUE 0x1C840C Kw_Wu32 10.0000000000 Kp_Ampc2Prc 0.00 10.0000000000 FORMAT "%13.10" EXTENDED_LIMITS 0.00 6553.59999847 /end CHARACTERISTIC
/begin CHARACTERISTIC AirCtl_RgnPKpPos_C "Grundwert der P-Verstärkung des PI-Reglers bei positiven Großsignalen für Partikelfilter Regeneration" VALUE 0x1C8410 Kw_Wu32 10.0000000000 Kp_Ampc2Prc 0.00 10.0000000000 FORMAT "%13.10" EXTENDED_LIMITS 0.00 6553.59999847 /end CHARACTERISTIC
/begin CHARACTERISTIC AirCtl_RgnPKpNeg_C "Grundwert der P-Verstärkung des PI-Reglers bei negativen Großsignalen für Partikelfilter Regeneration" VALUE 0x1C8414 Kw_Wu32 10.0000000000 Kp_Ampc2Prc 0.00 10.0000000000 FORMAT "%13.10" EXTENDED_LIMITS 0.00 6553.59999847 /end CHARACTERISTIC
/begin CHARACTERISTIC AirCtl_mRgnPWinPos_C "obere Kleinsignalgrenze für den P-Kanal des PI-Reglers für Partikelfilter Regeneration" VALUE 0x1C8418 Kw_Ws16 1500.000 AirMassPerCyl 0.00 1500.000 FORMAT "%8.3" EXTENDED_LIMITS -3276.800 3276.700 /end CHARACTERISTIC
/begin CHARACTERISTIC AirCtl_mRgnPWinNeg_C "untere Kleinsignalgrenze für den P-Kanal des PI-Reglers für Partikelfilter Regeneration" VALUE 0x1C841A Kw_Ws16 1500.000 AirMassPerCyl -1500.000 0.00 FORMAT "%8.3" EXTENDED_LIMITS -3276.800 3276.700 /end CHARACTERISTIC
/begin CHARACTERISTIC AirCtl_rGovBrkCor_CUR "Kennlinie zur Einspritzmengenkorrektur auf Grund Bremsenstatus und Wahlhebelposition" CURVE 0x1C841C Kl_Xs16_Ws16 300.0000 Prc -100.0000 200.0000 FORMAT "%8.4" EXTENDED_LIMITS -327.6800 327.6700
 /begin AXIS_DESCR STD_AXIS Eng_nAvrg EngN 4 0.00 6000.000 FORMAT "%8.3" EXTENDED_LIMITS -32768.00 32767.00 DEPOSIT ABSOLUTE /end AXIS_DESCR
/end CHARACTERISTIC
/begin CHARACTERISTIC AirCtl_rGovEGRMax_C "maximal zulässige Abgasrückführventilstellgröße" VALUE 0x1C842E Kw_Ws16 300.0000 Prc -100.0000 200.0000 FORMAT "%8.4" EXTENDED_LIMITS -327.6800 327.6700 /end CHARACTERISTIC
/begin CHARACTERISTIC AirCtl_rGovEGRMin_C "minimal zulässige Abgasrückführventilstellgröße" VALUE 0x1C8430 Kw_Ws16 300.0000 Prc -100.0000 200.0000 FORMAT "%8.4" EXTENDED_LIMITS -327.6800 327.6700 /end CHARACTERISTIC
/begin CHARACTERISTIC AirCtl_rGovThres1Low_C "Hystereseschwelle Low, 1. Teil von Dreifachhysterese" VALUE 0x1C8432 Kw_Ws16 100.0000 Prc 0.00 100.0000 FORMAT "%8.4" EXTENDED_LIMITS -327.6800 327.6700 /end CHARACTERISTIC
/begin CHARACTERISTIC AirCtl_rGovThres1High_C "Hystereseschwelle High, 1. Teil von Dreifachhysterese" VALUE 0x1C8434 Kw_Ws16 100.0000 Prc 0.00 100.0000 FORMAT "%8.4" EXTENDED_LIMITS -327.6800 327.6700 /end CHARACTERISTIC
/begin CHARACTERISTIC AirCtl_rGovY1Low_C "Hystereseausgang Low, 1. Teil von Dreifachhysterese" VALUE 0x1C8436 Kw_Ws16 100.0000 Prc 0.00 100.0000 FORMAT "%8.4" EXTENDED_LIMITS -327.6800 327.6700 /end CHARACTERISTIC
/begin CHARACTERISTIC AirCtl_rGovY1High_C "Hystereseausgang High, 1. Teil von Dreifachhysterese" VALUE 0x1C8438 Kw_Ws16 100.0000 Prc 0.00 100.0000 FORMAT "%8.4" EXTENDED_LIMITS -327.6800 327.6700 /end CHARACTERISTIC
/begin CHARACTERISTIC AirCtl_rGovThres2Low_C "Hystereseschwelle Low, 2. Teil von Dreifachhysterese" VALUE 0x1C843A Kw_Ws16 100.0000 Prc 0.00 100.0000 FORMAT "%8.4" EXTENDED_LIMITS -327.6800 327.6700 /end CHARACTERISTIC
/begin CHARACTERISTIC AirCtl_rGovThres2High_C "Hystereseschwelle High, 2. Teil von Dreifachhysterese" VALUE 0x1C843C Kw_Ws16 100.0000 Prc 0.00 100.0000 FORMAT "%8.4" EXTENDED_LIMITS -327.6800 327.6700 /end CHARACTERISTIC
/begin CHARACTERISTIC AirCtl_rGovY2Low_C "Hystereseausgang Low, 2. Teil von Dreifachhysterese" VALUE 0x1C843E Kw_Ws16 100.0000 Prc 0.00 100.0000 FORMAT "%8.4" EXTENDED_LIMITS -327.6800 327.6700 /end CHARACTERISTIC
/begin CHARACTERISTIC AirCtl_rGovY2High_C "Hystereseausgang High, 2. Teil von Dreifachhysterese" VALUE 0x1C8440 Kw_Ws16 100.0000 Prc 0.00 100.0000 FORMAT "%8.4" EXTENDED_LIMITS -327.6800 327.6700 /end CHARACTERISTIC
/begin CHARACTERISTIC AirCtl_rGovMax_C "maximal zulässige Reglerstellgröße" VALUE 0x1C8442 Kw_Ws16 300.0000 Prc -100.0000 200.0000 FORMAT "%8.4" EXTENDED_LIMITS -327.6800 327.6700 /end CHARACTERISTIC
/begin CHARACTERISTIC AirCtl_rGovMin_C "minimal zulässige Reglerstellgröße" VALUE 0x1C8444 Kw_Ws16 300.0000 Prc -100.0000 200.0000 FORMAT "%8.4" EXTENDED_LIMITS -327.6800 327.6700 /end CHARACTERISTIC
/begin CHARACTERISTIC AirCtl_rGovOut_mp_Vector "Konfigurationslabel für Bypass Freischnitt" VALUE 0x1C0A36 Kw_Wu8 255.0 OneToOne 0.00 255.0 FORMAT "%5.1" /end CHARACTERISTIC
/begin CHARACTERISTIC AirCtl_rGovOut_mp_Channel "Konfigurationslabel für Bypass Freischnitt" VALUE 0x1C0A37 Kw_Wu8 255.0 OneToOne 0.00 255.0 FORMAT "%5.1" /end CHARACTERISTIC
/begin CHARACTERISTIC AirCtl_rGovPCor_MAP "Luftdruckkorrekturkennfeld für Drosselklappe im Steuerungspfad" MAP 0x1C8446 Kf_Xs16_Ys16_Ws16 300.0000 Prc -100.0000 200.0000 FORMAT "%8.4" EXTENDED_LIMITS -327.6800 327.6700
 /begin AXIS_DESCR STD_AXIS InjCtl_qDes InjMass 9 0.00 327.6700 FORMAT "%8.4" EXTENDED_LIMITS -327.6800 327.6700 DEPOSIT ABSOLUTE /end AXIS_DESCR
 /begin AXIS_DESCR STD_AXIS AirCtl_pCor Pres_hPa 9 0.00 3500.000 FORMAT "%8.3" EXTENDED_LIMITS -32768.00 32767.00 DEPOSIT ABSOLUTE /end AXIS_DESCR
/end CHARACTERISTIC
/begin CHARACTERISTIC AirCtl_rGovQDes_MAP "Hauptkennfeld für Drosselklappe im Steuerungspfad" MAP 0x1C8510 Kf_Xs16_Ys16_Ws16 300.0000 Prc -100.0000 200.0000 FORMAT "%8.4" EXTENDED_LIMITS -327.6800 327.6700
 /begin AXIS_DESCR STD_AXIS Eng_nAvrg EngN 10 0.00 6000.000 FORMAT "%8.3" EXTENDED_LIMITS -32768.00 32767.00 DEPOSIT ABSOLUTE /end AXIS_DESCR
 /begin AXIS_DESCR STD_AXIS InjCtl_qDes InjMass 10 0.00 327.6700 FORMAT "%8.4" EXTENDED_LIMITS -327.6800 327.6700 DEPOSIT ABSOLUTE /end AXIS_DESCR
/end CHARACTERISTIC
/begin CHARACTERISTIC AirCtl_rGovRgnMax_C "Maximale Luftmassenregelwert während Regeneration" VALUE 0x1C8604 Kw_Ws16 300.0000 Prc -100.0000 200.0000 FORMAT "%8.4" EXTENDED_LIMITS -327.6800 327.6700 /end CHARACTERISTIC
/begin CHARACTERISTIC AirCtl_rGovRgnMin_MAP "Minimumwert der Luftmassenregelung während Regeneration" MAP 0x1C8606 Kf_Xs16_Ys16_Ws16 300.0000 Prc -100.0000 200.0000 FORMAT "%8.4" EXTENDED_LIMITS -327.6800 327.6700
 /begin AXIS_DESCR STD_AXIS Eng_nAvrg EngN 8 0.00 6000.000 FORMAT "%8.3" EXTENDED_LIMITS -32768.00 32767.00 DEPOSIT ABSOLUTE /end AXIS_DESCR
 /begin AXIS_DESCR STD_AXIS InjCtl_qCurr InjMass 8 0.00 327.6700 FORMAT "%8.4" EXTENDED_LIMITS -327.6800 327.6700 DEPOSIT ABSOLUTE /end AXIS_DESCR
/end CHARACTERISTIC
/begin CHARACTERISTIC AirCtl_rGovTEngCor_MAP "Temperaturkorrekturkennfeld für Drosselklappe im Steuerungspfad" MAP 0x1C86AA Kf_Xs16_Ys16_Ws16 300.0000 Prc -100.0000 200.0000 FORMAT "%8.4" EXTENDED_LIMITS -327.6800 327.6700
 /begin AXIS_DESCR STD_AXIS Eng_nAvrg EngN 10 0.00 6000.000 FORMAT "%8.3" EXTENDED_LIMITS -32768.00 32767.00 DEPOSIT ABSOLUTE /end AXIS_DESCR
 /begin AXIS_DESCR STD_AXIS Eng_tEng Temp_Cels 8 -50.14000 199.8600 FORMAT "%8.4" EXTENDED_LIMITS -3549.940 3003.560 DEPOSIT ABSOLUTE /end AXIS_DESCR
/end CHARACTERISTIC
/begin CHARACTERISTIC AirCtl_rGovTVA1Max_C "maximal zulässige Drosselklappenstellgröße im Steuerungspfad" VALUE 0x1C8772 Kw_Ws16 300.0000 Prc -100.0000 200.0000 FORMAT "%8.4" EXTENDED_LIMITS -327.6800 327.6700 /end CHARACTERISTIC
/begin CHARACTERISTIC AirCtl_rGovTVA1Min_C "minimal zulässige Drosselklappenstellgröße im Steuerungspfad" VALUE 0x1C8774 Kw_Ws16 300.0000 Prc -100.0000 200.0000 FORMAT "%8.4" EXTENDED_LIMITS -327.6800 327.6700 /end CHARACTERISTIC
/begin CHARACTERISTIC AirCtl_rGovTVAMax_C "maximal zulässige Drosselklappenstellgröße" VALUE 0x1C8776 Kw_Ws16 300.0000 Prc -100.0000 200.0000 FORMAT "%8.4" EXTENDED_LIMITS -327.6800 327.6700 /end CHARACTERISTIC
/begin CHARACTERISTIC AirCtl_rGovTVAMin_C "minimal zulässige Drosselklappenstellgröße" VALUE 0x1C8778 Kw_Ws16 300.0000 Prc -100.0000 200.0000 FORMAT "%8.4" EXTENDED_LIMITS -327.6800 327.6700 /end CHARACTERISTIC
/begin CHARACTERISTIC AirCtl_rGovTVA_Vector "Konfigurationslabel für Bypass Freischnitt" VALUE 0x1C0A38 Kw_Wu8 255.0 OneToOne 0.00 255.0 FORMAT "%5.1" /end CHARACTERISTIC
/begin CHARACTERISTIC AirCtl_rGovTVA_Channel "Konfigurationslabel für Bypass Freischnitt" VALUE 0x1C0A39 Kw_Wu8 255.0 OneToOne 0.00 255.0 FORMAT "%5.1" /end CHARACTERISTIC
/begin CHARACTERISTIC AirCtl_rIDflBPDem_C "Initialisierungswert des Reglers bei Abschaltursache Ladedruckanforderung" VALUE 0x1C877A Kw_Ws16 300.0000 Prc -100.0000 200.0000 FORMAT "%8.4" EXTENDED_LIMITS -327.6800 327.6700 /end CHARACTERISTIC
/begin CHARACTERISTIC AirCtl_rIDflColdStart_C "Initialisierungswert des Reglers bei Abschaltursache Kaltstart" VALUE 0x1C877C Kw_Ws16 300.0000 Prc -100.0000 200.0000 FORMAT "%8.4" EXTENDED_LIMITS -327.6800 327.6700 /end CHARACTERISTIC
/begin CHARACTERISTIC AirCtl_rIDflDiaLrnVal_C "Initialisierungswert des Reglers in Diagnosefall" VALUE 0x1C877E Kw_Ws16 300.0000 Prc -100.0000 200.0000 FORMAT "%8.4" EXTENDED_LIMITS -327.6800 327.6700 /end CHARACTERISTIC
/begin CHARACTERISTIC AirCtl_rIDflEGT_C "Initialisierungswert des Reglers bei Abschaltursache Regenerationsbeginn/ende" VALUE 0x1C8780 Kw_Ws16 300.0000 Prc -100.0000 200.0000 FORMAT "%8.4" EXTENDED_LIMITS -327.6800 327.6700 /end CHARACTERISTIC
/begin CHARACTERISTIC AirCtl_rIDflGearShft_C "Initialisierungswert des Reglers bei Abschaltursache Schaltvorgang" VALUE 0x1C8782 Kw_Ws16 300.0000 Prc -100.0000 200.0000 FORMAT "%8.4" EXTENDED_LIMITS -327.6800 327.6700 /end CHARACTERISTIC
/begin CHARACTERISTIC AirCtl_rIDflNoGov_C "Initialisierungswert des Reglers bei Abschaltursache Steuerung" VALUE 0x1C8784 Kw_Ws16 300.0000 Prc -100.0000 200.0000 FORMAT "%8.4" EXTENDED_LIMITS -327.6800 327.6700 /end CHARACTERISTIC
/begin CHARACTERISTIC AirCtl_rIDflNS_C "Vorgabewert 9 (Anti-Kaudern) für die Initialisierung des PI-Reglers" VALUE 0x1C8786 Kw_Ws16 300.0000 Prc -100.0000 200.0000 FORMAT "%8.4" EXTENDED_LIMITS -327.6800 327.6700 /end CHARACTERISTIC
/begin CHARACTERISTIC AirCtl_rIDflOvrRun_C "Initialisierungswert des Reglers bei Abschaltursache Schubbetrieb" VALUE 0x1C8788 Kw_Ws16 300.0000 Prc -100.0000 200.0000 FORMAT "%8.4" EXTENDED_LIMITS -327.6800 327.6700 /end CHARACTERISTIC
/begin CHARACTERISTIC AirCtl_rIDflShOffCo_C "Initialisierungswert des Reglers bei Abschaltanforderung durch Abschaltkoordinator" VALUE 0x1C878A Kw_Ws16 300.0000 Prc -100.0000 200.0000 FORMAT "%8.4" EXTENDED_LIMITS -327.6800 327.6700 /end CHARACTERISTIC
/begin CHARACTERISTIC AirCtl_rIDflShOff_C "Initialisierungswert des Reglers bei Abschaltung" VALUE 0x1C878C Kw_Ws16 300.0000 Prc -100.0000 200.0000 FORMAT "%8.4" EXTENDED_LIMITS -327.6800 327.6700 /end CHARACTERISTIC
/begin CHARACTERISTIC AirCtl_rLambdaLimRgn1_MAP "Kennfeld für Begrenzung I-Anteil durch Lambda für Regenerationsstufe 1" MAP 0x1C878E Kf_Xs16_Ys16_Ws16 300.0000 Prc -100.0000 200.0000 FORMAT "%8.4" EXTENDED_LIMITS -327.6800 327.6700
 /begin AXIS_DESCR STD_AXIS Eng_nAvrg EngN 3 0.00 6000.000 FORMAT "%8.3" EXTENDED_LIMITS -32768.00 32767.00 DEPOSIT ABSOLUTE /end AXIS_DESCR
 /begin AXIS_DESCR STD_AXIS AirCtl_rLmbd_mp lambda 3 -32.76800 32.76700 FORMAT "%8.5" DEPOSIT ABSOLUTE /end AXIS_DESCR
/end CHARACTERISTIC
/begin CHARACTERISTIC AirCtl_rLambdaLimRgn2_MAP "Kennfeld für Begrenzung I-Anteil durch Lambda für Regenerationsstufe 2" MAP 0x1C87B0 Kf_Xs16_Ys16_Ws16 300.0000 Prc -100.0000 200.0000 FORMAT "%8.4" EXTENDED_LIMITS -327.6800 327.6700
 /begin AXIS_DESCR STD_AXIS Eng_nAvrg EngN 3 0.00 6000.000 FORMAT "%8.3" EXTENDED_LIMITS -32768.00 32767.00 DEPOSIT ABSOLUTE /end AXIS_DESCR
 /begin AXIS_DESCR STD_AXIS AirCtl_rLmbd_mp lambda 3 -32.76800 32.76700 FORMAT "%8.5" DEPOSIT ABSOLUTE /end AXIS_DESCR
/end CHARACTERISTIC
/begin CHARACTERISTIC AirCtl_rLambdaLimRgn3_MAP "Kennfeld für Begrenzung I-Anteil durch Lambda für Regenerationsstufe 3" MAP 0x1C87D2 Kf_Xs16_Ys16_Ws16 300.0000 Prc -100.0000 200.0000 FORMAT "%8.4" EXTENDED_LIMITS -327.6800 327.6700
 /begin AXIS_DESCR STD_AXIS Eng_nAvrg EngN 3 0.00 6000.000 FORMAT "%8.3" EXTENDED_LIMITS -32768.00 32767.00 DEPOSIT ABSOLUTE /end AXIS_DESCR
 /begin AXIS_DESCR STD_AXIS AirCtl_rLmbd_mp lambda 3 -32.76800 32.76700 FORMAT "%8.5" DEPOSIT ABSOLUTE /end AXIS_DESCR
/end CHARACTERISTIC
/begin CHARACTERISTIC AirCtl_rLambdaLim_MAP "Kennfeld für I-Anteilbegrenzung des Reglers" MAP 0x1C87F4 Kf_Xs16_Ys16_Ws16 300.0000 Prc -100.0000 200.0000 FORMAT "%8.4" EXTENDED_LIMITS -327.6800 327.6700
 /begin AXIS_DESCR STD_AXIS Eng_nAvrg EngN 3 0.00 6000.000 FORMAT "%8.3" EXTENDED_LIMITS -32768.00 32767.00 DEPOSIT ABSOLUTE /end AXIS_DESCR
 /begin AXIS_DESCR STD_AXIS AirCtl_rLmbd_mp lambda 3 -32.76800 32.76700 FORMAT "%8.5" DEPOSIT ABSOLUTE /end AXIS_DESCR
/end CHARACTERISTIC
/begin CHARACTERISTIC AirCtl_tiPT1BPA_C "Zeitkonstante des PT1-Gliedes für die Filterung des TV des Ladedruckstellers" VALUE 0x1C48A0 Kw_Wu32 4294.9673 TimeDelay_s 0.0000010000000 4294.9673 FORMAT "%9.4" /end CHARACTERISTIC
/begin CHARACTERISTIC AirCtl_tiPT1EGR_C "Zeitkonstante des PT1-Gliedes für die Filterung des TV des Abgasrückführstellers" VALUE 0x1C48A4 Kw_Wu32 4294.9673 TimeDelay_s 0.0000010000000 4294.9673 FORMAT "%9.4" /end CHARACTERISTIC
/begin CHARACTERISTIC AirCtl_rRgn1EGROpnLp_MAP "Kennfeld für das AGR-Ventil im Regenerationsbetrieb 1, wenn dieses sich im gesteuerten Betrieb befindet" MAP 0x1C8816 Kf_Xs16_Ys16_Ws16 300.0000 Prc -100.0000 200.0000 FORMAT "%8.4" EXTENDED_LIMITS -327.6800 327.6700
 /begin AXIS_DESCR STD_AXIS Eng_nAvrg EngN 2 0.00 6000.000 FORMAT "%8.3" EXTENDED_LIMITS -32768.00 32767.00 DEPOSIT ABSOLUTE /end AXIS_DESCR
 /begin AXIS_DESCR STD_AXIS AirCtl_qCtl InjMass 2 0.00 327.6700 FORMAT "%8.4" EXTENDED_LIMITS -327.6800 327.6700 DEPOSIT ABSOLUTE /end AXIS_DESCR
/end CHARACTERISTIC
/begin CHARACTERISTIC AirCtl_rRgn1EGR_MAP "Kennfeld für Abgasrückführventil - Stellgröße bei Regenerationsbetrieb 1" MAP 0x1C882A Kf_Xs16_Ys16_Ws16 300.0000 Prc -100.0000 200.0000 FORMAT "%8.4" EXTENDED_LIMITS -327.6800 327.6700
 /begin AXIS_DESCR STD_AXIS Eng_nAvrg EngN 8 0.00 6000.000 FORMAT "%8.3" EXTENDED_LIMITS -32768.00 32767.00 DEPOSIT ABSOLUTE /end AXIS_DESCR
 /begin AXIS_DESCR STD_AXIS AirCtl_rGovOut_mp Prc 10 -327.6800 327.6700 FORMAT "%8.4" DEPOSIT ABSOLUTE /end AXIS_DESCR
/end CHARACTERISTIC
/begin CHARACTERISTIC AirCtl_rRgn1TVA_MAP "Kennfeld für Drosselklappenstellgröße bei Regenerationsbetrieb 1" MAP 0x1C88F2 Kf_Xs16_Ys16_Ws16 300.0000 Prc -100.0000 200.0000 FORMAT "%8.4" EXTENDED_LIMITS -327.6800 327.6700
 /begin AXIS_DESCR STD_AXIS Eng_nAvrg EngN 8 0.00 6000.000 FORMAT "%8.3" EXTENDED_LIMITS -32768.00 32767.00 DEPOSIT ABSOLUTE /end AXIS_DESCR
 /begin AXIS_DESCR STD_AXIS AirCtl_rGovOut_mp Prc 10 -327.6800 327.6700 FORMAT "%8.4" DEPOSIT ABSOLUTE /end AXIS_DESCR
/end CHARACTERISTIC
/begin CHARACTERISTIC AirCtl_rRgn2EGROpnLp_MAP "Kennfeld für das AGR-Ventil im Regenerationsbetrieb 2, wenn dieses sich im gesteuerten Betrieb befindet" MAP 0x1C89BA Kf_Xs16_Ys16_Ws16 300.0000 Prc -100.0000 200.0000 FORMAT "%8.4" EXTENDED_LIMITS -327.6800 327.6700
 /begin AXIS_DESCR STD_AXIS Eng_nAvrg EngN 8 0.00 6000.000 FORMAT "%8.3" EXTENDED_LIMITS -32768.00 32767.00 DEPOSIT ABSOLUTE /end AXIS_DESCR
 /begin AXIS_DESCR STD_AXIS AirCtl_qCtl InjMass 8 0.00 327.6700 FORMAT "%8.4" EXTENDED_LIMITS -327.6800 327.6700 DEPOSIT ABSOLUTE /end AXIS_DESCR
/end CHARACTERISTIC
/begin CHARACTERISTIC AirCtl_rRgn2EGR_MAP "Kennfeld für Abgasrückführventil - Stellgröße bei Regenerationsbetrieb 2" MAP 0x1C8A5E Kf_Xs16_Ys16_Ws16 300.0000 Prc -100.0000 200.0000 FORMAT "%8.4" EXTENDED_LIMITS -327.6800 327.6700
 /begin AXIS_DESCR STD_AXIS Eng_nAvrg EngN 8 0.00 6000.000 FORMAT "%8.3" EXTENDED_LIMITS -32768.00 32767.00 DEPOSIT ABSOLUTE /end AXIS_DESCR
 /begin AXIS_DESCR STD_AXIS AirCtl_rGovOut_mp Prc 10 -327.6800 327.6700 FORMAT "%8.4" DEPOSIT ABSOLUTE /end AXIS_DESCR
/end CHARACTERISTIC
/begin CHARACTERISTIC AirCtl_rRgn2TVA_MAP "Kennfeld für Drosselklappenstellgröße bei Regenerationsbetrieb 2" MAP 0x1C8B26 Kf_Xs16_Ys16_Ws16 300.0000 Prc -100.0000 200.0000 FORMAT "%8.4" EXTENDED_LIMITS -327.6800 327.6700
 /begin AXIS_DESCR STD_AXIS Eng_nAvrg EngN 8 0.00 6000.000 FORMAT "%8.3" EXTENDED_LIMITS -32768.00 32767.00 DEPOSIT ABSOLUTE /end AXIS_DESCR
 /begin AXIS_DESCR STD_AXIS AirCtl_rGovOut_mp Prc 10 -327.6800 327.6700 FORMAT "%8.4" DEPOSIT ABSOLUTE /end AXIS_DESCR
/end CHARACTERISTIC
/begin CHARACTERISTIC AirCtl_rTEngCorRgn_MAP "Konvertierungskurve Temp_Kelv -> %,Korrektur durch Motortemperatur für den Regenerationsbetrieb" MAP 0x1C5FF4 Kf_Xs16_Ys16_Ws16 100.0000 Prc 0.00 100.0000 FORMAT "%8.4" EXTENDED_LIMITS -327.6800 327.6700
 /begin AXIS_DESCR STD_AXIS Eng_nAvrg EngN 10 0.00 6000.000 FORMAT "%8.3" EXTENDED_LIMITS -32768.00 32767.00 DEPOSIT ABSOLUTE /end AXIS_DESCR
 /begin AXIS_DESCR STD_AXIS Eng_tEng Temp_Cels 8 -50.14000 199.8600 FORMAT "%8.4" EXTENDED_LIMITS -3549.940 3003.560 DEPOSIT ABSOLUTE /end AXIS_DESCR
/end CHARACTERISTIC
/begin CHARACTERISTIC AirCtl_rTEngCor_MAP "Kühlmitteltemperaturabhängige Korrektur" MAP 0x1C60BC Kf_Xs16_Ys16_Ws16 100.0000 Prc 0.00 100.0000 FORMAT "%8.4" EXTENDED_LIMITS -327.6800 327.6700
 /begin AXIS_DESCR STD_AXIS Eng_nAvrg EngN 10 0.00 6000.000 FORMAT "%8.3" EXTENDED_LIMITS -32768.00 32767.00 DEPOSIT ABSOLUTE /end AXIS_DESCR
 /begin AXIS_DESCR STD_AXIS Eng_tEng Temp_Cels 8 -50.14000 199.8600 FORMAT "%8.4" EXTENDED_LIMITS -3549.940 3003.560 DEPOSIT ABSOLUTE /end AXIS_DESCR
/end CHARACTERISTIC
/begin CHARACTERISTIC AirCtl_rTrmValCor_CUR "Konvertierung Luftmasse nach Prozent und Korrekturwert" CURVE 0x1C6184 Kl_Xs16_Ws16 655.3500 Prc -327.6800 327.6700 FORMAT "%8.4"
 /begin AXIS_DESCR STD_AXIS AirCtl_TrmValLim AirMassPerCyl 5 -400.0000 400.0000 FORMAT "%8.4" EXTENDED_LIMITS -3276.800 3276.700 DEPOSIT ABSOLUTE /end AXIS_DESCR
/end CHARACTERISTIC
/begin CHARACTERISTIC AirCtl_rTVADflBPDem_C "Vorgabewert für Stellgröße der Drosselklappe bei Abschaltursache Ladedruckanforderung" VALUE 0x1CA0A0 Kw_Ws16 300.0000 Prc -100.0000 200.0000 FORMAT "%8.4" EXTENDED_LIMITS -327.6800 327.6700 /end CHARACTERISTIC
/begin CHARACTERISTIC AirCtl_rTVADflBPLoDet_C "Vorgabewert für Stellgröße der Drosselklappe bei Abschaltursache Saugrohrunterdruck" VALUE 0x1CA0A2 Kw_Ws16 300.0000 Prc -100.0000 200.0000 FORMAT "%8.4" EXTENDED_LIMITS -327.6800 327.6700 /end CHARACTERISTIC
/begin CHARACTERISTIC AirCtl_rTVADflClsd_C "Drosselklappenstellung im Nachlauf und Motorstillstand" VALUE 0x1CA0A4 Kw_Ws16 100.0000 Prc 0.00 100.0000 FORMAT "%8.4" EXTENDED_LIMITS -327.6800 327.6700 /end CHARACTERISTIC
/begin CHARACTERISTIC AirCtl_rTVADflEngPrt_C "Vorgabewert für Stellgröße der Drosselklappe bei Abschaltursache Überdrehzahlerkennung" VALUE 0x1CA0A6 Kw_Ws16 300.0000 Prc -100.0000 200.0000 FORMAT "%8.4" EXTENDED_LIMITS -327.6800 327.6700 /end CHARACTERISTIC
/begin CHARACTERISTIC AirCtl_rTVADflGearShft_C "Vorgabewert für Stellgröße der Drosselklappe bei Abschaltursache Schaltvorgang" VALUE 0x1CA0A8 Kw_Ws16 300.0000 Prc -100.0000 200.0000 FORMAT "%8.4" EXTENDED_LIMITS -327.6800 327.6700 /end CHARACTERISTIC
/begin CHARACTERISTIC AirCtl_rTVADflLoAirTemp_C "Applikationswert für den low air temperature Fall wenn der Schalter aktiviert ist" VALUE 0x1CA0AA Kw_Ws16 100.0000 Prc 0.00 100.0000 FORMAT "%8.4" EXTENDED_LIMITS -327.6800 327.6700 /end CHARACTERISTIC
/begin CHARACTERISTIC AirCtl_rTVADflLogin_C "VGW für Drosselklappe nach EGR Abschaltung durch Login" VALUE 0x1CA0AC Kw_Ws16 100.0000 Prc 0.00 100.0000 FORMAT "%8.4" EXTENDED_LIMITS -327.6800 327.6700 /end CHARACTERISTIC
/begin CHARACTERISTIC AirCtl_rTVADflOvrRun_C "Vorgabewert für Stellgröße der Drosselklappe bei Abschaltursache Schubbetrieb" VALUE 0x1CA0AE Kw_Ws16 300.0000 Prc -100.0000 200.0000 FORMAT "%8.4" EXTENDED_LIMITS -327.6800 327.6700 /end CHARACTERISTIC
/begin CHARACTERISTIC AirCtl_rTVADflRgnShOff_C "Vorgabewert für Stellgröße der Drosselklappe bei Abschaltursache Abgasnachbehandlung" VALUE 0x1CA0B0 Kw_Ws16 300.0000 Prc -100.0000 200.0000 FORMAT "%8.4" EXTENDED_LIMITS -327.6800 327.6700 /end CHARACTERISTIC
/begin CHARACTERISTIC AirCtl_rTVADflShOffCo_C "Vorgabewert für Stellgröße der Drosselklappe bei Abschaltung durch Abschaltkoordinator" VALUE 0x1CA0B2 Kw_Ws16 300.0000 Prc -100.0000 200.0000 FORMAT "%8.4" EXTENDED_LIMITS -327.6800 327.6700 /end CHARACTERISTIC
/begin CHARACTERISTIC AirCtl_rTVADflShOff_C "Vorgabewert für Stellgröße der Drosselklappe bei Abschaltung" VALUE 0x1CA0B4 Kw_Ws16 300.0000 Prc -100.0000 200.0000 FORMAT "%8.4" EXTENDED_LIMITS -327.6800 327.6700 /end CHARACTERISTIC
/begin CHARACTERISTIC AirCtl_rTVAGearChngRgn_MAP "TVA Stellerwert während der Anti-Kaudern-Gangwechselerkennung und Partikelfilterregeneration" MAP 0x1CA0B6 Kf_Xs16_Ys16_Ws16 100.0000 Prc 0.00 100.0000 FORMAT "%8.4" EXTENDED_LIMITS -327.6800 327.6700
 /begin AXIS_DESCR STD_AXIS PCR_nAvrgFrz EngN 6 0.00 6000.000 FORMAT "%8.3" EXTENDED_LIMITS -32768.00 32767.00 DEPOSIT ABSOLUTE /end AXIS_DESCR
 /begin AXIS_DESCR STD_AXIS PCR_rBPAPRatFrz Fact 6 0.00 3.000000 FORMAT "%8.6" EXTENDED_LIMITS -4.000000 3.999878 DEPOSIT ABSOLUTE /end AXIS_DESCR
/end CHARACTERISTIC
/begin CHARACTERISTIC AirCtl_rTVALimMax_C "Max. Limit" VALUE 0x1C8BEE Kw_Ws16 300.0000 Prc -100.0000 200.0000 FORMAT "%8.4" EXTENDED_LIMITS -327.6800 327.6700 /end CHARACTERISTIC
/begin CHARACTERISTIC AirCtl_rTVALimMin_C "Min. Limit" VALUE 0x1C8BF0 Kw_Ws16 300.0000 Prc -100.0000 200.0000 FORMAT "%8.4" EXTENDED_LIMITS -327.6800 327.6700 /end CHARACTERISTIC
/begin CHARACTERISTIC AirCtl_rTVANSGearChng_C "TVA Stellerwert während der Anti-Kaudern-Gangwechselerkennung" VALUE 0x1CA11A Kw_Ws16 100.0000 Prc 0.00 100.0000 FORMAT "%8.4" EXTENDED_LIMITS -327.6800 327.6700 /end CHARACTERISTIC
/begin CHARACTERISTIC AirCtl_rTVANSOvrRun_C "TVA Stellerwert während der Anti-Kaudern-Schuberkennung" VALUE 0x1CA11C Kw_Ws16 100.0000 Prc 0.00 100.0000 FORMAT "%8.4" EXTENDED_LIMITS -327.6800 327.6700 /end CHARACTERISTIC
/begin CHARACTERISTIC AirCtl_rTVAOvrRunRgn_MAP "TVA Stellerwert während der Anti-Kaudern-Schuberkennung und Partikelfilterregeneration" MAP 0x1CA11E Kf_Xs16_Ys16_Ws16 100.0000 Prc 0.00 100.0000 FORMAT "%8.4" EXTENDED_LIMITS -327.6800 327.6700
 /begin AXIS_DESCR STD_AXIS PCR_nAvrgFrz EngN 6 0.00 6000.000 FORMAT "%8.3" EXTENDED_LIMITS -32768.00 32767.00 DEPOSIT ABSOLUTE /end AXIS_DESCR
 /begin AXIS_DESCR STD_AXIS PCR_rBPAPRatFrz Fact 6 0.00 3.000000 FORMAT "%8.6" EXTENDED_LIMITS -4.000000 3.999878 DEPOSIT ABSOLUTE /end AXIS_DESCR
/end CHARACTERISTIC
/begin CHARACTERISTIC AirCtl_rTVA_MAP "Kennfeld für Drosselklappenstellgröße" MAP 0x1C8BF2 Kf_Xs16_Ys16_Ws16 300.0000 Prc -100.0000 200.0000 FORMAT "%8.4" EXTENDED_LIMITS -327.6800 327.6700
 /begin AXIS_DESCR STD_AXIS Eng_nAvrg EngN 10 0.00 6000.000 FORMAT "%8.3" EXTENDED_LIMITS -32768.00 32767.00 DEPOSIT ABSOLUTE /end AXIS_DESCR
 /begin AXIS_DESCR STD_AXIS AirCtl_rGovOut_mp Prc 10 -327.6800 327.6700 FORMAT "%8.4" DEPOSIT ABSOLUTE /end AXIS_DESCR
/end CHARACTERISTIC
/begin CHARACTERISTIC AirCtl_stAftRunValCBV_C "Vorgabewert für EGR Kühler Bypass Ansteuerung im Nachlauf" VALUE 0x1C4998 Kw_Wu8 1.000 OneToOne 0.00 1.000 FORMAT "%5.3" EXTENDED_LIMITS 0.00 255.0 /end CHARACTERISTIC
/begin CHARACTERISTIC AirCtl_stATCorMsk_C "Maske für EGT-Status" VALUE 0x1C7A2C Kw_Wu32 4294967295.00 OneToOne 0.00 4294967295.00 FORMAT "%13.2" /end CHARACTERISTIC
/begin CHARACTERISTIC AirCtl_stCTCorMsk_C "Maske für EGT-Status" VALUE 0x1C7A30 Kw_Wu32 4294967295.00 OneToOne 0.00 4294967295.00 FORMAT "%13.2" /end CHARACTERISTIC
/begin CHARACTERISTIC AirCtl_stCtlRgnMsk_CA "Applizierbare Bitmasken für die Regenerationsstufen" VAL_BLK 0x1C619C Kwb_Wu32 4294967295.00 OneToOne 0.00 4294967295.00 FORMAT "%13.2" NUMBER 3 /end CHARACTERISTIC
/begin CHARACTERISTIC AirCtl_stDesBaseMsk_C "Bitmaske für die Einspritzcharakterabhängige Kennfeldum-schaltung." VALUE 0x1C7A34 Kw_Wu8 255.0 OneToOne 0.00 255.0 FORMAT "%5.1" /end CHARACTERISTIC
/begin CHARACTERISTIC AirCtl_stDesRgnMsk_CA "Applizierbare Bitmasken für die Regenerationsstufe" VAL_BLK 0x1C7A38 Kwb_Wu32 4294967295.00 OneToOne 0.00 4294967295.00 FORMAT "%13.2" NUMBER 3 /end CHARACTERISTIC
/begin CHARACTERISTIC AirCtl_stDflValCBV_C "Vorgabewert für EGR Kühler bypass" VALUE 0x1C4999 Kw_Wu8 1.000 OneToOne 0.00 1.000 FORMAT "%5.3" EXTENDED_LIMITS 0.00 255.0 /end CHARACTERISTIC
/begin CHARACTERISTIC AirCtl_stDiagStartCBV_C "Ausgang des EGR-Kühler Bypass nach Start" VALUE 0x1C499A Kw_Wu8 1.000 OneToOne 0.00 1.000 FORMAT "%5.3" EXTENDED_LIMITS 0.00 255.0 /end CHARACTERISTIC
/begin CHARACTERISTIC AirCtl_stGovDevRgnActvMsk_C "Maske für EGT_st zur Regenerationsmeldung im Regenerationsbetrieb" VALUE 0x1CA184 Kw_Wu32 4294967295.00 OneToOne 0.00 4294967295.00 FORMAT "%13.2" /end CHARACTERISTIC
/begin CHARACTERISTIC AirCtl_stGovDevRgnDeactvMsk_C "Maske für EGT_st zur Regenerationsmeldung im nicht Regenerationsbetrieb" VALUE 0x1CA188 Kw_Wu32 4294967295.00 OneToOne 0.00 4294967295.00 FORMAT "%13.2" /end CHARACTERISTIC
/begin CHARACTERISTIC AirCtl_stGovRgn1HysMsk_C "Bitmaske für Regenerationsanforderung 1 für Hysterese" VALUE 0x1C8CE8 Kw_Wu32 4294967295.00 OneToOne 0.00 4294967295.00 FORMAT "%13.2" /end CHARACTERISTIC
/begin CHARACTERISTIC AirCtl_stGovRgn1Msk_C "Bitmaske für Regenerationsanforderung 1 für Aufteilung der Stellgröße" VALUE 0x1C8CEC Kw_Wu32 4294967295.00 OneToOne 0.00 4294967295.00 FORMAT "%13.2" /end CHARACTERISTIC
/begin CHARACTERISTIC AirCtl_stGovRgn2HysMsk_C "Bitmaske für Regenerationsanforderung 2 für Hysterese" VALUE 0x1C8CF0 Kw_Wu32 4294967295.00 OneToOne 0.00 4294967295.00 FORMAT "%13.2" /end CHARACTERISTIC
/begin CHARACTERISTIC AirCtl_stGovRgn2Msk_C "Bitmaske für Regenerationsanforderung 2 für Aufteilung der Stellgröße" VALUE 0x1C8CF4 Kw_Wu32 4294967295.00 OneToOne 0.00 4294967295.00 FORMAT "%13.2" /end CHARACTERISTIC
/begin CHARACTERISTIC AirCtl_stGovRgnMsk_CA "Applizierbare Bitmasken für die Regenerationsstufen" VAL_BLK 0x1C8CF8 Kwb_Wu32 4294967295.00 OneToOne 0.00 4294967295.00 FORMAT "%13.2" NUMBER 2 /end CHARACTERISTIC
/begin CHARACTERISTIC AirCtl_stHighMsk_C "Maske zur Erkennung Regenerationsstufe" VALUE 0x1CA18C Kw_Wu32 4294967295.00 OneToOne 0.00 4294967295.00 FORMAT "%13.2" /end CHARACTERISTIC
/begin CHARACTERISTIC AirCtl_stInitGovRgnMsk_C "Bitmaske für Initialisierung der AGR Regelung" VALUE 0x1C8D00 Kw_Wu32 4294967295.00 OneToOne 0.00 4294967295.00 FORMAT "%13.2" /end CHARACTERISTIC
/begin CHARACTERISTIC AirCtl_stLimRgnMsk_CA "EGT state Maske für Regenerationsstufe 1, 2 und 3" VAL_BLK 0x1C8D04 Kwb_Wu32 4294967295.00 OneToOne 0.00 4294967295.00 FORMAT "%13.2" NUMBER 3 /end CHARACTERISTIC
/begin CHARACTERISTIC AirCtl_stMiddleMsk_C "Maske zur Erkennung Regenerationsstufe" VALUE 0x1CA190 Kw_Wu32 4294967295.00 OneToOne 0.00 4294967295.00 FORMAT "%13.2" /end CHARACTERISTIC
/begin CHARACTERISTIC AirCtl_stMonRgnMsk1_C "Maske zur Monitorumschaltung für Partikelfilter Regeneration 1" VALUE 0x1CA194 Kw_Wu32 4294967295.00 OneToOne 0.00 4294967295.00 FORMAT "%13.2" /end CHARACTERISTIC
/begin CHARACTERISTIC AirCtl_stMonRgnMsk2_C "Maske zur Monitorumschaltung für Partikelfilter Regeneration 2" VALUE 0x1CA198 Kw_Wu32 4294967295.00 OneToOne 0.00 4294967295.00 FORMAT "%13.2" /end CHARACTERISTIC
/begin CHARACTERISTIC AirCtl_stMonRgnMskOn_C "Maske zur Fehlerunterdrückung für Partikelfilter Regeneration" VALUE 0x1CA19C Kw_Wu32 4294967295.00 OneToOne 0.00 4294967295.00 FORMAT "%13.2" /end CHARACTERISTIC
/begin CHARACTERISTIC AirCtl_stMonShtrpMskOn_C "Ausblendmaske der Abschaltbedingungen bei Short Trip Diagnose" VALUE 0x1CA1A0 Kw_Wu32 4294967295.00 OneToOne 0.00 4294967295.00 FORMAT "%13.2" /end CHARACTERISTIC
/begin CHARACTERISTIC AirCtl_stNQCTCorMsk1_C "Maske 1 für EGT-Status" VALUE 0x1C7A44 Kw_Wu32 4294967295.00 OneToOne 0.00 4294967295.00 FORMAT "%13.2" /end CHARACTERISTIC
/begin CHARACTERISTIC AirCtl_stNQCTCorMsk2_C "Maske 2 für EGT-Status" VALUE 0x1C7A48 Kw_Wu32 4294967295.00 OneToOne 0.00 4294967295.00 FORMAT "%13.2" /end CHARACTERISTIC
/begin CHARACTERISTIC AirCtl_stNQCTCorMsk3_C "Maske 3 für EGT-Status" VALUE 0x1C7A4C Kw_Wu32 4294967295.00 OneToOne 0.00 4294967295.00 FORMAT "%13.2" /end CHARACTERISTIC
/begin CHARACTERISTIC AirCtl_stParRgnMsk_C "Maske zur Umschaltung von Reglerparametern für Partikelfilter Regeneration" VALUE 0x1C8D10 Kw_Wu32 4294967295.00 OneToOne 0.00 4294967295.00 FORMAT "%13.2" /end CHARACTERISTIC
/begin CHARACTERISTIC AirCtl_stRgnPT1Msk_C "applicable bitmask for PT1-filter" VALUE 0x1C7A50 Kw_Wu32 4294967295.00 OneToOne 0.00 4294967295.00 FORMAT "%13.2" /end CHARACTERISTIC
/begin CHARACTERISTIC AirCtl_swtAPCorVal_C "Schalterwert für add./mult. Atmosphärendruckkorrektur" VALUE 0x1C7A54 Kw_Wu8 1.000 OneToOne 0.00 1.000 FORMAT "%5.3" EXTENDED_LIMITS 0.00 255.0 READ_ONLY /end CHARACTERISTIC
/begin CHARACTERISTIC AirCtl_swtAPCorType_C "Schaltertyp für add./mult. Atmosphärendruckkorrektur" VALUE 0x1C7A55 Kw_Wu8 0.00 OneToOne 0.00 0.00 FORMAT "%5.2" EXTENDED_LIMITS 0.00 255.0 READ_ONLY /end CHARACTERISTIC
/begin CHARACTERISTIC AirCtl_swtATCorVal_C "Schalterwert für add./mult. Lufttemperaturkorrektur" VALUE 0x1C7A56 Kw_Wu8 1.000 OneToOne 0.00 1.000 FORMAT "%5.3" EXTENDED_LIMITS 0.00 255.0 READ_ONLY /end CHARACTERISTIC
/begin CHARACTERISTIC AirCtl_swtATCorType_C "Schaltertyp für add./mult. Lufttemperaturkorrektur" VALUE 0x1C7A57 Kw_Wu8 0.00 OneToOne 0.00 0.00 FORMAT "%5.2" EXTENDED_LIMITS 0.00 255.0 READ_ONLY /end CHARACTERISTIC
/begin CHARACTERISTIC AirCtl_swtBPClntBypOff_C "Schalter für activierung des EGR-Kühler Bypass Ventil, wenn die EGR wegen Ladedruckanforderung abgeschaltet wird" VALUE 0x1C499B Kw_Wu8 1.000 OneToOne 0.00 1.000 FORMAT "%5.3" EXTENDED_LIMITS 0.00 255.0 /end CHARACTERISTIC
/begin CHARACTERISTIC AirCtl_swtCorrActv_C "Umschalter zum Wechseln der Korrekturstrategie" VALUE 0x1C7A58 Kw_Wu8 1.000 OneToOne 0.00 1.000 FORMAT "%5.3" EXTENDED_LIMITS 0.00 255.0 /end CHARACTERISTIC
/begin CHARACTERISTIC AirCtl_swtCtlHys_C "Schalter für Hysterese des Steueranteils" VALUE 0x1C8D14 Kw_Wu8 1.000 OneToOne 0.00 1.000 FORMAT "%5.3" EXTENDED_LIMITS 0.00 255.0 /end CHARACTERISTIC
/begin CHARACTERISTIC AirCtl_swtEGRAWDoff_C "Schalter zur Aktivierung der EGR Abschaltung bei aktiven Untersetzunggetriebe" VALUE 0x1CA1A4 Kw_Wu8 1.000 OneToOne 0.00 1.000 FORMAT "%5.3" EXTENDED_LIMITS 0.00 255.0 /end CHARACTERISTIC
/begin CHARACTERISTIC AirCtl_swtEGRFrzMAP_C "Schalter zur Auswahl zwischen eingefrorenem oder Kennfeld-basiertem EGR-Stellgröße bei der Anti-Kaudern-Maßnahme" VALUE 0x1CA1A5 Kw_Wu8 1.000 OneToOne 0.00 1.000 FORMAT "%5.3" EXTENDED_LIMITS 0.00 255.0 /end CHARACTERISTIC
/begin CHARACTERISTIC AirCtl_swtEGROpnLp1_C "Schalter zur Auswahl des gesteuerten Betriebes für das AGR-Ventil im Regenerationsbetrieb 1" VALUE 0x1C8D15 Kw_Wu8 1.000 OneToOne 0.00 1.000 FORMAT "%5.3" EXTENDED_LIMITS 0.00 255.0 /end CHARACTERISTIC
/begin CHARACTERISTIC AirCtl_swtEGROpnLp2_C "Schalter zur Auswahl des gesteuerten Betriebes für das AGR-Ventil im Regenerationsbetrieb 2" VALUE 0x1C8D16 Kw_Wu8 1.000 OneToOne 0.00 1.000 FORMAT "%5.3" EXTENDED_LIMITS 0.00 255.0 /end CHARACTERISTIC
/begin CHARACTERISTIC AirCtl_swtGovCtl3Hys_C "Schalterwert für Auswahl von Dreifachhystereseausgang (=1) oder Begrenzerausgang (=0)" VALUE 0x1C8D17 Kw_Wu8 1.000 OneToOne 0.00 1.000 FORMAT "%5.3" EXTENDED_LIMITS 0.00 255.0 /end CHARACTERISTIC
/begin CHARACTERISTIC AirCtl_swtGovEGRRgn_C "Schalterwert für Pfadauswahl vo AirCtl_rGovEGRUnSplit im Regenerationsfall (=0: regeln; 1regeln; 2 steuern)" VALUE 0x1C8D18 Kw_Wu8 2.000 OneToOne 0.00 2.000 FORMAT "%5.3" EXTENDED_LIMITS 0.00 255.0 /end CHARACTERISTIC
/begin CHARACTERISTIC AirCtl_swtGovEGRSep_C "Auswahl der getrennten AGR Regelung" VALUE 0x1C8D19 Kw_Wu8 1.000 OneToOne 0.00 1.000 FORMAT "%5.3" EXTENDED_LIMITS 0.00 255.0 /end CHARACTERISTIC
/begin CHARACTERISTIC AirCtl_swtGovEGR_C "Schalterwert für Pfadauswahl von AirCtl_rGovEGRUnSplit im Standardfall (=0: regeln; 1 regeln; 2 steuern)" VALUE 0x1C8D1A Kw_Wu8 2.000 OneToOne 0.00 2.000 FORMAT "%5.3" EXTENDED_LIMITS 0.00 255.0 /end CHARACTERISTIC
/begin CHARACTERISTIC AirCtl_swtGovTVARgn_C "Schalterwert für Pfadauswahl von AirCtl_rGovTVA im Regenerationsbetrieb (=0: regeln; 1 steuern; 2 regeln)" VALUE 0x1C8D1B Kw_Wu8 2.000 OneToOne 0.00 2.000 FORMAT "%5.3" EXTENDED_LIMITS 0.00 255.0 /end CHARACTERISTIC
/begin CHARACTERISTIC AirCtl_swtGovTVA_C "Schalterwert für Pfadauswahl von AirCtl_rGovTVA im Standardfall (=0: regeln; 1 steuern; 2 regeln)" VALUE 0x1C8D1C Kw_Wu8 2.000 OneToOne 0.00 2.000 FORMAT "%5.3" EXTENDED_LIMITS 0.00 255.0 /end CHARACTERISTIC
/begin CHARACTERISTIC AirCtl_swtGovVal_C "Schalterwert für Reglerabschaltung (0=Gov OFF; 1=Gov ON)" VALUE 0x1C8D1D Kw_Wu8 1.000 OneToOne 0.00 1.000 FORMAT "%5.3" EXTENDED_LIMITS 0.00 255.0 /end CHARACTERISTIC
/begin CHARACTERISTIC AirCtl_swtGovType_C "Schaltertyp für Reglerabschaltung" VALUE 0x1C8D1E Kw_Wu8 1.000 OneToOne 1.000 2.000 FORMAT "%5.3" EXTENDED_LIMITS 0.00 255.0 /end CHARACTERISTIC
/begin CHARACTERISTIC AirCtl_swtLmbdRecCor_C "Auswahlschalter für Korrektionsfaktor AirCtl_facLmbd_mp für  I-Limitierung" VALUE 0x1C8D1F Kw_Wu8 1.000 OneToOne 0.00 1.000 FORMAT "%5.3" EXTENDED_LIMITS 0.00 255.0 /end CHARACTERISTIC
/begin CHARACTERISTIC AirCtl_swtLmbdThres_C "Auswahlschalter für Lambdagrenzwert zur I-Limitierung" VALUE 0x1C8D20 Kw_Wu8 1.000 OneToOne 0.00 1.000 FORMAT "%5.3" EXTENDED_LIMITS 0.00 255.0 /end CHARACTERISTIC
/begin CHARACTERISTIC AirCtl_swtRpOilCtl_C "Korrigierte Einspritzmengen Wahlschalter" VALUE 0x1C7ADA Kw_Wu8 255.0 OneToOne 0.00 255.0 FORMAT "%5.1" /end CHARACTERISTIC
/begin CHARACTERISTIC AirCtl_swtRpOilDes_C "Korrigierte Einspritzmengen Wahlschalter" VALUE 0x1C7ADB Kw_Wu8 255.0 OneToOne 0.00 255.0 FORMAT "%5.1" /end CHARACTERISTIC
/begin CHARACTERISTIC AirCtl_swtRpOilGov_C "Korrigierte Einspritzmengen Wahlschalter" VALUE 0x1C7ADC Kw_Wu8 255.0 OneToOne 0.00 255.0 FORMAT "%5.1" /end CHARACTERISTIC
/begin CHARACTERISTIC AirCtl_swtRpOilMon_C "Korrigierte Einspritzmengen Wahlschalter" VALUE 0x1C7ADD Kw_Wu8 255.0 OneToOne 0.00 255.0 FORMAT "%5.1" /end CHARACTERISTIC
/begin CHARACTERISTIC AirCtl_swtTempRevThres_C "Schalter der Temperaturwert des Arrays auswählt" VALUE 0x1C7A59 Kw_Wu8 4.00000000000 EngTempFldSel 0.00 4.00000000000 FORMAT "%13.11" /end CHARACTERISTIC
/begin CHARACTERISTIC AirCtl_swtTempStrtDelay_C "Schalter der Temperaturwert des Arrays auswählt" VALUE 0x1CA1A6 Kw_Wu8 4.00000000000 EngTempFldSel 0.00 4.00000000000 FORMAT "%13.11" /end CHARACTERISTIC
/begin CHARACTERISTIC AirCtl_swtTrmVal_C "Schalterwert für add./mult. Abgleichkorrektur" VALUE 0x1C7A5A Kw_Wu8 1.000 OneToOne 0.00 1.000 FORMAT "%5.3" EXTENDED_LIMITS 0.00 255.0 READ_ONLY /end CHARACTERISTIC
/begin CHARACTERISTIC AirCtl_swtTrmType_C "Schaltertyp für add./mult. Abgleichkorrektur" VALUE 0x1C7A5B Kw_Wu8 0.00 OneToOne 0.00 0.00 FORMAT "%5.2" EXTENDED_LIMITS 0.00 255.0 READ_ONLY /end CHARACTERISTIC
/begin CHARACTERISTIC AirCtl_swtTVADflLoAirTemp_C "Schalter zwischen dem Applikationswert und AirCtl_rGovTVA im low air temperature Fall" VALUE 0x1CA1A7 Kw_Wu8 1.000 OneToOne 0.00 1.000 FORMAT "%5.3" EXTENDED_LIMITS 0.00 255.0 /end CHARACTERISTIC
/begin CHARACTERISTIC AirCtl_swtTVAFrzMAP_C "Schalter zur Auswahl zwischen eingefrorenem oder Kennfeld-basiertem TVA-Stellgröße bei der Anti-Kaudern-Maßnahme" VALUE 0x1CA1A8 Kw_Wu8 1.000 OneToOne 0.00 1.000 FORMAT "%5.3" EXTENDED_LIMITS 0.00 255.0 /end CHARACTERISTIC
/begin CHARACTERISTIC AirCtl_swtVirtAPP_C "switch for detection of PWG or virtual PWG for expected overrun detection" VALUE 0x1C7A5C Kw_Wu8 255.0 OneToOne 0.00 255.0 FORMAT "%5.1" /end CHARACTERISTIC
/begin CHARACTERISTIC AirCtl_tAirCBVHysHi_C "Obere Grenze für Ansauglufttemperatur" VALUE 0x1C499C Kw_Ws16 250.0000 Temp_Cels -50.14000 199.8600 FORMAT "%8.4" EXTENDED_LIMITS -3549.940 3003.560 /end CHARACTERISTIC
/begin CHARACTERISTIC AirCtl_tAirCBVHysLo_C "Untere Grenze für Ansauglufttemperatur" VALUE 0x1C499E Kw_Ws16 250.0000 Temp_Cels -50.14000 199.8600 FORMAT "%8.4" EXTENDED_LIMITS -3549.940 3003.560 /end CHARACTERISTIC
/begin CHARACTERISTIC AirCtl_tAirHi_C "obere Hysteresegrenze für Überwachung niedriger Lufttemperatur" VALUE 0x1CA1AA Kw_Ws16 250.0000 Temp_Cels -50.14000 199.8600 FORMAT "%8.4" EXTENDED_LIMITS -3549.940 3003.560 /end CHARACTERISTIC
/begin CHARACTERISTIC AirCtl_tAirHotHi_C "obere Hysteresegrenze für Überwachung hohe Umgebungstemperatur" VALUE 0x1CA1AC Kw_Ws16 250.0000 Temp_Cels -50.14000 199.8600 FORMAT "%8.4" EXTENDED_LIMITS -3549.940 3003.560 /end CHARACTERISTIC
/begin CHARACTERISTIC AirCtl_tAirHotLo_C "untere Hysteresegrenze für Überwachung hohe Umgebungstemperatur" VALUE 0x1CA1AE Kw_Ws16 250.0000 Temp_Cels -50.14000 199.8600 FORMAT "%8.4" EXTENDED_LIMITS -3549.940 3003.560 /end CHARACTERISTIC
/begin CHARACTERISTIC AirCtl_tAirLo_C "untere Hysteresegrenze für Überwachung niedriger Lufttemperatur" VALUE 0x1CA1B0 Kw_Ws16 250.0000 Temp_Cels -50.14000 199.8600 FORMAT "%8.4" EXTENDED_LIMITS -3549.940 3003.560 /end CHARACTERISTIC
/begin CHARACTERISTIC AirCtl_tClntCBVHysHi_C "obere Schwelle der Kühlmitteltemperaturhysterese für den EGR-Kühler Bypass" VALUE 0x1C49A0 Kw_Ws16 200.0000 Temp_Cels -50.14000 149.8600 FORMAT "%8.4" EXTENDED_LIMITS -3549.940 3003.560 /end CHARACTERISTIC
/begin CHARACTERISTIC AirCtl_tClntCBVHysLo_C "untere Schwelle der Kühlmitteltemperaturhysterese für den EGR-Kühler Bypass" VALUE 0x1C49A2 Kw_Ws16 200.0000 Temp_Cels -50.14000 149.8600 FORMAT "%8.4" EXTENDED_LIMITS -3549.940 3003.560 /end CHARACTERISTIC
/begin CHARACTERISTIC AirCtl_tCThreshold_C "Kühlwassertemperaturschwelle für Parameterumschaltung der dyn. Sollwertbildung" VALUE 0x1C7A5E Kw_Ws16 6553.500 Temp_Cels -3549.940 3003.560 FORMAT "%8.3" /end CHARACTERISTIC
/begin CHARACTERISTIC AirCtl_tEngHHiNS_C "Oberer Wert der zu hohe Motortemperatur Hysterese im Anti-Kaudern Fall" VALUE 0x1CA1B2 Kw_Ws16 250.0000 Temp_Cels -50.14000 199.8600 FORMAT "%8.4" EXTENDED_LIMITS -3549.940 3003.560 /end CHARACTERISTIC
/begin CHARACTERISTIC AirCtl_tEngHHi_C "obere Hysteresegrenze für Überwachung hoher Kühlwassertemperatur" VALUE 0x1CA1B4 Kw_Ws16 250.0000 Temp_Cels -50.14000 199.8600 FORMAT "%8.4" EXTENDED_LIMITS -3549.940 3003.560 /end CHARACTERISTIC
/begin CHARACTERISTIC AirCtl_tEngHLoNS_C "Unterer Wert der zu hohe Motortemperatur Hysterese im Anti-Kaudern Fall" VALUE 0x1CA1B6 Kw_Ws16 250.0000 Temp_Cels -50.14000 199.8600 FORMAT "%8.4" EXTENDED_LIMITS -3549.940 3003.560 /end CHARACTERISTIC
/begin CHARACTERISTIC AirCtl_tEngHLo_C "untere Hysteresegrenze für Überwachung hoher Kühlwassertemperatur" VALUE 0x1CA1B8 Kw_Ws16 250.0000 Temp_Cels -50.14000 199.8600 FORMAT "%8.4" EXTENDED_LIMITS -3549.940 3003.560 /end CHARACTERISTIC
/begin CHARACTERISTIC AirCtl_tEngLHiNS_C "Oberer Wert der zu niedrige Motortemperatur Hysterese im Anti-Kaudern Fall" VALUE 0x1CA1BA Kw_Ws16 250.0000 Temp_Cels -50.14000 199.8600 FORMAT "%8.4" EXTENDED_LIMITS -3549.940 3003.560 /end CHARACTERISTIC
/begin CHARACTERISTIC AirCtl_tEngLHi_C "obere Hysteresegrenze für Überwachung niedriger Kühlwassertemperatur" VALUE 0x1CA1BC Kw_Ws16 250.0000 Temp_Cels -50.14000 199.8600 FORMAT "%8.4" EXTENDED_LIMITS -3549.940 3003.560 /end CHARACTERISTIC
/begin CHARACTERISTIC AirCtl_tEngLLoNS_C "Unterer Schwellwert der zu niedrige Motortemperatur Hysterese im Anti-Kaudern Fall" VALUE 0x1CA1BE Kw_Ws16 250.0000 Temp_Cels -50.14000 199.8600 FORMAT "%8.4" EXTENDED_LIMITS -3549.940 3003.560 /end CHARACTERISTIC
/begin CHARACTERISTIC AirCtl_tEngLLo_C "untere Hysteresegrenze für Überwachung niedriger Kühlwassertemperatur" VALUE 0x1CA1C0 Kw_Ws16 250.0000 Temp_Cels -50.14000 199.8600 FORMAT "%8.4" EXTENDED_LIMITS -3549.940 3003.560 /end CHARACTERISTIC
/begin CHARACTERISTIC AirCtl_tiAftLdDet_C "Zeit zum Einfrieren des Drosselklappenwertes nach negativen Lastwechsel" VALUE 0x1C8D22 Kw_Wu16 655350.0 Time_ms 0.00 655350.0 FORMAT "%8.1" /end CHARACTERISTIC
/begin CHARACTERISTIC AirCtl_tiATCorRmp_C "Zeit für rampenförmigen Sprung bei Wechel EGT-Status" VALUE 0x1C7A60 Kw_Wu32 65535999.9847 Rmp 0.00 65535999.9847 FORMAT "%13.4" /end CHARACTERISTIC
/begin CHARACTERISTIC AirCtl_tiBPAHold_CUR "maximale Zeit der LDR-Abschaltung" CURVE 0x1C48A8 Kl_Xs16_Ws16 134200.0 Time_ms 0.00 134200.0 FORMAT "%8.1" EXTENDED_LIMITS -327680.0 327670.0
 /begin AXIS_DESCR STD_AXIS AirCtl_rPT1EGR_mp DtyCyc 8 0.00 100.0000 FORMAT "%8.4" EXTENDED_LIMITS -327.6800 327.6700 DEPOSIT ABSOLUTE /end AXIS_DESCR
/end CHARACTERISTIC
/begin CHARACTERISTIC AirCtl_tiClutch_C "maximale Zeit für Schaltvorgangerkennung" VALUE 0x1CA1C2 Kw_Wu16 655350.0 TimeDeb 0.00 655350.0 FORMAT "%8.1" /end CHARACTERISTIC
/begin CHARACTERISTIC AirCtl_tiCoStrt_CUR "Kennlinie für Zeit, in der die Regelung nach Startabwurf abgeschaltet bleibt" CURVE 0x1CA1C4 Kl_Xs16_Ws16 33000.00 Time_ms 0.00 33000.00 FORMAT "%8.2" EXTENDED_LIMITS -327680.0 327670.0
 /begin AXIS_DESCR STD_AXIS AirCtl_tStrtDelay_mp Temp_Cels 25 -100.1400 199.8600 FORMAT "%8.4" EXTENDED_LIMITS -3549.940 3003.560 DEPOSIT ABSOLUTE /end AXIS_DESCR
/end CHARACTERISTIC
/begin CHARACTERISTIC AirCtl_tiCTCorRmp_C "Zeit für rampenförmigen Sprung bei Wechel EGT-Status" VALUE 0x1C7A64 Kw_Wu32 65535999.9847 Rmp 0.00 65535999.9847 FORMAT "%13.4" /end CHARACTERISTIC
/begin CHARACTERISTIC AirCtl_tiCtlValRgnPT1_CUR "Zeitkonstante für Dämpfung der Drosselklappe" CURVE 0x1C61A8 Kl_Xs16_Ws16 16.776704 TimeDelay_s_2 0.00051201563 16.777216 FORMAT "%9.6"
 /begin AXIS_DESCR STD_AXIS AirCtl_rTVA Prc 8 0.00 100.0000 FORMAT "%8.4" EXTENDED_LIMITS -327.6800 327.6700 DEPOSIT ABSOLUTE /end AXIS_DESCR
/end CHARACTERISTIC
/begin CHARACTERISTIC AirCtl_tiMaxDef_C "Vorentprellzeit für Erkennung positiver bleibender Regelabweichung" VALUE 0x1CA22A Kw_Wu16 655350.0 Time_ms 0.00 655350.0 FORMAT "%8.1" /end CHARACTERISTIC
/begin CHARACTERISTIC AirCtl_tiMaxOk_C "Vorentprellzeit für Heilung bei positiver bleibender Regelabweichung" VALUE 0x1CA22C Kw_Wu16 655350.0 Time_ms 0.00 655350.0 FORMAT "%8.1" /end CHARACTERISTIC
/begin CHARACTERISTIC AirCtl_tiMinDef_C "Vorentprellzeit für Erkennung negativer bleibender Regelabweichung" VALUE 0x1CA22E Kw_Wu16 655350.0 Time_ms 0.00 655350.0 FORMAT "%8.1" /end CHARACTERISTIC
/begin CHARACTERISTIC AirCtl_tiMinOk_C "Vorentprellzeit für Heilung bei neagtiver bleibender Regelabweichung" VALUE 0x1CA230 Kw_Wu16 655350.0 Time_ms 0.00 655350.0 FORMAT "%8.1" /end CHARACTERISTIC
/begin CHARACTERISTIC AirCtl_tiRgnMaxDef_C "Entprellzeit der Defekterkennung des Maximum Regelabweichungs-Fehlers" VALUE 0x1CA232 Kw_Wu16 655350.0 Time_ms 0.00 655350.0 FORMAT "%8.1" /end CHARACTERISTIC
/begin CHARACTERISTIC AirCtl_tiRgnMaxOk_C "Entprellzeit der Heilungserkennung des maximum Regelabweichungs-Fehler im Regenerationsmodus" VALUE 0x1CA234 Kw_Wu16 655350.0 Time_ms 0.00 655350.0 FORMAT "%8.1" /end CHARACTERISTIC
/begin CHARACTERISTIC AirCtl_tiRgnMinDef_C "Entprellzeit für die Defekterkennung des minimum Regelabweichungsfehlers im Regenerationsmodus" VALUE 0x1CA236 Kw_Wu16 655350.0 Time_ms 0.00 655350.0 FORMAT "%8.1" /end CHARACTERISTIC
/begin CHARACTERISTIC AirCtl_tiRgnMinOk_C "Entprellzeit für die  Heilungserkennung des minimum Regelabweichungsfehlers im Regenerationsmodus" VALUE 0x1CA238 Kw_Wu16 655350.0 Time_ms 0.00 655350.0 FORMAT "%8.1" /end CHARACTERISTIC
/begin CHARACTERISTIC AirCtl_tiDesRgnRmp_C "Rampenzeit für die Umschaltung des Sollwertes für Partikelfilter Regeneration" VALUE 0x1C7A68 Kw_Wu32 31.775030303030302 TimeEGTRmp 0.99296969696969695 32.768000000000001 FORMAT "%19.16" EXTENDED_LIMITS 0.000000015258789066052715 65.536000000000001 /end CHARACTERISTIC
/begin CHARACTERISTIC AirCtl_tiDesValRgnPT1_CUR "Zeitkonstante für Dämpfung der Drosselklappe" CURVE 0x1C7A6C Kl_Xs16_Ws16 16.776704 TimeDelay_s_2 0.00051201563 16.777216 FORMAT "%9.6"
 /begin AXIS_DESCR STD_AXIS AirCtl_rTVA Prc 8 0.00 100.0000 FORMAT "%8.4" EXTENDED_LIMITS -327.6800 327.6700 DEPOSIT ABSOLUTE /end AXIS_DESCR
/end CHARACTERISTIC
/begin CHARACTERISTIC AirCtl_tiDlyOvrRunDet_C "Verzögerungszeit für den EGR-Wert im Fall der Umschaltung vom Schub im Anti-Kaudern Fall" VALUE 0x1CA23A Kw_Wu16 655140.0 Time_ms 0.00 655140.0 FORMAT "%8.1" EXTENDED_LIMITS 0.00 655350.0 /end CHARACTERISTIC
/begin CHARACTERISTIC AirCtl_tiDly_CUR "Kennlinie für Verzögerungstimerwert" CURVE 0x1CA23C Kl_Xs16_Ws16 33000.00 Time_ms 0.00 33000.00 FORMAT "%8.2" EXTENDED_LIMITS -327680.0 327670.0
 /begin AXIS_DESCR STD_AXIS Eng_nAvrg EngN 25 0.00 6000.000 FORMAT "%8.3" EXTENDED_LIMITS -32768.00 32767.00 DEPOSIT ABSOLUTE /end AXIS_DESCR
/end CHARACTERISTIC
/begin CHARACTERISTIC AirCtl_tiDT1_C "Zeitkonstante des DT1-Gliedes" VALUE 0x1C8D24 Kw_Wu32 10.010579 TimeDelay_s 0.0010000001 10.011579 FORMAT "%9.6" EXTENDED_LIMITS 0.0000010000000 4294.9673 /end CHARACTERISTIC
/begin CHARACTERISTIC AirCtl_tiEGRHold_C "Minimale Zeit der ARF-Abschaltung" VALUE 0x1C48CA Kw_Wu16 268430.0 Time_ms 0.00 268430.0 FORMAT "%8.1" EXTENDED_LIMITS 0.00 655350.0 /end CHARACTERISTIC
/begin CHARACTERISTIC AirCtl_tiEGRPT1Rgn_C "EGR Anti-Kaudern Zeitkonstante für PT1 Filter bei Partikelfilterregeneration" VALUE 0x1CA2A4 Kw_Wu32 4294.9673 TimeDelay_s 0.0000010000000 4294.9673 FORMAT "%9.4" /end CHARACTERISTIC
/begin CHARACTERISTIC AirCtl_tiEGRPT1_C "EGR Anti-Kaudern Zeitkonstante für PT1 Filter" VALUE 0x1CA2A8 Kw_Wu32 4294.9673 TimeDelay_s 0.0000010000000 4294.9673 FORMAT "%9.4" /end CHARACTERISTIC
/begin CHARACTERISTIC AirCtl_tiGovRgnRmp_C "Rampenzeit für die Umschaltung der Steuergröße für Partikelfilter Regeneration" VALUE 0x1C8D28 Kw_Wu32 31.775030303030302 TimeEGTRmp 0.99296969696969695 32.768000000000001 FORMAT "%19.16" EXTENDED_LIMITS 0.000000015258789066052715 65.536000000000001 /end CHARACTERISTIC
/begin CHARACTERISTIC AirCtl_tiInitGovRgn_C "Wartezeit für Initialisierung der AGR Regelung bei Umschalten in/von Regenerationsbetrieb" VALUE 0x1C8D2C Kw_Wu16 655140.0 Time_ms 0.00 655140.0 FORMAT "%8.1" EXTENDED_LIMITS 0.00 655350.0 /end CHARACTERISTIC
/begin CHARACTERISTIC AirCtl_tiLowIdle_C "Grenzzeit für Leerlaufabschaltung" VALUE 0x1CA2AC Kw_Wu32 42949672950.0 Time_ms 0.00 42949672950.0 FORMAT "%13.1" /end CHARACTERISTIC
/begin CHARACTERISTIC AirCtl_tiMonRgn1_C "Verzögerungszeit für den Eingriff der Partikelfilter Regeneration 1" VALUE 0x1CA2B0 Kw_Wu32 42949672.9500 Time_s 0.00 42949672.9500 FORMAT "%13.4" /end CHARACTERISTIC
/begin CHARACTERISTIC AirCtl_tiMonRgn2_C "Verzögerungszeit für den Eingriff der Partikelfilter Regeneration 2" VALUE 0x1CA2B4 Kw_Wu32 42949672.9500 Time_s 0.00 42949672.9500 FORMAT "%13.4" /end CHARACTERISTIC
/begin CHARACTERISTIC AirCtl_tiNQCTCorRmp_C "Zeit für rampenförmigen Sprung bei Wechel EGT-Status" VALUE 0x1C7A90 Kw_Wu32 65535999.9847 Rmp 0.00 65535999.9847 FORMAT "%13.4" /end CHARACTERISTIC
/begin CHARACTERISTIC AirCtl_tiOvrRunDel_C "Verzögerungszeit für Schuberkennung" VALUE 0x1CA2B8 Kw_Wu16 655350.0 Time_ms 0.00 655350.0 FORMAT "%8.1" /end CHARACTERISTIC
/begin CHARACTERISTIC AirCtl_tiParRgnRmpNeg_C "Neg. Rampenzeit für die Umschaltung Reglerparameter für Partikelfilter Regeneration" VALUE 0x1C8D30 Kw_Wu32 65535999.9847 Rmp 0.00 65535999.9847 FORMAT "%13.4" /end CHARACTERISTIC
/begin CHARACTERISTIC AirCtl_tiParRgnRmpPos_C "Pos. Rampenzeit für die Umschaltung Reglerparameter für Partikelfilter Regeneration" VALUE 0x1C8D34 Kw_Wu32 65535999.9847 Rmp 0.00 65535999.9847 FORMAT "%13.4" /end CHARACTERISTIC
/begin CHARACTERISTIC AirCtl_tiPT1qDes_C "Zeitkonstante des PT1-Glieds für die Wunscheinspritzmenge." VALUE 0x1C48CC Kw_Wu32 4294.9663 TimeDelay_s 0.0010000001 4294.9673 FORMAT "%9.4" EXTENDED_LIMITS 0.0000010000000 4294.9673 /end CHARACTERISTIC
/begin CHARACTERISTIC AirCtl_tiSwtDiagStartCBV_C "Zeit für die Ansteuerung des EGR-Kühler Bypass nach Start" VALUE 0x1C49A4 Kw_Wu16 1000.000 Time_ms 0.00 1000.000 FORMAT "%8.3" EXTENDED_LIMITS 0.00 655350.0 /end CHARACTERISTIC
/begin CHARACTERISTIC AirCtl_tiTVAPT1Rgn_C "EGR Stellerwert während der Anti-Kaudern-Schuberkennung" VALUE 0x1CA2BC Kw_Wu32 4294.9673 TimeDelay_s 0.0000010000000 4294.9673 FORMAT "%9.4" /end CHARACTERISTIC
/begin CHARACTERISTIC AirCtl_tiTVAPT1_C "TVA Anti-Kaudern Zeitkonstante für PT1 Filter" VALUE 0x1CA2C0 Kw_Wu32 4294.9673 TimeDelay_s 0.0000010000000 4294.9673 FORMAT "%9.4" /end CHARACTERISTIC
/begin CHARACTERISTIC AirCtl_TrmVal_C "ARF-Abgleichwert" VALUE 0x1C7A94 Kw_Ws16 3000.000 AirMassPerCyl -1500.000 1500.000 FORMAT "%8.3" EXTENDED_LIMITS -3276.800 3276.700 /end CHARACTERISTIC
/begin CHARACTERISTIC AirCtl_trqCrCtloff_C "unterer AirCtl_trqCrCtloff Hystersenoffsetwert" VALUE 0x1CA2C4 Kw_Ws16 1000.000 Trq 0.00 1000.000 FORMAT "%8.3" EXTENDED_LIMITS -3276.800 3276.700 /end CHARACTERISTIC
/begin CHARACTERISTIC AirCtl_tTurbHi_C "Obere Turbinentemperatur-Hystereseschwelle für EGR-Ventilschutz" VALUE 0x1CA2C6 Kw_Ws16 1323.100 Temp_Cels -50.14000 1272.960 FORMAT "%8.3" EXTENDED_LIMITS -3549.940 3003.560 /end CHARACTERISTIC
/begin CHARACTERISTIC AirCtl_tTurbLo_C "Untere Turbinentemperatur-Hystereseschwelle für EGR-Ventilschutz" VALUE 0x1CA2C8 Kw_Ws16 1323.100 Temp_Cels -50.14000 1272.960 FORMAT "%8.3" EXTENDED_LIMITS -3549.940 3003.560 /end CHARACTERISTIC
/begin CHARACTERISTIC AirCtl_uBattThres_C "Grenze für Batteriespannungsüberwachung" VALUE 0x1CA2CA Kw_Ws16 1331328. Volt_Batt -665674.1 665653.8 FORMAT "%8.1" /end CHARACTERISTIC
/begin CHARACTERISTIC AirSys_swtRstTrgOfsLrn_C "Applikationsschalter zum Löschen aller gelernten Werte in BPA, TVA, EGR und FMA" VALUE 0x1CA2CD Kw_Wu8 1.000 OneToOne 0.00 1.000 FORMAT "%5.3" EXTENDED_LIMITS 0.00 255.0 /end CHARACTERISTIC
/begin CHARACTERISTIC AltCD_tiDebAccessDef_C "Fehlerentprellzeit des Modulzugriffsfehlers" VALUE 0x1CA59C Kw_Wu16 65540.00 Time_ms 0.00 65540.00 FORMAT "%8.2" EXTENDED_LIMITS 0.00 655350.0 /end CHARACTERISTIC
/begin CHARACTERISTIC AltCD_tiDebAccessOk_C "Heilungsentprellzeit des Modulzugriffsfehler" VALUE 0x1CA59E Kw_Wu16 65540.00 Time_ms 0.00 65540.00 FORMAT "%8.2" EXTENDED_LIMITS 0.00 655350.0 /end CHARACTERISTIC
/begin CHARACTERISTIC AltCD_ctPlausErr_C "max. Anzahl der Durchgänge, für die die Filterung ein Beschreiben des Buffers verhindern kann" VALUE 0x1CA5A0 Kw_Wu8 50.00 OneToOne 0.00 50.00 FORMAT "%5.2" EXTENDED_LIMITS 0.00 255.0 /end CHARACTERISTIC
/begin CHARACTERISTIC AltCD_ctPwrStgOnMax_C "maximale Anzahl von Endstufen-Einschaltungen pro Fahrzyklus bei SCB oder Übertemperatur" VALUE 0x1CA57E Kw_Wu16 65535.00 OneToOne 0.00 65535.00 FORMAT "%8.2" /end CHARACTERISTIC
/begin CHARACTERISTIC AltCD_tiDebDtyCycMaxDef_C "Fehlerentprellzeit bei SRC-HIGH des gemessenen TV" VALUE 0x1CA5A2 Kw_Wu16 65540.00 Time_ms 0.00 65540.00 FORMAT "%8.2" EXTENDED_LIMITS 0.00 655350.0 /end CHARACTERISTIC
/begin CHARACTERISTIC AltCD_tiDebDtyCycMaxOk_C "Heilungsentprellzeit bei SRC-HIGH des gemessenen TV" VALUE 0x1CA5A4 Kw_Wu16 65540.00 Time_ms 0.00 65540.00 FORMAT "%8.2" EXTENDED_LIMITS 0.00 655350.0 /end CHARACTERISTIC
/begin CHARACTERISTIC AltCD_tiDebDtyCycMinDef_C "Fehlerentprellzeit bei SRC-LOW des gemessenen TV" VALUE 0x1CA5A6 Kw_Wu16 65540.00 Time_ms 0.00 65540.00 FORMAT "%8.2" EXTENDED_LIMITS 0.00 655350.0 /end CHARACTERISTIC
/begin CHARACTERISTIC AltCD_tiDebDtyCycMinOk_C "Heilungsentprellzeit bei SRC-LOW des gemessenen TV" VALUE 0x1CA5A8 Kw_Wu16 65540.00 Time_ms 0.00 65540.00 FORMAT "%8.2" EXTENDED_LIMITS 0.00 655350.0 /end CHARACTERISTIC
/begin CHARACTERISTIC AltCD_tiDebPer2HiTransLo_C "Entprellzeit für zu kleine Periodendauer (1 -> 0 Erkennung)" VALUE 0x1CA5AA Kw_Wu16 655350.0 TimeDeb 0.00 655350.0 FORMAT "%8.1" /end CHARACTERISTIC
/begin CHARACTERISTIC AltCD_tiDebPer2HiTransHi_C "Entprellzeit für zu kleine Periodendauer (0 -> 1 Erkennung)" VALUE 0x1CA5AC Kw_Wu16 655350.0 TimeDeb 0.00 655350.0 FORMAT "%8.1" /end CHARACTERISTIC
/begin CHARACTERISTIC AltCD_tiDebPer2LoTransLo_C "Entprellzeit für zu große Periodendauer (1 -> 0 Erkennung)" VALUE 0x1CA5AE Kw_Wu16 655350.0 TimeDeb 0.00 655350.0 FORMAT "%8.1" /end CHARACTERISTIC
/begin CHARACTERISTIC AltCD_tiDebPer2LoTransHi_C "Entprellzeit für zu große Periodendauer (0 -> 1 Erkennung)" VALUE 0x1CA5B0 Kw_Wu16 655350.0 TimeDeb 0.00 655350.0 FORMAT "%8.1" /end CHARACTERISTIC
/begin CHARACTERISTIC AltCD_rLoadStepUp_C "Rampensteigung im Fehlerfall" VALUE 0x1CA5B4 Kw_Wu32 655359.999847 RmpPrc 0.00 655359.999847 FORMAT "%13.6" /end CHARACTERISTIC
/begin CHARACTERISTIC AltCD_rLoadStepDown_C "Rampensteigung im Fehlerfall" VALUE 0x1CA5B8 Kw_Wu32 655359.999847 RmpPrc 0.00 655359.999847 FORMAT "%13.6" /end CHARACTERISTIC
/begin CHARACTERISTIC AltCD_stSensIDWord_C "Schalter der TransStagefunktion" VALUE 0x1CA5BC Kw_Wu16 65535.00 OneToOne 0.00 65535.00 FORMAT "%8.2" /end CHARACTERISTIC
/begin CHARACTERISTIC AltCD_rAltLoadDfl_C "Vorgabewert im Fehlerfall" VALUE 0x1CA5BE Kw_Ws16 100.0000 Prc 0.00 100.0000 FORMAT "%8.4" EXTENDED_LIMITS -327.6800 327.6700 /end CHARACTERISTIC
/begin CHARACTERISTIC AltCD_rUnFltStepUp_C "Rampensteigung im Fehlerfall" VALUE 0x1CA5C0 Kw_Wu32 655359.999847 RmpPrc 0.00 655359.999847 FORMAT "%13.6" /end CHARACTERISTIC
/begin CHARACTERISTIC AltCD_rUnFltStepDown_C "Rampensteigung im Fehlerfall" VALUE 0x1CA5C4 Kw_Wu32 655359.999847 RmpPrc 0.00 655359.999847 FORMAT "%13.6" /end CHARACTERISTIC
/begin CHARACTERISTIC AltCD_stSensIDWordUnFlt_C "Schalter der TransStagefunktion" VALUE 0x1CA5C8 Kw_Wu16 65535.00 OneToOne 0.00 65535.00 FORMAT "%8.2" /end CHARACTERISTIC
/begin CHARACTERISTIC AltCD_rLoadUnFltDfl_C "Vorgabewert im Fehlerfall" VALUE 0x1CA5CA Kw_Ws16 100.0000 Prc 0.00 100.0000 FORMAT "%8.4" EXTENDED_LIMITS -327.6800 327.6700 /end CHARACTERISTIC
/begin CHARACTERISTIC AltCD_stLoadPwmInInv_C "Schalter zur Signalinvertierung" VALUE 0x1CA5CC Kw_Wu8 1.000 OneToOne 0.00 1.000 FORMAT "%5.3" EXTENDED_LIMITS 0.00 255.0 /end CHARACTERISTIC
/begin CHARACTERISTIC AltCD_tiLoadPwmInMinPer_C "SRC-min der gemessenen Periodendauer" VALUE 0x1CA5CE Kw_Ws16 3275.700 Period 1.000000 3276.700 FORMAT "%8.3" EXTENDED_LIMITS -3276.800 3276.700 /end CHARACTERISTIC
/begin CHARACTERISTIC AltCD_tiLoadPwmInMaxPer_C "SRC-high der gemessenen Periodendauer" VALUE 0x1CA5D0 Kw_Ws16 719.2000 Period 100.0000 819.2000 FORMAT "%8.4" EXTENDED_LIMITS -3276.800 3276.700 /end CHARACTERISTIC
/begin CHARACTERISTIC AltCD_dcycLoadPwmInMin_C "SRC-low des gemessenen TV des Generatorsignals" VALUE 0x1CA5D2 Kw_Ws16 100.0000 DtyCyc 0.00 100.0000 FORMAT "%8.4" EXTENDED_LIMITS -327.6800 327.6700 /end CHARACTERISTIC
/begin CHARACTERISTIC AltCD_dcycLoadPwmInMax_C "SRC-high des gemessenen TV des Generatorsignals" VALUE 0x1CA5D4 Kw_Ws16 100.0000 DtyCyc 0.00 100.0000 FORMAT "%8.4" EXTENDED_LIMITS -327.6800 327.6700 /end CHARACTERISTIC
/begin CHARACTERISTIC AltCD_rLoadLin_CUR "Kennlinie zur Umrechnung von % TV in % Last" CURVE 0x1CA5D6 Kl_Xs16_Ws16 100.0000 Prc 0.00 100.0000 FORMAT "%8.4" EXTENDED_LIMITS -327.6800 327.6700
 /begin AXIS_DESCR STD_AXIS AltCD_dcycAltLoad DtyCyc 25 0.00 100.0000 FORMAT "%8.4" EXTENDED_LIMITS -327.6800 327.6700 DEPOSIT ABSOLUTE /end AXIS_DESCR
/end CHARACTERISTIC
/begin CHARACTERISTIC AltCD_rThresExc_C "Schwellwert der Generatorerregung" VALUE 0x1CA580 Kw_Ws16 100.0000 Prc 0.00 100.0000 FORMAT "%8.4" EXTENDED_LIMITS -327.6800 327.6700 /end CHARACTERISTIC
/begin CHARACTERISTIC AltCD_stInvOutExc_C "Invertiertes Signal der Generatorerregung" VALUE 0x1CA582 Kw_Wu8 1.000 OneToOne 0.00 1.000 FORMAT "%5.3" EXTENDED_LIMITS 0.00 255.0 /end CHARACTERISTIC
/begin CHARACTERISTIC AltCD_stPwrStgDiaExc_C "Abschaltbedingung der Generatorerregung" VALUE 0x1CA583 Kw_Wu8 255.0 OneToOne 0.00 255.0 FORMAT "%5.1" /end CHARACTERISTIC
/begin CHARACTERISTIC AltCD_stSPICtl_C "Parameter zur Anzeige der verwendeten Endstufenart ( 1 = SPI kontrollierbare Endstufe, 0 = nicht SPI-Endstufe )" VALUE 0x1CA584 Kw_Wu8 1.000 OneToOne 0.00 1.000 FORMAT "%5.3" EXTENDED_LIMITS 0.00 255.0 /end CHARACTERISTIC
/begin CHARACTERISTIC AltCD_tiBtwTst_C "Zeitabstand, in dem im Fehlerfall die Endstufe getestet wird" VALUE 0x1CA586 Kw_Wu16 29900.00 Time_ms 100.0000 30000.00 FORMAT "%8.2" EXTENDED_LIMITS 0.00 655350.0 /end CHARACTERISTIC
/begin CHARACTERISTIC AltCD_tiDebExcTempDefExc_C "Fehlerentprellzeit für Übertemperatur der Generatorerregung [ms]" VALUE 0x1CA588 Kw_Wu16 655350.0 Time_ms 0.00 655350.0 FORMAT "%8.1" /end CHARACTERISTIC
/begin CHARACTERISTIC AltCD_tiDebExcTempOkExc_C "Heilungsentprellzeit für Übertemperatur der Generatorerregung [ms]" VALUE 0x1CA58A Kw_Wu16 655350.0 Time_ms 0.00 655350.0 FORMAT "%8.1" /end CHARACTERISTIC
/begin CHARACTERISTIC AltCD_tiDebNoLoadDefExc_C "Fehlerentprellzeit für Leerlauf der Generatorerregung [ms]" VALUE 0x1CA58C Kw_Wu16 655350.0 Time_ms 0.00 655350.0 FORMAT "%8.1" /end CHARACTERISTIC
/begin CHARACTERISTIC AltCD_tiDebNoLoadOkExc_C "Heilungsentprellzeit für Leerlauf der Generatorerregung [ms]" VALUE 0x1CA58E Kw_Wu16 655350.0 Time_ms 0.00 655350.0 FORMAT "%8.1" /end CHARACTERISTIC
/begin CHARACTERISTIC AltCD_tiDebShrtBatDefExc_C "Fehlerentprellzeit für Kurzschluß nach U-Batt der Generatorerregung [ms]" VALUE 0x1CA590 Kw_Wu16 655350.0 Time_ms 0.00 655350.0 FORMAT "%8.1" /end CHARACTERISTIC
/begin CHARACTERISTIC AltCD_tiDebShrtBatOkExc_C "Heilungsentprellzeit für Kurzschluß nach U-Batt der Generatorerregung [ms]" VALUE 0x1CA592 Kw_Wu16 655350.0 Time_ms 0.00 655350.0 FORMAT "%8.1" /end CHARACTERISTIC
/begin CHARACTERISTIC AltCD_tiDebShrtGndDefExc_C "Fehlerentprellzeit für Kurzschluß nach Masse der Generatorerregung [ms]" VALUE 0x1CA594 Kw_Wu16 655350.0 Time_ms 0.00 655350.0 FORMAT "%8.1" /end CHARACTERISTIC
/begin CHARACTERISTIC AltCD_tiDebShrtGndOkExc_C "Heilungsentprellzeit für Kurzschluß nach Masse der Generatorerregung [ms]" VALUE 0x1CA596 Kw_Wu16 655350.0 Time_ms 0.00 655350.0 FORMAT "%8.1" /end CHARACTERISTIC
/begin CHARACTERISTIC AltCD_tiHighTimeThres_C "minimale Hightime für das Beschreiben des Buffers" VALUE 0x1CA63C Kw_Wu16 1500.000 Time_PwmHigh 0.00 1500.000 FORMAT "%8.3" EXTENDED_LIMITS 0.00 6553.500 /end CHARACTERISTIC
/begin CHARACTERISTIC AltCD_tiPT1InAcc_C "Filter zur Mittelwertbildung des TV aus dem Pin-State" VALUE 0x1CA640 Kw_Wu32 4294967.3 TimeDelay_ms 0.0010000000 4294967.3 FORMAT "%9.1" /end CHARACTERISTIC
/begin CHARACTERISTIC AltCD_tiPT1UnFlt_C "PT1-Filterzeitkonstante" VALUE 0x1CA644 Kw_Wu32 4294967.3 TimeDelay_ms 0.0010000000 4294967.3 FORMAT "%9.1" /end CHARACTERISTIC
/begin CHARACTERISTIC AltCD_tiPT1_C "Filter des gemessenen TV" VALUE 0x1CA648 Kw_Wu32 4294967.3 TimeDelay_ms 0.0010000000 4294967.3 FORMAT "%9.1" /end CHARACTERISTIC
/begin CHARACTERISTIC AltCD_tiPwrStgOn_C "Zeit für welche die Endstufe im Fehlerfall eingeschalten wird (nur nicht SPI kontrolliert)" VALUE 0x1CA598 Kw_Wu16 500.0000 Time_ms 0.00 500.0000 FORMAT "%8.4" EXTENDED_LIMITS 0.00 655350.0 /end CHARACTERISTIC
/begin CHARACTERISTIC Alt_tiDebPwrCanDef_C "Fehlerentprellzeit für Dfp_AltpPwrCan_mp" VALUE 0x1CA2CE Kw_Wu16 655350.0 Time_ms 0.00 655350.0 FORMAT "%8.1" /end CHARACTERISTIC
/begin CHARACTERISTIC Alt_tiDebPwrCanOk_C "Fehlerheilzeit für Dfp_AltpPwrCan_mp" VALUE 0x1CA2D0 Kw_Wu16 655350.0 Time_ms 0.00 655350.0 FORMAT "%8.1" /end CHARACTERISTIC
/begin CHARACTERISTIC Alt_nThresERR_C "Drehzahlschwelle für Generatorerregung" VALUE 0x1CA526 Kw_Ws16 6000.000 EngN 0.00 6000.000 FORMAT "%8.3" EXTENDED_LIMITS -32768.00 32767.00 /end CHARACTERISTIC
/begin CHARACTERISTIC Alt_pwrAdjValDef_C "Standardwert für Abgleich Leistungsanforderung Generator" VALUE 0x1CA2D2 Kw_Ws16 0.00 Fact 1.000000 1.000000 FORMAT "%8.6" EXTENDED_LIMITS -4.000000 3.999878 /end CHARACTERISTIC
/begin CHARACTERISTIC Alt_pwrAdjValMax_C "Maximalwert für Abgleich Leistungsanforderung Generator" VALUE 0x1CA2D4 Kw_Ws16 3.199951 Fact 0.00 3.199951 FORMAT "%8.6" EXTENDED_LIMITS -4.000000 3.999878 /end CHARACTERISTIC
/begin CHARACTERISTIC Alt_pwrAdjValMin_C "Minimalwert für Abgleich Leistungsanforderung Generator" VALUE 0x1CA2D6 Kw_Ws16 3.199951 Fact 0.00 3.199951 FORMAT "%8.6" EXTENDED_LIMITS -4.000000 3.999878 /end CHARACTERISTIC
/begin CHARACTERISTIC Alt_pwrAltLoadVar2_MAP "Kennfeld der Generatorlast, Variante 2" MAP 0x1CA2D8 Kf_Xs16_Ys16_Ws16 300000.1 Pwr 0.00 300000.1 FORMAT "%8.1" EXTENDED_LIMITS -308831.1 308821.7
 /begin AXIS_DESCR STD_AXIS Eng_nAvrg EngN 8 0.00 6000.000 FORMAT "%8.3" EXTENDED_LIMITS -32768.00 32767.00 DEPOSIT ABSOLUTE /end AXIS_DESCR
 /begin AXIS_DESCR STD_AXIS AltCD_rAltLoad Prc 8 0.00 100.0000 FORMAT "%8.4" EXTENDED_LIMITS -327.6800 327.6700 DEPOSIT ABSOLUTE /end AXIS_DESCR
/end CHARACTERISTIC
/begin CHARACTERISTIC Alt_pwrAltLoadVar3_MAP "Generatorlastkennfeld, Variante 3" MAP 0x1CA37C Kf_Xs16_Ys16_Ws16 300000.1 Pwr 0.00 300000.1 FORMAT "%8.1" EXTENDED_LIMITS -308831.1 308821.7
 /begin AXIS_DESCR STD_AXIS Eng_nAvrg EngN 8 0.00 6000.000 FORMAT "%8.3" EXTENDED_LIMITS -32768.00 32767.00 DEPOSIT ABSOLUTE /end AXIS_DESCR
 /begin AXIS_DESCR STD_AXIS AltCD_rAltLoad Prc 8 0.00 100.0000 FORMAT "%8.4" EXTENDED_LIMITS -327.6800 327.6700 DEPOSIT ABSOLUTE /end AXIS_DESCR
/end CHARACTERISTIC
/begin CHARACTERISTIC Alt_pwrAltLoad_MAP "Kennfeld der Generatorlast" MAP 0x1CA420 Kf_Xs16_Ys16_Ws16 300000.1 Pwr 0.00 300000.1 FORMAT "%8.1" EXTENDED_LIMITS -308831.1 308821.7
 /begin AXIS_DESCR STD_AXIS Eng_nAvrg EngN 8 0.00 6000.000 FORMAT "%8.3" EXTENDED_LIMITS -32768.00 32767.00 DEPOSIT ABSOLUTE /end AXIS_DESCR
 /begin AXIS_DESCR STD_AXIS AltCD_rAltLoad Prc 8 0.00 100.0000 FORMAT "%8.4" EXTENDED_LIMITS -327.6800 327.6700 DEPOSIT ABSOLUTE /end AXIS_DESCR
/end CHARACTERISTIC
/begin CHARACTERISTIC Alt_pwrCanDef_MAP "Kennfeld von Vorgabewerten bei CAN-Fehler" MAP 0x1CA4C4 Kf_Xs16_Ys16_Ws16 300000.1 Pwr 0.00 300000.1 FORMAT "%8.1" EXTENDED_LIMITS -308831.1 308821.7
 /begin AXIS_DESCR STD_AXIS CTSCD_tClnt Temp_Cels 4 -50.14000 149.8600 FORMAT "%8.4" EXTENDED_LIMITS -3549.940 3003.560 DEPOSIT ABSOLUTE /end AXIS_DESCR
 /begin AXIS_DESCR STD_AXIS Eng_nAvrg EngN 8 0.00 6000.000 FORMAT "%8.3" EXTENDED_LIMITS -32768.00 32767.00 DEPOSIT ABSOLUTE /end AXIS_DESCR
/end CHARACTERISTIC
/begin CHARACTERISTIC Alt_pwrCanMax_C "Maximale Generatorleistung" VALUE 0x1CA520 Kw_Ws16 300000.1 Pwr 0.00 300000.1 FORMAT "%8.1" EXTENDED_LIMITS -308831.1 308821.7 /end CHARACTERISTIC
/begin CHARACTERISTIC Alt_pwrCanMin_C "Minimale Generatorleistung" VALUE 0x1CA522 Kw_Ws16 300000.1 Pwr 0.00 300000.1 FORMAT "%8.1" EXTENDED_LIMITS -308831.1 308821.7 /end CHARACTERISTIC
/begin CHARACTERISTIC Alt_swtPwrCan_C "Schalter für Generatorleistung über CAN" VALUE 0x1CA524 Kw_Wu8 1.000 OneToOne 0.00 1.000 FORMAT "%5.3" EXTENDED_LIMITS 0.00 255.0 /end CHARACTERISTIC
/begin CHARACTERISTIC Alt_swtPwrDetCan_C "alternator power over CAN  BEM message (=1) or PWM/BSG message (=0)" VALUE 0x1CA525 Kw_Wu8 1.000 OneToOne 0.00 1.000 FORMAT "%5.3" EXTENDED_LIMITS 0.00 255.0 /end CHARACTERISTIC
/begin CHARACTERISTIC Alt_tiDelPT_MAP "Kennfeld (p,t) zur Verzögerungsbestimmung für Generatorerregung" MAP 0x1CA528 Kf_Xs16_Ys16_Ws16 60000.00 Time_ms 0.00 60000.00 FORMAT "%8.2" EXTENDED_LIMITS -327680.0 327670.0
 /begin AXIS_DESCR STD_AXIS APSCD_pVal Pres_hPa 4 0.00 3500.000 FORMAT "%8.3" EXTENDED_LIMITS -32768.00 32767.00 DEPOSIT ABSOLUTE /end AXIS_DESCR
 /begin AXIS_DESCR STD_AXIS Eng_tEng Temp_Cels 5 -50.14000 199.8600 FORMAT "%8.4" EXTENDED_LIMITS -3549.940 3003.560 DEPOSIT ABSOLUTE /end AXIS_DESCR
/end CHARACTERISTIC
/begin CHARACTERISTIC Alt_tiExcdur_C "Impulszeit der Generatorerregung" VALUE 0x1CA566 Kw_Wu16 655350.0 Time_ms 0.00 655350.0 FORMAT "%8.1" /end CHARACTERISTIC
/begin CHARACTERISTIC Alt_tiLdRespTi_CUR "Kennlinie zur Ermittlung der Lastreaktionszeit aus der Motor-temperatur" CURVE 0x1CA568 Kl_Xs16_Ws16 327.5700 Time_s 0.00 327.5700 FORMAT "%8.4" EXTENDED_LIMITS -327.6800 327.6700
 /begin AXIS_DESCR STD_AXIS Eng_tEng Temp_Cels 4 -50.14000 199.8600 FORMAT "%8.4" EXTENDED_LIMITS -3549.940 3003.560 DEPOSIT ABSOLUTE /end AXIS_DESCR
/end CHARACTERISTIC
/begin CHARACTERISTIC Alt_tiLdRespTi_ReqDur_C "Übermittlungsdauer der Lastreaktionszeit" VALUE 0x1CA57A Kw_Wu16 655350.0 Time_ms 0.00 655350.0 FORMAT "%8.1" /end CHARACTERISTIC
/begin CHARACTERISTIC Alt_uBattThres_C "Batteriespannungsschwelle zum Unterdrücken der Erregungs-Verzögerung" VALUE 0x1CA57C Kw_Ws16 665653.8 Volt_Batt 0.00 665653.8 FORMAT "%8.1" EXTENDED_LIMITS -665674.1 665653.8 /end CHARACTERISTIC
/begin CHARACTERISTIC BIPCD_ddiBWMin_C "Minimale BIP-Bandbreite (Entscheidungsschwelle)" VALUE 0x1C0B3C Kw_Ws16 65535.00 OneToOne -32768.00 32767.00 FORMAT "%8.2" /end CHARACTERISTIC
/begin CHARACTERISTIC BIPCD_iWinLim_CUR "Maximal zulaessiger Strom im BIP- Fenster, je nach UBatt" CURVE 0x1CC5A0 Kl_Xs16_Ws16 28000.95 UI_Curr 0.00 28000.95 FORMAT "%8.2" EXTENDED_LIMITS -1091005. 1090972.
 /begin AXIS_DESCR STD_AXIS BattCD_u Volt_Batt 3 0.00 20782.00 FORMAT "%8.2" EXTENDED_LIMITS -665674.1 665653.8 DEPOSIT ABSOLUTE /end AXIS_DESCR
/end CHARACTERISTIC
/begin CHARACTERISTIC BIPCD_numSkip_C "Anzahl der Samples, die zu Beginn des BIP-Fensters verworfen werden" VALUE 0x1CC5AE Kw_Wu8 255.0 OneToOne 0.00 255.0 FORMAT "%5.1" /end CHARACTERISTIC
/begin CHARACTERISTIC BIPCD_numSpreadPoI2_C "Tangentenspreizung PoI2" VALUE 0x1C0B3E Kw_Wu8 255.0 OneToOne 0.00 255.0 FORMAT "%5.1" /end CHARACTERISTIC
/begin CHARACTERISTIC BIPCD_numSpread_C "Tangentenspreizung" VALUE 0x1C0B3F Kw_Wu8 255.0 OneToOne 0.00 255.0 FORMAT "%5.1" /end CHARACTERISTIC
/begin CHARACTERISTIC BIP_facFltInfl_C "Faktor zur Filterung der BIP-Zeit-Erwartungswertabweichung für beeinflusste Einspritztypen" VALUE 0x1CC542 Kw_Wu16 15.99976 Fact_BIP 0.00 15.99976 FORMAT "%8.5" /end CHARACTERISTIC
/begin CHARACTERISTIC BIP_facFlt_C "Faktor zur Filterung der BIP-Zeit-Erwartungswertabweichung" VALUE 0x1CC544 Kw_Wu16 15.99976 Fact_BIP 0.00 15.99976 FORMAT "%8.5" /end CHARACTERISTIC
/begin CHARACTERISTIC BIP_facFTCor_CUR "BIP-Kraftstofftemperatur-Korrekturkennlinie" CURVE 0x1CC1D8 Kl_Xs16_Ws16 1.000000 Fact_BIP 0.5000000 1.500000 FORMAT "%8.6" EXTENDED_LIMITS -8.000000 7.999756
 /begin AXIS_DESCR STD_AXIS FTSCD_tFuel Temp_Cels 6 -50.14000 149.8600 FORMAT "%8.4" EXTENDED_LIMITS -3549.940 3003.560 DEPOSIT ABSOLUTE /end AXIS_DESCR
/end CHARACTERISTIC
/begin CHARACTERISTIC BIP_facInjBegCorInfl_MAP "BIP-Förderbeginn-Korrekturkennfeld beeinflusste Einspritztypen" MAP 0x1CC222 Kf_Xs16_Ys16_Ws16 0.8000488 Fact_BIP 0.8000488 1.600098 FORMAT "%8.6" EXTENDED_LIMITS -8.000000 7.999756
 /begin AXIS_DESCR STD_AXIS Eng_nAvrg EngN 10 0.00 6000.000 FORMAT "%8.3" EXTENDED_LIMITS -32768.00 32767.00 DEPOSIT ABSOLUTE /end AXIS_DESCR
 /begin AXIS_DESCR STD_AXIS BIP_phiIDes_mp AngleCrS 8 -60.00000 49.99219 FORMAT "%8.5" EXTENDED_LIMITS -768.0000 767.9766 DEPOSIT ABSOLUTE /end AXIS_DESCR
/end CHARACTERISTIC
/begin CHARACTERISTIC BIP_facInjBegCor_MAP "BIP-Förderbeginn-Korrekturkennfeld" MAP 0x1CC2EA Kf_Xs16_Ys16_Ws16 0.8000488 Fact_BIP 0.8000488 1.600098 FORMAT "%8.6" EXTENDED_LIMITS -8.000000 7.999756
 /begin AXIS_DESCR STD_AXIS Eng_nAvrg EngN 10 0.00 6000.000 FORMAT "%8.3" EXTENDED_LIMITS -32768.00 32767.00 DEPOSIT ABSOLUTE /end AXIS_DESCR
 /begin AXIS_DESCR STD_AXIS BIP_phiIDes_mp AngleCrS 17 -60.00000 49.99219 FORMAT "%8.5" EXTENDED_LIMITS -768.0000 767.9766 DEPOSIT ABSOLUTE /end AXIS_DESCR
/end CHARACTERISTIC
/begin CHARACTERISTIC BIP_nLimOff_C "Drehzahlschwelle für Abschrankung der BIP-Erfassung (unterer Hysteresewert)" VALUE 0x1CC55C Kw_Wu16 6000.000 EngN 0.00 6000.000 FORMAT "%8.3" EXTENDED_LIMITS 0.00 65535.00 /end CHARACTERISTIC
/begin CHARACTERISTIC BIP_nLimOn_C "Drehzahlschwelle für Abschrankung der BIP-Erfassung (oberer Hysteresewert)" VALUE 0x1CC55E Kw_Wu16 6000.000 EngN 0.00 6000.000 FORMAT "%8.3" EXTENDED_LIMITS 0.00 65535.00 /end CHARACTERISTIC
/begin CHARACTERISTIC BIP_nSwtMonExt_C "Drehzahlschwelle für erweiterte BIP-Überwachungsgrenzen" VALUE 0x1CC546 Kw_Wu16 6000.000 EngN 0.00 6000.000 FORMAT "%8.3" EXTENDED_LIMITS 0.00 65535.00 /end CHARACTERISTIC
/begin CHARACTERISTIC BIP_numDebConDef_C "Entprellzahl bis Dfp_BIP_Con_mp endgueltig defekt" VALUE 0x1CC548 Kw_Wu16 65535.00 OneToOne 0.00 65535.00 FORMAT "%8.2" /end CHARACTERISTIC
/begin CHARACTERISTIC BIP_numDebDvtDef_C "Entprellzahl bis Dfp_BIP%_mp.MAX/MIN endgültig defekt" VALUE 0x1CC54A Kw_Wu16 65535.00 OneToOne 0.00 65535.00 FORMAT "%8.2" /end CHARACTERISTIC
/begin CHARACTERISTIC BIP_numDebSRDef_C "Anzahl erfolglose Such-Durchläufe bis Dfp_BIP%_mp.SIG endgültig defekt" VALUE 0x1CC564 Kw_Wu16 65535.00 OneToOne 0.00 65535.00 FORMAT "%8.2" /end CHARACTERISTIC
/begin CHARACTERISTIC BIP_numDebSREnd_C "Anzahl vorhandene BIPs bevor Search-Mode beendet wird und BIP als bestätigt gilt" VALUE 0x1CC566 Kw_Wu16 65535.00 OneToOne 0.00 65535.00 FORMAT "%8.2" /end CHARACTERISTIC
/begin CHARACTERISTIC BIP_numDebSRStart_C "Anzahl nicht vorhandene BIPs bevor Search-Mode vom Forward-State gestartet wird" VALUE 0x1CC568 Kw_Wu16 65535.00 OneToOne 0.00 65535.00 FORMAT "%8.2" /end CHARACTERISTIC
/begin CHARACTERISTIC BIP_swtInjBegDisplay_C "Auswahlschalter der angibt, für welchen Einspritztyp BIP_phiDes_mp gilt" VALUE 0x1CC478 Kw_Wu8 5.000 OneToOne 1.000 6.000 FORMAT "%5.3" EXTENDED_LIMITS 0.00 255.0 /end CHARACTERISTIC
/begin CHARACTERISTIC BIP_swtLimSeq_C "Sequenz für Abschrankung der BIP-Erfassung" VALUE 0x1CC560 Kw_Wu8 255.0 OneToOne 0.00 255.0 FORMAT "%5.1" /end CHARACTERISTIC
/begin CHARACTERISTIC BIP_swtMon_C "Legt fest, welche Einspritztypen BIP-Fehler auslösen dürfen" VALUE 0x1CC54C Kw_Wu8 3.000 OneToOne 0.00 3.000 FORMAT "%5.3" EXTENDED_LIMITS 0.00 255.0 /end CHARACTERISTIC
/begin CHARACTERISTIC BIP_swtWinAlt_C "Aktivierung der alternierenden BIP-Erfassung" VALUE 0x1CC561 Kw_Wu8 1.000 OneToOne 0.00 1.000 FORMAT "%5.3" EXTENDED_LIMITS 0.00 255.0 /end CHARACTERISTIC
/begin CHARACTERISTIC BIP_swtWinPrio_C "Prioritäten der Einspritztypen bei der BIP-Erfassung" VALUE 0x1CC562 Kw_Wu16 65535.00 OneToOne 0.00 65535.00 FORMAT "%8.2" /end CHARACTERISTIC
/begin CHARACTERISTIC BIP_tiBase_CUR "BIP-Grundkennlinie" CURVE 0x1CC1F2 Kl_Xs16_Ws16 13000.00 InjTime_us 0.00 13000.00 FORMAT "%8.2" EXTENDED_LIMITS -32768.00 32767.00
 /begin AXIS_DESCR STD_AXIS BattCD_u Volt_Batt 10 0.00 20782.00 FORMAT "%8.2" EXTENDED_LIMITS -665674.1 665653.8 DEPOSIT ABSOLUTE /end AXIS_DESCR
/end CHARACTERISTIC
/begin CHARACTERISTIC BIP_tiDvtNegExt_C "Maximal zugelassene negative BIP-Zeit-Erwartungswertabweichung (mit Vorzeichen) oberhalb BIP_nSwtMonExt_C" VALUE 0x1CC54E Kw_Ws16 65535.00 InjTime_us -32768.00 32767.00 FORMAT "%8.2" /end CHARACTERISTIC
/begin CHARACTERISTIC BIP_tiDvtNegInfl_C "Maximal zugelassene negative BIP-Zeit-Erwartungswertabweichung (mit Vorzeichen) für beeinflusste Einspritztypen" VALUE 0x1CC550 Kw_Ws16 65535.00 InjTime_us -32768.00 32767.00 FORMAT "%8.2" /end CHARACTERISTIC
/begin CHARACTERISTIC BIP_tiDvtNeg_C "Maximal zugelassene negative BIP-Zeit-Erwartungswertabweichung (mit Vorzeichen)" VALUE 0x1CC552 Kw_Ws16 65535.00 InjTime_us -32768.00 32767.00 FORMAT "%8.2" /end CHARACTERISTIC
/begin CHARACTERISTIC BIP_tiDvtPosExt_C "Maximal zugelassene positive BIP-Zeit-Erwartungswertabweichung oberhalb BIP_nSwtMonExt_C" VALUE 0x1CC554 Kw_Ws16 65535.00 InjTime_us -32768.00 32767.00 FORMAT "%8.2" /end CHARACTERISTIC
/begin CHARACTERISTIC BIP_tiDvtPosInfl_C "Maximal zugelassene positive BIP-Zeit-Erwartungswertabweichung für beeinflusste Einspritztypen" VALUE 0x1CC556 Kw_Ws16 65535.00 InjTime_us -32768.00 32767.00 FORMAT "%8.2" /end CHARACTERISTIC
/begin CHARACTERISTIC BIP_tiDvtPos_C "Maximal zugelassene positive BIP-Zeit-Erwartungswertabweichung" VALUE 0x1CC558 Kw_Ws16 65535.00 InjTime_us -32768.00 32767.00 FORMAT "%8.2" /end CHARACTERISTIC
/begin CHARACTERISTIC BIP_tiMultiInjCor_MAP "BIP-Mehrfacheinspritzungs-Korrekturkennfeld" MAP 0x1CC47A Kf_Xs16_Ys16_Ws16 500.0000 InjTime_us -500.0000 0.00 FORMAT "%8.4" EXTENDED_LIMITS -32768.00 32767.00
 /begin AXIS_DESCR STD_AXIS BIP_tiPauseToPoI2_mp InjTime_us 10 0.00 32767.00 FORMAT "%8.2" EXTENDED_LIMITS -32768.00 32767.00 DEPOSIT ABSOLUTE /end AXIS_DESCR
 /begin AXIS_DESCR STD_AXIS BIP_tiMI1Dur_mp InjTime_us 8 -32767.00 32767.00 FORMAT "%8.2" EXTENDED_LIMITS -32768.00 32767.00 DEPOSIT ABSOLUTE /end AXIS_DESCR
/end CHARACTERISTIC
/begin CHARACTERISTIC BIP_tiWinDurDelta_CUR "Maximal erlaubte Änderung der BIP-Fenster-Breite" CURVE 0x1CC56A Kl_Xs16_Ws16 400.0000 InjTime_us -200.0000 200.0000 FORMAT "%8.4" EXTENDED_LIMITS -32768.00 32767.00
 /begin AXIS_DESCR STD_AXIS BIPCD_iDelta UI_Curr 5 -7990.759 7990.759 FORMAT "%8.3" EXTENDED_LIMITS -1091005. 1090972. DEPOSIT ABSOLUTE /end AXIS_DESCR
/end CHARACTERISTIC
/begin CHARACTERISTIC BIP_tiWinDurIni_C "BIP-Fensterbreite zu Beginn des WarmUp-Modes" VALUE 0x1CC580 Kw_Ws16 65535.00 InjTime_us -32768.00 32767.00 FORMAT "%8.2" /end CHARACTERISTIC
/begin CHARACTERISTIC BIP_tiWinDur_C "BIP-Fensterbreite" VALUE 0x1CC582 Kw_Ws16 65535.00 InjTime_us -32768.00 32767.00 FORMAT "%8.2" /end CHARACTERISTIC
/begin CHARACTERISTIC BIP_tiWinOffNegPoI2_C "Negativer BIP-Fenster-Offset des Forward-States (mit Vorzeichen) für PoI2" VALUE 0x1CC584 Kw_Ws16 65535.00 InjTime_us -32768.00 32767.00 FORMAT "%8.2" /end CHARACTERISTIC
/begin CHARACTERISTIC BIP_tiWinOffNegSRInfl_C "Negative Grenze des Search-Modes für beeinflusste Einspritztypen" VALUE 0x1CC586 Kw_Ws16 65535.00 InjTime_us -32768.00 32767.00 FORMAT "%8.2" /end CHARACTERISTIC
/begin CHARACTERISTIC BIP_tiWinOffNegSR_C "Negative Grenze des Search-Modes" VALUE 0x1CC588 Kw_Ws16 65535.00 InjTime_us -32768.00 32767.00 FORMAT "%8.2" /end CHARACTERISTIC
/begin CHARACTERISTIC BIP_tiWinOffNeg_C "Negativer BIP-Fenster-Offset des Forward-States (mit Vorzeichen)" VALUE 0x1CC58A Kw_Ws16 65535.00 InjTime_us -32768.00 32767.00 FORMAT "%8.2" /end CHARACTERISTIC
/begin CHARACTERISTIC BIP_tiWinOffPosSRInfl_C "Positive Grenze des Search Modes für beeinflusste Einspritztypen" VALUE 0x1CC58C Kw_Ws16 65535.00 InjTime_us -32768.00 32767.00 FORMAT "%8.2" /end CHARACTERISTIC
/begin CHARACTERISTIC BIP_tiWinOffPosSR_C "Positive Grenze des Search-Modes" VALUE 0x1CC58E Kw_Ws16 65535.00 InjTime_us -32768.00 32767.00 FORMAT "%8.2" /end CHARACTERISTIC
/begin CHARACTERISTIC BIP_tiWinOffStep_C "Schrittweite des Sweep-Modes zur Änderung des BIP-Fenster-Offsets" VALUE 0x1CC590 Kw_Wu16 65535.00 InjTime_us 0.00 65535.00 FORMAT "%8.2" /end CHARACTERISTIC
/begin CHARACTERISTIC BIP_tMinMon_C "Minimal notwendige Kraftstofftemperatur für BIP-Fehlereinträge" VALUE 0x1CC55A Kw_Ws16 200.0000 Temp_Cels -50.14000 149.8600 FORMAT "%8.4" EXTENDED_LIMITS -3549.940 3003.560 /end CHARACTERISTIC
/begin CHARACTERISTIC BIP_uBattDfl_C "Batteriespannungs-Ersatzwert (nur für BIP-Komponente)" VALUE 0x1CC21C Kw_Ws16 7780.553 Volt_Batt 13001.45 20782.00 FORMAT "%8.2" EXTENDED_LIMITS -665674.1 665653.8 /end CHARACTERISTIC
/begin CHARACTERISTIC BIP_uBattMax_C "Batteriespannungs-Maximum (nur für BIP-Komponente)" VALUE 0x1CC21E Kw_Ws16 6277.261 Volt_Batt 14504.74 20782.00 FORMAT "%8.2" EXTENDED_LIMITS -665674.1 665653.8 /end CHARACTERISTIC
/begin CHARACTERISTIC BIP_uBattMin_C "Batteriespannungs-Minimum (nur für BIP-Komponente)" VALUE 0x1CC220 Kw_Ws16 5992.854 Volt_Batt 7008.592 13001.45 FORMAT "%8.2" EXTENDED_LIMITS -665674.1 665653.8 /end CHARACTERISTIC
/begin CHARACTERISTIC BPACD_ctPwrStgOnMax2_C "Maximum der Endstufe 2 aktivierungen im Fahrzyklus bei SCB oder Übertemperatur Fehler" VALUE 0x1CC5B0 Kw_Wu16 65535.00 OneToOne 0.00 65535.00 FORMAT "%8.2" /end CHARACTERISTIC
/begin CHARACTERISTIC BPACD_ctPwrStgOnMax_C "Maximum der Endstufen aktivierungen im Fahrzyklus bei SCB oder Übertemperatur Fehler" VALUE 0x1CC5B2 Kw_Wu16 65535.00 OneToOne 0.00 65535.00 FORMAT "%8.2" /end CHARACTERISTIC
/begin CHARACTERISTIC BPACD_DebExcTemp2Def_C "Fehlerentprellzeit für Übertemperatur 2" VALUE 0x1CC5B4 Kw_Wu16 655350.0 Time_ms 0.00 655350.0 FORMAT "%8.1" /end CHARACTERISTIC
/begin CHARACTERISTIC BPACD_DebExcTemp2Ok_C "Heilungsentprellzeit für Übertemperatur 2" VALUE 0x1CC5B6 Kw_Wu16 655350.0 Time_ms 0.00 655350.0 FORMAT "%8.1" /end CHARACTERISTIC
/begin CHARACTERISTIC BPACD_DebExcTempDef_C "Fehlerentprellzeit für Übertemperatur" VALUE 0x1CC5B8 Kw_Wu16 655350.0 Time_ms 0.00 655350.0 FORMAT "%8.1" /end CHARACTERISTIC
/begin CHARACTERISTIC BPACD_DebExcTempOk_C "Heilungsentprellzeit für Übertemperatur" VALUE 0x1CC5BA Kw_Wu16 655350.0 Time_ms 0.00 655350.0 FORMAT "%8.1" /end CHARACTERISTIC
/begin CHARACTERISTIC BPACD_DebNoLoad2Def_C "Fehlerentprellzeit für Lastabfall 2" VALUE 0x1CC5BC Kw_Wu16 655350.0 Time_ms 0.00 655350.0 FORMAT "%8.1" /end CHARACTERISTIC
/begin CHARACTERISTIC BPACD_DebNoLoad2Ok_C "Heilungsentprellzeit für Lastabfall 2" VALUE 0x1CC5BE Kw_Wu16 655350.0 Time_ms 0.00 655350.0 FORMAT "%8.1" /end CHARACTERISTIC
/begin CHARACTERISTIC BPACD_DebNoLoadDef_C "Fehlerentprellzeit für Lastabfall" VALUE 0x1CC5C0 Kw_Wu16 655350.0 Time_ms 0.00 655350.0 FORMAT "%8.1" /end CHARACTERISTIC
/begin CHARACTERISTIC BPACD_DebNoLoadOk_C "Heilungsentprellzeit für Lastabfall" VALUE 0x1CC5C2 Kw_Wu16 655350.0 Time_ms 0.00 655350.0 FORMAT "%8.1" /end CHARACTERISTIC
/begin CHARACTERISTIC BPACD_DebShortCircBat2Def_C "Fehlerentprellzeitzeit für Kurzschluß nach Batteriespannung 2" VALUE 0x1CC5C4 Kw_Wu16 655350.0 Time_ms 0.00 655350.0 FORMAT "%8.1" /end CHARACTERISTIC
/begin CHARACTERISTIC BPACD_DebShortCircBat2Ok_C "Heilungsentprellzeit für Kurzschluß nach Batteriespannung 2" VALUE 0x1CC5C6 Kw_Wu16 655350.0 Time_ms 0.00 655350.0 FORMAT "%8.1" /end CHARACTERISTIC
/begin CHARACTERISTIC BPACD_DebShortCircBatDef_C "Fehlerentprellzeitzeit für Kurzschluß nach Batteriespannung" VALUE 0x1CC5C8 Kw_Wu16 655350.0 Time_ms 0.00 655350.0 FORMAT "%8.1" /end CHARACTERISTIC
/begin CHARACTERISTIC BPACD_DebShortCircBatOk_C "Heilungsentprellzeit für Kurzschluß nach Batteriespannung" VALUE 0x1CC5CA Kw_Wu16 655350.0 Time_ms 0.00 655350.0 FORMAT "%8.1" /end CHARACTERISTIC
/begin CHARACTERISTIC BPACD_DebShortCircGnd2Def_C "Fehlerentprellzeit für Kurzschluß nach Masse 2" VALUE 0x1CC5CC Kw_Wu16 655350.0 Time_ms 0.00 655350.0 FORMAT "%8.1" /end CHARACTERISTIC
/begin CHARACTERISTIC BPACD_DebShortCircGnd2Ok_C "Heilungsentprellzeit für Kurzschluß nach Masse 2" VALUE 0x1CC5CE Kw_Wu16 655350.0 Time_ms 0.00 655350.0 FORMAT "%8.1" /end CHARACTERISTIC
/begin CHARACTERISTIC BPACD_DebShortCircGndDef_C "Fehlerentprellzeit für Kurzschluß nach Masse" VALUE 0x1CC5D0 Kw_Wu16 655350.0 Time_ms 0.00 655350.0 FORMAT "%8.1" /end CHARACTERISTIC
/begin CHARACTERISTIC BPACD_DebShortCircGndOk_C "Heilungsentprellzeit für Kurzschluß nach Masse" VALUE 0x1CC5D2 Kw_Wu16 655350.0 Time_ms 0.00 655350.0 FORMAT "%8.1" /end CHARACTERISTIC
/begin CHARACTERISTIC BPACD_stInvOut2_C "Invertierungsparameter für das Signal 2 der Ladedruckstellerendstufe" VALUE 0x1CC5D4 Kw_Wu8 1.000 OneToOne 0.00 1.000 FORMAT "%5.3" EXTENDED_LIMITS 0.00 255.0 /end CHARACTERISTIC
/begin CHARACTERISTIC BPACD_tiPer2_C "Periodendauer Ladedrucksteller 2." VALUE 0x1CC5D6 Kw_Ws16 10.60000 Period 1.100000 11.70000 FORMAT "%8.5" EXTENDED_LIMITS -3276.800 3276.700 /end CHARACTERISTIC
/begin CHARACTERISTIC BPACD_stInvOut_C "Invertierungsparameter für das Signal der Ladedruckstellerendstufe" VALUE 0x1CC5D8 Kw_Wu8 1.000 OneToOne 0.00 1.000 FORMAT "%5.3" EXTENDED_LIMITS 0.00 255.0 /end CHARACTERISTIC
/begin CHARACTERISTIC BPACD_tiPer_C "Periodendauer Ladedrucksteller." VALUE 0x1CC5DA Kw_Ws16 10.60000 Period 1.100000 11.70000 FORMAT "%8.5" EXTENDED_LIMITS -3276.800 3276.700 /end CHARACTERISTIC
/begin CHARACTERISTIC BPACD_rCnv2_CUR "Kennlinie zur konvertierung von Öffnungsgrad 2 in Tastverhältnis" CURVE 0x1CC5DC Kl_Xs16_Ws16 100.0000 DtyCyc 0.00 100.0000 FORMAT "%8.4" EXTENDED_LIMITS -327.6800 327.6700
 /begin AXIS_DESCR STD_AXIS PCR_rBPACD2 Prc 25 -100.0000 200.0000 FORMAT "%8.4" EXTENDED_LIMITS -327.6800 327.6700 DEPOSIT ABSOLUTE /end AXIS_DESCR
/end CHARACTERISTIC
/begin CHARACTERISTIC BPACD_rCnv_CUR "Kennlinie zur konvertierung von Öffnungsgrad in Tastverhältnis" CURVE 0x1CC642 Kl_Xs16_Ws16 100.0000 DtyCyc 0.00 100.0000 FORMAT "%8.4" EXTENDED_LIMITS -327.6800 327.6700
 /begin AXIS_DESCR STD_AXIS PCR_rBPACD Prc 25 -100.0000 200.0000 FORMAT "%8.4" EXTENDED_LIMITS -327.6800 327.6700 DEPOSIT ABSOLUTE /end AXIS_DESCR
/end CHARACTERISTIC
/begin CHARACTERISTIC BPACD_rOutMax2_C "Maximal auszugebendes Tastverhältnis LDS 2" VALUE 0x1CC6A8 Kw_Ws16 655.3500 DtyCyc -327.6800 327.6700 FORMAT "%8.4" /end CHARACTERISTIC
/begin CHARACTERISTIC BPACD_rOutMax_C "Maximal auszugebendes Tastverhältnis" VALUE 0x1CC6AA Kw_Ws16 655.3500 DtyCyc -327.6800 327.6700 FORMAT "%8.4" /end CHARACTERISTIC
/begin CHARACTERISTIC BPACD_rOutMin2_C "Minimal auszugebendes Tastverhältnis LDS_2" VALUE 0x1CC6AC Kw_Ws16 655.3500 DtyCyc -327.6800 327.6700 FORMAT "%8.4" /end CHARACTERISTIC
/begin CHARACTERISTIC BPACD_rOutMin_C "Minimal auszugebendes Tastverhältnis" VALUE 0x1CC6AE Kw_Ws16 655.3500 DtyCyc -327.6800 327.6700 FORMAT "%8.4" /end CHARACTERISTIC
/begin CHARACTERISTIC BPACD_stPwrStgActv2_C "Aktivierung der Abschaltbedingungen der Endstufe 2" VALUE 0x1CC6B0 Kw_Wu8 255.0 OneToOne 0.00 255.0 FORMAT "%5.1" /end CHARACTERISTIC
/begin CHARACTERISTIC BPACD_stPwrStgActv_C "Aktivierung der Abschaltbedingungen der Endstufe" VALUE 0x1CC6B1 Kw_Wu8 255.0 OneToOne 0.00 255.0 FORMAT "%5.1" /end CHARACTERISTIC
/begin CHARACTERISTIC BPACD_stPwrStgDia2_C "Aktivierung der Abschaltbedingungen der Endstufediagnose 2" VALUE 0x1CC6B2 Kw_Wu8 255.0 OneToOne 0.00 255.0 FORMAT "%5.1" /end CHARACTERISTIC
/begin CHARACTERISTIC BPACD_stPwrStgDia_C "Aktivierung der Abschaltbedingungen der Endstufediagnose" VALUE 0x1CC6B3 Kw_Wu8 255.0 OneToOne 0.00 255.0 FORMAT "%5.1" /end CHARACTERISTIC
/begin CHARACTERISTIC BPACD_stSPICtl2_C "Parameter zur Auswahl des Endstufentypes  ( 1 = SPI Endstufe, 0 = Nicht SPI Endstufe )" VALUE 0x1CC6B4 Kw_Wu8 1.000 OneToOne 0.00 1.000 FORMAT "%5.3" EXTENDED_LIMITS 0.00 255.0 /end CHARACTERISTIC
/begin CHARACTERISTIC BPACD_stSPICtl_C "Parameter zur Auswahl des Endstufentypes  ( 1 = SPI Endstufe, 0 = Nicht SPI Endstufe )" VALUE 0x1CC6B5 Kw_Wu8 1.000 OneToOne 0.00 1.000 FORMAT "%5.3" EXTENDED_LIMITS 0.00 255.0 /end CHARACTERISTIC
/begin CHARACTERISTIC BPACD_swt2_C "Schalter für Batteriespannungskorrektur 2 (0 = AUS, 1 = EIN)" VALUE 0x1CC6B6 Kw_Wu8 255.0 OneToOne 0.00 255.0 FORMAT "%5.1" /end CHARACTERISTIC
/begin CHARACTERISTIC BPACD_swtEActrOn_C "Schalter zur Auswahl des elektrischen Ladedruckstellers über CAN (0 = AUS, 1 = EIN)" VALUE 0x1CC6B7 Kw_Wu8 1.000 OneToOne 0.00 1.000 FORMAT "%5.3" EXTENDED_LIMITS 0.00 255.0 /end CHARACTERISTIC
/begin CHARACTERISTIC BPACD_swt_C "Schalter für Batteriespannungskorrektur (0 = AUS, 1 = EIN)" VALUE 0x1CC6B8 Kw_Wu8 255.0 OneToOne 0.00 255.0 FORMAT "%5.1" /end CHARACTERISTIC
/begin CHARACTERISTIC BPACD_tiBtwTst2_C "Zeitabstand, in dem im Fehlerfall die Endstufe 2 getestet wird" VALUE 0x1CC6BA Kw_Wu16 29980.00 Time_ms 20.00000 30000.00 FORMAT "%8.2" EXTENDED_LIMITS 0.00 655350.0 /end CHARACTERISTIC
/begin CHARACTERISTIC BPACD_tiBtwTst_C "Zeitabstand, in dem im Fehlerfall die Endstufe getestet wird" VALUE 0x1CC6BC Kw_Wu16 29980.00 Time_ms 20.00000 30000.00 FORMAT "%8.2" EXTENDED_LIMITS 0.00 655350.0 /end CHARACTERISTIC
/begin CHARACTERISTIC BPACD_tiPwrStgOn2_C "Zeit für die die Endstufe eingeschalten wird bei nicht SPI Endstufen" VALUE 0x1CC6BE Kw_Wu16 500.0000 Time_ms 0.00 500.0000 FORMAT "%8.4" EXTENDED_LIMITS 0.00 655350.0 /end CHARACTERISTIC
/begin CHARACTERISTIC BPACD_tiPwrStgOn_C "Zeit für die die Endstufe eingeschalten wird bei nicht SPI Endstufen" VALUE 0x1CC6C0 Kw_Wu16 500.0000 Time_ms 0.00 500.0000 FORMAT "%8.4" EXTENDED_LIMITS 0.00 655350.0 /end CHARACTERISTIC
/begin CHARACTERISTIC BPASCD_uSRCMinRelPos_C "Spannungsgrenze für SRC Min Fehler" VALUE 0x1CC6C4 Kw_Ws16 5200.391 Volt 0.00 5200.391 FORMAT "%8.3" EXTENDED_LIMITS -160156.4 160151.5 /end CHARACTERISTIC
/begin CHARACTERISTIC BPASCD_uSRCMaxRelPos_C "Spannungsgrenze für SRC High Fehler" VALUE 0x1CC6C6 Kw_Ws16 5200.391 Volt 0.00 5200.391 FORMAT "%8.3" EXTENDED_LIMITS -160156.4 160151.5 /end CHARACTERISTIC
/begin CHARACTERISTIC BPASCD_rLinRelPos_CUR "Linearisierungs Kennlinie für den Positionsrückmelder" CURVE 0x1CC6C8 Kl_Xs16_Ws16 100.0000 Prc 0.00 100.0000 FORMAT "%8.4" EXTENDED_LIMITS -327.6800 327.6700
 /begin AXIS_DESCR STD_AXIS BPASCD_uRawRelPos Volt 9 0.00 5200.391 FORMAT "%8.3" EXTENDED_LIMITS -160156.4 160151.5 DEPOSIT ABSOLUTE /end AXIS_DESCR
/end CHARACTERISTIC
/begin CHARACTERISTIC BPASCD_DebSigDefRelPos_C "Fehlerentprellzeit für CAN Fehler" VALUE 0x1CC6EE Kw_Wu16 655350.0 Time_ms 0.00 655350.0 FORMAT "%8.1" /end CHARACTERISTIC
/begin CHARACTERISTIC BPASCD_DebSigOkRelPos_C "Heilungsentprellzeit für CAN Fehler" VALUE 0x1CC6F0 Kw_Wu16 655350.0 Time_ms 0.00 655350.0 FORMAT "%8.1" /end CHARACTERISTIC
/begin CHARACTERISTIC BPASCD_DebSRCHiDefRelPos_C "Fehlerentprellzeit für SRC High" VALUE 0x1CC6F2 Kw_Wu16 655350.0 Time_ms 0.00 655350.0 FORMAT "%8.1" /end CHARACTERISTIC
/begin CHARACTERISTIC BPASCD_DebSRCHiOkRelPos_C "Heilungsentprellzeit für SRC High" VALUE 0x1CC6F4 Kw_Wu16 655350.0 Time_ms 0.00 655350.0 FORMAT "%8.1" /end CHARACTERISTIC
/begin CHARACTERISTIC BPASCD_DebSRCLoDefRelPos_C "Fehlerentprellzeit für SRC Low" VALUE 0x1CC6F6 Kw_Wu16 655350.0 Time_ms 0.00 655350.0 FORMAT "%8.1" /end CHARACTERISTIC
/begin CHARACTERISTIC BPASCD_DebSRCLoOkRelPos_C "Heilungsentprellzeit für SRC Low" VALUE 0x1CC6F8 Kw_Wu16 655350.0 Time_ms 0.00 655350.0 FORMAT "%8.1" /end CHARACTERISTIC
/begin CHARACTERISTIC BPASCD_dtRmpSlpUpRelPos_C "Rampensteigung bei Heilung/Vorgabewert" VALUE 0x1CC6FC Kw_Wu32 655359.999847 RmpPrc 0.00 655359.999847 FORMAT "%13.6" /end CHARACTERISTIC
/begin CHARACTERISTIC BPASCD_dtRmpSlpDwnRelPos_C "Rampensteigung bei Heilung/Vorgabewert" VALUE 0x1CC700 Kw_Wu32 655359.999847 RmpPrc 0.00 655359.999847 FORMAT "%13.6" /end CHARACTERISTIC
/begin CHARACTERISTIC BPASCD_facOfs_C "Gewichtungsfaktor des Offsetwertes" VALUE 0x1CC704 Kw_Ws16 1.000000 Fact 0.00 1.000000 FORMAT "%8.6" EXTENDED_LIMITS -4.000000 3.999878 /end CHARACTERISTIC
/begin CHARACTERISTIC BPASCD_nMinOfs_CUR "Kennlinie für minimales Motordrehzahl- Offset." CURVE 0x1CC706 Kl_Xs16_Ws16 6000.000 EngN 0.00 6000.000 FORMAT "%8.3" EXTENDED_LIMITS -32768.00 32767.00
 /begin AXIS_DESCR STD_AXIS APSCD_pVal Pres_hPa 4 0.00 3500.000 FORMAT "%8.3" EXTENDED_LIMITS -32768.00 32767.00 DEPOSIT ABSOLUTE /end AXIS_DESCR
/end CHARACTERISTIC
/begin CHARACTERISTIC BPASCD_numSSpRelPos_C "Nummer des Spannungsmodules an dem die Sensorversorgung angeschlossen ist" VALUE 0x1CC718 Kw_Wu8 2.000 OneToOne 1.000 3.000 FORMAT "%5.3" EXTENDED_LIMITS 0.00 255.0 /end CHARACTERISTIC
/begin CHARACTERISTIC BPASCD_rOutMinOfs_C "Minimaler Ansteuerwert zur Offsetadaption" VALUE 0x1CC71A Kw_Ws16 100.0000 DtyCyc 0.00 100.0000 FORMAT "%8.4" EXTENDED_LIMITS -327.6800 327.6700 /end CHARACTERISTIC
/begin CHARACTERISTIC BPASCD_rRefOfs_C "Referenzwert des Offset" VALUE 0x1CC71C Kw_Ws16 100.0000 Prc 0.00 100.0000 FORMAT "%8.4" EXTENDED_LIMITS -327.6800 327.6700 /end CHARACTERISTIC
/begin CHARACTERISTIC BPASCD_swtSigRelPos_C "Wahlschalter für Signalquelle ADC oder CAN" VALUE 0x1CC71E Kw_Wu8 1.000 OneToOne 0.00 1.000 FORMAT "%5.3" EXTENDED_LIMITS 0.00 255.0 /end CHARACTERISTIC
/begin CHARACTERISTIC BPASCD_tiOfs_C "Dauer der Bedingungen für Offsetadaption" VALUE 0x1CC720 Kw_Wu16 5000.000 Time_ms 0.00 5000.000 FORMAT "%8.3" EXTENDED_LIMITS 0.00 655350.0 /end CHARACTERISTIC
/begin CHARACTERISTIC BPASCD_tMinOfs_C "Minimale Motortemperatur zur Offsetadaption" VALUE 0x1CC722 Kw_Ws16 250.0000 Temp_Cels -50.14000 199.8600 FORMAT "%8.4" EXTENDED_LIMITS -3549.940 3003.560 /end CHARACTERISTIC
/begin CHARACTERISTIC BPASCD_stSensIDWordRelPos_C "Geberkennwort des Ladedrucksteller Positionssensors" VALUE 0x1CC724 Kw_Wu16 65535.00 OneToOne 0.00 65535.00 FORMAT "%8.2" /end CHARACTERISTIC
/begin CHARACTERISTIC BPASCD_rDflRelPos_C "Vorgabewert für die Position des Ladedruckstellers" VALUE 0x1CC726 Kw_Ws16 100.0000 Prc 0.00 100.0000 FORMAT "%8.4" EXTENDED_LIMITS -327.6800 327.6700 /end CHARACTERISTIC
/begin CHARACTERISTIC BPASCD_uMaxOfs_C "Maximalwert der Rohspannung zur Offsetadaption" VALUE 0x1CC728 Kw_Ws16 5200.391 Volt 0.00 5200.391 FORMAT "%8.3" EXTENDED_LIMITS -160156.4 160151.5 /end CHARACTERISTIC
/begin CHARACTERISTIC BPASCD_uMinOfs_C "Minimalwert der Rohspannung zur Offsetadaption" VALUE 0x1CC72A Kw_Ws16 5200.391 Volt 0.00 5200.391 FORMAT "%8.3" EXTENDED_LIMITS -160156.4 160151.5 /end CHARACTERISTIC
/begin CHARACTERISTIC FrmMng_stCrshIntstyCrCtl_C "Anwendungsparameter, um die CrCtl Absperrvorrichtung wegen Luftsacks zu entdecken, zerschmettert Intensität" VALUE 0x1D78E6 Kw_Wu8 7.000 OneToOne 0.00 7.000 FORMAT "%5.3" EXTENDED_LIMITS 0.00 255.0 /end CHARACTERISTIC
/begin CHARACTERISTIC FrmMng_stCrshIntstyPSP_C "Anwendungsparameter, um die PSP Absperrvorrichtung wegen Airbagabbruch-Intensität zu entdecken" VALUE 0x1D78E7 Kw_Wu8 7.000 OneToOne 0.00 7.000 FORMAT "%5.3" EXTENDED_LIMITS 0.00 255.0 /end CHARACTERISTIC
/begin CHARACTERISTIC SigTst_AltRLYExcEn_C "Stellertestüberwachung Freigabemaske für die Generatorerregung" VALUE 0x1F0496 Kw_Wu8 7.000 OneToOne 0.00 7.000 FORMAT "%5.3" EXTENDED_LIMITS 0.00 255.0 /end CHARACTERISTIC
/begin CHARACTERISTIC SigTst_BPAEn_C "Stellertestüberwachung Freigabemaske für Ladedrucksteller" VALUE 0x1F0497 Kw_Wu8 7.000 OneToOne 0.00 7.000 FORMAT "%5.3" EXTENDED_LIMITS 0.00 255.0 /end CHARACTERISTIC
/begin CHARACTERISTIC SigTst_BPA2En_C "Stellertestüberwachung Freigabemaske für Ladedrucksteller 2" VALUE 0x1F0498 Kw_Wu8 7.000 OneToOne 0.00 7.000 FORMAT "%5.3" EXTENDED_LIMITS 0.00 255.0 /end CHARACTERISTIC
/begin CHARACTERISTIC UAcc_LogReqPWAirCtlOff_C "Passwort für Abschaltung EGR durch Login im aktuellen Fahrzyklus" VALUE 0x1C148E Kw_Wu16 55535.00 OneToOne 10000.00 65535.00 FORMAT "%8.2" EXTENDED_LIMITS 0.00 65535.00 /end CHARACTERISTIC
/begin CHARACTERISTIC UAcc_LogReqPWAirCtlOn_C "Passwort für Einschaltung EGR durch Login im aktuellen Fahrzyklus" VALUE 0x1C1490 Kw_Wu16 55535.00 OneToOne 10000.00 65535.00 FORMAT "%8.2" EXTENDED_LIMITS 0.00 65535.00 /end CHARACTERISTIC
/begin COMPU_METHOD AirMassPerCyl "Luftmasse pro Zylinder" RAT_FUNC "%6.3" "[mg/Hub Luft]" COEFFS 0 10 0 0 0 1 /end COMPU_METHOD
/begin COMPU_METHOD AirMassPerTime_20ms "Luftmasse pro Sekunde [kg/s]" RAT_FUNC "%6.2" "[(mg/Hub Luft)/s]" COEFFS 0 0.2 0 0 0 1 /end COMPU_METHOD
/begin COMPU_METHOD AngleCrS "Winkel Kurbelwelle" RAT_FUNC "%6.4" "[deg CrS]" COEFFS 0 42.6666666666667 0 0 0 1 /end COMPU_METHOD
/begin COMPU_METHOD DtyCyc "Tastverhaeltnis" RAT_FUNC "%6.4" "[%]" COEFFS 0 100 0 0 0 1 /end COMPU_METHOD
/begin COMPU_METHOD EGTSwt_S16 "Faktor (0...1) für sint16 Type mit 0.000061 Auflösung" RAT_FUNC "%7.6" "-" COEFFS 0 16384 0 0 0 1 /end COMPU_METHOD
/begin COMPU_METHOD EngN "Motordrehzahl" RAT_FUNC "%6.2" "[rpm]" COEFFS 0 1 0 0 0 1 /end COMPU_METHOD
/begin COMPU_METHOD EngTempFldSel "Verbale Umrechnung für Auswahl aus dem Motortemperatur-Feld Eng_tFld" TAB_VERB "%6.3" "" COMPU_TAB_REF EngTempFldSel /end COMPU_METHOD
/begin COMPU_VTAB EngTempFldSel "Verbale Umrechnung für Auswahl aus dem Motortemperatur-Feld Eng_tFld" TAB_VERB 5 0 "Coolant_Temperature" 1 "Oil_Temperature" 2 "Engine_Temperature" 3 "Fuel_Temperature" 4 "Coolant_Temperature_CAN" /end COMPU_VTAB
/begin COMPU_METHOD Fact "Faktor mit Auflösung 1 / 8192, hauptsächlich für einen Faktorenbereich 0...1 verwendet" RAT_FUNC "%6.5" "[-]" COEFFS 0 8192 0 0 0 1 /end COMPU_METHOD
/begin COMPU_METHOD Fact1 "Faktor mit Auflösung 0,01 (100 mal höherer Bereich als Fact)" RAT_FUNC "%6.4" "[-]" COEFFS 0 128 0 0 0 1 /end COMPU_METHOD
/begin COMPU_METHOD Fact_BIP "Auflösung der BIP-Berechnungen" RAT_FUNC "%6.5" "[-]" COEFFS 0 4096 0 0 0 1 /end COMPU_METHOD
/begin COMPU_METHOD InjMass "Einspritzmenge" RAT_FUNC "%6.4" "[mg/hub]" COEFFS 0 100 0 0 0 1 /end COMPU_METHOD
/begin COMPU_METHOD InjMassPerSec_20ms "Einspritzmengenänderung pro Sekunde für 20ms-Tasks" RAT_FUNC "%6.3" "[mg/hub/s]" COEFFS 0 2 0 0 0 1 /end COMPU_METHOD
/begin COMPU_METHOD InjTime_us "Zeit in Microsekunden für das Einspritztiming" RAT_FUNC "%6.2" "[us]" COEFFS 0 1 0 0 0 1 /end COMPU_METHOD
/begin COMPU_METHOD Kd "Differentialverstärkung Kd (gleiche Einheit/Umrechnungsformel an Ein- und Ausgang)" RAT_FUNC "%7.6" "[1/1]" COEFFS 0 65536 0 0 0 1 /end COMPU_METHOD
/begin COMPU_METHOD Kd_Ampc2Prc "Differentialverstärkung Kd (Luftmasse pro Zyl. AirMassPerCyl zu Prozent Prc)" RAT_FUNC "%8.7" "[%/(mg/Hub Luft)]" COEFFS 0 655360 0 0 0 1 /end COMPU_METHOD
/begin COMPU_METHOD Kd_InjMass2Prc "Differentialverstärkung (Einspritzmasse zu Prozent)" RAT_FUNC "%7.6" "[%/(mg/Hub)]" COEFFS 0 65536 0 0 0 1 /end COMPU_METHOD
/begin COMPU_METHOD Ki_Ampc2Prc "Integralverstärkung (Luftmasse pro Zyl. AirMassPerCyl zu Prozent Prc)" RAT_FUNC "%7.6" "[%/(mg/Hub Luft)/s]" COEFFS 0 42949.67296 0 0 0 1 /end COMPU_METHOD
/begin COMPU_METHOD Kp_Ampc2Prc "Proportionalverstärkung (Luftmasse zu Prozent)" RAT_FUNC "%8.7" "[%/(mg/Hub Luft)]" COEFFS 0 655360 0 0 0 1 /end COMPU_METHOD
/begin COMPU_METHOD lambda "Lambda" RAT_FUNC "%6.5" "[-]" COEFFS 0 1000 0 0 0 1 /end COMPU_METHOD
/begin COMPU_METHOD OneToOne "eins zu eins (physikalischer Wert ist gleich dem internen Wert)" RAT_FUNC "%6.2" "[-]" COEFFS 0 1 0 0 0 1 /end COMPU_METHOD
/begin COMPU_METHOD Period "Periodendauer" RAT_FUNC "%6.3" "[ms]" COEFFS 0 10 0 0 0 1 /end COMPU_METHOD
/begin COMPU_METHOD Prc "Prozent, gleiche interne Auflösung wie Fact, aber Darstellung in Prozent (0...100%)" RAT_FUNC "%6.4" "[%]" COEFFS 0 100 0 0 0 1 /end COMPU_METHOD
/begin COMPU_METHOD PrcPerSec_20ms "Prozentänderung pro Sekunde für 20ms-Tasks" RAT_FUNC "%6.3" "[%/s]" COEFFS 0 2 0 0 0 1 /end COMPU_METHOD
/begin COMPU_METHOD Pres_hPa "Druck (angezeigt in [hPa])" RAT_FUNC "%6.2" "[hPa]" COEFFS 0 1 0 0 0 1 /end COMPU_METHOD
/begin COMPU_METHOD Pwr "Leistung" RAT_FUNC "%6.2" "[W]" COEFFS 0 0.10610329539459 0 0 0 1 /end COMPU_METHOD
/begin COMPU_METHOD Rmp "einheitenloser Rampengradient (für Library Ramp, etc.)" RAT_FUNC "%6.4" "[1/s]" COEFFS 0 65.536 0 0 0 1 /end COMPU_METHOD
/begin COMPU_METHOD RmpAirMassPerCyl "Rampengradient für Luftmasse pro Zylinder" RAT_FUNC "%6.4" "[(mg/Hub Luft)/s]" COEFFS 0 655.36 0 0 0 1 /end COMPU_METHOD
/begin COMPU_METHOD RmpPrc "Prozent Rampengradient" RAT_FUNC "%6.5" "[%/s]" COEFFS 0 6553.6 0 0 0 1 /end COMPU_METHOD
/begin COMPU_METHOD Temp_Cels "Temperatur dargestellt in °C (gleiche interne Darstellung wie Temp_Kelv)" RAT_FUNC "%6.1" "[deg C]" COEFFS 0 10 2731.4 0 0 1 /end COMPU_METHOD
/begin COMPU_METHOD TimeDeb "Entprellzeit in Millisekunden für Libraryfunktion Debounce" RAT_FUNC "%6.1" "[ms]" COEFFS 0 0.1 0 0 0 1 /end COMPU_METHOD
/begin COMPU_METHOD TimeDelay_ms "Zeitkonstante T1 fuer die Bibliotheksfunktionen PT1, DT1, etc.,  in ms angegeben" RAT_FUNC "%9.0" "[ms]" COEFFS 0 0 1 0 2.3283064365387e-07 0 /end COMPU_METHOD
/begin COMPU_METHOD TimeDelay_s "Zeitkonstante T1 (in s) für PT1, DT1, etc." RAT_FUNC "%9.3" "[s]" COEFFS 0 0 1 0 0.00023283064365387 0 /end COMPU_METHOD
/begin COMPU_METHOD TimeDelay_s_2 "Zeitkonstante T1 (in s) für PT1, DT1, etc. normiert auf 16 bit" RAT_FUNC "%9.4" "[s]" COEFFS 0 0 1 0 0.0596046447753906 0 /end COMPU_METHOD
/begin COMPU_METHOD TimeEGTRmp "Umrechnung  Zeit in Rampensteigung,  Verwendet in EGT-Bibliothek" RAT_FUNC "%6.3" "[s]" COEFFS 0 0 1 0 0.0152587890625 0 /end COMPU_METHOD
/begin COMPU_METHOD Time_ms "Zeit in ms für Fehlerentprellung (DSM) und SW-Timer" RAT_FUNC "%6.1" "[ms]" COEFFS 0 0.1 0 0 0 1 /end COMPU_METHOD
/begin COMPU_METHOD Time_PwmHigh "Periodenzeit von der HWE (Tio_PwmGetAvrg)" RAT_FUNC "%6.3" "[us]" COEFFS 0 10 0 0 0 1 /end COMPU_METHOD
/begin COMPU_METHOD Time_s "Zeit in s für Fehlerentprellung (DSM) und SW-Timer" RAT_FUNC "%6.4" "[s]" COEFFS 0 100 0 0 0 1 /end COMPU_METHOD
/begin COMPU_METHOD Trq "Motormoment" RAT_FUNC "%6.3" "[Nm]" COEFFS 0 10 0 0 0 1 /end COMPU_METHOD
/begin COMPU_METHOD UI_Curr "Magnetventilstrom fuer Pumpe-Duese-Element" RAT_FUNC "%6.1" "[mA]" COEFFS 0 0.0300346940351333 0 0 0 1 /end COMPU_METHOD
/begin COMPU_METHOD Volt "Spannung in V (von ADC)" RAT_FUNC "%6.2" "[mV]" COEFFS 0 0.2046 0 0 0 1 /end COMPU_METHOD
/begin COMPU_METHOD Volt_Batt "Batteriespannung" RAT_FUNC "%6.1" "[mV]" COEFFS 0 0.0492252911173131 0 0 0 1 /end COMPU_METHOD
/begin RECORD_LAYOUT Kf_Xs16_Ys16_Ws16 NO_AXIS_PTS_X 1 SWORD NO_AXIS_PTS_Y 2 SWORD AXIS_PTS_X 3 SWORD INDEX_INCR DIRECT AXIS_PTS_Y 4 SWORD INDEX_INCR DIRECT FNC_VALUES 5 SWORD COLUMN_DIR DIRECT /end RECORD_LAYOUT
/begin RECORD_LAYOUT Kl_Xs16_Ws16 NO_AXIS_PTS_X 1 SWORD AXIS_PTS_X 2 SWORD INDEX_INCR DIRECT FNC_VALUES 3 SWORD COLUMN_DIR DIRECT /end RECORD_LAYOUT
/begin RECORD_LAYOUT Kwb_Wu32 FNC_VALUES 1 ULONG COLUMN_DIR DIRECT /end RECORD_LAYOUT
/begin RECORD_LAYOUT Kw_Ws16 FNC_VALUES 1 SWORD COLUMN_DIR DIRECT /end RECORD_LAYOUT
/begin RECORD_LAYOUT Kw_Ws32 FNC_VALUES 1 SLONG COLUMN_DIR DIRECT /end RECORD_LAYOUT
/begin RECORD_LAYOUT Kw_Wu16 FNC_VALUES 1 UWORD COLUMN_DIR DIRECT /end RECORD_LAYOUT
/begin RECORD_LAYOUT Kw_Wu32 FNC_VALUES 1 ULONG COLUMN_DIR DIRECT /end RECORD_LAYOUT
/begin RECORD_LAYOUT Kw_Wu8 FNC_VALUES 1 UBYTE COLUMN_DIR DIRECT /end RECORD_LAYOUT
/begin FUNCTION AirCtl_BPDem "Ladedruckanforderung"
 /begin DEF_CHARACTERISTIC AirCtl_dqDesThr_C AirCtl_drBPAThr_C AirCtl_facBPAHold_CUR AirCtl_nWinHi_C AirCtl_nWinLow_C AirCtl_qCurrMax_C AirCtl_qCurrMin_C AirCtl_rEGRMax_C AirCtl_tiBPAHold_CUR AirCtl_tiEGRHold_C AirCtl_tiPT1BPA_C AirCtl_tiPT1EGR_C AirCtl_tiPT1qDes_C /end DEF_CHARACTERISTIC
/end FUNCTION
/begin FUNCTION AirCtl_ClntByp "Berechnung der Ansteuerung des EGR-Kühler Bypass Ventils"
 /begin DEF_CHARACTERISTIC AirCtl_mAirCBVHysHi_CUR AirCtl_mAirCBVHysLo_CUR AirCtl_qCBVHysHi_CUR AirCtl_qCBVHysLo_CUR AirCtl_stAftRunValCBV_C AirCtl_stDflValCBV_C AirCtl_stDiagStartCBV_C AirCtl_swtBPClntBypOff_C AirCtl_tAirCBVHysHi_C AirCtl_tAirCBVHysLo_C AirCtl_tClntCBVHysHi_C AirCtl_tClntCBVHysLo_C AirCtl_tiSwtDiagStartCBV_C /end DEF_CHARACTERISTIC
/end FUNCTION
/begin FUNCTION AirCtl_ControlMonitor "Monitoring and switching for EGR/TVA feedforward control" /begin DEF_CHARACTERISTIC AirCtl_tAirHotHi_C AirCtl_tAirHotLo_C /end DEF_CHARACTERISTIC /end FUNCTION
/begin FUNCTION AirCtl_CtlValCalc "Abgasrückführung - Steuerung"
 /begin DEF_CHARACTERISTIC AirCtl_dRmpSlpCtlBase_C AirCtl_facATCor_MAP AirCtl_facCtlRgn1_CUR AirCtl_facCtlRgn2_CUR AirCtl_facCtlRgn3_CUR AirCtl_facCtlValRgnPT1_CUR AirCtl_facNQAPCor_MAP AirCtl_pCor_MAP AirCtl_qRpOilCorr_CUR AirCtl_rAPCor_CUR AirCtl_rAPCor_MAP AirCtl_rCtlBase0_MAP AirCtl_rCtlBase1_MAP AirCtl_rCtlBase2_MAP AirCtl_rCtlRgn1a_MAP AirCtl_rCtlRgn1b_MAP AirCtl_rCtlRgn2a_MAP AirCtl_rCtlRgn2b_MAP AirCtl_rCtlRgn3a_MAP AirCtl_rCtlRgn3b_MAP AirCtl_rTEngCorRgn_MAP AirCtl_rTEngCor_MAP AirCtl_rTrmValCor_CUR AirCtl_stCtlRgnMsk_CA AirCtl_swtRpOilCtl_C AirCtl_swtRpOilDes_C AirCtl_swtRpOilGov_C AirCtl_swtRpOilMon_C AirCtl_tiCtlValRgnPT1_CUR /end DEF_CHARACTERISTIC
/end FUNCTION
/begin FUNCTION AirCtl_DesValCalc "Abgasrückführung - Sollwertbildung"
 /begin DEF_CHARACTERISTIC AirCtl_APCorRgn_CUR AirCtl_APCor_CUR AirCtl_ATCorRgn_MAP AirCtl_ATCor_MAP AirCtl_CTCorRgn_CUR AirCtl_CTCor_CUR AirCtl_DKdCo_C AirCtl_DKdNegCo_C AirCtl_DKdNegWm_C AirCtl_DKdPosCo_C AirCtl_DKdPosWm_C AirCtl_DKdWm_C AirCtl_DT1CoNeg_C AirCtl_DT1CoPos_C AirCtl_DT1WmNeg_C AirCtl_DT1WmPos_C AirCtl_MaxTrmVal_C AirCtl_MinTrmVal_C AirCtl_NQAPCorRgn_MAP AirCtl_NQAPCor_MAP AirCtl_NQCTCorRgn1_MAP AirCtl_NQCTCorRgn2_MAP AirCtl_NQCTCorRgn3_MAP AirCtl_NQCTCor_MAP AirCtl_RevThres_CUR AirCtl_TrmVal_C AirCtl_dRmpSlpDesBase_C AirCtl_dmRampStepDown_C AirCtl_dmRampStepUp_C AirCtl_dqDWinNegCo_C AirCtl_dqDWinNegWm_C AirCtl_dqDWinPosCo_C AirCtl_dqDWinPosWm_C AirCtl_drOvrRunAtcpHi_C AirCtl_drOvrRunAtcpLo_C AirCtl_facDesRgn1_CUR AirCtl_facDesRgn2_CUR AirCtl_facDesRgn3_CUR AirCtl_facDesValRgnPT1_CUR AirCtl_kdOvrRunAtcpDT1_C AirCtl_mAPCorAfterStrt_CUR AirCtl_mCorAfterStart_C AirCtl_mCorStrt_C AirCtl_mCor_CUR AirCtl_mDesBase0_MAP AirCtl_mDesBase1_MAP AirCtl_mDesBase2_MAP AirCtl_mDesBasePil_MAP AirCtl_mDesRgn1a_MAP AirCtl_mDesRgn1b_MAP AirCtl_mDesRgn2a_MAP AirCtl_mDesRgn2b_MAP AirCtl_mDesRgn3a_MAP AirCtl_mDesRgn3b_MAP AirCtl_mDesShtrp_CUR AirCtl_mMaxDesVal_C AirCtl_mMinDesVal_C AirCtl_stATCorMsk_C AirCtl_stCTCorMsk_C AirCtl_stDesBaseMsk_C AirCtl_stDesRgnMsk_CA AirCtl_stNQCTCorMsk1_C AirCtl_stNQCTCorMsk2_C AirCtl_stNQCTCorMsk3_C AirCtl_stRgnPT1Msk_C AirCtl_swtAPCorType_C AirCtl_swtAPCorVal_C AirCtl_swtATCorType_C AirCtl_swtATCorVal_C AirCtl_swtCorrActv_C AirCtl_swtTempRevThres_C AirCtl_swtTrmType_C AirCtl_swtTrmVal_C AirCtl_swtVirtAPP_C AirCtl_tCThreshold_C AirCtl_tiATCorRmp_C AirCtl_tiCTCorRmp_C AirCtl_tiDesRgnRmp_C AirCtl_tiDesValRgnPT1_CUR AirCtl_tiNQCTCorRmp_C AirCtl_tiOvrRunAtcpDT1_C /end DEF_CHARACTERISTIC
/end FUNCTION
/begin FUNCTION AirCtl_Governor "Adaptiver Abgasrückführregler"
 /begin DEF_CHARACTERISTIC AirCtl_DKdNeg_C AirCtl_DKdPos_C AirCtl_DKd_C AirCtl_DT1_C AirCtl_IKiNeg_C AirCtl_IKiPos_C AirCtl_IKi_C AirCtl_PKpNeg_C AirCtl_PKpPos_C AirCtl_PKp_C AirCtl_RgnDKdNeg_C AirCtl_RgnDKdPos_C AirCtl_RgnDKd_C AirCtl_RgnDT1_C AirCtl_RgnIKiNeg_C AirCtl_RgnIKiPos_C AirCtl_RgnIKi_C AirCtl_RgnPKpNeg_C AirCtl_RgnPKpPos_C AirCtl_RgnPKp_C AirCtl_YHigh_C AirCtl_YLow_C AirCtl_dqDWinNeg_C AirCtl_dqDWinPos_C AirCtl_dqRgnDWinNeg_C AirCtl_dqRgnDWinPos_C AirCtl_facATParAd_CUR AirCtl_facEGROpnLpCor2_CUR AirCtl_facGovRgnRmpEGR_CUR AirCtl_facGovRgnRmpTVA_CUR AirCtl_facILimCorRgn1_MAP AirCtl_facILimCorRgn2_MAP AirCtl_facILimCorRgn3_MAP AirCtl_facILimCor_MAP AirCtl_facLmbdDes_C AirCtl_facLmbdRecCorRgn1_MAP AirCtl_facLmbdRecCorRgn2_MAP AirCtl_facLmbdRecCorRgn3_MAP AirCtl_facLmbdRecCor_MAP AirCtl_facNQParAd_MAP AirCtl_m2rDKd_C AirCtl_mGovDevMax_C AirCtl_mGovDevMin_C AirCtl_mIWinNeg_C AirCtl_mIWinPos_C AirCtl_mPWinNeg_C AirCtl_mPWinPos_C AirCtl_mRgnIWinNeg_C AirCtl_mRgnIWinPos_C AirCtl_mRgnPWinNeg_C AirCtl_mRgnPWinPos_C AirCtl_qGovOff_CUR AirCtl_qGovOn_CUR AirCtl_qGovRgn1Off_CUR AirCtl_qGovRgn1On_CUR AirCtl_qGovRgn2Off_CUR AirCtl_qGovRgn2On_CUR AirCtl_qLdDet_CUR AirCtl_rEGRDflClsd_C AirCtl_rEGR_MAP AirCtl_rGovBrkCor_CUR AirCtl_rGovEGRMax_C AirCtl_rGovEGRMin_C AirCtl_rGovMax_C AirCtl_rGovMin_C AirCtl_rGovOut_mp_Channel AirCtl_rGovOut_mp_Vector AirCtl_rGovPCor_MAP AirCtl_rGovQDes_MAP AirCtl_rGovRgnMax_C AirCtl_rGovRgnMin_MAP AirCtl_rGovTEngCor_MAP AirCtl_rGovTVA1Max_C AirCtl_rGovTVA1Min_C AirCtl_rGovTVAMax_C AirCtl_rGovTVAMin_C AirCtl_rGovTVA_Channel AirCtl_rGovTVA_Vector AirCtl_rGovThres1High_C AirCtl_rGovThres1Low_C AirCtl_rGovThres2High_C AirCtl_rGovThres2Low_C AirCtl_rGovY1High_C AirCtl_rGovY1Low_C AirCtl_rGovY2High_C AirCtl_rGovY2Low_C AirCtl_rIDflBPDem_C AirCtl_rIDflColdStart_C AirCtl_rIDflDiaLrnVal_C AirCtl_rIDflEGT_C AirCtl_rIDflGearShft_C AirCtl_rIDflNS_C AirCtl_rIDflNoGov_C AirCtl_rIDflOvrRun_C AirCtl_rIDflShOffCo_C AirCtl_rIDflShOff_C AirCtl_rLambdaLimRgn1_MAP AirCtl_rLambdaLimRgn2_MAP AirCtl_rLambdaLimRgn3_MAP AirCtl_rLambdaLim_MAP AirCtl_rRgn1EGROpnLp_MAP AirCtl_rRgn1EGR_MAP AirCtl_rRgn1TVA_MAP AirCtl_rRgn2EGROpnLp_MAP AirCtl_rRgn2EGR_MAP AirCtl_rRgn2TVA_MAP AirCtl_rTVA_MAP AirCtl_rThresPointHigh_C AirCtl_rThresPointLow_C AirCtl_stGovRgn1HysMsk_C AirCtl_stGovRgn1Msk_C AirCtl_stGovRgn2HysMsk_C AirCtl_stGovRgn2Msk_C AirCtl_stGovRgnMsk_CA AirCtl_stInitGovRgnMsk_C AirCtl_stLimRgnMsk_CA AirCtl_swtCtlHys_C AirCtl_swtEGROpnLp1_C AirCtl_swtEGROpnLp2_C AirCtl_swtGovCtl3Hys_C AirCtl_swtGovEGRRgn_C AirCtl_swtGovEGRSep_C AirCtl_swtGovEGR_C AirCtl_swtGovTVARgn_C AirCtl_swtGovTVA_C AirCtl_swtGovType_C AirCtl_swtGovVal_C AirCtl_swtLmbdRecCor_C AirCtl_swtLmbdThres_C AirCtl_tiAftLdDet_C AirCtl_tiDT1_C AirCtl_tiGovRgnRmp_C AirCtl_tiInitGovRgn_C AirCtl_tiParRgnRmpNeg_C AirCtl_tiParRgnRmpPos_C /end DEF_CHARACTERISTIC
/end FUNCTION
/begin FUNCTION AirCtl_Monitor "Abgasrückführregelung - Überwachung und Abschaltung"
 /begin DEF_CHARACTERISTIC AirCtl_dtrqSmkLim_C AirCtl_facMaxDevCorRgn_MAP AirCtl_facMaxDevCor_MAP AirCtl_facMaxDevTempCorRgn_CUR AirCtl_facMaxDevTempCor_CUR AirCtl_facMinDevCorRgn_MAP AirCtl_facMinDevCor_MAP AirCtl_facMinDevTempCorRgn_CUR AirCtl_facMinDevTempCor_CUR AirCtl_mMaxDevRgn_MAP AirCtl_mMaxDevShtrp_CUR AirCtl_mMaxDev_MAP AirCtl_mMinDevRgn_MAP AirCtl_mMinDevShtrp_CUR AirCtl_mMinDev_MAP AirCtl_mMonOffDevRgn_C AirCtl_mMonOffDev_C AirCtl_nHealHi_C AirCtl_nHealLo_C AirCtl_nHealRgnHi_C AirCtl_nHealRgnLo_C AirCtl_nLI_C AirCtl_nOvrRunDel_CUR AirCtl_nOvrRun_CUR AirCtl_pAirHiNS_C AirCtl_pAirHi_C AirCtl_pAirLoNS_C AirCtl_pAirLo_C AirCtl_qHealHi_C AirCtl_qHealLo_C AirCtl_qHealRgnHi_C AirCtl_qHealRgnLo_C AirCtl_qHigh1_CUR AirCtl_qHigh_CUR AirCtl_qLow_CUR AirCtl_qMiddle1_CUR AirCtl_qMiddle_CUR AirCtl_qMonMaxNS_C AirCtl_qOvrRun_C AirCtl_rEGRDflBPDem_C AirCtl_rEGRDflBPLoDet_C AirCtl_rEGRDflEngPrt_C AirCtl_rEGRDflGearShft_C AirCtl_rEGRDflLoAirTemp_C AirCtl_rEGRDflLogin_C AirCtl_rEGRDflOvrRun_C AirCtl_rEGRDflRgnShOff_C AirCtl_rEGRDflShOffCo_C AirCtl_rEGRDflShOff_C AirCtl_rEGRDflVlvShOff_C AirCtl_rEGRGearChngRgn_MAP AirCtl_rEGRGearChng_MAP AirCtl_rEGROvrRunRgn_MAP AirCtl_rEGROvrRun_C AirCtl_rEGROvrRun_MAP AirCtl_rTVADflBPDem_C AirCtl_rTVADflBPLoDet_C AirCtl_rTVADflClsd_C AirCtl_rTVADflEngPrt_C AirCtl_rTVADflGearShft_C AirCtl_rTVADflLoAirTemp_C AirCtl_rTVADflLogin_C AirCtl_rTVADflOvrRun_C AirCtl_rTVADflRgnShOff_C AirCtl_rTVADflShOffCo_C AirCtl_rTVADflShOff_C AirCtl_rTVAGearChngRgn_MAP AirCtl_rTVALimMax_C AirCtl_rTVALimMin_C AirCtl_rTVANSGearChng_C AirCtl_rTVANSOvrRun_C AirCtl_rTVAOvrRunRgn_MAP AirCtl_stGovDevRgnActvMsk_C AirCtl_stGovDevRgnDeactvMsk_C AirCtl_stHighMsk_C AirCtl_stMiddleMsk_C AirCtl_stMonRgnMsk1_C AirCtl_stMonRgnMsk2_C AirCtl_stMonRgnMskOn_C AirCtl_stMonShtrpMskOn_C AirCtl_stParRgnMsk_C AirCtl_swtEGRAWDoff_C AirCtl_swtEGRFrzMAP_C AirCtl_swtTVADflLoAirTemp_C AirCtl_swtTVAFrzMAP_C AirCtl_swtTempStrtDelay_C AirCtl_tAirHi_C AirCtl_tAirLo_C AirCtl_tEngHHiNS_C AirCtl_tEngHHi_C AirCtl_tEngHLoNS_C AirCtl_tEngHLo_C AirCtl_tEngLHiNS_C AirCtl_tEngLHi_C AirCtl_tEngLLoNS_C AirCtl_tEngLLo_C AirCtl_tTurbHi_C AirCtl_tTurbLo_C AirCtl_tiClutch_C AirCtl_tiCoStrt_CUR AirCtl_tiDlyOvrRunDet_C AirCtl_tiDly_CUR AirCtl_tiEGRPT1Rgn_C AirCtl_tiEGRPT1_C AirCtl_tiLowIdle_C AirCtl_tiMaxDef_C AirCtl_tiMaxOk_C AirCtl_tiMinDef_C AirCtl_tiMinOk_C AirCtl_tiMonRgn1_C AirCtl_tiMonRgn2_C AirCtl_tiOvrRunDel_C AirCtl_tiRgnMaxDef_C AirCtl_tiRgnMaxOk_C AirCtl_tiRgnMinDef_C AirCtl_tiRgnMinOk_C AirCtl_tiTVAPT1Rgn_C AirCtl_tiTVAPT1_C AirCtl_trqCrCtloff_C AirCtl_uBattThres_C UAcc_LogReqPWAirCtlOff_C UAcc_LogReqPWAirCtlOn_C /end DEF_CHARACTERISTIC
/end FUNCTION
/begin FUNCTION AirSys_Co "Air System Co-ordinator" /begin DEF_CHARACTERISTIC AirSys_swtRstTrgOfsLrn_C /end DEF_CHARACTERISTIC /end FUNCTION
/begin FUNCTION AirbCD "Komponententreiber Airbagsignalerfassung" /begin SUB_FUNCTION AirbCD_Co /end SUB_FUNCTION /end FUNCTION
/begin FUNCTION AirbCD_Co "Komponententreiber Airbagsignalerfassung"
 /begin DEF_CHARACTERISTIC AirbCD_DebCrashCrCtlDef_C AirbCD_DebCrashCrCtlOk_C AirbCD_DebCrashFCMDef_C AirbCD_DebCrashFCMOk_C AirbCD_DebCrashPSPDef_C AirbCD_DebCrashPSPOk_C AirbCD_nEngThresMin_C AirbCD_nEngThresStrtMax_C AirbCD_nEngThresStrtMin_C AirbCD_tiDebNeg_C AirbCD_tiDebPos_C FrmMng_stCrshIntstyCrCtl_C FrmMng_stCrshIntstyPSP_C /end DEF_CHARACTERISTIC
/end FUNCTION
/begin FUNCTION Airsystem "Luftsystem"
 /begin SUB_FUNCTION Boost_Pressure Exhaust_Gas_Recirculation FlMng_InjMassLim Swirl /end SUB_FUNCTION
/end FUNCTION
/begin FUNCTION Alt "Generator" /begin SUB_FUNCTION AltCD Alt_DetAltPwr Alt_excitement /end SUB_FUNCTION /end FUNCTION
/begin FUNCTION AltCD "Komponententreiber Generator" /begin SUB_FUNCTION AltCD_Excitement AltCD_Load AltCD_Out_Proc /end SUB_FUNCTION /end FUNCTION
/begin FUNCTION AltCD_DigOut "Alternator control" /begin DEF_CHARACTERISTIC AltCD_ctPwrStgOnMax_C AltCD_stSPICtl_C AltCD_tiPwrStgOn_C /end DEF_CHARACTERISTIC /end FUNCTION
/begin FUNCTION AltCD_Excitement "Generatorerregung Komponententreiber"
 /begin DEF_CHARACTERISTIC AltCD_rThresExc_C AltCD_stInvOutExc_C AltCD_stPwrStgDiaExc_C AltCD_tiDebExcTempDefExc_C AltCD_tiDebExcTempOkExc_C AltCD_tiDebNoLoadDefExc_C AltCD_tiDebNoLoadOkExc_C AltCD_tiDebShrtBatDefExc_C AltCD_tiDebShrtBatOkExc_C AltCD_tiDebShrtGndDefExc_C AltCD_tiDebShrtGndOkExc_C SigTst_AltRLYExcEn_C /end DEF_CHARACTERISTIC
/end FUNCTION
/begin FUNCTION AltCD_Load "Generatorlasterfassung"
 /begin DEF_CHARACTERISTIC AltCD_ctPlausErr_C AltCD_dcycLoadPwmInMax_C AltCD_dcycLoadPwmInMin_C AltCD_rAltLoadDfl_C AltCD_rLoadLin_CUR AltCD_rLoadStepDown_C AltCD_rLoadStepUp_C AltCD_rLoadUnFltDfl_C AltCD_rUnFltStepDown_C AltCD_rUnFltStepUp_C AltCD_stLoadPwmInInv_C AltCD_stSensIDWordUnFlt_C AltCD_stSensIDWord_C AltCD_tiDebAccessDef_C AltCD_tiDebAccessOk_C AltCD_tiDebDtyCycMaxDef_C AltCD_tiDebDtyCycMaxOk_C AltCD_tiDebDtyCycMinDef_C AltCD_tiDebDtyCycMinOk_C AltCD_tiDebPer2HiTransHi_C AltCD_tiDebPer2HiTransLo_C AltCD_tiDebPer2LoTransHi_C AltCD_tiDebPer2LoTransLo_C AltCD_tiHighTimeThres_C AltCD_tiLoadPwmInMaxPer_C AltCD_tiLoadPwmInMinPer_C AltCD_tiPT1InAcc_C AltCD_tiPT1UnFlt_C AltCD_tiPT1_C /end DEF_CHARACTERISTIC
/end FUNCTION
/begin FUNCTION AltCD_Out_Proc "Ausgabe eines PWM-Signals (gew. Sollspannung)" /begin DEF_CHARACTERISTIC AltCD_tiBtwTst_C /end DEF_CHARACTERISTIC /end FUNCTION
/begin FUNCTION Alt_DetAltPwr "Ermittlung Leistungsbedarf Generator"
 /begin DEF_CHARACTERISTIC Alt_pwrAdjValDef_C Alt_pwrAdjValMax_C Alt_pwrAdjValMin_C Alt_pwrAltLoadVar2_MAP Alt_pwrAltLoadVar3_MAP Alt_pwrAltLoad_MAP Alt_pwrCanDef_MAP Alt_pwrCanMax_C Alt_pwrCanMin_C Alt_swtPwrCan_C Alt_swtPwrDetCan_C Alt_tiDebPwrCanDef_C Alt_tiDebPwrCanOk_C /end DEF_CHARACTERISTIC
/end FUNCTION
/begin FUNCTION Alt_excitement "Generatorabschaltung"
 /begin DEF_CHARACTERISTIC Alt_nThresERR_C Alt_tiDelPT_MAP Alt_tiExcdur_C Alt_tiLdRespTi_CUR Alt_tiLdRespTi_ReqDur_C Alt_uBattThres_C /end DEF_CHARACTERISTIC
/end FUNCTION
/begin FUNCTION Application_root "Wurzel Applikationsfunktionen"
 /begin SUB_FUNCTION ACCtl AOHt Accessoires Airsystem Bypass Component_Protection Conv_ClthPrt Drivetrain ECU_Grp Engine Hardwaresignaldisplay IO Miscellaneous OvRMon PCU Pre_injection Propulsion Protocols Start_of_injection _11_DSM n_Control signals /end SUB_FUNCTION
/end FUNCTION
/begin FUNCTION BIPCD_BIPDet "BIP Erfassung"
 /begin DEF_CHARACTERISTIC BIPCD_ddiBWMin_C BIPCD_iWinLim_CUR BIPCD_numSkip_C BIPCD_numSpreadPoI2_C BIPCD_numSpread_C /end DEF_CHARACTERISTIC
/end FUNCTION
/begin FUNCTION BIP_Base "Berechnung der BIP-Grunddaten"
 /begin DEF_CHARACTERISTIC BIP_facFTCor_CUR BIP_tiBase_CUR BIP_uBattDfl_C BIP_uBattMax_C BIP_uBattMin_C /end DEF_CHARACTERISTIC
/end FUNCTION
/begin FUNCTION BIP_Control "BIP Regelung"
 /begin DEF_CHARACTERISTIC BIP_facInjBegCorInfl_MAP BIP_facInjBegCor_MAP BIP_swtInjBegDisplay_C BIP_tiMultiInjCor_MAP /end DEF_CHARACTERISTIC
/end FUNCTION
/begin FUNCTION BIP_Monitor "BIP Überwachung"
 /begin DEF_CHARACTERISTIC BIP_facFltInfl_C BIP_facFlt_C BIP_nSwtMonExt_C BIP_numDebConDef_C BIP_numDebDvtDef_C BIP_swtMon_C BIP_tMinMon_C BIP_tiDvtNegExt_C BIP_tiDvtNegInfl_C BIP_tiDvtNeg_C BIP_tiDvtPosExt_C BIP_tiDvtPosInfl_C BIP_tiDvtPos_C /end DEF_CHARACTERISTIC
/end FUNCTION
/begin FUNCTION BIP_WinCo "BIP-Fenster-Koordinator"
 /begin DEF_CHARACTERISTIC BIP_nLimOff_C BIP_nLimOn_C BIP_swtLimSeq_C BIP_swtWinAlt_C BIP_swtWinPrio_C /end DEF_CHARACTERISTIC
/end FUNCTION
/begin FUNCTION BIP_WinState "BIP-Fenster Zustands-Automat"
 /begin DEF_CHARACTERISTIC BIP_numDebSRDef_C BIP_numDebSREnd_C BIP_numDebSRStart_C BIP_tiWinDurDelta_CUR BIP_tiWinDurIni_C BIP_tiWinDur_C BIP_tiWinOffNegPoI2_C BIP_tiWinOffNegSRInfl_C BIP_tiWinOffNegSR_C BIP_tiWinOffNeg_C BIP_tiWinOffPosSRInfl_C BIP_tiWinOffPosSR_C BIP_tiWinOffStep_C /end DEF_CHARACTERISTIC
/end FUNCTION
/begin FUNCTION BPACD_Co "Komponententreiber des Ladedruckstellers"
 /begin DEF_CHARACTERISTIC BPACD_DebExcTemp2Def_C BPACD_DebExcTemp2Ok_C BPACD_DebExcTempDef_C BPACD_DebExcTempOk_C BPACD_DebNoLoad2Def_C BPACD_DebNoLoad2Ok_C BPACD_DebNoLoadDef_C BPACD_DebNoLoadOk_C BPACD_DebShortCircBat2Def_C BPACD_DebShortCircBat2Ok_C BPACD_DebShortCircBatDef_C BPACD_DebShortCircBatOk_C BPACD_DebShortCircGnd2Def_C BPACD_DebShortCircGnd2Ok_C BPACD_DebShortCircGndDef_C BPACD_DebShortCircGndOk_C BPACD_ctPwrStgOnMax2_C BPACD_ctPwrStgOnMax_C BPACD_rCnv2_CUR BPACD_rCnv_CUR BPACD_rOutMax2_C BPACD_rOutMax_C BPACD_rOutMin2_C BPACD_rOutMin_C BPACD_stInvOut2_C BPACD_stInvOut_C BPACD_stPwrStgActv2_C BPACD_stPwrStgActv_C BPACD_stPwrStgDia2_C BPACD_stPwrStgDia_C BPACD_stSPICtl2_C BPACD_stSPICtl_C BPACD_swt2_C BPACD_swtEActrOn_C BPACD_swt_C BPACD_tiBtwTst2_C BPACD_tiBtwTst_C BPACD_tiPer2_C BPACD_tiPer_C BPACD_tiPwrStgOn2_C BPACD_tiPwrStgOn_C SigTst_BPA2En_C SigTst_BPAEn_C /end DEF_CHARACTERISTIC
/end FUNCTION
/begin FUNCTION BPASCD_Co "Komponententreiber Koordinator für den Ladedrucksteller Sensor"
 /begin DEF_CHARACTERISTIC BPASCD_DebSRCHiDefRelPos_C BPASCD_DebSRCHiOkRelPos_C BPASCD_DebSRCLoDefRelPos_C BPASCD_DebSRCLoOkRelPos_C BPASCD_DebSigDefRelPos_C BPASCD_DebSigOkRelPos_C BPASCD_dtRmpSlpDwnRelPos_C BPASCD_dtRmpSlpUpRelPos_C BPASCD_facOfs_C BPASCD_nMinOfs_CUR BPASCD_numSSpRelPos_C BPASCD_rDflRelPos_C BPASCD_rLinRelPos_CUR BPASCD_rOutMinOfs_C BPASCD_rRefOfs_C BPASCD_stSensIDWordRelPos_C BPASCD_swtSigRelPos_C BPASCD_tMinOfs_C BPASCD_tiOfs_C BPASCD_uMaxOfs_C BPASCD_uMinOfs_C BPASCD_uSRCMaxRelPos_C BPASCD_uSRCMinRelPos_C /end DEF_CHARACTERISTIC
/end FUNCTION
/end MODULE
/end PROJECT
