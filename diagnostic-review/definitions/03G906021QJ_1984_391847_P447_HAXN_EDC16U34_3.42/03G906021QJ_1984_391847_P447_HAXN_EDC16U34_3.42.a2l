ASAP2_VERSION 1 3
/begin PROJECT X447 "EDC16U34"
/begin HEADER "" VERSION "VAA1" PROJECT_NO X447 /end HEADER
/begin MODULE DIM ""
/begin MOD_COMMON "" BYTE_ORDER MSB_FIRST ALIGNMENT_BYTE 1 ALIGNMENT_WORD 2 ALIGNMENT_LONG 4 ALIGNMENT_FLOAT32_IEEE 4 /end MOD_COMMON
/begin CHARACTERISTIC ACCCD_tiBrkTrqDet_C "Entprellzeit der ACC Brems-Moment Erkennung" VALUE 0x1C21EA Kw_Wu16 655350.0 Time_ms 0.00 655350.0 FORMAT "%8.1" /end CHARACTERISTIC
/begin CHARACTERISTIC ACCCD_trqBrkDetUp_C "Aufwärtsrampensteigung der ACC Brems-Momenten-Anforderung" VALUE 0x1C21F0 Kw_Wu32 6553549.99847 RmpTrqPrpHigh 50.0000000000 6553599.99847 FORMAT "%13.5" EXTENDED_LIMITS 0.00 6553599.99847 /end CHARACTERISTIC
/begin CHARACTERISTIC ACCCD_trqBrkDetDwn_C "Abwärtsrampensteigung der ACC Brems-Momenten-Anforderung" VALUE 0x1C21F4 Kw_Wu32 6553549.99847 RmpTrqPrpHigh 50.0000000000 6553599.99847 FORMAT "%13.5" EXTENDED_LIMITS 0.00 6553599.99847 /end CHARACTERISTIC
/begin CHARACTERISTIC ACCCD_tiWrongCodedDebDef_C "Fehlerentprellzeit für falsch codiertes MSG" VALUE 0x1C21F8 Kw_Wu16 655350.0 Time_ms 0.00 655350.0 FORMAT "%8.1" /end CHARACTERISTIC
/begin CHARACTERISTIC ACCCD_tiWrongCodedDebOk_C "Fehlerheilungszeit für falsch codiertes MSG" VALUE 0x1C21FA Kw_Wu16 655350.0 Time_ms 0.00 655350.0 FORMAT "%8.1" /end CHARACTERISTIC
/begin CHARACTERISTIC AirSys_swtOLDAvisible_C "Schalter für Darstellung von entsprechenden Abgas-, Ansaugfluteigenschaften" VALUE 0x1CA2CC Kw_Wu8 2.00000000000 numAirSys 0.00 2.00000000000 FORMAT "%13.11" /end CHARACTERISTIC
/begin CHARACTERISTIC CaSCD_ctEdgOfs_C "Anzahl von Nockenwellenflanken mit erkannter CaS/CrS Verdrehung" VALUE 0x1CC931 Kw_Wu8 255.0 OneToOne 0.00 255.0 FORMAT "%5.1" /end CHARACTERISTIC
/begin CHARACTERISTIC CaSCD_ctErrSync_C "maximale Anzahl von Störungen auf dem Phasengebersystem während einer Nockenwellenumdrehung" VALUE 0x1CC933 Kw_Wu8 255.0 OneToOne 0.00 255.0 FORMAT "%5.1" /end CHARACTERISTIC
/begin CHARACTERISTIC CaSCD_ctLrnDiffMax_C "Anzahl der Schritte zum Zähnchenlernen" VALUE 0x1CC9BC Kw_Wu16 65535.00 OneToOne 0.00 65535.00 FORMAT "%8.2" /end CHARACTERISTIC
/begin CHARACTERISTIC CaSCD_ctShftSync_C "Anzahl falscher Nockenwellenflanken bis neue Positionssuche" VALUE 0x1CC935 Kw_Wu8 255.0 OneToOne 0.00 255.0 FORMAT "%5.1" /end CHARACTERISTIC
/begin CHARACTERISTIC CaSCD_dKLrn_C "K-Faktor für Zähnchenlern-Algorithmus" VALUE 0x1CC9BE Kw_Ws16 32766.00 OneToOne 1.000000 32767.00 FORMAT "%8.2" EXTENDED_LIMITS -32768.00 32767.00 /end CHARACTERISTIC
/begin CHARACTERISTIC CaSCD_nBackUpLrnDiff_C "Der Zähnchenlern-Algorithmus is nur unterhalb dieser Drehzahl aktiv" VALUE 0x1CC9C0 Kw_Ws16 5200.000 EngN 800.0000 6000.000 FORMAT "%8.3" EXTENDED_LIMITS -32768.00 32767.00 /end CHARACTERISTIC
/begin CHARACTERISTIC CaSCD_phiDvnDiffLrn_C "Die gelernten Abweichungen werden nur im EEPROM abgelegt, wenn eine der Abweichungen größer ist als dieser Wert" VALUE 0x1CC9C2 Kw_Ws16 3.000000 AngleCaS 0.00 3.000000 FORMAT "%8.6" EXTENDED_LIMITS -384.0000 383.9883 /end CHARACTERISTIC
/begin CHARACTERISTIC CaSCD_phiOfsTolc_C "Toleranz zur Erkennung eines Segmentzahns" VALUE 0x1C0BAC Kw_Ws16 360.0000 AngleCaS 0.00 360.0000 FORMAT "%8.4" EXTENDED_LIMITS -384.0000 383.9883 /end CHARACTERISTIC
/begin CHARACTERISTIC CaSCD_phiSeg2Seg_C "Winkel zwischen zwei Segmentzähnen" VALUE 0x1CC9C4 Kw_Ws16 360.0000 AngleCaS 0.00 360.0000 FORMAT "%8.4" EXTENDED_LIMITS -384.0000 383.9883 /end CHARACTERISTIC
/begin CHARACTERISTIC CaSCD_phiSegToothTolc_C "maximale Toleranz eines Segmentzahnes" VALUE 0x1CC9C6 Kw_Ws16 3.000000 AngleCaS 0.00 3.000000 FORMAT "%8.6" EXTENDED_LIMITS -384.0000 383.9883 /end CHARACTERISTIC
/begin CHARACTERISTIC CaSCD_phiSync2Seg_C "Winkel zwischen der ersten Segmentflanke und der Sync-Flanke. (Pos. wenn Sync-Flanke vor Seg-Flanke, sonst Neg.)" VALUE 0x1CC9C8 Kw_Ws16 720.0000 AngleCaS -360.0000 360.0000 FORMAT "%8.4" EXTENDED_LIMITS -384.0000 383.9883 /end CHARACTERISTIC
/begin CHARACTERISTIC CaSCD_phiSync2Zero_C "Winkel zwischen der Sync-Flanke und dem physikalischen Nullpunkt des Systems" VALUE 0x1CC9CA Kw_Ws16 360.0000 AngleCaS 0.00 360.0000 FORMAT "%8.4" EXTENDED_LIMITS -384.0000 383.9883 /end CHARACTERISTIC
/begin CHARACTERISTIC CaSCD_rSeg2SegMax_CUR "max Wert für Phasensignalverhältnis im Backup-Mode, Verhältnis = T[i-1] / T[i]" CURVE 0x1CC9CC Kl_Xs16_Ws16 20.00000 Fact1 0.00 20.00000 FORMAT "%8.5" EXTENDED_LIMITS -256.0000 255.9922
 /begin AXIS_DESCR STD_AXIS Eng_nAvrg EngN 5 0.00 6000.000 FORMAT "%8.3" EXTENDED_LIMITS -32768.00 32767.00 DEPOSIT ABSOLUTE /end AXIS_DESCR
/end CHARACTERISTIC
/begin CHARACTERISTIC CaSCD_rSeg2SegMin_CUR "min Wert für Phasensignalverhältnis im Backup-Mode, Verhältnis = T[i-1] / T[i]" CURVE 0x1CC9E2 Kl_Xs16_Ws16 20.00000 Fact1 0.00 20.00000 FORMAT "%8.5" EXTENDED_LIMITS -256.0000 255.9922
 /begin AXIS_DESCR STD_AXIS Eng_nAvrg EngN 5 0.00 6000.000 FORMAT "%8.3" EXTENDED_LIMITS -32768.00 32767.00 DEPOSIT ABSOLUTE /end AXIS_DESCR
/end CHARACTERISTIC
/begin CHARACTERISTIC CaSCD_stEdgeTrigBackup_C "Triggerbedingung für die Phasenflankenerfassung in backup mode" VALUE 0x1CC9F8 Kw_Wu8 2.000 OneToOne 1.000 3.000 FORMAT "%5.3" EXTENDED_LIMITS 0.00 255.0 /end CHARACTERISTIC
/begin CHARACTERISTIC CaSCD_stEnaLrnDiffBackUp_C "Aktivierung des Zähnchenlern-Algorithmus" VALUE 0x1CC9F9 Kw_Wu8 1.000 OneToOne 0.00 1.000 FORMAT "%5.3" EXTENDED_LIMITS 0.00 255.0 /end CHARACTERISTIC
/begin CHARACTERISTIC CrSCD_ctIncTolcBackUp_C "Anzahl der simulierten Inkremente, die im Vergleich auf die realen Inkremente falsch sein dürfen (+/-)" VALUE 0x1C0C9A Kw_Ws16 32767.00 OneToOne 0.00 32767.00 FORMAT "%8.2" EXTENDED_LIMITS -32768.00 32767.00 /end CHARACTERISTIC
/begin CHARACTERISTIC Diff_dtrqCANerrPos_C "positive Rampensteigung bei CAN Fehler" VALUE 0x1CD5DC Kw_Wu32 6553549.99847 RmpTrqPrpHigh 50.0000000000 6553599.99847 FORMAT "%13.5" EXTENDED_LIMITS 0.00 6553599.99847 /end CHARACTERISTIC
/begin CHARACTERISTIC Diff_dtrqCANerrNeg_C "negative Rampensteigung bei Heilung des CAN Fehlers" VALUE 0x1CD5E0 Kw_Wu32 6553549.99847 RmpTrqPrpHigh 50.0000000000 6553599.99847 FORMAT "%13.5" EXTENDED_LIMITS 0.00 6553599.99847 /end CHARACTERISTIC
/begin CHARACTERISTIC Diff_trqCANerrMax_C "Begrenzungsmoment bei CAN Fehler" VALUE 0x1CD5E4 Kw_Ws32 104856.000000 TrqPrpHigh -52428.8000000 52427.2000000 FORMAT "%13.7" EXTENDED_LIMITS -214748364.800 214748364.700 /end CHARACTERISTIC
/begin CHARACTERISTIC DrvTrn_drSlpPos_C "Positive Rampensteigung für das Triebstrangübersetzungsverhältnis" VALUE 0x1CD72C Kw_Wu32 655359.899902 RmpTransR 0.0999450683594 655359.999847 FORMAT "%13.6" EXTENDED_LIMITS 0.00 655359.999847 /end CHARACTERISTIC
/begin CHARACTERISTIC DrvTrn_drSlpNeg_C "Negative Rampensteigung für das Triebstrangübersetzungsverhältnis" VALUE 0x1CD730 Kw_Wu32 655359.899902 RmpTransR 0.0999450683594 655359.999847 FORMAT "%13.6" EXTENDED_LIMITS 0.00 655359.999847 /end CHARACTERISTIC
/begin CHARACTERISTIC DrvTrn_rTransDTInit_C "Triebstrangübersetzungs-Vorgabewert (Radmoment pro Motormoment)" VALUE 0x1CD734 Kw_Ws16 99.00000 TransR 1.000000 100.0000 FORMAT "%8.4" EXTENDED_LIMITS -327.6800 327.6700 /end CHARACTERISTIC
/begin CHARACTERISTIC DrvTrn_stSigCVTVal_C "Ersatzwert für den Getriebetype aus dem Gearbx-Modul bei CVT-Getrieben" VALUE 0x1CD736 Kw_Wu8 1.000 OneToOne 0.00 1.000 FORMAT "%5.3" EXTENDED_LIMITS 0.00 255.0 /end CHARACTERISTIC
/begin CHARACTERISTIC DrvTrn_swtNotFrozen_C "Schalter zum deaktivieren der Einfrierfunktion vom Übersetzungsverhältnis" VALUE 0x1CD737 Kw_Wu8 1.000 OneToOne 0.00 1.000 FORMAT "%5.3" EXTENDED_LIMITS 0.00 255.0 /end CHARACTERISTIC
/begin CHARACTERISTIC DrvTrn_swtSigCVT_C "Entkopplung der Quelle der Triebsstrangübersetzung von der Gangerkennung für CVT" VALUE 0x1CD738 Kw_Wu8 1.000 OneToOne 0.00 1.000 FORMAT "%5.3" EXTENDED_LIMITS 0.00 255.0 /end CHARACTERISTIC
/begin CHARACTERISTIC DrvTrn_swtSigVal_C "Signalquelle ADC/CAN" VALUE 0x1CD739 Kw_Wu8 1.000 OneToOne 0.00 1.000 FORMAT "%5.3" EXTENDED_LIMITS 0.00 255.0 /end CHARACTERISTIC
/begin CHARACTERISTIC DSM_FCMClear_C "Fehlerspeicher löschen über Label" VALUE 0x1CD8C5 Kw_Wu8 1.000 OneToOne 0.00 1.000 FORMAT "%5.3" EXTENDED_LIMITS 0.00 255.0 /end CHARACTERISTIC
/begin CHARACTERISTIC DSM_FrzFrEnvironment_C "Freeze frame, Auswahl der Umweltbedingungen" VAL_BLK 0x1CD8C6 Kwb_Wu16 1152.00000000 SigName 0.00 1152.00000000 FORMAT "%13.8" NUMBER 20 /end CHARACTERISTIC
/begin CHARACTERISTIC DSM_FrzFrExtEnv_C "Freeze frame Erweiterung, Auswahl der Umweltbedingungen" VAL_BLK 0x1CD8EE Kwb_Wu16 1152.00000000 SigName 0.00 1152.00000000 FORMAT "%13.8" NUMBER 7 /end CHARACTERISTIC
/begin CHARACTERISTIC DSM_numSelDfp_C "Selektieren eines Dfps für die Bit-informationsanzeige in Meßpunkten" VALUE 0x1CD8FE Kw_Wu16 384.000000000 DfpName 0.00 384.000000000 FORMAT "%13.9" /end CHARACTERISTIC
/begin CHARACTERISTIC DSM_RdyABForceMsk_C "Maske zur Erzwingung von Readiness durch bitweises AND mit Message DSM_stRdyAB" VALUE 0x1D250C Kw_Wu16 65535.00 OneToOne 0.00 65535.00 FORMAT "%8.2" /end CHARACTERISTIC
/begin CHARACTERISTIC DSM_RdyCDForceMsk_C "Maske zur Erzwingung von Readiness durch bitweises AND mit Message DSM_stRdyCD" VALUE 0x1D250E Kw_Wu16 65535.00 OneToOne 0.00 65535.00 FORMAT "%8.2" /end CHARACTERISTIC
/begin CHARACTERISTIC DSM_RdyOnMilEnable_C "Verhalten Readiness bei angesteuerter MIL" VALUE 0x1D2510 Kw_Wu8 1.00000000000 RdyOnMilEnable 0.00 1.00000000000 FORMAT "%13.11" /end CHARACTERISTIC
/begin CHARACTERISTIC DSM_stStepWidth_CA "Schrittweite der Ereignisentprellung der up/down counter" VAL_BLK 0x1CD91C Kwb_Wu8 255.0 OneToOne 0.00 255.0 FORMAT "%5.1" NUMBER 4 /end CHARACTERISTIC
/begin CHARACTERISTIC DSM_SysLampMode_C "Aktivierungsbedingung der System Lampe (1= aktuelle Fehler, 0 = bestätigte Fehlerspeichereinträge)" VALUE 0x1CD920 Kw_Wu8 2.00000000000 SysLampMode 0.00 2.00000000000 FORMAT "%13.11" /end CHARACTERISTIC
/begin CHARACTERISTIC DSM_tiDCMin_C "Mindestzeit für driving cycle Erkennung (Maximalwert = Nachlauf)" VALUE 0x1CD922 Kw_Wu16 65535.00 TimeDsmDC 0.00 65535.00 FORMAT "%8.2" /end CHARACTERISTIC
/begin CHARACTERISTIC DSM_tiWucDelay_C "Zeitverzögerung für die Abtasung der Kühlwassertemperatur bei Start zur Warm Up Cycle Ermittlung" VALUE 0x1CD924 Kw_Wu16 655350.0 Time_ms 0.00 655350.0 FORMAT "%8.1" /end CHARACTERISTIC
/begin CHARACTERISTIC DSM_WucMinDiff_C "Minimale Differenztemperatur für warm up cycle" VALUE 0x1CD928 Kw_Ws16 6553.500 TempDiff_Kelv -3276.800 3276.700 FORMAT "%8.3" /end CHARACTERISTIC
/begin CHARACTERISTIC DSM_WucMinTemp_C "Minimaltemperatur für warm up cycle" VALUE 0x1CD92A Kw_Ws16 6553.500 Temp_Cels -3549.940 3003.560 FORMAT "%8.3" /end CHARACTERISTIC
/begin CHARACTERISTIC DTR_limKLine_CA "Grenzkalibrierung fuer K-Line, wenn die Testergebnisse nicht zur Verfuegung stehen" VAL_BLK 0x1D2526 Kwb_Wu8 2.00000000000 LimKLine 0.00 2.00000000000 FORMAT "%13.11" NUMBER 18 /end CHARACTERISTIC
/begin CHARACTERISTIC DTR_numCANOBDMId_CA "OBDMID Kalibration für Mode $06" VAL_BLK 0x1D2538 Kwb_Wu8 255.0 OneToOne 0.00 255.0 FORMAT "%5.1" NUMBER 18 /end CHARACTERISTIC
/begin CHARACTERISTIC DTR_numCANTestId_CA "Test Id applikation für CARB Mode $6 über CAN" VAL_BLK 0x1D254A Kwb_Wu8 255.0 OneToOne 0.00 255.0 FORMAT "%5.1" NUMBER 18 /end CHARACTERISTIC
/begin CHARACTERISTIC DTR_numKLineCmpntId_CA "Komponenten ID Kalibration für K-Line Diagsnose für Mode $06" VAL_BLK 0x1D255C Kwb_Wu8 255.0 OneToOne 0.00 255.0 FORMAT "%5.1" NUMBER 18 /end CHARACTERISTIC
/begin CHARACTERISTIC DTR_numKLineTestId_CA "Test Id applikation für CARB Mode $6 über K-Line" VAL_BLK 0x1D256E Kwb_Wu8 255.0 OneToOne 0.00 255.0 FORMAT "%5.1" NUMBER 18 /end CHARACTERISTIC
/begin CHARACTERISTIC EATSCD_uSRCMin_C "SRC Minimum Umgebungstemperatur" VALUE 0x1D2588 Kw_Ws16 5200.391 Volt 0.00 5200.391 FORMAT "%8.3" EXTENDED_LIMITS -160156.4 160151.5 /end CHARACTERISTIC
/begin CHARACTERISTIC EATSCD_uSRCMax_C "SRC Maximum Umgebungstemperatur" VALUE 0x1D258A Kw_Ws16 5200.391 Volt 0.00 5200.391 FORMAT "%8.3" EXTENDED_LIMITS -160156.4 160151.5 /end CHARACTERISTIC
/begin CHARACTERISTIC EATSCD_tLin_CUR "Linearisierungskennlinie der Umgebungstemperatur" CURVE 0x1D258C Kl_Xs16_Ws16 250.0000 Temp_Cels -50.04000 199.9600 FORMAT "%8.4" EXTENDED_LIMITS -3549.940 3003.560
 /begin AXIS_DESCR STD_AXIS EATSCD_uRaw Volt 25 0.00 5200.391 FORMAT "%8.3" EXTENDED_LIMITS -160156.4 160151.5 DEPOSIT ABSOLUTE /end AXIS_DESCR
/end CHARACTERISTIC
/begin CHARACTERISTIC EATSCD_DebCanDefOk_C "Heilungsentprellung  Umgebungstemperatursensor defekt über CAN" VALUE 0x1D25F4 Kw_Wu16 655350.0 Time_ms 0.00 655350.0 FORMAT "%8.1" /end CHARACTERISTIC
/begin CHARACTERISTIC EATSCD_DebCanInacDef_C "Fehlerentprellung  Umgebungstemperatursensor ungenau über CAN" VALUE 0x1D25F6 Kw_Wu16 655350.0 Time_ms 0.00 655350.0 FORMAT "%8.1" /end CHARACTERISTIC
/begin CHARACTERISTIC EATSCD_DebCanInacOk_C "Heilungsentprellung  Umgebungstemperatursensor ungenau über CAN" VALUE 0x1D25F8 Kw_Wu16 655350.0 Time_ms 0.00 655350.0 FORMAT "%8.1" /end CHARACTERISTIC
/begin CHARACTERISTIC EATSCD_DebCanNotImplDef_C "Fehlerentprellung  Umgebungstemperatursensor nicht verbaut über CAN" VALUE 0x1D25FA Kw_Wu16 655350.0 Time_ms 0.00 655350.0 FORMAT "%8.1" /end CHARACTERISTIC
/begin CHARACTERISTIC EATSCD_DebCanNotImplOk_C "Heilungsentprellung  Umgebungstemperatursensor nicht verbaut über CAN" VALUE 0x1D25FC Kw_Wu16 655350.0 Time_ms 0.00 655350.0 FORMAT "%8.1" /end CHARACTERISTIC
/begin CHARACTERISTIC EATSCD_DebSRCHighDef_C "EATS Fehlerentprellungszeit fuer SRC-High" VALUE 0x1D25FE Kw_Wu16 655350.0 Time_ms 0.00 655350.0 FORMAT "%8.1" /end CHARACTERISTIC
/begin CHARACTERISTIC EATSCD_DebSRCHighOk_C "EATS Heilungsentprellzeit fuer SRC-High" VALUE 0x1D2600 Kw_Wu16 655350.0 Time_ms 0.00 655350.0 FORMAT "%8.1" /end CHARACTERISTIC
/begin CHARACTERISTIC EATSCD_DebSRCLowDef_C "EATS Fehlerentprellungszeit fuer SRC-Low" VALUE 0x1D2602 Kw_Wu16 655350.0 Time_ms 0.00 655350.0 FORMAT "%8.1" /end CHARACTERISTIC
/begin CHARACTERISTIC EATSCD_DebSRCLowOk_C "EATS Heilungsentprellzeit fuer SRC-Low" VALUE 0x1D2604 Kw_Wu16 655350.0 Time_ms 0.00 655350.0 FORMAT "%8.1" /end CHARACTERISTIC
/begin CHARACTERISTIC EATSCD_dtRmpSlpUp_C "popsitive Rampensteigung" VALUE 0x1D2608 Kw_Wu32 6553599.99847 RmpTemp 0.00 6553599.99847 FORMAT "%13.5" /end CHARACTERISTIC
/begin CHARACTERISTIC EATSCD_dtRmpSlpDwn_C "negative Rampensteigung" VALUE 0x1D260C Kw_Wu32 6553599.99847 RmpTemp 0.00 6553599.99847 FORMAT "%13.5" /end CHARACTERISTIC
/begin CHARACTERISTIC EATSCD_swtSigVal_C "Datensatzwert Signalquelle Umgebungsluftemperatur (0 = ADC, 1 = CAN)" VALUE 0x1D2610 Kw_Wu8 2.000 OneToOne 0.00 2.000 FORMAT "%5.3" EXTENDED_LIMITS 0.00 255.0 /end CHARACTERISTIC
/begin CHARACTERISTIC EATSCD_swtSigType_C "Auswahlschalter Belegung EATSCD_swtSig mit EATSCD_swtSigVal_C oder E2PROM" VALUE 0x1D2611 Kw_Wu8 1.000 OneToOne 1.000 2.000 FORMAT "%5.3" EXTENDED_LIMITS 0.00 255.0 /end CHARACTERISTIC
/begin CHARACTERISTIC EATSCD_stSensIDWord_C "Geberkennwort Umgebungstemperatur" VALUE 0x1D2612 Kw_Wu16 65535.00 OneToOne 0.00 65535.00 FORMAT "%8.2" /end CHARACTERISTIC
/begin CHARACTERISTIC EATSCD_tDfl_C "Vorgabewert Umgebungstemperatur" VALUE 0x1D2614 Kw_Ws16 250.0000 Temp_Cels -50.04000 199.9600 FORMAT "%8.4" EXTENDED_LIMITS -3549.940 3003.560 /end CHARACTERISTIC
/begin CHARACTERISTIC EcuInit_tiTimestampTO_C "Timeout für Timestamp, welche in Flash geschrieben werden" VALUE 0x1D261A Kw_Wu16 655.1400 Time_s 0.00 655.1400 FORMAT "%8.4" EXTENDED_LIMITS 0.00 655.3500 /end CHARACTERISTIC
/begin CHARACTERISTIC ECU_vPrgThres_C "obere Geschwindigkeitsgrenze für die FLASH Programmierung" VALUE 0x1D2618 Kw_Ws16 327.6700 Vel 0.00 327.6700 FORMAT "%8.4" EXTENDED_LIMITS -327.6800 327.6700 /end CHARACTERISTIC
/begin CHARACTERISTIC EEPCD_DsSWT1_KSK_C "Applikationslabelmaske für EEPROM-Schalter" VALUE 0x1D261E Kw_Wu16 65535.00 OneToOne 0.00 65535.00 FORMAT "%8.2" /end CHARACTERISTIC
/begin CHARACTERISTIC EEPCD_DsSWT1_SWTCC_C "Applikationslabelmaske für EEPROM-Schalter PRP_CCON" VALUE 0x1D2620 Kw_Wu16 65535.00 OneToOne 0.00 65535.00 FORMAT "%8.2" /end CHARACTERISTIC
/begin CHARACTERISTIC EEPCD_DsSWT2_CCTYPE_C "Applikationslabelmaske für EEPROM-Schalter PRP_CCSel" VALUE 0x1D2622 Kw_Wu16 65535.00 OneToOne 0.00 65535.00 FORMAT "%8.2" /end CHARACTERISTIC
/begin CHARACTERISTIC EEPCD_DsSWT2_EATS_C "Applikationslabelmaske für EEPROM-Schalter" VALUE 0x1D2624 Kw_Wu16 65535.00 OneToOne 0.00 65535.00 FORMAT "%8.2" /end CHARACTERISTIC
/begin CHARACTERISTIC EEPCD_DsSWT2_OTS_C "Applikationslabelmaske für EEPROM-Schalter" VALUE 0x1D2626 Kw_Wu16 65535.00 OneToOne 0.00 65535.00 FORMAT "%8.2" /end CHARACTERISTIC
/begin CHARACTERISTIC EepDev_dVal_C "der zu schreibende Wert (EEPROM)" VALUE 0x1D2628 Kw_Wu8 255.0 OneToOne 0.00 255.0 FORMAT "%5.1" /end CHARACTERISTIC
/begin CHARACTERISTIC EepDev_dWrInitPattern_C "Trigger für das Schreiben des Erstinitialisirungsmarkers" VALUE 0x1D2629 Kw_Wu8 0.00 OneToOne 0.00 0.00 FORMAT "%5.2" EXTENDED_LIMITS 0.00 255.0 /end CHARACTERISTIC
/begin CHARACTERISTIC EepDev_numBlock_C "Nummer des zu lesenden bzw.schreibenden Blockes" VALUE 0x1D262A Kw_Wu8 255.0 OneToOne 0.00 255.0 FORMAT "%5.1" /end CHARACTERISTIC
/begin CHARACTERISTIC EepDev_numInitBlocks_CA "Kennwerteblock welcher die Blocknummern der zu initialisierenden Blöcke enthält" VAL_BLK 0x1D262B Kwb_Wu8 35.0000000000 EepBlock 1.00000000000 36.0000000000 FORMAT "%13.10" NUMBER 36 /end CHARACTERISTIC
/begin CHARACTERISTIC EepDev_numOffset_C "Byteoffset des zu schreibenden Wertes" VALUE 0x1D264F Kw_Wu8 255.0 OneToOne 0.00 255.0 FORMAT "%5.1" /end CHARACTERISTIC
/begin CHARACTERISTIC EepDev_stJob_C "Starten des Lese- bzw. Schreibaufgabe" VALUE 0x1D2650 Kw_Wu8 255.0 OneToOne 0.00 255.0 FORMAT "%5.1" /end CHARACTERISTIC
/begin CHARACTERISTIC EepInit_AirCtlTrm_C "Trimmwert Sollwertbildung AGR" VALUE 0x1C0CB8 Kw_Ws16 3276.700 AirMassPerCyl 0.00 3276.700 FORMAT "%8.3" EXTENDED_LIMITS -3276.800 3276.700 /end CHARACTERISTIC
/begin CHARACTERISTIC EepInit_dCodeTbl_C "Codiertabelle" VAL_BLK 0x1C0CBA Kwb_Wu8 255.0 OneToOne 0.00 255.0 FORMAT "%5.1" NUMBER 4 /end CHARACTERISTIC
/begin CHARACTERISTIC EepInit_dHwPartNum_C "Erstinitalisirungswert für dHwPartNum" ASCII 0x1C0CBE Ktx 255.0 defaultAscii 0.00 255.0 NUMBER 12 /end CHARACTERISTIC
/begin CHARACTERISTIC EepInit_dnCoVehLvl1_C "Offset- Wert der Zielmotorehzahl fuer Leerlauf [ E1 ]" VALUE 0x1C0CCC Kw_Ws16 6000.000 EngN 0.00 6000.000 FORMAT "%8.3" EXTENDED_LIMITS -32768.00 32767.00 /end CHARACTERISTIC
/begin CHARACTERISTIC EepInit_dnCoVehLvl2_C "Offset- Wert der Zielmotorehzahl fuer Leerlauf [ E2 ]" VALUE 0x1C0CCE Kw_Ws16 6000.000 EngN 0.00 6000.000 FORMAT "%8.3" EXTENDED_LIMITS -32768.00 32767.00 /end CHARACTERISTIC
/begin CHARACTERISTIC EepInit_dnSetpointTrm_C "Trimmwert Leerlaufdrehzahl" VALUE 0x1C0CD0 Kw_Ws16 32767.00 EngN 0.00 32767.00 FORMAT "%8.2" EXTENDED_LIMITS -32768.00 32767.00 /end CHARACTERISTIC
/begin CHARACTERISTIC EepInit_dPartNr_C "VW/Audi - Teilenummer" ASCII 0x1C0CD2 Ktx 255.0 defaultAscii 0.00 255.0 NUMBER 12 /end CHARACTERISTIC
/begin CHARACTERISTIC EepInit_dPrgVer_C "Programmstand" ASCII 0x1C0CDF Ktx 255.0 defaultAscii 0.00 255.0 NUMBER 4 /end CHARACTERISTIC
/begin CHARACTERISTIC EepInit_dSysName_C "Systembezeichnung" ASCII 0x1C0CE4 Ktx 255.0 defaultAscii 0.00 255.0 NUMBER 20 /end CHARACTERISTIC
/begin CHARACTERISTIC EepInit_factAltDemTrm_C "Trimmwert des Generatormomentes" VALUE 0x1C0CFA Kw_Ws16 3.999878 Fact 0.00 3.999878 FORMAT "%8.6" EXTENDED_LIMITS -4.000000 3.999878 /end CHARACTERISTIC
/begin CHARACTERISTIC EepInit_factSvrPmpDemTrm_C "Trimmwert der Lenkungsservopumpe" VALUE 0x1C0CFC Kw_Ws16 3.999878 Fact 0.00 3.999878 FORMAT "%8.6" EXTENDED_LIMITS -4.000000 3.999878 /end CHARACTERISTIC
/begin CHARACTERISTIC EepInit_factTrqACTrm_C "Trimmwert für Klimakompressormomentenabgleich" VALUE 0x1C0CFE Kw_Ws16 0.00 Fact 1.000000 1.000000 FORMAT "%8.6" EXTENDED_LIMITS -4.000000 3.999878 /end CHARACTERISTIC
/begin CHARACTERISTIC EepInit_factTrqLimTrm_C "Trimmwert des Maximalmomentes" VALUE 0x1C0D00 Kw_Ws16 3.999878 Fact 0.00 3.999878 FORMAT "%8.6" EXTENDED_LIMITS -4.000000 3.999878 /end CHARACTERISTIC
/begin CHARACTERISTIC EepInit_SWT1_C "Funktionsschalter" VALUE 0x1C0D02 Kw_Wu16 65535.00 OneToOne 0.00 65535.00 FORMAT "%8.2" /end CHARACTERISTIC
/begin CHARACTERISTIC EepInit_SWT2_C "Signalschalter" VALUE 0x1C0D04 Kw_Wu16 65535.00 OneToOne 0.00 65535.00 FORMAT "%8.2" /end CHARACTERISTIC
/begin CHARACTERISTIC EepInit_tGlwCtlTrm_C "EEPROM-Initialisierungswert des Trimmwerts für Kühlmitteltemperaturabgleich" VALUE 0x1C0D06 Kw_Ws16 100.0000 TempDiff_Kelv -50.00000 50.00000 FORMAT "%8.5" EXTENDED_LIMITS -3276.800 3276.700 /end CHARACTERISTIC
/begin CHARACTERISTIC EepInit_trqStartTrm_C "Trimmwert des Startbasismomentes" VALUE 0x1C0D08 Kw_Ws16 3276.700 Trq 0.00 3276.700 FORMAT "%8.3" EXTENDED_LIMITS -3276.800 3276.700 /end CHARACTERISTIC
/begin CHARACTERISTIC EepInit_vSpdLimMax2_C "Trimmwert der Höchstgeschwindigkeitsbegrenzung" VALUE 0x1C0D0A Kw_Ws16 300.0000 Vel 0.00 300.0000 FORMAT "%8.4" EXTENDED_LIMITS -327.6800 327.6700 /end CHARACTERISTIC
/begin CHARACTERISTIC EepInit_vSpdLimMax_C "Trimmwert der Höchstgeschwindigkeitsbegrenzung" VALUE 0x1C0D0C Kw_Ws16 300.0000 Vel 0.00 300.0000 FORMAT "%8.4" EXTENDED_LIMITS -327.6800 327.6700 /end CHARACTERISTIC
/begin CHARACTERISTIC EGPpCD_uSRCMinTemp_C "SRC-MIN-Wert für Abgastemperatur vor Abgasturbolader" VALUE 0x1D27B0 Kw_Ws16 5200.391 Volt 0.00 5200.391 FORMAT "%8.3" EXTENDED_LIMITS -160156.4 160151.5 /end CHARACTERISTIC
/begin CHARACTERISTIC EGPpCD_uSRCMaxTemp_C "SRC-MAX-Wert für Abgastemperatur vor Abgasturbolader" VALUE 0x1D27B2 Kw_Ws16 5200.391 Volt 0.00 5200.391 FORMAT "%8.3" EXTENDED_LIMITS -160156.4 160151.5 /end CHARACTERISTIC
/begin CHARACTERISTIC EGPpCD_tLinTemp_CUR "Linearisierungskennlinie der Abgastemperatur vor Abgasturbolader" CURVE 0x1D27B4 Kl_Xs16_Ws16 1323.100 Temp_Cels -50.14000 1272.960 FORMAT "%8.3" EXTENDED_LIMITS -3549.940 3003.560
 /begin AXIS_DESCR STD_AXIS EGPpCD_uRawTempPreTrbn Volt 40 0.00 5200.391 FORMAT "%8.3" EXTENDED_LIMITS -160156.4 160151.5 DEPOSIT ABSOLUTE /end AXIS_DESCR
/end CHARACTERISTIC
/begin CHARACTERISTIC EGPpCD_DebSRCHighDefTemp_C "Fehlerentprellung SRC-High-Fehler der Abgastemperatur vor Turbine" VALUE 0x1D2856 Kw_Wu16 655350.0 Time_ms 0.00 655350.0 FORMAT "%8.1" /end CHARACTERISTIC
/begin CHARACTERISTIC EGPpCD_DebSRCHighOkTemp_C "Heilungsentprellung SRC-High-Fehler der Abgastemperatur vor Turbine" VALUE 0x1D2858 Kw_Wu16 655350.0 Time_ms 0.00 655350.0 FORMAT "%8.1" /end CHARACTERISTIC
/begin CHARACTERISTIC EGPpCD_DebSRCLowDefTemp_C "Fehlerentprellung SRC-Low-Fehler für die Abgastemperatur vor Turbine" VALUE 0x1D285A Kw_Wu16 655350.0 Time_ms 0.00 655350.0 FORMAT "%8.1" /end CHARACTERISTIC
/begin CHARACTERISTIC EGPpCD_DebSRCLowOkTemp_C "Heilungsentprellzeit für SRC-Low-Fehler für die Abgastemperatur vor Turbine" VALUE 0x1D285C Kw_Wu16 655350.0 Time_ms 0.00 655350.0 FORMAT "%8.1" /end CHARACTERISTIC
/begin CHARACTERISTIC EGPpCD_dtRmpSlpUpTemp_C "Aufwärts-Schrittweite für Abgastemperatur vor Abgasturbolader" VALUE 0x1D2860 Kw_Wu32 6553599.99847 RmpTemp 0.00 6553599.99847 FORMAT "%13.5" /end CHARACTERISTIC
/begin CHARACTERISTIC EGPpCD_dtRmpSlpDwnTemp_C "Abwärts-Schrittweite für Abgastemperatur vor Abgasturbolader" VALUE 0x1D2864 Kw_Wu32 6553599.99847 RmpTemp 0.00 6553599.99847 FORMAT "%13.5" /end CHARACTERISTIC
/begin CHARACTERISTIC EGPpCD_swtActvTPreTrbn_C "Aktivierung/Deaktivierung  des Komponententreibers für Abgastemperatur vor Abgasturbolader" VALUE 0x1D2868 Kw_Wu8 1.000 OneToOne 0.00 1.000 FORMAT "%5.3" EXTENDED_LIMITS 0.00 255.0 /end CHARACTERISTIC
/begin CHARACTERISTIC EGPpCD_swtFltTempPreTrbn_C "Schalter fuer Aktivierung des Filters der T3 Sensor Spannung" VALUE 0x1D2869 Kw_Wu8 1.000 OneToOne 0.00 1.000 FORMAT "%5.3" EXTENDED_LIMITS 0.00 255.0 /end CHARACTERISTIC
/begin CHARACTERISTIC EGPpCD_stSensIDWordTemp_C "Kennzahl zur Festlegung des Fehlerverhaltens der Abgastemperatur vor Abgasturbolader" VALUE 0x1D286A Kw_Wu16 65535.00 OneToOne 0.00 65535.00 FORMAT "%8.2" /end CHARACTERISTIC
/begin CHARACTERISTIC EGPpCD_tDflTemp_C "Vorgabewert für Abgastemperatur vor Abgasturbolader" VALUE 0x1D286C Kw_Ws16 1323.100 Temp_Cels -50.14000 1272.960 FORMAT "%8.3" EXTENDED_LIMITS -3549.940 3003.560 /end CHARACTERISTIC
/begin CHARACTERISTIC EGPp_facGeoSil_C "geometrischer Faktor Schalldämpfer" VALUE 0x1D2654 Kw_Ws16 100.0000 Fact1 0.00 100.0000 FORMAT "%8.4" EXTENDED_LIMITS -256.0000 255.9922 /end CHARACTERISTIC
/begin CHARACTERISTIC EGPp_facPow_CUR "Potenzfunktion für Abgasvolumenstrom" CURVE 0x1D2656 Kl_Xs16_Ws16 250.0000 Fact1 0.00 250.0000 FORMAT "%8.4" EXTENDED_LIMITS -256.0000 255.9922 READ_ONLY
 /begin AXIS_DESCR STD_AXIS EGPp_dvolSilBnk_mp CubMtrPerHr 2 0.00 3200.000 FORMAT "%8.3" EXTENDED_LIMITS -3276.800 3276.700 DEPOSIT ABSOLUTE /end AXIS_DESCR
/end CHARACTERISTIC
/begin CHARACTERISTIC EGPp_facRhoEta_CUR "temperaturabhängiger Dichte- und Viskositätsfaktor" CURVE 0x1D2660 Kl_Xs16_Ws16 4.000000 Fact 0.00 4.000000 FORMAT "%8.6" EXTENDED_LIMITS -4.000000 3.999878 READ_ONLY
 /begin AXIS_DESCR STD_AXIS EGPp_tPstSimBnk_mp Temp_Cels 2 -40.04000 999.9600 FORMAT "%8.3" EXTENDED_LIMITS -3549.940 3003.560 DEPOSIT ABSOLUTE /end AXIS_DESCR
/end CHARACTERISTIC
/begin CHARACTERISTIC EGPp_pPstPFltEG_MAP "Druckabfallkennfeld" MAP 0x1D266A Kf_Xs16_Ys16_Ws16 4000.000 Pres_hPa 0.00 4000.000 FORMAT "%8.3" EXTENDED_LIMITS -32768.00 32767.00
 /begin AXIS_DESCR STD_AXIS EGPp_dmEG_mp AirMassPerTime 10 0.00 1000.000 FORMAT "%8.3" EXTENDED_LIMITS -3276.800 3276.700 DEPOSIT ABSOLUTE /end AXIS_DESCR
 /begin AXIS_DESCR STD_AXIS EGPp_tSurf_mp Temp_Cels 10 -50.04000 999.9600 FORMAT "%8.3" EXTENDED_LIMITS -3549.940 3003.560 DEPOSIT ABSOLUTE /end AXIS_DESCR
/end CHARACTERISTIC
/begin CHARACTERISTIC EGPp_pPstPFlt_MAP "Druckabfallkennfeld" MAP 0x1D275E Kf_Xs16_Ys16_Ws16 400.0000 Pres_hPa 0.00 400.0000 FORMAT "%8.4" EXTENDED_LIMITS -32768.00 32767.00
 /begin AXIS_DESCR STD_AXIS Eng_nAvrg EngN 5 0.00 8000.000 FORMAT "%8.3" EXTENDED_LIMITS -32768.00 32767.00 DEPOSIT ABSOLUTE /end AXIS_DESCR
 /begin AXIS_DESCR STD_AXIS InjCtl_qSetUnBal InjMass 5 0.00 200.0000 FORMAT "%8.4" EXTENDED_LIMITS -327.6800 327.6700 DEPOSIT ABSOLUTE /end AXIS_DESCR
/end CHARACTERISTIC
/begin CHARACTERISTIC EGPp_tiPresFltPT1_C "PT1 Filterzeit für die Druckmodellierung im Abgasrohr" VALUE 0x1D27A8 Kw_Wu32 4294.9673 TimeDelay_s 0.0000010000000 4294.9673 FORMAT "%9.4" /end CHARACTERISTIC
/begin CHARACTERISTIC EGPp_swtPresCalcMod_C "Schalter zur Auswahl zwischen dem Modell 1 und dem Modell 2 für die Auswertung des Abgasgegendrucks [ ]" VALUE 0x1D27AC Kw_Wu8 1.000 OneToOne 0.00 1.000 FORMAT "%5.3" EXTENDED_LIMITS 0.00 255.0 /end CHARACTERISTIC
/begin CHARACTERISTIC EGPp_swtPresCalc_C "Schalter für Druckberechnung (0-Kennfeld, 1- Simulation)" VALUE 0x1D27AD Kw_Wu8 1.000 OneToOne 0.00 1.000 FORMAT "%5.3" EXTENDED_LIMITS 0.00 255.0 /end CHARACTERISTIC
/begin CHARACTERISTIC EGRCD_CBVDebExcTempDef_C "Defekterkennungszeit für Übertemperatur" VALUE 0x1D28C0 Kw_Wu16 655350.0 Time_ms 0.00 655350.0 FORMAT "%8.1" /end CHARACTERISTIC
/begin CHARACTERISTIC EGRCD_CBVDebExcTempOK_C "Fehlerheilungszeit für Übertemperatur" VALUE 0x1D28C2 Kw_Wu16 655350.0 Time_ms 0.00 655350.0 FORMAT "%8.1" /end CHARACTERISTIC
/begin CHARACTERISTIC EGRCD_CBVDebNoLoadDef_C "Fehlererkenungszeit für Lastabfall" VALUE 0x1D28C4 Kw_Wu16 655350.0 Time_ms 0.00 655350.0 FORMAT "%8.1" /end CHARACTERISTIC
/begin CHARACTERISTIC EGRCD_CBVDebNoLoadOK_C "Heilungszeit für Fehler Lastabfall" VALUE 0x1D28C6 Kw_Wu16 655350.0 Time_ms 0.00 655350.0 FORMAT "%8.1" /end CHARACTERISTIC
/begin CHARACTERISTIC EGRCD_CBVDebShortCircBatDef_C "Defekterkennungszeit für Fehler KS mit Batteriespannung" VALUE 0x1D28C8 Kw_Wu16 655350.0 Time_ms 0.00 655350.0 FORMAT "%8.1" /end CHARACTERISTIC
/begin CHARACTERISTIC EGRCD_CBVDebShortCircBatOK_C "Heilungszeit für Fehler KS mit Batteriespannung" VALUE 0x1D28CA Kw_Wu16 655350.0 Time_ms 0.00 655350.0 FORMAT "%8.1" /end CHARACTERISTIC
/begin CHARACTERISTIC EGRCD_CBVDebShortCircGndDef_C "Fehlererkennungszeit für KS mit Masse" VALUE 0x1D28CC Kw_Wu16 655350.0 Time_ms 0.00 655350.0 FORMAT "%8.1" /end CHARACTERISTIC
/begin CHARACTERISTIC EGRCD_CBVDebShortCircGndOK_C "Heilungszeit für Fehler KS mit Masse" VALUE 0x1D28CE Kw_Wu16 655350.0 Time_ms 0.00 655350.0 FORMAT "%8.1" /end CHARACTERISTIC
/begin CHARACTERISTIC EGRCD_ctCBVPwrStgOnMax_C "Max. Anzahl an Aktivierungen der Endstufe pro Fahrzyklus bei SCB oder Übertemperatur" VALUE 0x1D28D0 Kw_Wu16 65535.00 OneToOne 0.00 65535.00 FORMAT "%8.2" /end CHARACTERISTIC
/begin CHARACTERISTIC EGRCD_ctPwrStgOnMax_C "Maximale Anzahl der aktivierung der Endstufe bei SCB und Übertemperatur Fehler" VALUE 0x1D2870 Kw_Wu16 65535.00 OneToOne 0.00 65535.00 FORMAT "%8.2" /end CHARACTERISTIC
/begin CHARACTERISTIC EGRCD_DebExcTempDef_C "Fehlerentprellzeit für Übertemperatur" VALUE 0x1D2872 Kw_Wu16 655350.0 Time_ms 0.00 655350.0 FORMAT "%8.1" /end CHARACTERISTIC
/begin CHARACTERISTIC EGRCD_DebExcTempOk_C "Heilungsentprellzeit für Übertemperatur" VALUE 0x1D2874 Kw_Wu16 655350.0 Time_ms 0.00 655350.0 FORMAT "%8.1" /end CHARACTERISTIC
/begin CHARACTERISTIC EGRCD_DebNoLoadDef_C "Fehlerentprellzeit für Lastabfall" VALUE 0x1D2876 Kw_Wu16 655350.0 Time_ms 0.00 655350.0 FORMAT "%8.1" /end CHARACTERISTIC
/begin CHARACTERISTIC EGRCD_DebNoLoadOk_C "Heilungsentprellzeit für Lastabfall" VALUE 0x1D2878 Kw_Wu16 655350.0 Time_ms 0.00 655350.0 FORMAT "%8.1" /end CHARACTERISTIC
/begin CHARACTERISTIC EGRCD_DebShortCircBatDef_C "Fehlerentprellzeit für Kurzschluß nach Batteriespannung" VALUE 0x1D287A Kw_Wu16 655350.0 Time_ms 0.00 655350.0 FORMAT "%8.1" /end CHARACTERISTIC
/begin CHARACTERISTIC EGRCD_DebShortCircBatOk_C "Heilungsentprellzeit für Kurzschluß nach Batteriespannung" VALUE 0x1D287C Kw_Wu16 655350.0 Time_ms 0.00 655350.0 FORMAT "%8.1" /end CHARACTERISTIC
/begin CHARACTERISTIC EGRCD_DebShortCircGndDef_C "Fehlerentprellzeit für Kurzschluß nach Masse" VALUE 0x1D287E Kw_Wu16 655350.0 Time_ms 0.00 655350.0 FORMAT "%8.1" /end CHARACTERISTIC
/begin CHARACTERISTIC EGRCD_DebShortCircGndOk_C "Heilungsentprellzeit für Kurzschluß nach Masse" VALUE 0x1D2880 Kw_Wu16 655350.0 Time_ms 0.00 655350.0 FORMAT "%8.1" /end CHARACTERISTIC
/begin CHARACTERISTIC EGRCD_DebSigDef_C "Fehlerentprellungszeit für CJ220-Endstufenfehler" VALUE 0x1D2882 Kw_Wu16 655350.0 Time_ms 0.00 655350.0 FORMAT "%8.1" /end CHARACTERISTIC
/begin CHARACTERISTIC EGRCD_DebSigOk_C "Heilungsentprellungszeit für CJ220-Endstufenfehler" VALUE 0x1D2884 Kw_Wu16 655350.0 Time_ms 0.00 655350.0 FORMAT "%8.1" /end CHARACTERISTIC
/begin CHARACTERISTIC EGRCD_facLpGnStrt_C "Korrekturfaktorkompensation in START-Zustand" VALUE 0x1D2886 Kw_Ws16 7.999878 Fact -4.000000 3.999878 FORMAT "%8.6" /end CHARACTERISTIC
/begin CHARACTERISTIC EGRCD_numDia_C "Applikationsparameter fuer Diagnose Signal :EGR-Steller" VALUE 0x1D2888 Kw_Wu8 20.0000000000 NumPinDia 1.00000000000 21.0000000000 FORMAT "%13.10" /end CHARACTERISTIC
/begin CHARACTERISTIC EGRCD_numDisCJ220_C "Deaktivierungspin des CJ220-Treibers für AGR-Steller" VALUE 0x1D2889 Kw_Wu8 22.0000000000 NumPinDioOut 0.00 22.0000000000 FORMAT "%13.10" /end CHARACTERISTIC
/begin CHARACTERISTIC EGRCD_numPwmOut1_C "Applikationsparameter für EGR Steller" VALUE 0x1D288A Kw_Wu8 11.0000000000 NumPinPwmOut 2.00000000000 13.0000000000 FORMAT "%13.10" /end CHARACTERISTIC
/begin CHARACTERISTIC EGRCD_numPwmOut2_C "Applikationsparameter fuer EGR-Steller" VALUE 0x1D288B Kw_Wu8 11.0000000000 NumPinPwmOut 2.00000000000 13.0000000000 FORMAT "%13.10" /end CHARACTERISTIC
/begin CHARACTERISTIC EGRCD_numPwmOut_C "Applikationsparameter fuer EGR-Steller" VALUE 0x1D288C Kw_Wu8 11.0000000000 NumPinPwmOut 2.00000000000 13.0000000000 FORMAT "%13.10" /end CHARACTERISTIC
/begin CHARACTERISTIC EGRCD_numStCJ220_C "Pin-Selektor für das Zustandsflag der CJ200-Endstufendiagnose" VALUE 0x1D288D Kw_Wu8 0.00 NumPinDioIn 13.0000000000 13.0000000000 FORMAT "%13.10" /end CHARACTERISTIC
/begin CHARACTERISTIC EGRCD_tiPT1FacCor_C "Zeitkonstante zur PT1-Filter-Batteriespannungskorrektur" VALUE 0x1D2890 Kw_Wu32 4294.9673 TimeDelay_s 0.0000010000000 4294.9673 FORMAT "%9.4" /end CHARACTERISTIC
/begin CHARACTERISTIC EGRCD_stInvOut_C "Invertierungsparameter für das Signal der Abgasrückführstellerendstufe" VALUE 0x1D2894 Kw_Wu8 1.000 OneToOne 0.00 1.000 FORMAT "%5.3" EXTENDED_LIMITS 0.00 255.0 /end CHARACTERISTIC
/begin CHARACTERISTIC EGRCD_tiPer_C "Periodendauer Abgasrückführsteller" VALUE 0x1D2896 Kw_Ws16 6553.500 Period -3276.800 3276.700 FORMAT "%8.3" /end CHARACTERISTIC
/begin CHARACTERISTIC EGRCD_rCnv_MAP "Kennfeld zur konvertierung in Tastverhältnis" MAP 0x1D2898 Kf_Xs16_Ys16_Ws16 100.0000 DtyCyc 0.00 100.0000 FORMAT "%8.4" EXTENDED_LIMITS -327.6800 327.6700
 /begin AXIS_DESCR STD_AXIS Eng_nAvrg EngN 2 0.00 8000.000 FORMAT "%8.3" EXTENDED_LIMITS -32768.00 32767.00 DEPOSIT ABSOLUTE /end AXIS_DESCR
 /begin AXIS_DESCR STD_AXIS EGRVlv_rEGR DtyCyc 2 -327.6800 327.6700 FORMAT "%8.4" DEPOSIT ABSOLUTE /end AXIS_DESCR
/end CHARACTERISTIC
/begin CHARACTERISTIC EGRCD_rOutDfl_C "Vorgabewert des Endstufenausgangs" VALUE 0x1D28AC Kw_Ws16 655.3500 DtyCyc -327.6800 327.6700 FORMAT "%8.4" /end CHARACTERISTIC
/begin CHARACTERISTIC EGRCD_rOutMax_C "Maximal auszugebendes Tastverhältnis" VALUE 0x1D28AE Kw_Ws16 655.3500 DtyCyc -327.6800 327.6700 FORMAT "%8.4" /end CHARACTERISTIC
/begin CHARACTERISTIC EGRCD_rOutMin_C "Minimal auszugebendes Tastverhältnis" VALUE 0x1D28B0 Kw_Ws16 655.3500 DtyCyc -327.6800 327.6700 FORMAT "%8.4" /end CHARACTERISTIC
/begin CHARACTERISTIC EGRCD_rTst_C "Tastverhältnis, dass im Fehlerfall zyklisch ausgegeben wird" VALUE 0x1D28B2 Kw_Ws16 100.0000 DtyCyc 0.00 100.0000 FORMAT "%8.4" EXTENDED_LIMITS -327.6800 327.6700 /end CHARACTERISTIC
/begin CHARACTERISTIC EGRCD_stCBVInvOut_C "Invertierung des Ausgangs" VALUE 0x1D28D2 Kw_Wu8 1.000 OneToOne 0.00 1.000 FORMAT "%5.3" EXTENDED_LIMITS 0.00 255.0 /end CHARACTERISTIC
/begin CHARACTERISTIC EGRCD_stCBVPwrStgActv_C "Statuswort für die Deaktivierung der Endstufe" VALUE 0x1D28D3 Kw_Wu8 255.0 OneToOne 0.00 255.0 FORMAT "%5.1" /end CHARACTERISTIC
/begin CHARACTERISTIC EGRCD_stCBVPwrStgDia_C "Statuswort für die Deaktivierung der Endstufendiagnose" VALUE 0x1D28D4 Kw_Wu8 255.0 OneToOne 0.00 255.0 FORMAT "%5.1" /end CHARACTERISTIC
/begin CHARACTERISTIC EGRCD_stCBVSPICtl_C "Parameter zur Auswahl der verwendeten Endstufe (1 = SPI kontrollierte Endstufe, 0 = nicht SPI kontrollierte Endstufe)" VALUE 0x1D28D5 Kw_Wu8 1.000 OneToOne 0.00 1.000 FORMAT "%5.3" EXTENDED_LIMITS 0.00 255.0 /end CHARACTERISTIC
/begin CHARACTERISTIC EGRCD_stDisInvOut_C "Invertierung der Ansteuerung des Disable Pins der H-Brücke" VALUE 0x1D28B4 Kw_Wu8 1.000 OneToOne 0.00 1.000 FORMAT "%5.3" EXTENDED_LIMITS 0.00 255.0 /end CHARACTERISTIC
/begin CHARACTERISTIC EGRCD_stInvStCJ220_C "Statuswort zur Invertierung der aus der CJ220 ausgelesenen Information" VALUE 0x1D28B5 Kw_Wu8 1.000 OneToOne 0.00 1.000 FORMAT "%5.3" EXTENDED_LIMITS 0.00 255.0 /end CHARACTERISTIC
/begin CHARACTERISTIC EGRCD_stPwrStgActv_C "Aktivierung der Abschaltbedingungen der Endstufe" VALUE 0x1D28B6 Kw_Wu8 255.0 OneToOne 0.00 255.0 FORMAT "%5.1" /end CHARACTERISTIC
/begin CHARACTERISTIC EGRCD_stPwrStgDia_C "Aktivierung der Abschaltbedingungen der Endstufendiagnose" VALUE 0x1D28B7 Kw_Wu8 255.0 OneToOne 0.00 255.0 FORMAT "%5.1" /end CHARACTERISTIC
/begin CHARACTERISTIC EGRCD_stSPICtl_C "0 = Non SPI powerstage )" VALUE 0x1D28B8 Kw_Wu8 1.000 OneToOne 0.00 1.000 FORMAT "%5.3" EXTENDED_LIMITS 0.00 255.0 /end CHARACTERISTIC
/begin CHARACTERISTIC EGRCD_swtLSPwrStgOn_C "Schalter zur Erkennung von unterem mechanischen Anschlag" VALUE 0x1D28B9 Kw_Wu8 255.0 OneToOne 0.00 255.0 FORMAT "%5.1" /end CHARACTERISTIC
/begin CHARACTERISTIC EGRCD_swt_C "Schalter Batteriesspannungskorrektur (0 = AUS, 1 = EIN);H - Brücke-Paket (0 = EIN; 1 = AUS)" VALUE 0x1D28BA Kw_Wu8 255.0 OneToOne 0.00 255.0 FORMAT "%5.1" /end CHARACTERISTIC
/begin CHARACTERISTIC EGRCD_tiBtwTstCBV_C "Zeitabstand, in dem im Fehlerfall die Endstufe getestet wird" VALUE 0x1D28D6 Kw_Wu16 29900.00 Time_ms 100.0000 30000.00 FORMAT "%8.2" EXTENDED_LIMITS 0.00 655350.0 /end CHARACTERISTIC
/begin CHARACTERISTIC EGRCD_tiBtwTst_C "Zeitabstand, in dem im Fehlerfall die Endstufe getestet wird" VALUE 0x1D28BC Kw_Wu16 29990.00 Time_ms 10.00000 30000.00 FORMAT "%8.2" EXTENDED_LIMITS 0.00 655350.0 /end CHARACTERISTIC
/begin CHARACTERISTIC EGRCD_tiCBVPwrStgOn_C "Zeit, für die nicht SPI-fähige Endstufen im Fehlerfall eingeschaltet werden" VALUE 0x1D28D8 Kw_Wu16 500.0000 Time_ms 0.00 500.0000 FORMAT "%8.4" EXTENDED_LIMITS 0.00 655350.0 /end CHARACTERISTIC
/begin CHARACTERISTIC EGRCD_tiPwrStgOn_C "Zeit für welche die Endstufe im Fehlerfall eingeschalten wird (nur nicht SPI kontrolliert)" VALUE 0x1D28BE Kw_Wu16 500.0000 Time_ms 0.00 500.0000 FORMAT "%8.4" EXTENDED_LIMITS 0.00 655350.0 /end CHARACTERISTIC
/begin CHARACTERISTIC EGRSCD_uRawSRCMin_C "Untere SRC-Grenze für EGR-Sensorsignal" VALUE 0x1D28DC Kw_Ws16 5200.391 Volt 0.00 5200.391 FORMAT "%8.3" EXTENDED_LIMITS -160156.4 160151.5 /end CHARACTERISTIC
/begin CHARACTERISTIC EGRSCD_uRawSRCMax_C "Obere SRC-Grenze für EGR-Sensorsignal" VALUE 0x1D28DE Kw_Ws16 5200.391 Volt 0.00 5200.391 FORMAT "%8.3" EXTENDED_LIMITS -160156.4 160151.5 /end CHARACTERISTIC
/begin CHARACTERISTIC EGRSCD_rLin_CUR "Linearisierte Kennlinie für EGR-Sensorsignal" CURVE 0x1D28E0 Kl_Xs16_Ws16 100.0000 DtyCyc 0.00 100.0000 FORMAT "%8.4" EXTENDED_LIMITS -327.6800 327.6700
 /begin AXIS_DESCR STD_AXIS EGRSCD_uRaw Volt 25 0.00 5200.391 FORMAT "%8.3" EXTENDED_LIMITS -160156.4 160151.5 DEPOSIT ABSOLUTE /end AXIS_DESCR
/end CHARACTERISTIC
/begin CHARACTERISTIC EGRSCD_DebSRCHighDef_C "Fehlerentprellungszeit für SRC-High Fehler" VALUE 0x1D2946 Kw_Wu16 655350.0 Time_ms 0.00 655350.0 FORMAT "%8.1" /end CHARACTERISTIC
/begin CHARACTERISTIC EGRSCD_DebSRCHighOk_C "Heilungsentprellungszeit für SRC-High Fehler" VALUE 0x1D2948 Kw_Wu16 655350.0 Time_ms 0.00 655350.0 FORMAT "%8.1" /end CHARACTERISTIC
/begin CHARACTERISTIC EGRSCD_DebSRCLowDef_C "Fehlerentprellungszeit für SRC-Low Fehler" VALUE 0x1D294A Kw_Wu16 655350.0 Time_ms 0.00 655350.0 FORMAT "%8.1" /end CHARACTERISTIC
/begin CHARACTERISTIC EGRSCD_DebSRCLowOk_C "Heilungsentprellungszeit für SRC-Low Fehler" VALUE 0x1D294C Kw_Wu16 655350.0 Time_ms 0.00 655350.0 FORMAT "%8.1" /end CHARACTERISTIC
/begin CHARACTERISTIC EGRSCD_facAdaptClsStrt_C "Korrekturfaktor" VALUE 0x1D294E Kw_Ws16 4.000000 Fact 0.00 4.000000 FORMAT "%8.6" EXTENDED_LIMITS -4.000000 3.999878 /end CHARACTERISTIC
/begin CHARACTERISTIC EGRSCD_facAdaptPosCls_C "Maximaler Wert des ausgegebenen Steuersignals" VALUE 0x1D2950 Kw_Ws16 4.000000 Fact 0.00 4.000000 FORMAT "%8.6" EXTENDED_LIMITS -4.000000 3.999878 /end CHARACTERISTIC
/begin CHARACTERISTIC EGRSCD_IKiDwn_C "Maximaler Wert des ausgegebenen Steuersignals" VALUE 0x1D2954 Kw_Wu32 999999.999767 Ki 0.00 999999.999767 FORMAT "%13.6" /end CHARACTERISTIC
/begin CHARACTERISTIC EGRSCD_IKiUp_C "Minimaler Wert des ausgegebenen Steuersignals" VALUE 0x1D2958 Kw_Wu32 999999.999767 Ki 0.00 999999.999767 FORMAT "%13.6" /end CHARACTERISTIC
/begin CHARACTERISTIC EGRSCD_numAdaptClsMax_C "Maximale Zahl von öffnenden und schließenden Zyklen" VALUE 0x1D295C Kw_Wu8 255.0 OneToOne 0.00 255.0 FORMAT "%5.1" /end CHARACTERISTIC
/begin CHARACTERISTIC EGRSCD_numAdc_C "Applikationsparameter für AGR-Sensor" VALUE 0x1D295D Kw_Wu8 23.0000000000 NumPinAdc 2.00000000000 25.0000000000 FORMAT "%13.10" /end CHARACTERISTIC
/begin CHARACTERISTIC EGRSCD_rAdaptAgOpnMax_C "Maximal zulässiger  Öffnungswinkel" VALUE 0x1D295E Kw_Ws16 100.0000 DtyCyc 0.00 100.0000 FORMAT "%8.4" EXTENDED_LIMITS -327.6800 327.6700 /end CHARACTERISTIC
/begin CHARACTERISTIC EGRSCD_rAdaptAgOpnMin_C "Minimaler Öffnungswinkel" VALUE 0x1D2960 Kw_Ws16 100.0000 DtyCyc 0.00 100.0000 FORMAT "%8.4" EXTENDED_LIMITS -327.6800 327.6700 /end CHARACTERISTIC
/begin CHARACTERISTIC EGRSCD_rAdaptDiffPlausLgTime_C "Zulässige langzeitige Drift" VALUE 0x1D2962 Kw_Ws16 100.0000 DtyCyc 0.00 100.0000 FORMAT "%8.4" EXTENDED_LIMITS -327.6800 327.6700 /end CHARACTERISTIC
/begin CHARACTERISTIC EGRSCD_rAdaptDiffPlausShTime_C "Zulässige kurzzeitige Drift" VALUE 0x1D2964 Kw_Ws16 100.0000 DtyCyc 0.00 100.0000 FORMAT "%8.4" EXTENDED_LIMITS -327.6800 327.6700 /end CHARACTERISTIC
/begin CHARACTERISTIC EGRSCD_rAdaptDiffPlaus_C "Zulässige Differenz zwischen minimalen und maximalen Anspassungswerten" VALUE 0x1D2966 Kw_Ws16 100.0000 DtyCyc 0.00 100.0000 FORMAT "%8.4" EXTENDED_LIMITS -327.6800 327.6700 /end CHARACTERISTIC
/begin CHARACTERISTIC EGRSCD_rAdaptInitOpn0_C "Initialisierungswert des Integrators zum Öffnen der Klappe (Erstes Mal)" VALUE 0x1D2968 Kw_Ws16 100.0000 DtyCyc 0.00 100.0000 FORMAT "%8.4" EXTENDED_LIMITS -327.6800 327.6700 /end CHARACTERISTIC
/begin CHARACTERISTIC EGRSCD_rAdaptInitOpn_C "Initialisierungswert des Integrators zum Öffnen der Klappe" VALUE 0x1D296A Kw_Ws16 100.0000 DtyCyc 0.00 100.0000 FORMAT "%8.4" EXTENDED_LIMITS -327.6800 327.6700 /end CHARACTERISTIC
/begin CHARACTERISTIC EGRSCD_rAdaptOpnBnd_C "Initialisierungswert des Integrators bei Erreichen der max. zulässigen Stellung" VALUE 0x1D296C Kw_Ws16 100.0000 DtyCyc 0.00 100.0000 FORMAT "%8.4" EXTENDED_LIMITS -327.6800 327.6700 /end CHARACTERISTIC
/begin CHARACTERISTIC EGRSCD_rCmpNewCtlUn_C "Vorgabewert des neuen SGs" VALUE 0x1D296E Kw_Ws16 100.0000 DtyCyc 0.00 100.0000 FORMAT "%8.4" EXTENDED_LIMITS -327.6800 327.6700 /end CHARACTERISTIC
/begin CHARACTERISTIC EGRSCD_rMax_C "Maximaler Wert des ausgegebenen Steuersignals" VALUE 0x1D2970 Kw_Ws16 100.0000 DtyCyc 0.00 100.0000 FORMAT "%8.4" EXTENDED_LIMITS -327.6800 327.6700 /end CHARACTERISTIC
/begin CHARACTERISTIC EGRSCD_rMin_C "Minimaler Wert des ausgegebenen Steuersignals" VALUE 0x1D2972 Kw_Ws16 100.0000 DtyCyc 0.00 100.0000 FORMAT "%8.4" EXTENDED_LIMITS -327.6800 327.6700 /end CHARACTERISTIC
/begin CHARACTERISTIC EGRSCD_drRmpSlpUp_C "Steigende Rampensteigung für Übergangszustand" VALUE 0x1D2974 Kw_Wu32 655359.999847 RmpDtyCyc 0.00 655359.999847 FORMAT "%13.6" /end CHARACTERISTIC
/begin CHARACTERISTIC EGRSCD_drRmpSlpDwn_C "Fallende Rampensteigung für Übergangszustand" VALUE 0x1D2978 Kw_Wu32 655359.999847 RmpDtyCyc 0.00 655359.999847 FORMAT "%13.6" /end CHARACTERISTIC
/begin CHARACTERISTIC EGRSCD_rPullDwnMax_C "Maximal zulässiger  Integratorwer" VALUE 0x1D297C Kw_Ws16 100.0000 DtyCyc 0.00 100.0000 FORMAT "%8.4" EXTENDED_LIMITS -327.6800 327.6700 /end CHARACTERISTIC
/begin CHARACTERISTIC EGRSCD_rPullDwnMin_C "Minimal zulässiger  Integratorwert" VALUE 0x1D297E Kw_Ws16 100.0000 DtyCyc 0.00 100.0000 FORMAT "%8.4" EXTENDED_LIMITS -327.6800 327.6700 /end CHARACTERISTIC
/begin CHARACTERISTIC EGRSCD_rPullDwnThres_C "Pull Down Integrator Schwelle zur Aktivierung des Lernens des temporären Offsets" VALUE 0x1D2980 Kw_Ws16 100.0000 DtyCyc -100.0000 0.00 FORMAT "%8.4" EXTENDED_LIMITS -327.6800 327.6700 /end CHARACTERISTIC
/begin CHARACTERISTIC EGRSCD_rRelPosOfs_C "Offset-Korrekturwert" VALUE 0x1D2982 Kw_Ws16 100.0000 DtyCyc 0.00 100.0000 FORMAT "%8.4" EXTENDED_LIMITS -327.6800 327.6700 /end CHARACTERISTIC
/begin CHARACTERISTIC EGRSCD_rSensVlvThres_C "Schwellenwert zur Erkennung des unteren mechanischen Anschlags" VALUE 0x1D2984 Kw_Ws16 100.0000 DtyCyc 0.00 100.0000 FORMAT "%8.4" EXTENDED_LIMITS -327.6800 327.6700 /end CHARACTERISTIC
/begin CHARACTERISTIC EGRSCD_rTmpOfsLrnMax_C "Maximaler positiver temporärer Offset" VALUE 0x1D2986 Kw_Ws16 100.0000 DtyCyc 0.00 100.0000 FORMAT "%8.4" EXTENDED_LIMITS -327.6800 327.6700 /end CHARACTERISTIC
/begin CHARACTERISTIC EGRSCD_rTmpOfsLrnMin_C "Maximaler negativer temporärer Offset" VALUE 0x1D2988 Kw_Ws16 100.0000 DtyCyc -100.0000 0.00 FORMAT "%8.4" EXTENDED_LIMITS -327.6800 327.6700 /end CHARACTERISTIC
/begin CHARACTERISTIC EGRSCD_stNewVlvTrg_C "Trigger für neue Klappe" VALUE 0x1D298A Kw_Wu8 1.000 OneToOne 0.00 1.000 FORMAT "%5.3" EXTENDED_LIMITS 0.00 255.0 /end CHARACTERISTIC
/begin CHARACTERISTIC EGRSCD_stOfsLrnTrg_C "Trigger zum Offsetlernen" VALUE 0x1D298B Kw_Wu8 1.000 OneToOne 0.00 1.000 FORMAT "%5.3" EXTENDED_LIMITS 0.00 255.0 /end CHARACTERISTIC
/begin CHARACTERISTIC EGRSCD_swtRelPosOfs_C "Schalter zur Aktivierung des Ersatzwerts von dem Offset" VALUE 0x1D298C Kw_Wu8 1.000 OneToOne 0.00 1.000 FORMAT "%5.3" EXTENDED_LIMITS 0.00 255.0 /end CHARACTERISTIC
/begin CHARACTERISTIC EGRSCD_tEngMax_C "Maximaler Motortemperaturwert zur Freigabe der Nullpunktadaption" VALUE 0x1D298E Kw_Ws16 250.0000 Temp_Cels -50.14000 199.8600 FORMAT "%8.4" EXTENDED_LIMITS -3549.940 3003.560 /end CHARACTERISTIC
/begin CHARACTERISTIC EGRSCD_tEngMin_C "Minimaler Motortemperaturwert zur Freigabe der Nullpunktadaption" VALUE 0x1D2990 Kw_Ws16 250.0000 Temp_Cels -50.14000 199.8600 FORMAT "%8.4" EXTENDED_LIMITS -3549.940 3003.560 /end CHARACTERISTIC
/begin CHARACTERISTIC EGRSCD_tiAdaptJamVlv_C "Entprellungszeit zur Erkennung verklemmter Klappe" VALUE 0x1D2992 Kw_Wu16 20000.00 Time_ms 0.00 20000.00 FORMAT "%8.2" EXTENDED_LIMITS 0.00 655350.0 /end CHARACTERISTIC
/begin CHARACTERISTIC EGRSCD_tiAdaptPullDwn_C "Zeit für das komplette Schliessen des Ventils" VALUE 0x1D2994 Kw_Wu16 20000.00 Time_ms 0.00 20000.00 FORMAT "%8.2" EXTENDED_LIMITS 0.00 655350.0 /end CHARACTERISTIC
/begin CHARACTERISTIC EGRSCD_tiClsJamVlv_C "Entprellzeit zur Erkennung von dem verklemmten Ventil" VALUE 0x1D2996 Kw_Wu16 20000.00 Time_ms 0.00 20000.00 FORMAT "%8.2" EXTENDED_LIMITS 0.00 655350.0 /end CHARACTERISTIC
/begin CHARACTERISTIC EGRSCD_stSensIDWord_C "Übergangszustand-ID-Wort für das AGR-Sensor" VALUE 0x1D2998 Kw_Wu16 65535.00 OneToOne 0.00 65535.00 FORMAT "%8.2" /end CHARACTERISTIC
/begin CHARACTERISTIC EGRSCD_rDfl_C "Vorgabewert im Falle eines Fehlers" VALUE 0x1D299A Kw_Ws16 100.0000 DtyCyc 0.00 100.0000 FORMAT "%8.4" EXTENDED_LIMITS -327.6800 327.6700 /end CHARACTERISTIC
/begin CHARACTERISTIC EGRSCD_uBattMax_C "Maximaler Batteriespannungswert zur Freigabe der Nullpunktadaption" VALUE 0x1D299C Kw_Ws16 28603.18 Volt_Batt 0.00 28603.18 FORMAT "%8.2" EXTENDED_LIMITS -665674.1 665653.8 /end CHARACTERISTIC
/begin CHARACTERISTIC EGRSCD_uBattMin_C "Minimaler Batteriespannungswert zur Freigabe der Nullpunktadaption" VALUE 0x1D299E Kw_Ws16 28603.18 Volt_Batt 0.00 28603.18 FORMAT "%8.2" EXTENDED_LIMITS -665674.1 665653.8 /end CHARACTERISTIC
/begin CHARACTERISTIC EGRVlv_DKdNeg_C "D-Verstärkung des PID-Reglers bei negativen Großsignalen" VALUE 0x1D29C4 Kw_Ws32 10.0000000000 Kd 0.00 10.0000000000 FORMAT "%13.10" EXTENDED_LIMITS -32768.0000000 32767.9999847 /end CHARACTERISTIC
/begin CHARACTERISTIC EGRVlv_DKdPos_C "D-Verstärkung des PID-Reglers bei positiven Großsignalen" VALUE 0x1D29C8 Kw_Ws32 10.0000000000 Kd 0.00 10.0000000000 FORMAT "%13.10" EXTENDED_LIMITS -32768.0000000 32767.9999847 /end CHARACTERISTIC
/begin CHARACTERISTIC EGRVlv_drRelPosNeg_C "Schwellwert für Ventilgeschwindigkeit bei Erkennung auf langsames Schließen" VALUE 0x1D29CC Kw_Ws16 1000.000 VlvVel 0.00 1000.000 FORMAT "%8.3" EXTENDED_LIMITS -3276.800 3276.700 /end CHARACTERISTIC
/begin CHARACTERISTIC EGRVlv_tiCurrEffFlt_C "Zeitkonstante für Mittelwertbildung des Effektivstroms" VALUE 0x1D29D0 Kw_Wu32 4294.9673 TimeDelay_s 0.0000010000000 4294.9673 FORMAT "%9.4" /end CHARACTERISTIC
/begin CHARACTERISTIC EGRVlv_iEff_CUR "Kennlinie zur Ermittlung des Effektivstroms" CURVE 0x1D29D4 Kl_Xs16_Ws16 10.00000 Curr_A 0.00 10.00000 FORMAT "%8.5" EXTENDED_LIMITS -327.6800 327.6700
 /begin AXIS_DESCR STD_AXIS EGRVlv_rAbsEGRCorr_mp DtyCyc 8 0.00 100.0000 FORMAT "%8.4" EXTENDED_LIMITS -327.6800 327.6700 DEPOSIT ABSOLUTE /end AXIS_DESCR
/end CHARACTERISTIC
/begin CHARACTERISTIC EGRVlv_IKiNeg_C "I-Verstärkung des PID-Reglers bei negativen Großsignalen" VALUE 0x1D29F8 Kw_Ws32 100.000062957 Ki 0.00 100.000062957 FORMAT "%13.9" EXTENDED_LIMITS -500000.000000 499999.999767 /end CHARACTERISTIC
/begin CHARACTERISTIC EGRVlv_IKiPos_C "I-Verstärkung des PID-Reglers bei positiven Großsignalen" VALUE 0x1D29FC Kw_Ws32 100.000062957 Ki 0.00 100.000062957 FORMAT "%13.9" EXTENDED_LIMITS -500000.000000 499999.999767 /end CHARACTERISTIC
/begin CHARACTERISTIC EGRVlv_numEngTempMon_C "Index für Temperatur aus Motortemperatur-Feld" VALUE 0x1D29A0 Kw_Wu8 4.00000000000 EngTempFldSel 0.00 4.00000000000 FORMAT "%13.11" /end CHARACTERISTIC
/begin CHARACTERISTIC EGRVlv_numLckdDetThres_C "Grenze für Anzahl der Abtastungen seit konstanter Regelabweichung im mechanischen Anschlag" VALUE 0x1D2A00 Kw_Wu8 255.0 OneToOne 0.00 255.0 FORMAT "%5.1" /end CHARACTERISTIC
/begin CHARACTERISTIC EGRVlv_PKpNeg_C "P-Verstärkung des PID-Reglers bei negativen Großsignalen" VALUE 0x1D2A04 Kw_Ws32 10.0000000000 Kp 0.00 10.0000000000 FORMAT "%13.10" EXTENDED_LIMITS -32768.0000000 32767.9999847 /end CHARACTERISTIC
/begin CHARACTERISTIC EGRVlv_PKpPos_C "P-Verstärkung des PID-Reglers bei positiven Großsignalen" VALUE 0x1D2A08 Kw_Ws32 10.0000000000 Kp 0.00 10.0000000000 FORMAT "%13.10" EXTENDED_LIMITS -32768.0000000 32767.9999847 /end CHARACTERISTIC
/begin CHARACTERISTIC EGRVlv_PullDwnIKi_C "I-Verstärkung des Pull-Down-Integrators" VALUE 0x1D2A0C Kw_Wu32 100.000000000 Ki_EGRVlv 0.00 100.000000000 FORMAT "%13.9" EXTENDED_LIMITS 0.00 655359.999847 /end CHARACTERISTIC
/begin CHARACTERISTIC EGRVlv_rDvtMax_C "Grenze für Erkennung auf positive bleibende Regelabweichung" VALUE 0x1D29A2 Kw_Ws16 100.0000 DtyCyc 0.00 100.0000 FORMAT "%8.4" EXTENDED_LIMITS -327.6800 327.6700 /end CHARACTERISTIC
/begin CHARACTERISTIC EGRVlv_rDvtMin_C "Grenze für Erkennung auf neagtive bleibende Regelabweichung" VALUE 0x1D29A4 Kw_Ws16 100.0000 DtyCyc -100.0000 0.00 FORMAT "%8.4" EXTENDED_LIMITS -327.6800 327.6700 /end CHARACTERISTIC
/begin CHARACTERISTIC EGRVlv_rGvnrDvtThres_C "Schwellwert für die Ausblendung des D-Anteils des PID-Reglers" VALUE 0x1D2A10 Kw_Ws16 100.0000 DtyCyc 0.00 100.0000 FORMAT "%8.4" EXTENDED_LIMITS -327.6800 327.6700 /end CHARACTERISTIC
/begin CHARACTERISTIC EGRVlv_rGvnrMax_CUR "Kennlinie für den oberen Grenzwert des Reglersollwerts" CURVE 0x1D2A12 Kl_Xs16_Ws16 100.0000 DtyCyc 0.00 100.0000 FORMAT "%8.4" EXTENDED_LIMITS -327.6800 327.6700
 /begin AXIS_DESCR STD_AXIS EGRVlv_iEffFlt_mp Curr_A 3 0.00 10.00000 FORMAT "%8.5" EXTENDED_LIMITS -327.6800 327.6700 DEPOSIT ABSOLUTE /end AXIS_DESCR
/end CHARACTERISTIC
/begin CHARACTERISTIC EGRVlv_rGvnrMin_CUR "Kennlinie für den unteren Grenzwert des Reglersollwerts" CURVE 0x1D2A20 Kl_Xs16_Ws16 100.0000 DtyCyc -100.0000 0.00 FORMAT "%8.4" EXTENDED_LIMITS -327.6800 327.6700
 /begin AXIS_DESCR STD_AXIS EGRVlv_iEffFlt_mp Curr_A 3 0.00 10.00000 FORMAT "%8.5" EXTENDED_LIMITS -327.6800 327.6700 DEPOSIT ABSOLUTE /end AXIS_DESCR
/end CHARACTERISTIC
/begin CHARACTERISTIC EGRVlv_rInitStep_C "Vorhaltewert für I-Anteil bei Sprung aus unterem mechanischen Anschlag" VALUE 0x1D2A2E Kw_Ws16 100.0000 DtyCyc 0.00 100.0000 FORMAT "%8.4" EXTENDED_LIMITS -327.6800 327.6700 /end CHARACTERISTIC
/begin CHARACTERISTIC EGRVlv_rLckdDetThres_C "Regelabweichungsdifferenzschwelle zur Erkennung des mechanischen Anschlags" VALUE 0x1D2A30 Kw_Ws16 200.0000 DtyCyc -100.0000 100.0000 FORMAT "%8.4" EXTENDED_LIMITS -327.6800 327.6700 /end CHARACTERISTIC
/begin CHARACTERISTIC EGRVlv_RlsIKi_C "I-Verstärkung des Integrators der Losreißfunktion" VALUE 0x1D29A8 Kw_Wu32 100000.000000 Ki_EGRVlv 0.00 100000.000000 FORMAT "%13.6" EXTENDED_LIMITS 0.00 655359.999847 /end CHARACTERISTIC
/begin CHARACTERISTIC EGRVlv_rLSRelPosThresDwn_C "Schwellwert für Lageistwert, unterhalb dem der untere mechanische Anschlag erkannt wird" VALUE 0x1D2A32 Kw_Ws16 100.0000 DtyCyc 0.00 100.0000 FORMAT "%8.4" EXTENDED_LIMITS -327.6800 327.6700 /end CHARACTERISTIC
/begin CHARACTERISTIC EGRVlv_rLSRelPosThresInit_C "Sollwertschwelle zur Aktivierung des Pull Down Integrators nach Init" VALUE 0x1D2A34 Kw_Ws16 100.0000 DtyCyc 0.00 100.0000 FORMAT "%8.4" EXTENDED_LIMITS -327.6800 327.6700 /end CHARACTERISTIC
/begin CHARACTERISTIC EGRVlv_rLSThresDwn_C "Schwellwert für Lagesollwert, unterhalb dem der untere mechanische Anschlag erkannt wird" VALUE 0x1D2A36 Kw_Ws16 100.0000 DtyCyc 0.00 100.0000 FORMAT "%8.4" EXTENDED_LIMITS -327.6800 327.6700 /end CHARACTERISTIC
/begin CHARACTERISTIC EGRVlv_rLSThresUp_C "Schwellwert für Lagesollwert, oberhalb dem nicht auf unteren mechanischen Anschlag erkannt wird" VALUE 0x1D2A38 Kw_Ws16 100.0000 DtyCyc 0.00 100.0000 FORMAT "%8.4" EXTENDED_LIMITS -327.6800 327.6700 /end CHARACTERISTIC
/begin CHARACTERISTIC EGRVlv_rOutCurrMax_C "oberer Grenzwert des I-Anteils des Lagereglers" VALUE 0x1D2A3A Kw_Ws16 100.0000 DtyCyc 0.00 100.0000 FORMAT "%8.4" EXTENDED_LIMITS -327.6800 327.6700 /end CHARACTERISTIC
/begin CHARACTERISTIC EGRVlv_rOutDMax_C "maximal zulässige Stellgröße des D-Anteils des PID-Reglers" VALUE 0x1D2A3C Kw_Ws16 100.0000 DtyCyc 0.00 100.0000 FORMAT "%8.4" EXTENDED_LIMITS -327.6800 327.6700 /end CHARACTERISTIC
/begin CHARACTERISTIC EGRVlv_rPIDWinNeg_C "untere Kleinsignalgrenze des PID-Reglers" VALUE 0x1D2A3E Kw_Ws16 100.0000 DtyCyc -100.0000 0.00 FORMAT "%8.4" EXTENDED_LIMITS -327.6800 327.6700 /end CHARACTERISTIC
/begin CHARACTERISTIC EGRVlv_rPIDWinPos_C "obere Kleinsignalgrenze des PID-Reglers" VALUE 0x1D2A40 Kw_Ws16 100.0000 DtyCyc 0.00 100.0000 FORMAT "%8.4" EXTENDED_LIMITS -327.6800 327.6700 /end CHARACTERISTIC
/begin CHARACTERISTIC EGRVlv_rPullDwnMax_C "maximal zulässiges Ansteuertastverhältnis des Pull-Down-Integrators" VALUE 0x1D2A42 Kw_Ws16 100.0000 DtyCyc 0.00 100.0000 FORMAT "%8.4" EXTENDED_LIMITS -327.6800 327.6700 /end CHARACTERISTIC
/begin CHARACTERISTIC EGRVlv_rRelPosNeg_C "Schwellwert für Ventilhub bei Erkennung auf langsames Schließen" VALUE 0x1D2A44 Kw_Ws16 100.0000 DtyCyc 0.00 100.0000 FORMAT "%8.4" EXTENDED_LIMITS -327.6800 327.6700 /end CHARACTERISTIC
/begin CHARACTERISTIC EGRVlv_rRlsMax_C "maximal zulässiges Ansteuertastverhältnis der Losreißfunktion" VALUE 0x1D29AC Kw_Ws16 100.0000 DtyCyc 0.00 100.0000 FORMAT "%8.4" EXTENDED_LIMITS -327.6800 327.6700 /end CHARACTERISTIC
/begin CHARACTERISTIC EGRVlv_rStepThres_C "Schwellwert für Erkennung auf Sprung aus unterem mechanischen Anschlag" VALUE 0x1D2A46 Kw_Ws16 100.0000 DtyCyc 0.00 100.0000 FORMAT "%8.4" EXTENDED_LIMITS -327.6800 327.6700 /end CHARACTERISTIC
/begin CHARACTERISTIC EGRVlv_SlwClsDKd_C "D-Verstärkung des PID-Reglers für langsames Schließen" VALUE 0x1D2A48 Kw_Ws32 10.0000000000 Kd 0.00 10.0000000000 FORMAT "%13.10" EXTENDED_LIMITS -32768.0000000 32767.9999847 /end CHARACTERISTIC
/begin CHARACTERISTIC EGRVlv_SlwClsIKi_C "I-Verstärkung des PID-Reglers für langsames Schließen" VALUE 0x1D2A4C Kw_Ws32 100.000062957 Ki 0.00 100.000062957 FORMAT "%13.9" EXTENDED_LIMITS -500000.000000 499999.999767 /end CHARACTERISTIC
/begin CHARACTERISTIC EGRVlv_SlwClsPKp_C "P-Verstärkung des PID-Reglers für langsames Schließen" VALUE 0x1D2A50 Kw_Ws32 10.0000000000 Kp 0.00 10.0000000000 FORMAT "%13.10" EXTENDED_LIMITS -32768.0000000 32767.9999847 /end CHARACTERISTIC
/begin CHARACTERISTIC EGRVlv_SmlSigNegDKd_C "D-Verstärkung des PID-Reglers bei negativen Kleinsignalen" VALUE 0x1D2A54 Kw_Ws32 10.0000000000 Kd 0.00 10.0000000000 FORMAT "%13.10" EXTENDED_LIMITS -32768.0000000 32767.9999847 /end CHARACTERISTIC
/begin CHARACTERISTIC EGRVlv_SmlSigNegIKi_C "I-Verstärkung des PID-Reglers bei negativen Kleinsignalen" VALUE 0x1D2A58 Kw_Ws32 100.000062957 Ki 0.00 100.000062957 FORMAT "%13.9" EXTENDED_LIMITS -500000.000000 499999.999767 /end CHARACTERISTIC
/begin CHARACTERISTIC EGRVlv_SmlSigNegPKp_C "P-Verstärkung des PID-Reglers bei negativen Kleinsignalen" VALUE 0x1D2A5C Kw_Ws32 10.0000000000 Kp 0.00 10.0000000000 FORMAT "%13.10" EXTENDED_LIMITS -32768.0000000 32767.9999847 /end CHARACTERISTIC
/begin CHARACTERISTIC EGRVlv_SmlSigPosDKd_C "D-Verstärkung des PID-Reglers bei positiven Kleinsignalen" VALUE 0x1D2A60 Kw_Ws32 10.0000000000 Kd 0.00 10.0000000000 FORMAT "%13.10" EXTENDED_LIMITS -32768.0000000 32767.9999847 /end CHARACTERISTIC
/begin CHARACTERISTIC EGRVlv_SmlSigPosIKi_C "I-Verstärkung des PID-Reglers bei positiven Kleinsignalen" VALUE 0x1D2A64 Kw_Ws32 100.000062957 Ki 0.00 100.000062957 FORMAT "%13.9" EXTENDED_LIMITS -500000.000000 499999.999767 /end CHARACTERISTIC
/begin CHARACTERISTIC EGRVlv_SmlSigPosPKp_C "P-Verstärkung des PID-Reglers bei positiven Kleinsignalen" VALUE 0x1D2A68 Kw_Ws32 10.0000000000 Kp 0.00 10.0000000000 FORMAT "%13.10" EXTENDED_LIMITS -32768.0000000 32767.9999847 /end CHARACTERISTIC
/begin CHARACTERISTIC EGRVlv_swtGvnrByp_C "Schalter zur Umgehung des Lagereglers" VALUE 0x1D29AE Kw_Wu8 1.000 OneToOne 0.00 1.000 FORMAT "%5.3" EXTENDED_LIMITS 0.00 255.0 /end CHARACTERISTIC
/begin CHARACTERISTIC EGRVlv_tEngHi_C "Obere Temperaturschwelle zur Freigabe der Überwachung auf Regelabweichung" VALUE 0x1D29B0 Kw_Ws16 473.0000 Temp_Cels -273.1400 199.8600 FORMAT "%8.4" EXTENDED_LIMITS -3549.940 3003.560 /end CHARACTERISTIC
/begin CHARACTERISTIC EGRVlv_tEngLo_C "Untere Temperaturschwelle zur Freigabe der Überwachung auf Regelabweichung" VALUE 0x1D29B2 Kw_Ws16 473.0000 Temp_Cels -273.1400 199.8600 FORMAT "%8.4" EXTENDED_LIMITS -3549.940 3003.560 /end CHARACTERISTIC
/begin CHARACTERISTIC EGRVlv_tiActvPullDwn_C "Zeit zwischen der periodischen Aktivierung des Pull Down Integrators" VALUE 0x1D2A6C Kw_Wu16 655.3500 Time_s 0.00 655.3500 FORMAT "%8.4" /end CHARACTERISTIC
/begin CHARACTERISTIC EGRVlv_DebGvnrDvtMaxDef_C "Vorentprellzeit für Erkennung auf positive bleibende Regelabweichung" VALUE 0x1D29B4 Kw_Wu16 1000.000 Time_ms 0.00 1000.000 FORMAT "%8.3" EXTENDED_LIMITS 0.00 655350.0 /end CHARACTERISTIC
/begin CHARACTERISTIC EGRVlv_DebGvnrDvtMaxOk_C "Vorentprellzeit für Heilung bei positiver bleibender Regelabweichung" VALUE 0x1D29B6 Kw_Wu16 1000.000 Time_ms 0.00 1000.000 FORMAT "%8.3" EXTENDED_LIMITS 0.00 655350.0 /end CHARACTERISTIC
/begin CHARACTERISTIC EGRVlv_DebGvnrDvtMinDef_C "Vorentprellzeit für Erkennung auf negative bleibende Regelabweichung" VALUE 0x1D29B8 Kw_Wu16 1000.000 Time_ms 0.00 1000.000 FORMAT "%8.3" EXTENDED_LIMITS 0.00 655350.0 /end CHARACTERISTIC
/begin CHARACTERISTIC EGRVlv_DebGvnrDvtMinOk_C "Vorentprellzeit für Heilung bei negativer bleibender Regelabweichung" VALUE 0x1D29BA Kw_Wu16 1000.000 Time_ms 0.00 1000.000 FORMAT "%8.3" EXTENDED_LIMITS 0.00 655350.0 /end CHARACTERISTIC
/begin CHARACTERISTIC EGRVlv_tiGvnrDT1_C "Zeitkonstante des DT1-Gliedes im PID-Regler" VALUE 0x1D2A70 Kw_Wu32 4294.9663 TimeDelay_s 0.0010000001 4294.9673 FORMAT "%9.4" EXTENDED_LIMITS 0.0000010000000 4294.9673 /end CHARACTERISTIC
/begin CHARACTERISTIC EGRVlv_tiParDT1_C "Zeitkonstante des DT1-Glieds zum Erkennen auf langsames Schließen" VALUE 0x1D2A74 Kw_Wu32 4294.9663 TimeDelay_s 0.0010000001 4294.9673 FORMAT "%9.4" EXTENDED_LIMITS 0.0000010000000 4294.9673 /end CHARACTERISTIC
/begin CHARACTERISTIC EGRVlv_tiPullDwn_C "Laufzeit des Pull-Down-Integrators" VALUE 0x1D2A78 Kw_Wu16 5.000000 Time_s 0.00 5.000000 FORMAT "%8.6" EXTENDED_LIMITS 0.00 655.3500 /end CHARACTERISTIC
/begin CHARACTERISTIC EGRVlv_tiRepRls_C "Wartezeit für wiederholtes Starten der Losreißfunktion" VALUE 0x1D29BC Kw_Wu32 3600.00000000 Time_s 0.00 3600.00000000 FORMAT "%13.8" EXTENDED_LIMITS 0.00 42949672.9500 /end CHARACTERISTIC
/begin CHARACTERISTIC EGRVlv_tiRls_C "Laufzeit für Losreißfunktion" VALUE 0x1D29C0 Kw_Wu16 5.000000 Time_s 0.00 5.000000 FORMAT "%8.6" EXTENDED_LIMITS 0.00 655.3500 /end CHARACTERISTIC
/begin CHARACTERISTIC EGSys_AlpFreeCnvtTube_C "Wärmeübertragungskoeffizient am Abgasrohr aufgrund freier Konvektion" VAL_BLK 0x1D41E4 Kwb_Ws16 999.9000 ThermalCoEff 0.1000000 1000.000 FORMAT "%8.3" EXTENDED_LIMITS -3276.800 3276.700 NUMBER 4 /end CHARACTERISTIC
/begin CHARACTERISTIC EGSys_AlpOxiCat_MAP "Wärmeübertragungskoeffizienten-Abgas" MAP 0x1D3C68 Kf_Xs16_Ys16_Ws16 1000.000 ThermalCoEff 0.00 1000.000 FORMAT "%8.3" EXTENDED_LIMITS -3276.800 3276.700
 /begin AXIS_DESCR STD_AXIS EGSys_dmEG AirMassPerTime 16 -3276.000 3276.000 FORMAT "%8.3" EXTENDED_LIMITS -3276.800 3276.700 DEPOSIT ABSOLUTE /end AXIS_DESCR
 /begin AXIS_DESCR STD_AXIS VSSCD_v Vel 16 0.00 327.6700 FORMAT "%8.4" EXTENDED_LIMITS -327.6800 327.6700 DEPOSIT ABSOLUTE /end AXIS_DESCR
/end CHARACTERISTIC
/begin CHARACTERISTIC EGSys_CalHCOxiCat_C "unterer Heizwert des Kraftstoffes [J/g]" VALUE 0x1D3EAC Kw_Ws16 655350.0 Calory_Low -327680.0 327670.0 FORMAT "%8.1" /end CHARACTERISTIC
/begin CHARACTERISTIC EGSys_CalValFl_C "Unterer Heizwert Kraftstoff" VALUE 0x1D3EAE Kw_Wu16 65535.00 Calory 0.00 65535.00 FORMAT "%8.2" /end CHARACTERISTIC
/begin CHARACTERISTIC EGSys_cndHtEG_CUR "Wärmeleitfähigkeit Abgas (nicht applizierbar)" CURVE 0x1D2F70 Kl_Xs16_Ws16 1.000000 Fact 0.00 1.000000 FORMAT "%8.6" EXTENDED_LIMITS -4.000000 3.999878 READ_ONLY
 /begin AXIS_DESCR STD_AXIS EGSys_tEGInpCrv_mp Temp_Cels 8 -45.04000 1049.960 FORMAT "%8.3" EXTENDED_LIMITS -3549.940 3003.560 DEPOSIT ABSOLUTE /end AXIS_DESCR
/end CHARACTERISTIC
/begin CHARACTERISTIC EGSys_cpEGOxiCatDfl_C "Spezifische Wärmekapazität des OxiKats" VALUE 0x1D3EB0 Kw_Ws16 2999.900 HeatCapacity 0.1000000 3000.000 FORMAT "%8.3" EXTENDED_LIMITS -3276.800 3276.700 /end CHARACTERISTIC
/begin CHARACTERISTIC EGSys_cpEG_MAP "Wärmekapazität Abgas (nicht applizierbar)" MAP 0x1D2F92 Kf_Xs16_Ys16_Ws16 2.000000 SpecificHeat 0.00 2.000000 FORMAT "%8.6" EXTENDED_LIMITS -3.276800 3.276700 READ_ONLY
 /begin AXIS_DESCR STD_AXIS EGSys_tEGInpCrv_mp Temp_Cels 6 -45.04000 3003.560 FORMAT "%8.3" EXTENDED_LIMITS -3549.940 3003.560 DEPOSIT ABSOLUTE /end AXIS_DESCR
 /begin AXIS_DESCR STD_AXIS EGSys_rLmbdAprx lambda 6 -30.00000 30.00000 FORMAT "%8.5" EXTENDED_LIMITS -32.76800 32.76700 DEPOSIT ABSOLUTE /end AXIS_DESCR
/end CHARACTERISTIC
/begin CHARACTERISTIC EGSys_cpNSC_C "Wärmekapazität NSC" VALUE 0x1D3BB8 Kw_Ws16 2999.900 HeatCapacity 0.1000000 3000.000 FORMAT "%8.3" EXTENDED_LIMITS -3276.800 3276.700 /end CHARACTERISTIC
/begin CHARACTERISTIC EGSys_cpOxiCatHCMod_C "Wärmekapazität-Oxicat" VALUE 0x1D3EB2 Kw_Ws16 655350.0 HeatCapacity_Low -327680.0 327670.0 FORMAT "%8.1" /end CHARACTERISTIC
/begin CHARACTERISTIC EGSys_cpOxiCat_C "Wärmekapazität Oxidationskatalysator" VALUE 0x1D3EB4 Kw_Ws16 2999.900 HeatCapacity 0.1000000 3000.000 FORMAT "%8.3" EXTENDED_LIMITS -3276.800 3276.700 /end CHARACTERISTIC
/begin CHARACTERISTIC EGSys_cpTube_C "Wärmekapazität Abgasrohr" VAL_BLK 0x1D41EC Kwb_Ws16 2999.900 HeatCapacity 0.1000000 3000.000 FORMAT "%8.3" EXTENDED_LIMITS -3276.800 3276.700 NUMBER 4 /end CHARACTERISTIC
/begin CHARACTERISTIC EGSys_dmAir_MAP "Kennfeld zur Ermittlung Luftmassenstrom im Auslegungspunkt (zur Temperaturkorrektur)" MAP 0x1D389A Kf_Xs16_Ys16_Ws16 1000.000 AirMassPerTime 0.00 1000.000 FORMAT "%8.3" EXTENDED_LIMITS -3276.800 3276.700
 /begin AXIS_DESCR STD_AXIS Eng_nAvrg EngN 8 0.00 8000.000 FORMAT "%8.3" EXTENDED_LIMITS -32768.00 32767.00 DEPOSIT ABSOLUTE /end AXIS_DESCR
 /begin AXIS_DESCR STD_AXIS InjCtl_qCurr InjMass 8 0.00 100.0000 FORMAT "%8.4" EXTENDED_LIMITS -327.6800 327.6700 DEPOSIT ABSOLUTE /end AXIS_DESCR
/end CHARACTERISTIC
/begin CHARACTERISTIC EGSys_dmEGMinVal_C "Kleinstwert Abgasmassenstrom für thermische Modellierung" VALUE 0x1D2FF6 Kw_Ws16 1000.000 AirMassPerTime 0.00 1000.000 FORMAT "%8.3" EXTENDED_LIMITS -3276.800 3276.700 /end CHARACTERISTIC
/begin CHARACTERISTIC EGSys_dmExhGas_MAP "Abgasmassenstrom" MAP 0x1D2C94 Kf_Xs16_Ys16_Ws16 1000.000 AirMassPerTime 0.00 1000.000 FORMAT "%8.3" EXTENDED_LIMITS -3276.800 3276.700
 /begin AXIS_DESCR STD_AXIS AFSCD_dmAirPerTime AirMassPerTime 10 0.00 1000.000 FORMAT "%8.3" EXTENDED_LIMITS -3276.800 3276.700 DEPOSIT ABSOLUTE /end AXIS_DESCR
 /begin AXIS_DESCR STD_AXIS InjCtl_qCurr InjMass 10 0.00 100.0000 FORMAT "%8.4" EXTENDED_LIMITS -327.6800 327.6700 DEPOSIT ABSOLUTE /end AXIS_DESCR
/end CHARACTERISTIC
/begin CHARACTERISTIC EGSys_dmHCCldStrt_CUR "Kennlinie für HC Massenstrom bei Kaltstart" CURVE 0x1D2FF8 Kl_Xs16_Ws16 5.000000 InjMassPerTimeHigh 0.00 5.000000 FORMAT "%8.6" EXTENDED_LIMITS -32.76800 32.76700
 /begin AXIS_DESCR STD_AXIS InjCtl_qSetUnBal InjMass 12 0.00 327.6700 FORMAT "%8.4" EXTENDED_LIMITS -327.6800 327.6700 DEPOSIT ABSOLUTE /end AXIS_DESCR
/end CHARACTERISTIC
/begin CHARACTERISTIC EGSys_dmPlsThresLSUSrvTst_C "Minimaler Massenstrom für gültigen Gasstoß im Servicetest Modus" VAL_BLK 0x1D2A7C Kwb_Ws16 1000.000 AirMassPerTime 0.00 1000.000 FORMAT "%8.3" EXTENDED_LIMITS -3276.800 3276.700 NUMBER 1 /end CHARACTERISTIC
/begin CHARACTERISTIC EGSys_dmPlsThresLSU_C "Minimaler Massenstrom für gültigen Gasstoß" VAL_BLK 0x1D2A7E Kwb_Ws16 1000.000 AirMassPerTime 0.00 1000.000 FORMAT "%8.3" EXTENDED_LIMITS -3276.800 3276.700 NUMBER 1 /end CHARACTERISTIC
/begin CHARACTERISTIC EGSys_dwEnvOxiCatDfl_C "Ersatzwert Wärmestrom vom OxiCat an die Umgebung imFehlerfall [J/s]" VALUE 0x1D3EB8 Kw_Ws32 429496729.500 Pwr1 -214748364.800 214748364.700 FORMAT "%13.3" /end CHARACTERISTIC
/begin CHARACTERISTIC EGSys_dwEnvOxiCatOutDfl_C "Ersatzwert für Wärmeaustausch vom OxiKat zur Umgebung" VALUE 0x1D3EBC Kw_Ws32 429496729.500 Pwr1 -214748364.800 214748364.700 FORMAT "%13.3" /end CHARACTERISTIC
/begin CHARACTERISTIC EGSys_dwEnvOxiCatSurfDfl_C "Ersatzwert für Wärmeaustausch vom OxiKat zur Umgebung" VALUE 0x1D3EC0 Kw_Ws32 429496729.500 Pwr1 -214748364.800 214748364.700 FORMAT "%13.3" /end CHARACTERISTIC
/begin CHARACTERISTIC EGSys_etaChrg1_MAP "Kennfeld zur Berechnung der Gesamteffizienz des Turboladers" MAP 0x1D406C Kf_Xs16_Ys16_Ws16 0.9998779 Fact 0.0001220703 1.000000 FORMAT "%8.6" EXTENDED_LIMITS -4.000000 3.999878
 /begin AXIS_DESCR STD_AXIS AFSCD_dmAirPerTime AirMassPerTime 8 0.00 1000.000 FORMAT "%8.3" EXTENDED_LIMITS -3276.800 3276.700 DEPOSIT ABSOLUTE /end AXIS_DESCR
 /begin AXIS_DESCR STD_AXIS EGSys_rPresCmpr_mp Fact 8 0.00 8.000000 FORMAT "%8.6" EXTENDED_LIMITS -4.000000 3.999878 DEPOSIT ABSOLUTE /end AXIS_DESCR
/end CHARACTERISTIC
/begin CHARACTERISTIC EGSys_etaChrg2_MAP "Kennfeld zur Berechnung der Gesamteffizienz des zweiten Modells des Torbolader Temperaturmodells" MAP 0x1D4110 Kf_Xs16_Ys16_Ws16 0.9998779 Fact 0.0001220703 1.000000 FORMAT "%8.6" EXTENDED_LIMITS -4.000000 3.999878
 /begin AXIS_DESCR STD_AXIS AFSCD_dmAirPerTime AirMassPerTime 8 0.00 1000.000 FORMAT "%8.3" EXTENDED_LIMITS -3276.800 3276.700 DEPOSIT ABSOLUTE /end AXIS_DESCR
 /begin AXIS_DESCR STD_AXIS EGSys_rPresCmpr_mp Fact 8 0.00 8.000000 FORMAT "%8.6" EXTENDED_LIMITS -4.000000 3.999878 DEPOSIT ABSOLUTE /end AXIS_DESCR
/end CHARACTERISTIC
/begin CHARACTERISTIC EGSys_facAirMass_CUR "Kennlinie zur Luftmassenabhängigen Temperaturkorrektur" CURVE 0x1D393E Kl_Xs16_Ws16 2.000000 Fact 0.00 2.000000 FORMAT "%8.6" EXTENDED_LIMITS -4.000000 3.999878
 /begin AXIS_DESCR STD_AXIS EGSys_rAirPerTime_mp Fact 8 0.00 8.000000 FORMAT "%8.6" EXTENDED_LIMITS -4.000000 3.999878 DEPOSIT ABSOLUTE /end AXIS_DESCR
/end CHARACTERISTIC
/begin CHARACTERISTIC EGSys_facBrickOxiCat_C "Faktor, um Oxicat in Bricks aufzuteilen" VALUE 0x1D3EC4 Kw_Ws16 655.3500 Fact100 -327.6800 327.6700 FORMAT "%8.4" /end CHARACTERISTIC
/begin CHARACTERISTIC EGSys_facCldStrtLSU_C "Faktor für Schwellwerterhöhung bei wiederholtem Kaltstart" VAL_BLK 0x1D2A80 Kwb_Ws16 1.000000 Fact 0.00 1.000000 FORMAT "%8.6" EXTENDED_LIMITS -4.000000 3.999878 NUMBER 1 /end CHARACTERISTIC
/begin CHARACTERISTIC EGSys_facCorrCldEng_CUR "Kennlinie zur Abgastemperatur-Korrektur beim kaltem Motor" CURVE 0x1D3960 Kl_Xs16_Ws16 2.000000 Fact 0.00 2.000000 FORMAT "%8.6" EXTENDED_LIMITS -4.000000 3.999878
 /begin AXIS_DESCR STD_AXIS EGSys_tDiffCldEng_mp TempDiff_Kelv 8 -3276.800 3276.700 FORMAT "%8.3" DEPOSIT ABSOLUTE /end AXIS_DESCR
/end CHARACTERISTIC
/begin CHARACTERISTIC EGSys_facHCCnvOxiCat1_CUR "Kennlinie für HC-Umwandlungsrate [-]" CURVE 0x1D3EC6 Kl_Xs16_Ws16 2.000000 Fact 0.00 2.000000 FORMAT "%8.6" EXTENDED_LIMITS -4.000000 3.999878
 /begin AXIS_DESCR STD_AXIS EGSys_tEGPreOxiCat Temp_Cels 8 -3549.940 3003.560 FORMAT "%8.3" DEPOSIT ABSOLUTE /end AXIS_DESCR
/end CHARACTERISTIC
/begin CHARACTERISTIC EGSys_facHCCnvOxiCat2_CUR "Kennlinie für HC-Umwandlungsrate [-]" CURVE 0x1D3EE8 Kl_Xs16_Ws16 2.000000 Fact 0.00 2.000000 FORMAT "%8.6" EXTENDED_LIMITS -4.000000 3.999878
 /begin AXIS_DESCR STD_AXIS EGSys_tEGPreOxiCat Temp_Cels 8 -3549.940 3003.560 FORMAT "%8.3" DEPOSIT ABSOLUTE /end AXIS_DESCR
/end CHARACTERISTIC
/begin CHARACTERISTIC EGSys_facHCPoI1Gvnr_MAP "Kennfeld für HC Mengenkorrektur vom PoI1 Temperaturregler" MAP 0x1D302A Kf_Xs16_Ys16_Ws16 1.000000 Fact 0.00 1.000000 FORMAT "%8.6" EXTENDED_LIMITS -4.000000 3.999878
 /begin AXIS_DESCR STD_AXIS InjCtl_qSetUnBal InjMass 12 0.00 327.6700 FORMAT "%8.4" EXTENDED_LIMITS -327.6800 327.6700 DEPOSIT ABSOLUTE /end AXIS_DESCR
 /begin AXIS_DESCR STD_AXIS InjCrv_phiPoI1Des AngleCrS 12 -60.00000 49.99219 FORMAT "%8.5" EXTENDED_LIMITS -768.0000 767.9766 DEPOSIT ABSOLUTE /end AXIS_DESCR
/end CHARACTERISTIC
/begin CHARACTERISTIC EGSys_facHCPoI2Gvnr_MAP "Kennfeld für HC Mengenkorrektur vom PoI1 Temperaturregler" MAP 0x1D317E Kf_Xs16_Ys16_Ws16 1.000000 Fact 0.00 1.000000 FORMAT "%8.6" EXTENDED_LIMITS -4.000000 3.999878
 /begin AXIS_DESCR STD_AXIS InjCtl_qSetUnBal InjMass 12 0.00 327.6700 FORMAT "%8.4" EXTENDED_LIMITS -327.6800 327.6700 DEPOSIT ABSOLUTE /end AXIS_DESCR
 /begin AXIS_DESCR STD_AXIS InjCrv_phiPoI2Des AngleCrS 12 -60.00000 49.99219 FORMAT "%8.5" EXTENDED_LIMITS -768.0000 767.9766 DEPOSIT ABSOLUTE /end AXIS_DESCR
/end CHARACTERISTIC
/begin CHARACTERISTIC EGSys_facIAT_CUR "Kennlinie zur ansauglufttemperaturabhängigen Korrektur der Abgastemperatur" CURVE 0x1D3982 Kl_Xs16_Ws16 2.000000 Fact 0.00 2.000000 FORMAT "%8.6" EXTENDED_LIMITS -4.000000 3.999878
 /begin AXIS_DESCR STD_AXIS EGSys_tDiffIAT_mp TempDiff_Kelv 8 -3276.800 3276.700 FORMAT "%8.3" DEPOSIT ABSOLUTE /end AXIS_DESCR
/end CHARACTERISTIC
/begin CHARACTERISTIC EGSys_facPlsLSUSrvTst_C "Faktor für Abnahme der Wärmeschwelle bei gültigem Gasstoß im Servicetest-Modus" VAL_BLK 0x1D2A82 Kwb_Ws16 1.000000 Fact 0.00 1.000000 FORMAT "%8.6" EXTENDED_LIMITS -4.000000 3.999878 NUMBER 1 /end CHARACTERISTIC
/begin CHARACTERISTIC EGSys_facPlsLSU_C "Faktor für Abnahme der Wärmeschwelle bei gültigem Gasstoß" VAL_BLK 0x1D2A84 Kwb_Ws16 1.000000 Fact 0.00 1.000000 FORMAT "%8.6" EXTENDED_LIMITS -4.000000 3.999878 NUMBER 1 /end CHARACTERISTIC
/begin CHARACTERISTIC EGSys_facPlsThresLSU_C "minimaler Wärmemengenschwellwert zur Aktivierung der Gasstoß-Erkennung" VAL_BLK 0x1D2A86 Kwb_Ws16 1.000000 Fact 0.00 1.000000 FORMAT "%8.6" EXTENDED_LIMITS -4.000000 3.999878 NUMBER 1 /end CHARACTERISTIC
/begin CHARACTERISTIC EGSys_facStrtDlv_CUR "Kennlinie zur Förderbeginnabhängigen Temperaturkorrektur" CURVE 0x1D39A4 Kl_Xs16_Ws16 2.000000 Fact 0.00 2.000000 FORMAT "%8.6" EXTENDED_LIMITS -4.000000 3.999878
 /begin AXIS_DESCR STD_AXIS EGSys_phiDiffStrt_mp AngleCrS 8 -49.99219 49.99219 FORMAT "%8.5" EXTENDED_LIMITS -768.0000 767.9766 DEPOSIT ABSOLUTE /end AXIS_DESCR
/end CHARACTERISTIC
/begin CHARACTERISTIC EGSys_facTempClg_CUR "Abkühlkennlinie abgasführende Bauteile" CURVE 0x1D3FF4 Kl_Xs16_Ws16 2.000000 Fact 0.00 2.000000 FORMAT "%8.6" EXTENDED_LIMITS -4.000000 3.999878
 /begin AXIS_DESCR STD_AXIS EGSys_rTimeOxiCat_mp Fact1 8 0.00 8.000000 FORMAT "%8.6" EXTENDED_LIMITS -256.0000 255.9922 DEPOSIT ABSOLUTE /end AXIS_DESCR
/end CHARACTERISTIC
/begin CHARACTERISTIC EGSys_facTempCmb_CUR "Temperaturabhängiger Faktor zur Korrektur der im Oxidationskatalysator abreagierenden Kraftstoffmasse" CURVE 0x1D3F0A Kl_Xs16_Ws16 2.000000 Fact 0.00 2.000000 FORMAT "%8.6" EXTENDED_LIMITS -4.000000 3.999878
 /begin AXIS_DESCR STD_AXIS EGSys_tAvrgOxiCat_mp Temp_Cels 8 -3549.940 3003.560 FORMAT "%8.3" DEPOSIT ABSOLUTE /end AXIS_DESCR
/end CHARACTERISTIC
/begin CHARACTERISTIC EGSys_facThresNoSftyFac_C "Parameter zur Herabsetzung des Faktors der Sicherheitsbedatung für den Wärmemengenschwellwert im Servicetest-Modus" VALUE 0x1D2A88 Kw_Ws16 1.000000 Fact 0.00 1.000000 FORMAT "%8.6" EXTENDED_LIMITS -4.000000 3.999878 /end CHARACTERISTIC
/begin CHARACTERISTIC EGSys_facTimeClg_CUR "inverse Abkühlkennlinie Motor" CURVE 0x1D4016 Kl_Xs16_Ws16 255.0000 Fact1 0.00 255.0000 FORMAT "%8.4" EXTENDED_LIMITS -256.0000 255.9922
 /begin AXIS_DESCR STD_AXIS EGSys_rTempClnt_mp Fact 8 0.00 3.900024 FORMAT "%8.6" EXTENDED_LIMITS -4.000000 3.999878 DEPOSIT ABSOLUTE /end AXIS_DESCR
/end CHARACTERISTIC
/begin CHARACTERISTIC EGSys_lDiamTube_C "Durchmesser Abgasrohr" VAL_BLK 0x1D41F4 Kwb_Ws16 99.99219 Length1 0.007812500 100.0000 FORMAT "%8.4" EXTENDED_LIMITS -256.0000 255.9922 NUMBER 4 /end CHARACTERISTIC
/begin CHARACTERISTIC EGSys_lLngthTube_C "Länge Abgasrohr" VAL_BLK 0x1D41FC Kwb_Ws16 99.99219 Length1 0.007812500 100.0000 FORMAT "%8.4" EXTENDED_LIMITS -256.0000 255.9922 NUMBER 4 /end CHARACTERISTIC
/begin CHARACTERISTIC EGSys_tiPT1NSC_C "Feste thermische Zeitkonstante zur NSC-Modellierung" VALUE 0x1D3BBC Kw_Wu32 4294.9663 TimeDelay_s 0.0010000001 4294.9673 FORMAT "%9.4" EXTENDED_LIMITS 0.0000010000000 4294.9673 /end CHARACTERISTIC
/begin CHARACTERISTIC EGSys_nTrbnMax_MAP "Mögliche Antriebsdrehzahl der Turbine" MAP 0x1D2D88 Kf_Xs16_Ys16_Ws16 250000.0 TurboN 0.00 250000.0 FORMAT "%8.1" EXTENDED_LIMITS -327680.0 327670.0
 /begin AXIS_DESCR STD_AXIS EGSys_dmExhGas_mp AirMassPerTime 10 0.00 1000.000 FORMAT "%8.3" EXTENDED_LIMITS -3276.800 3276.700 DEPOSIT ABSOLUTE /end AXIS_DESCR
 /begin AXIS_DESCR STD_AXIS PCR_rBPACD Prc 10 -100.0000 200.0000 FORMAT "%8.4" EXTENDED_LIMITS -327.6800 327.6700 DEPOSIT ABSOLUTE /end AXIS_DESCR
/end CHARACTERISTIC
/begin CHARACTERISTIC EGSys_numECU_C "Anzahl der Steuergeräte" VALUE 0x1D32D2 Kw_Wu8 254.0 OneToOne 1.000 255.0 FORMAT "%5.1" EXTENDED_LIMITS 0.00 255.0 /end CHARACTERISTIC
/begin CHARACTERISTIC EGSys_numMaxCldStrt_C "Maximale Anzahl der zu zählenden Kaltstarts" VAL_BLK 0x1D2A8A Kwb_Wu8 10.00 OneToOne 0.00 10.00 FORMAT "%5.2" EXTENDED_LIMITS 0.00 255.0 NUMBER 1 /end CHARACTERISTIC
/begin CHARACTERISTIC EGSys_numOxiCatMod_C "Schalter für die Auswahl des Modelles für den Wärmeaustausch mit der Umgebung" VALUE 0x1D3F2C Kw_Wu8 1.000 OneToOne 0.00 1.000 FORMAT "%5.3" EXTENDED_LIMITS 0.00 255.0 /end CHARACTERISTIC
/begin CHARACTERISTIC EGSys_numPlsSrvTst_C "Anzahl der gültigen Gasstösse zum Verdampfen des Kondensats am Sondeneinbauort im Servicetest-Modus" VAL_BLK 0x1D2A8B Kwb_Wu8 255.0 OneToOne 0.00 255.0 FORMAT "%5.1" NUMBER 1 /end CHARACTERISTIC
/begin CHARACTERISTIC EGSys_numRdPosLSU2_C "Leseindex im Temperaturarray für Abgastemperatur(en) am Sensoreinbauort (im Fehlerfall)" VAL_BLK 0x1D32D3 Kwb_Wu8 23.00 OneToOne 0.00 23.00 FORMAT "%5.2" EXTENDED_LIMITS 0.00 255.0 NUMBER 1 /end CHARACTERISTIC
/begin CHARACTERISTIC EGSys_numRdPosLSUWall_C "Leseindex der Rohrwandtemperatur im Temperaturarray" VAL_BLK 0x1D32D4 Kwb_Wu8 23.00 OneToOne 0.00 23.00 FORMAT "%5.2" EXTENDED_LIMITS 0.00 255.0 NUMBER 1 /end CHARACTERISTIC
/begin CHARACTERISTIC EGSys_numRdPosLSU_C "Leseindex im Temperaturarray für Abgastemperatur(en) am Sensoreinbauort" VAL_BLK 0x1D32D5 Kwb_Wu8 23.00 OneToOne 0.00 23.00 FORMAT "%5.2" EXTENDED_LIMITS 0.00 255.0 NUMBER 1 /end CHARACTERISTIC
/begin CHARACTERISTIC EGSys_numRdPosMon_C "Lesen von von Adresse in der Temperaturreihe für temparatures in Sensor-Montagepositionen" VAL_BLK 0x1D32D6 Kwb_Wu8 23.00 OneToOne 0.00 23.00 FORMAT "%5.2" EXTENDED_LIMITS 0.00 255.0 NUMBER 3 /end CHARACTERISTIC
/begin CHARACTERISTIC EGSys_numRdPosNSC2_C "Leseindex im Temperaturarray für NSC Einlaßtemperatur (im Fehlerfall)" VAL_BLK 0x1D32D9 Kwb_Wu8 23.00 OneToOne 0.00 23.00 FORMAT "%5.2" EXTENDED_LIMITS 0.00 255.0 NUMBER 1 /end CHARACTERISTIC
/begin CHARACTERISTIC EGSys_numRdPosNSC_C "Leseindex im Temperaturarray für NSC Einlaßtemperatur" VAL_BLK 0x1D32DA Kwb_Wu8 23.00 OneToOne 0.00 23.00 FORMAT "%5.2" EXTENDED_LIMITS 0.00 255.0 NUMBER 1 /end CHARACTERISTIC
/begin CHARACTERISTIC EGSys_numRdPosOxiCat2_C "Leseindex im Temperaturarray für Oxydations-Katalysator-Einlaßtemperatur (im Fehlerfall)" VALUE 0x1D32DB Kw_Wu8 23.00 OneToOne 0.00 23.00 FORMAT "%5.2" EXTENDED_LIMITS 0.00 255.0 /end CHARACTERISTIC
/begin CHARACTERISTIC EGSys_numRdPosOxiCatBrik2_C "Leseindex im Temperaturarray für Oxydations-Katalysator-Einlaßtemperatur (im Fehlerfall) (Brickmodell)" VAL_BLK 0x1D32DC Kwb_Wu8 23.00 OneToOne 0.00 23.00 FORMAT "%5.2" EXTENDED_LIMITS 0.00 255.0 NUMBER 2 /end CHARACTERISTIC
/begin CHARACTERISTIC EGSys_numRdPosOxiCatBrik_C "Leseindex im Temperaturarray für Oxydations-Katalysator-Einlaßtemperatur (Brick Modell)" VAL_BLK 0x1D32DE Kwb_Wu8 23.00 OneToOne 0.00 23.00 FORMAT "%5.2" EXTENDED_LIMITS 0.00 255.0 NUMBER 2 /end CHARACTERISTIC
/begin CHARACTERISTIC EGSys_numRdPosOxiCat_C "Leseindex im Temperaturarray für Oxydations-Katalysator-Einlaßtemperatur" VALUE 0x1D32E0 Kw_Wu8 23.00 OneToOne 0.00 23.00 FORMAT "%5.2" EXTENDED_LIMITS 0.00 255.0 /end CHARACTERISTIC
/begin CHARACTERISTIC EGSys_numRdPosTrbn2_C "Leseindex im Temperaturarray für Turbineneinlaßtemperatur (im Fehlerfall)" VAL_BLK 0x1D32E1 Kwb_Wu8 23.00 OneToOne 0.00 23.00 FORMAT "%5.2" EXTENDED_LIMITS 0.00 255.0 NUMBER 2 /end CHARACTERISTIC
/begin CHARACTERISTIC EGSys_numRdPosTrbn_C "Leseindex im Temperaturarray für Turbineneinlaßtemperatur" VAL_BLK 0x1D32E3 Kwb_Wu8 23.00 OneToOne 0.00 23.00 FORMAT "%5.2" EXTENDED_LIMITS 0.00 255.0 NUMBER 2 /end CHARACTERISTIC
/begin CHARACTERISTIC EGSys_numRdPosTube2_C "Leseindex im Temperaturarray für Rohr-Einlaßtemperaturen (im Fehlerfall)" VAL_BLK 0x1D32E5 Kwb_Wu8 23.00 OneToOne 0.00 23.00 FORMAT "%5.2" EXTENDED_LIMITS 0.00 255.0 NUMBER 4 /end CHARACTERISTIC
/begin CHARACTERISTIC EGSys_numRdPosTube_C "Leseindex im Temperaturarray für Rohr-Einlaßtemperaturen" VAL_BLK 0x1D32E9 Kwb_Wu8 23.00 OneToOne 0.00 23.00 FORMAT "%5.2" EXTENDED_LIMITS 0.00 255.0 NUMBER 4 /end CHARACTERISTIC
/begin CHARACTERISTIC EGSys_numTempCldStrt_C "Temperatur Array für Kaltstart" VALUE 0x1D32ED Kw_Wu8 4.00000000000 EngTempFldSel 0.00 4.00000000000 FORMAT "%13.11" /end CHARACTERISTIC
/begin CHARACTERISTIC EGSys_numTempEngDewDet_C "Index zur Auswahl der Motortemperatur aus dem Temperaturfeld Eng_tFld" VALUE 0x1D2A8C Kw_Wu8 4.00000000000 EngTempFldSel 0.00 4.00000000000 FORMAT "%13.11" /end CHARACTERISTIC
/begin CHARACTERISTIC EGSys_numTempEng_C "Index zur Auswahl der Motortemperatur aus dem Temperaturfeld Eng_tFld" VALUE 0x1D3894 Kw_Wu8 4.00000000000 EngTempFldSel 0.00 4.00000000000 FORMAT "%13.11" /end CHARACTERISTIC
/begin CHARACTERISTIC EGSys_NuTubeEnv_CUR "Nusselt-Zahl Abgasrohr-Aussenumströmung (nicht applizierbar)" CURVE 0x1D4204 Kl_Xs16_Ws16 5309.000 OneToOne 0.00 5309.000 FORMAT "%8.3" EXTENDED_LIMITS -32768.00 32767.00 READ_ONLY
 /begin AXIS_DESCR STD_AXIS EGSys_ReTubeEnvInpCrv_mp OneToOne 8 0.00 3750.000 FORMAT "%8.3" EXTENDED_LIMITS -32768.00 32767.00 DEPOSIT ABSOLUTE /end AXIS_DESCR
/end CHARACTERISTIC
/begin CHARACTERISTIC EGSys_NuTube_CUR "Nusselt-Zahl für Abgasrohrdurchströmung (nicht applizierbar)" CURVE 0x1D4226 Kl_Xs16_Ws16 1130.000 OneToOne 0.00 1130.000 FORMAT "%8.3" EXTENDED_LIMITS -32768.00 32767.00 READ_ONLY
 /begin AXIS_DESCR STD_AXIS EGSys_ReTubeInpCrv_mp ReynoldsNum 8 0.00 800000.0 FORMAT "%8.1" EXTENDED_LIMITS -3276800. 3276700. DEPOSIT ABSOLUTE /end AXIS_DESCR
/end CHARACTERISTIC
/begin CHARACTERISTIC EGSys_tiPT1OxiCat_C "Feste thermische Zeitkonstante zur Oxidationskatalysator-Modellierung" VALUE 0x1D3F30 Kw_Wu32 4294.9663 TimeDelay_s 0.0010000001 4294.9673 FORMAT "%9.4" EXTENDED_LIMITS 0.0000010000000 4294.9673 /end CHARACTERISTIC
/begin CHARACTERISTIC EGSys_pExhGas_MAP "Kennfeld für Abgasgegendruck" MAP 0x1D2B9E Kf_Xs16_Ys16_Ws16 3500.000 Pres_hPa 0.00 3500.000 FORMAT "%8.3" EXTENDED_LIMITS -32768.00 32767.00
 /begin AXIS_DESCR STD_AXIS AFSCD_dmAirPerTime AirMassPerTime 10 0.00 1000.000 FORMAT "%8.3" EXTENDED_LIMITS -3276.800 3276.700 DEPOSIT ABSOLUTE /end AXIS_DESCR
 /begin AXIS_DESCR STD_AXIS InjCtl_qSetUnBal InjMass 10 0.00 327.6700 FORMAT "%8.4" EXTENDED_LIMITS -327.6800 327.6700 DEPOSIT ABSOLUTE /end AXIS_DESCR
/end CHARACTERISTIC
/begin CHARACTERISTIC EGSys_phiStrtDlv_MAP "Kennfeld zur Ermittlung Förderbeginn MI1 im Auslegungspunkt (zur Temperaturkorrektur)" MAP 0x1D39C6 Kf_Xs16_Ys16_Ws16 99.98437 AngleCrS -49.99219 49.99219 FORMAT "%8.5" EXTENDED_LIMITS -768.0000 767.9766
 /begin AXIS_DESCR STD_AXIS Eng_nAvrg EngN 8 0.00 8000.000 FORMAT "%8.3" EXTENDED_LIMITS -32768.00 32767.00 DEPOSIT ABSOLUTE /end AXIS_DESCR
 /begin AXIS_DESCR STD_AXIS InjCtl_qCurr InjMass 8 0.00 100.0000 FORMAT "%8.4" EXTENDED_LIMITS -327.6800 327.6700 DEPOSIT ABSOLUTE /end AXIS_DESCR
/end CHARACTERISTIC
/begin CHARACTERISTIC EGSys_tiChrgMOD1PT1_C "Zeitkonstante der Abgastemperatur nach Turbo PT1 Filter" VALUE 0x1D41B4 Kw_Wu32 4294.9663 TimeDelay_s 0.0010000001 4294.9673 FORMAT "%9.4" EXTENDED_LIMITS 0.0000010000000 4294.9673 /end CHARACTERISTIC
/begin CHARACTERISTIC EGSys_tiChrgMOD2PT1_C "Zeitkonstante der Abgastemperatur nach Turbo PT1 Filter" VALUE 0x1D41B8 Kw_Wu32 4294.9663 TimeDelay_s 0.0010000001 4294.9673 FORMAT "%9.4" EXTENDED_LIMITS 0.0000010000000 4294.9673 /end CHARACTERISTIC
/begin CHARACTERISTIC EGSys_pValDfl_C "Vorgabewert Umgebungsdruck für Turboladermodell" VALUE 0x1D41BC Kw_Ws16 1000.000 Pres_hPa 500.0000 1500.000 FORMAT "%8.3" EXTENDED_LIMITS -32768.00 32767.00 /end CHARACTERISTIC
/begin CHARACTERISTIC EGSys_qHCNrm_MAP "Kennfeld für HC Masse im Normalbetrieb" MAP 0x1D32EE Kf_Xs16_Ys16_Ws16 20.00000 InjMass 0.00 20.00000 FORMAT "%8.5" EXTENDED_LIMITS -327.6800 327.6700
 /begin AXIS_DESCR STD_AXIS Eng_nAvrg EngN 12 0.00 6000.000 FORMAT "%8.3" EXTENDED_LIMITS -32768.00 32767.00 DEPOSIT ABSOLUTE /end AXIS_DESCR
 /begin AXIS_DESCR STD_AXIS InjCtl_qSetUnBal InjMass 12 0.00 327.6700 FORMAT "%8.4" EXTENDED_LIMITS -327.6800 327.6700 DEPOSIT ABSOLUTE /end AXIS_DESCR
/end CHARACTERISTIC
/begin CHARACTERISTIC EGSys_qHCOxiCatMon_MAP "Kennfeld für HC Masse bei OxiCat Überwachung" MAP 0x1D3442 Kf_Xs16_Ys16_Ws16 20.00000 InjMass 0.00 20.00000 FORMAT "%8.5" EXTENDED_LIMITS -327.6800 327.6700
 /begin AXIS_DESCR STD_AXIS Eng_nAvrg EngN 12 0.00 6000.000 FORMAT "%8.3" EXTENDED_LIMITS -32768.00 32767.00 DEPOSIT ABSOLUTE /end AXIS_DESCR
 /begin AXIS_DESCR STD_AXIS InjCtl_qSetUnBal InjMass 12 0.00 327.6700 FORMAT "%8.4" EXTENDED_LIMITS -327.6800 327.6700 DEPOSIT ABSOLUTE /end AXIS_DESCR
/end CHARACTERISTIC
/begin CHARACTERISTIC EGSys_qHCRgn1_MAP "Kennfeld für HC Menge im ersten Regenerationsmodus, wenn PiI2 inaktiv ist" MAP 0x1D3596 Kf_Xs16_Ys16_Ws16 20.00000 InjMass 0.00 20.00000 FORMAT "%8.5" EXTENDED_LIMITS -327.6800 327.6700
 /begin AXIS_DESCR STD_AXIS Eng_nAvrg EngN 12 0.00 6000.000 FORMAT "%8.3" EXTENDED_LIMITS -32768.00 32767.00 DEPOSIT ABSOLUTE /end AXIS_DESCR
 /begin AXIS_DESCR STD_AXIS InjCtl_qSetUnBal InjMass 12 0.00 327.6700 FORMAT "%8.4" EXTENDED_LIMITS -327.6800 327.6700 DEPOSIT ABSOLUTE /end AXIS_DESCR
/end CHARACTERISTIC
/begin CHARACTERISTIC EGSys_qHCRgn2_MAP "Kennfeld für HC Masse im zweiten Regenerationsmodus, wenn PiI2 inaktiv ist" MAP 0x1D36EA Kf_Xs16_Ys16_Ws16 20.00000 InjMass 0.00 20.00000 FORMAT "%8.5" EXTENDED_LIMITS -327.6800 327.6700
 /begin AXIS_DESCR STD_AXIS Eng_nAvrg EngN 12 0.00 6000.000 FORMAT "%8.3" EXTENDED_LIMITS -32768.00 32767.00 DEPOSIT ABSOLUTE /end AXIS_DESCR
 /begin AXIS_DESCR STD_AXIS InjCtl_qSetUnBal InjMass 12 0.00 327.6700 FORMAT "%8.4" EXTENDED_LIMITS -327.6800 327.6700 DEPOSIT ABSOLUTE /end AXIS_DESCR
/end CHARACTERISTIC
/begin CHARACTERISTIC EGSys_rPres_MAP "Abgasgegendruckverhältnis vor und nach Turbine" MAP 0x1D2E7C Kf_Xs16_Ys16_Ws16 3.900024 Fact 0.00 3.900024 FORMAT "%8.6" EXTENDED_LIMITS -4.000000 3.999878
 /begin AXIS_DESCR STD_AXIS PCR_nTrbn TurboN 10 0.00 250000.0 FORMAT "%8.1" EXTENDED_LIMITS -327680.0 327670.0 DEPOSIT ABSOLUTE /end AXIS_DESCR
 /begin AXIS_DESCR STD_AXIS EGSys_nTrbnMax_mp TurboN 10 0.00 250000.0 FORMAT "%8.1" EXTENDED_LIMITS -327680.0 327670.0 DEPOSIT ABSOLUTE /end AXIS_DESCR
/end CHARACTERISTIC
/begin CHARACTERISTIC EGSys_rSqTube_C "Anteil der vom Fahrtwind beaufschlagten Oberfläche Abgasrohr" VAL_BLK 0x1D4248 Kwb_Ws16 3.800049 Fact 0.09997559 3.900024 FORMAT "%8.6" EXTENDED_LIMITS -4.000000 3.999878 NUMBER 4 /end CHARACTERISTIC
/begin CHARACTERISTIC EGSys_rTempAdbt_CUR "Kennlinie für die adiabatische Zustandänderung der Temperatur (nicht applizierbar)" CURVE 0x1D41BE Kl_Xs16_Ws16 0.4000244 Fact 1.000000 1.400024 FORMAT "%8.6" EXTENDED_LIMITS -4.000000 3.999878 READ_ONLY
 /begin AXIS_DESCR STD_AXIS EGSys_rPresCmpr_mp Fact 8 1.000000 8.000000 FORMAT "%8.6" EXTENDED_LIMITS -4.000000 3.999878 DEPOSIT ABSOLUTE /end AXIS_DESCR
/end CHARACTERISTIC
/begin CHARACTERISTIC EGSys_sqOxiCat_C "OxiCat-Oberflächenbereich" VALUE 0x1D3F34 Kw_Ws16 6.553500 Area_Low -3.276800 3.276700 FORMAT "%8.6" /end CHARACTERISTIC
/begin CHARACTERISTIC EGSys_stMsgDiaLSU_C "16-Bit Code zur Umschaltung auf den zweiten Applikationsparametersatz im Servicetest-Modus" VALUE 0x1D2B9C Kw_Wu16 65535.00 OneToOne 0.00 65535.00 FORMAT "%8.2" /end CHARACTERISTIC
/begin CHARACTERISTIC EGSys_stMskOxiCatMon_C "Bitmaske für HC Masse bei OxiCat Überwachung" VALUE 0x1D3840 Kw_Wu32 2147483647.00 OneToOne 0.00 2147483647.00 FORMAT "%13.2" EXTENDED_LIMITS 0.00 4294967295.00 /end CHARACTERISTIC
/begin CHARACTERISTIC EGSys_stMskRgn1_C "Bitmaske für HC Masse bei ersten Regenerationsmodus" VALUE 0x1D3844 Kw_Wu32 2147483647.00 OneToOne 0.00 2147483647.00 FORMAT "%13.2" EXTENDED_LIMITS 0.00 4294967295.00 /end CHARACTERISTIC
/begin CHARACTERISTIC EGSys_stMskRgn2_C "Bitmaske für HC Masse im zweiten Regenerationsmodus" VALUE 0x1D3848 Kw_Wu32 2147483647.00 OneToOne 0.00 2147483647.00 FORMAT "%13.2" EXTENDED_LIMITS 0.00 4294967295.00 /end CHARACTERISTIC
/begin CHARACTERISTIC EGSys_swtDewDetShOff_C "Umschalter für Ersatzfunktion (Zeitapplikation) (1: Ersatzfunktion, 0: Taupunkterkennung)" VAL_BLK 0x1D2A8D Kwb_Wu8 10.00 OneToOne 0.00 10.00 FORMAT "%5.2" EXTENDED_LIMITS 0.00 255.0 NUMBER 1 /end CHARACTERISTIC
/begin CHARACTERISTIC EGSys_swtHCCtlOxiCatActv_C "Schalter zum Aktivieren für HCI bei OxiCat" VALUE 0x1D384C Kw_Wu8 1.000 OneToOne 0.00 1.000 FORMAT "%5.3" EXTENDED_LIMITS 0.00 255.0 /end CHARACTERISTIC
/begin CHARACTERISTIC EGSys_swtPresSel_C "Auswahl, ob Atmosphaerendruck (=1) oder Druck vor Partikelfilter (=0)" VALUE 0x1D2C92 Kw_Wu8 1.000 OneToOne 0.00 1.000 FORMAT "%5.3" EXTENDED_LIMITS 0.00 255.0 /end CHARACTERISTIC
/begin CHARACTERISTIC EGSys_swtPstPFltActv_C "Auswahl ob PFlt Drucksimulation verwendet wird" VALUE 0x1D2C93 Kw_Wu8 1.000 OneToOne 0.00 1.000 FORMAT "%5.3" EXTENDED_LIMITS 0.00 255.0 /end CHARACTERISTIC
/begin CHARACTERISTIC EGSys_swtTAirSens_C "Umschalter für Umgebungstemperatursensor (1: Ladelufttemperatursensor, 0: Umgebungslufttemperatursensor)" VALUE 0x1D3895 Kw_Wu8 1.000 OneToOne 0.00 1.000 FORMAT "%5.3" EXTENDED_LIMITS 0.00 255.0 /end CHARACTERISTIC
/begin CHARACTERISTIC EGSys_swtTimeNSC_C "Schalter zur Verwendung fester oder variabler thermischer Zeitkonstante für NSC (1 = fest, 0 = variabel)" VALUE 0x1D3BC0 Kw_Wu8 1.000 OneToOne 0.00 1.000 FORMAT "%5.3" EXTENDED_LIMITS 0.00 255.0 /end CHARACTERISTIC
/begin CHARACTERISTIC EGSys_swtTimeOxiCat_C "Schalter zur Verwendung fester oder variabler thermischer Zeitkonstante für Oxidationskatalysator (1 = fest, 0 = variabel)" VALUE 0x1D3F36 Kw_Wu8 1.000 OneToOne 0.00 1.000 FORMAT "%5.3" EXTENDED_LIMITS 0.00 255.0 /end CHARACTERISTIC
/begin CHARACTERISTIC EGSys_swtTrbModSel_C "Schalter für turbolader modell [-]" VALUE 0x1D3896 Kw_Wu8 1.000 OneToOne 0.00 1.000 FORMAT "%5.3" EXTENDED_LIMITS 0.00 255.0 /end CHARACTERISTIC
/begin CHARACTERISTIC EGSys_swtUI_C "Schalter für Einspritzsystem (UI=1, CR=0)" VALUE 0x1D384D Kw_Wu8 1.000 OneToOne 0.00 1.000 FORMAT "%5.3" EXTENDED_LIMITS 0.00 255.0 /end CHARACTERISTIC
/begin CHARACTERISTIC EGSys_tEGPstTrbnDfl_C "Ersatzwert Turbinentemperatur im Fehlerfall" VAL_BLK 0x1D41E0 Kwb_Ws16 1095.000 Temp_Cels -45.04000 1049.960 FORMAT "%8.3" EXTENDED_LIMITS -3549.940 3003.560 NUMBER 2 /end CHARACTERISTIC
/begin CHARACTERISTIC EGSys_tEGTubeDfl_C "Ersatzwert Abgastemperatur im Abgasrohr" VAL_BLK 0x1D4250 Kwb_Ws16 1095.000 Temp_Cels -45.04000 1049.960 FORMAT "%8.3" EXTENDED_LIMITS -3549.940 3003.560 NUMBER 4 /end CHARACTERISTIC
/begin CHARACTERISTIC EGSys_tEngStat_C "Kühlmitteltemperatur (bzw Motortemperatur) betriebswarmer Motor unter normalen Bendingungen" VALUE 0x1D3A6A Kw_Ws16 1095.000 Temp_Cels -45.04000 1049.960 FORMAT "%8.3" EXTENDED_LIMITS -3549.940 3003.560 /end CHARACTERISTIC
/begin CHARACTERISTIC EGSys_tExcClntDfl_C "Ersatzwert für Motor-Übertemperatur" VALUE 0x1D3898 Kw_Ws16 1095.000 TempDiff_Kelv -45.00000 1050.000 FORMAT "%8.3" EXTENDED_LIMITS -3276.800 3276.700 /end CHARACTERISTIC
/begin CHARACTERISTIC EGSys_tIAT_MAP "Kennfeld Ansauglufttemperatur im Auslegungspunkt zur Korrektur der stationären Krümmeraustrittstemperatur" MAP 0x1D3A6C Kf_Xs16_Ys16_Ws16 3048.600 Temp_Cels -45.04000 3003.560 FORMAT "%8.3" EXTENDED_LIMITS -3549.940 3003.560
 /begin AXIS_DESCR STD_AXIS Eng_nAvrg EngN 8 0.00 8000.000 FORMAT "%8.3" EXTENDED_LIMITS -32768.00 32767.00 DEPOSIT ABSOLUTE /end AXIS_DESCR
 /begin AXIS_DESCR STD_AXIS InjCtl_qCurr InjMass 8 0.00 100.0000 FORMAT "%8.4" EXTENDED_LIMITS -327.6800 327.6700 DEPOSIT ABSOLUTE /end AXIS_DESCR
/end CHARACTERISTIC
/begin CHARACTERISTIC EGSys_tiDebLSU0_C "Entprellzeit Heizungsfreigabe Lambdasonde 0" VAL_BLK 0x1D2A8E Kwb_Wu16 20.00000 Time_s 0.00 20.00000 FORMAT "%8.5" EXTENDED_LIMITS 0.00 655.3500 NUMBER 1 /end CHARACTERISTIC
/begin CHARACTERISTIC EGSys_tiDebNrmTransOk_C "Entprellzeit zur Verzögerung der Berechnungen nach Start bis gültige Temperaturen anliegen" VALUE 0x1D2A90 Kw_Ws16 1000.000 TimeDeb 0.00 1000.000 FORMAT "%8.3" EXTENDED_LIMITS -327680.0 327670.0 /end CHARACTERISTIC
/begin CHARACTERISTIC EGSys_tiHaValClnt_C "Abkühl-Halbwertszeit Motor" VALUE 0x1D4038 Kw_Wu32 42949672.9500 Time_s 0.00 42949672.9500 FORMAT "%13.4" /end CHARACTERISTIC
/begin CHARACTERISTIC EGSys_tiHaValNSC_C "Abkühl-Halbwertszeit NSC" VALUE 0x1D403C Kw_Wu32 42949672.9500 Time_s 0.00 42949672.9500 FORMAT "%13.4" /end CHARACTERISTIC
/begin CHARACTERISTIC EGSys_tiHaValOxiCatBrik_C "Halbwertszeit Abkühlung OxiCat brik Modell" VAL_BLK 0x1D4040 Kwb_Wu32 42949672.9500 Time_s 0.00 42949672.9500 FORMAT "%13.4" NUMBER 2 /end CHARACTERISTIC
/begin CHARACTERISTIC EGSys_tiHaValOxiCat_C "Abkühl-Halbwertszeit Oxidationskatalysator" VALUE 0x1D4048 Kw_Wu32 42949672.9500 Time_s 0.00 42949672.9500 FORMAT "%13.4" /end CHARACTERISTIC
/begin CHARACTERISTIC EGSys_tiHaValTrb_C "Abkühlen der Halbzeit-Periode turbocharge" VAL_BLK 0x1D404C Kwb_Wu32 42949672.9500 Time_s 0.00 42949672.9500 FORMAT "%13.4" NUMBER 2 /end CHARACTERISTIC
/begin CHARACTERISTIC EGSys_tiHaValTube_C "Abkühl-Halbwertszeit Abgasrohr" VAL_BLK 0x1D4054 Kwb_Wu32 42949672.9500 Time_s 0.00 42949672.9500 FORMAT "%13.4" NUMBER 4 /end CHARACTERISTIC
/begin CHARACTERISTIC EGSys_tiHtgDelLSU_C "Verzögerung der Heizungsfreigabe im Fehlerfall" VAL_BLK 0x1D2A94 Kwb_Wu32 42949672.9500 Time_s 0.00 42949672.9500 FORMAT "%13.4" NUMBER 1 /end CHARACTERISTIC
/begin CHARACTERISTIC EGSys_tIntegIniSrvTst_C "Temperaturschwellwert für die Aktivierung des Wärmemengenintegrators im Servicetest-Modus" VAL_BLK 0x1D2A98 Kwb_Ws16 100.0000 Temp_Cels -0.04000000 99.96000 FORMAT "%8.4" EXTENDED_LIMITS -3549.940 3003.560 NUMBER 1 /end CHARACTERISTIC
/begin CHARACTERISTIC EGSys_tIntegIni_C "Temperaturschwellwert für die Aktivierung des Wärmemengenintegrators" VAL_BLK 0x1D2A9A Kwb_Ws16 100.0000 Temp_Cels -0.04000000 99.96000 FORMAT "%8.4" EXTENDED_LIMITS -3549.940 3003.560 NUMBER 1 /end CHARACTERISTIC
/begin CHARACTERISTIC EGSys_tiOfsClg_C "Abkühlzeitkorrektur Motor wg. Stauwärmeeffekten" VALUE 0x1D4064 Kw_Wu32 42949672.9500 Time_s 0.00 42949672.9500 FORMAT "%13.4" /end CHARACTERISTIC
/begin CHARACTERISTIC EGSys_tiPlsLSUSrvTst_C "Minimale Dauer für gültigen Gaspuls im Servicetest-Modus" VAL_BLK 0x1D2A9C Kwb_Wu16 20.00000 Time_s 0.00 20.00000 FORMAT "%8.5" EXTENDED_LIMITS 0.00 655.3500 NUMBER 1 /end CHARACTERISTIC
/begin CHARACTERISTIC EGSys_tiPlsLSU_C "Minimale Dauer für gültigen Gaspuls" VAL_BLK 0x1D2A9E Kwb_Wu16 20.00000 Time_s 0.00 20.00000 FORMAT "%8.5" EXTENDED_LIMITS 0.00 655.3500 NUMBER 1 /end CHARACTERISTIC
/begin CHARACTERISTIC EGSys_tManfDfl_C "Vorgabewert Abgaskrümmertemperatur im Fehlerfall" VALUE 0x1D3B10 Kw_Ws16 1095.000 Temp_Cels -45.04000 1049.960 FORMAT "%8.3" EXTENDED_LIMITS -3549.940 3003.560 /end CHARACTERISTIC
/begin CHARACTERISTIC EGSys_tManfStat_MAP "Kennfeld zur Ermittlung der stationären Abgaskrümmertemperatur" MAP 0x1D3B12 Kf_Xs16_Ys16_Ws16 3048.600 Temp_Cels -45.04000 3003.560 FORMAT "%8.3" EXTENDED_LIMITS -3549.940 3003.560
 /begin AXIS_DESCR STD_AXIS Eng_nAvrg EngN 8 0.00 8000.000 FORMAT "%8.3" EXTENDED_LIMITS -32768.00 32767.00 DEPOSIT ABSOLUTE /end AXIS_DESCR
 /begin AXIS_DESCR STD_AXIS EGSys_qMIStd InjMassCyc 8 0.00 100.0000 FORMAT "%8.4" EXTENDED_LIMITS -327.6800 327.6700 DEPOSIT ABSOLUTE /end AXIS_DESCR
/end CHARACTERISTIC
/begin CHARACTERISTIC EGSys_tNSCDfl_C "Ersatzwert für NSC Temperatur" VALUE 0x1D3BC2 Kw_Ws16 1095.000 Temp_Cels -45.04000 1049.960 FORMAT "%8.3" EXTENDED_LIMITS -3549.940 3003.560 /end CHARACTERISTIC
/begin CHARACTERISTIC EGSys_tNSCExoIncr_MAP "Kennfeld für Temperaturerhöhung im NSC aufgrund chemischer Reaktionen" MAP 0x1D3BC4 Kf_Xs16_Ys16_Ws16 1095.000 TempDiff_Kelv -45.00000 1050.000 FORMAT "%8.3" EXTENDED_LIMITS -3276.800 3276.700
 /begin AXIS_DESCR STD_AXIS EGSys_tAvrgNSC_mp Temp_Cels 8 -3549.940 3003.560 FORMAT "%8.3" DEPOSIT ABSOLUTE /end AXIS_DESCR
 /begin AXIS_DESCR STD_AXIS EGSys_rLmbdAprx lambda 8 -30.00000 30.00000 FORMAT "%8.5" EXTENDED_LIMITS -32.76800 32.76700 DEPOSIT ABSOLUTE /end AXIS_DESCR
/end CHARACTERISTIC
/begin CHARACTERISTIC EGSys_tOxiCatDfl_C "Ersatzwert Oxidationskatalysatortemperatur" VALUE 0x1D3F38 Kw_Ws16 1095.000 Temp_Cels -45.04000 1049.960 FORMAT "%8.3" EXTENDED_LIMITS -3549.940 3003.560 /end CHARACTERISTIC
/begin CHARACTERISTIC EGSys_tOxiCatExoIncr_MAP "Kennfeld für Tempertaturerhöhung im Oxidationskatalysator aufgrund chemischer Reaktionen" MAP 0x1D3F3A Kf_Xs16_Ys16_Ws16 1095.000 TempDiff_Kelv -45.00000 1050.000 FORMAT "%8.3" EXTENDED_LIMITS -3276.800 3276.700
 /begin AXIS_DESCR STD_AXIS EGSys_tAvrgOxiCat_mp Temp_Cels 8 -3549.940 3003.560 FORMAT "%8.3" DEPOSIT ABSOLUTE /end AXIS_DESCR
 /begin AXIS_DESCR STD_AXIS EGSys_rLmbdAprx lambda 8 -30.00000 30.00000 FORMAT "%8.5" EXTENDED_LIMITS -32.76800 32.76700 DEPOSIT ABSOLUTE /end AXIS_DESCR
/end CHARACTERISTIC
/begin CHARACTERISTIC EGSys_tOxiCatHCModDfl_C "Ersatzwert für OxiKat Temperatur" VALUE 0x1D3FDE Kw_Ws16 1095.000 Temp_Cels -45.04000 1049.960 FORMAT "%8.3" EXTENDED_LIMITS -3549.940 3003.560 /end CHARACTERISTIC
/begin CHARACTERISTIC EGSys_tOxiCatHCModOutDfl_C "Ersatzwert für die OxiCat-Temperatur (K)" VALUE 0x1D3FE0 Kw_Ws16 1095.000 Temp_Cels -45.04000 1049.960 FORMAT "%8.3" EXTENDED_LIMITS -3549.940 3003.560 /end CHARACTERISTIC
/begin CHARACTERISTIC EGSys_tOxiCatHCModSurfDfl_C "Ersatzwert für die OxiCat-Temperatur (Oberflächentemperatur) (K)" VALUE 0x1D3FE2 Kw_Ws16 1095.000 Temp_Cels -45.04000 1049.960 FORMAT "%8.3" EXTENDED_LIMITS -3549.940 3003.560 /end CHARACTERISTIC
/begin CHARACTERISTIC EGSys_tOxiCatIKi_C "Verstärkungsfaktor für den OxiCat Integrator [-]" VALUE 0x1D3FE4 Kw_Wu32 4.00003045797 Ki_Kelv_Sec 0.00 4.00003045797 FORMAT "%13.11" EXTENDED_LIMITS 0.00 9999999.99767 /end CHARACTERISTIC
/begin CHARACTERISTIC EGSys_tOxiCatIKiPos_C "Integratorverstärkung jenseits der positiven Fensterbegrenzung [-]" VALUE 0x1D3FE8 Kw_Wu32 4.00003045797 Ki_Kelv_Sec 0.00 4.00003045797 FORMAT "%13.11" EXTENDED_LIMITS 0.00 9999999.99767 /end CHARACTERISTIC
/begin CHARACTERISTIC EGSys_tOxiCatIKiNeg_C "Integratorverstärkung jenseits der negativen Fensterbegrenzung [-]" VALUE 0x1D3FEC Kw_Wu32 4.00003045797 Ki_Kelv_Sec 0.00 4.00003045797 FORMAT "%13.11" EXTENDED_LIMITS 0.00 9999999.99767 /end CHARACTERISTIC
/begin CHARACTERISTIC EGSys_tOxiCatIWinPos_C "Obere Kleinsignalgrenze für den OxiCat Integrator [-]" VALUE 0x1D3FF0 Kw_Ws16 65535.00 OneToOne -32768.00 32767.00 FORMAT "%8.2" READ_ONLY /end CHARACTERISTIC
/begin CHARACTERISTIC EGSys_tOxiCatIWinNeg_C "Untere Kleinsignalgrenze für den OxiCat Integrator [-]" VALUE 0x1D3FF2 Kw_Ws16 65535.00 OneToOne -32768.00 32767.00 FORMAT "%8.2" READ_ONLY /end CHARACTERISTIC
/begin CHARACTERISTIC EGSys_tStrtCsRepl_C "Ersatzwert für Initialisierungstemperaturen der abgasführen den Bauteile im Fehlerfall" VALUE 0x1D4068 Kw_Ws16 1095.000 Temp_Cels -45.04000 1049.960 FORMAT "%8.3" EXTENDED_LIMITS -3549.940 3003.560 /end CHARACTERISTIC
/begin CHARACTERISTIC EGSys_tThresCldStrt_C "Temperaturschwelle für Kaltstart" VALUE 0x1D384E Kw_Ws16 1095.000 Temp_Cels -45.04000 1049.960 FORMAT "%8.3" EXTENDED_LIMITS -3549.940 3003.560 /end CHARACTERISTIC
/begin CHARACTERISTIC EGSys_tThresLSUActSrvTst_C "Temperaturschwellwert für reversible TPE im Servicetest-Modus" VAL_BLK 0x1D2AA0 Kwb_Ws16 100.0000 Temp_Cels -0.04000000 99.96000 FORMAT "%8.4" EXTENDED_LIMITS -3549.940 3003.560 NUMBER 1 /end CHARACTERISTIC
/begin CHARACTERISTIC EGSys_tThresLSUAct_C "Temperaturschwellwert für reversible TPE" VAL_BLK 0x1D2AA2 Kwb_Ws16 100.0000 Temp_Cels -0.04000000 99.96000 FORMAT "%8.4" EXTENDED_LIMITS -3549.940 3003.560 NUMBER 1 /end CHARACTERISTIC
/begin CHARACTERISTIC EGSys_tTubeDfl_C "Ersatzwert Abgasrohr-Temperatur" VAL_BLK 0x1D4258 Kwb_Ws16 1095.000 Temp_Cels -45.04000 1049.960 FORMAT "%8.3" EXTENDED_LIMITS -3549.940 3003.560 NUMBER 4 /end CHARACTERISTIC
/begin CHARACTERISTIC EGSys_tTubeIKi_C "I-Verstärkung Integrator zur Abgasrohr-Temperaturmodellierung" VALUE 0x1D4260 Kw_Wu32 4.00003045797 Ki_Kelv_Sec 0.00 4.00003045797 FORMAT "%13.11" EXTENDED_LIMITS 0.00 9999999.99767 /end CHARACTERISTIC
/begin CHARACTERISTIC EGSys_tTubeIKiPos_C "I-Verstärkung Integrator Abgasrohr-Temperaturmodellierung für pos. Großsignalbereich" VALUE 0x1D4264 Kw_Wu32 4.00003045797 Ki_Kelv_Sec 0.00 4.00003045797 FORMAT "%13.11" EXTENDED_LIMITS 0.00 9999999.99767 /end CHARACTERISTIC
/begin CHARACTERISTIC EGSys_tTubeIKiNeg_C "I-Verstärkung Integrator Abgasrohr-Temperaturmodellierung für neg. Großsignalbereich" VALUE 0x1D4268 Kw_Wu32 4.00003045797 Ki_Kelv_Sec 0.00 4.00003045797 FORMAT "%13.11" EXTENDED_LIMITS 0.00 9999999.99767 /end CHARACTERISTIC
/begin CHARACTERISTIC EGSys_tTubeIWinPos_C "Obere Kleinstwertgrenze Integrator zur Abgasrohr-Temperaturmodellierung" VALUE 0x1D426C Kw_Ws16 65535.00 OneToOne -32768.00 32767.00 FORMAT "%8.2" READ_ONLY /end CHARACTERISTIC
/begin CHARACTERISTIC EGSys_tTubeIWinNeg_C "Untere Kleinstwertgrenze Integrator zur Abgasrohr-Temperaturmodellierung" VALUE 0x1D426E Kw_Ws16 65535.00 OneToOne -32768.00 32767.00 FORMAT "%8.2" READ_ONLY /end CHARACTERISTIC
/begin CHARACTERISTIC EGSys_tWtEquiv_C "äquivalente Wassertemperatur beim Verdampfen" VAL_BLK 0x1D2AA4 Kwb_Ws16 1095.000 Temp_Cels -45.04000 1049.960 FORMAT "%8.3" EXTENDED_LIMITS -3549.940 3003.560 NUMBER 1 /end CHARACTERISTIC
/begin CHARACTERISTIC EGSys_vscDynEG_CUR "Dynamische Viskosität Abgas (nicht applizierbar)" CURVE 0x1D3850 Kl_Xs16_Ws16 0.9998779 Fact 0.0001220703 1.000000 FORMAT "%8.6" EXTENDED_LIMITS -4.000000 3.999878 READ_ONLY
 /begin AXIS_DESCR STD_AXIS EGSys_tEGInpCrv_mp Temp_Cels 8 -45.04000 1049.960 FORMAT "%8.3" EXTENDED_LIMITS -3549.940 3003.560 DEPOSIT ABSOLUTE /end AXIS_DESCR
/end CHARACTERISTIC
/begin CHARACTERISTIC EGSys_vscKinEG_CUR "Kinematische Viskosität Abgas (nicht applizierbar)" CURVE 0x1D3872 Kl_Xs16_Ws16 0.9998779 Fact 0.0001220703 1.000000 FORMAT "%8.6" EXTENDED_LIMITS -4.000000 3.999878 READ_ONLY
 /begin AXIS_DESCR STD_AXIS EGSys_tEGInpCrv_mp Temp_Cels 8 -45.04000 1049.960 FORMAT "%8.3" EXTENDED_LIMITS -3549.940 3003.560 DEPOSIT ABSOLUTE /end AXIS_DESCR
/end CHARACTERISTIC
/begin CHARACTERISTIC EGSys_wLSUIKi_C "Verstärkung des Integrators" VAL_BLK 0x1D2AA6 Kwb_Ws16 5.000000 OneToOne 0.00 5.000000 FORMAT "%8.6" EXTENDED_LIMITS -32768.00 32767.00 NUMBER 1 /end CHARACTERISTIC
/begin CHARACTERISTIC EGSys_wThresLSU0_MAP "Wärmeschwellen Grundkennfeld Lambdasonde 0" MAP 0x1D2AA8 Kf_Xs16_Ys16_Ws16 6000.000 Energy 0.00 6000.000 FORMAT "%8.3" EXTENDED_LIMITS -32768.00 32767.00
 /begin AXIS_DESCR STD_AXIS EGSys_tEGLSUInpCrv0_mp Temp_Cels 10 -45.04000 1049.960 FORMAT "%8.3" EXTENDED_LIMITS -3549.940 3003.560 DEPOSIT ABSOLUTE /end AXIS_DESCR
 /begin AXIS_DESCR STD_AXIS EGSys_tEngDewDet_mp Temp_Cels 10 -45.04000 1049.960 FORMAT "%8.3" EXTENDED_LIMITS -3549.940 3003.560 DEPOSIT ABSOLUTE /end AXIS_DESCR
/end CHARACTERISTIC
/begin CHARACTERISTIC EGT_stTSync_Vector "Konfigurationslabel für Bypass" VALUE 0x1C0A82 Kw_Wu8 255.0 OneToOne 0.00 255.0 FORMAT "%5.1" /end CHARACTERISTIC
/begin CHARACTERISTIC EGT_stTSync_Channel "Konfigurationslabels für Bypass" VALUE 0x1C0A83 Kw_Wu8 255.0 OneToOne 0.00 255.0 FORMAT "%5.1" /end CHARACTERISTIC
/begin CHARACTERISTIC EGT_swtEGTActv_C "Schalter- Wert, um die EGT- Funktionen ein- oder auszuschalten" VALUE 0x1D4274 Kw_Wu8 1.000 OneToOne 0.00 1.000 FORMAT "%5.3" EXTENDED_LIMITS 0.00 255.0 /end CHARACTERISTIC
/begin CHARACTERISTIC EGT_tiRmpSlpMax_C "Maximale Rampenlaufzeit für EGT-Mehrfachschalter" VALUE 0x1D4278 Kw_Wu32 15.0000000000 Time_s 0.00 15.0000000000 FORMAT "%13.10" EXTENDED_LIMITS 0.00 42949672.9500 /end CHARACTERISTIC
/begin CHARACTERISTIC EGT_tiRmpSlp_C "Rampensteigungswert zur Auswertung des zentralen EGT-Rampenwertes" VALUE 0x1D4270 Kw_Wu32 31.775030303030302 TimeEGTRmp 0.99296969696969695 32.768000000000001 FORMAT "%19.16" EXTENDED_LIMITS 0.000000015258789066052715 65.536000000000001 /end CHARACTERISTIC
/begin CHARACTERISTIC EMCCD_ctM1PwrStgOnMax_C "maximale Anzahl von Endstufen-Einschaltungen pro Fahrzyklus bei SCB oder Übertemperatur" VALUE 0x1D427C Kw_Wu16 65535.00 OneToOne 0.00 65535.00 FORMAT "%8.2" /end CHARACTERISTIC
/begin CHARACTERISTIC EMCCD_DebExcTempDef_C "Zeit bis defekt für EXC_TEMP Fehler" VALUE 0x1D427E Kw_Wu16 655350.0 Time_ms 0.00 655350.0 FORMAT "%8.1" /end CHARACTERISTIC
/begin CHARACTERISTIC EMCCD_DebExcTempOk_C "Heilungszeit für EXC_TEMP Fehler" VALUE 0x1D4280 Kw_Wu16 655350.0 Time_ms 0.00 655350.0 FORMAT "%8.1" /end CHARACTERISTIC
/begin CHARACTERISTIC EMCCD_DebNoLoadDef_C "Zeit bis defekt für NO_LOAD Fehler" VALUE 0x1D4282 Kw_Wu16 655350.0 Time_ms 0.00 655350.0 FORMAT "%8.1" /end CHARACTERISTIC
/begin CHARACTERISTIC EMCCD_DebNoLoadOk_C "Heilungszeit für NO_LOAD Fehler" VALUE 0x1D4284 Kw_Wu16 655350.0 Time_ms 0.00 655350.0 FORMAT "%8.1" /end CHARACTERISTIC
/begin CHARACTERISTIC EMCCD_DebShortCircBatDef_C "Zeit bis defekt für SHORTCIRC_BAT Fehler" VALUE 0x1D4286 Kw_Wu16 655350.0 Time_ms 0.00 655350.0 FORMAT "%8.1" /end CHARACTERISTIC
/begin CHARACTERISTIC EMCCD_DebShortCircBatOk_C "Heilungszeit für SHORTCIRC_BAT Fehler" VALUE 0x1D4288 Kw_Wu16 655350.0 Time_ms 0.00 655350.0 FORMAT "%8.1" /end CHARACTERISTIC
/begin CHARACTERISTIC EMCCD_DebShortCircGndDef_C "Zeit bis defekt für SHORTCIRC_GND Fehler" VALUE 0x1D428A Kw_Wu16 655350.0 Time_ms 0.00 655350.0 FORMAT "%8.1" /end CHARACTERISTIC
/begin CHARACTERISTIC EMCCD_DebShortCircGndOk_C "Heilungszeit für SHORTCIRC_GND Fehler" VALUE 0x1D428C Kw_Wu16 655350.0 Time_ms 0.00 655350.0 FORMAT "%8.1" /end CHARACTERISTIC
/begin CHARACTERISTIC EMCCD_stEngMntCtl_Init_C "Initialisierungswert für den Status der Motorlagersteuerung Ausgang 1" VALUE 0x1D428E Kw_Wu8 15.00 OneToOne 0.00 15.00 FORMAT "%5.2" EXTENDED_LIMITS 0.00 255.0 /end CHARACTERISTIC
/begin CHARACTERISTIC EMCCD_stM1SPICtl_C "Parameter zur Anzeige der verwendeten Endstufenart ( 1 = SPI kontrollierbare Endstufe, 0 = nicht SPI-Endstufe )" VALUE 0x1D428F Kw_Wu8 1.000 OneToOne 0.00 1.000 FORMAT "%5.3" EXTENDED_LIMITS 0.00 255.0 /end CHARACTERISTIC
/begin CHARACTERISTIC EMCCD_swtEnOut_C "Aggregatelager Endstufen deaktivieren" VALUE 0x1D4290 Kw_Wu8 15.00 OneToOne 0.00 15.00 FORMAT "%5.2" EXTENDED_LIMITS 0.00 255.0 /end CHARACTERISTIC
/begin CHARACTERISTIC EMCCD_swtInvOut_C "Invertierter Ausgang der Aggregatelagersteuerung" VALUE 0x1D4291 Kw_Wu8 15.00 OneToOne 0.00 15.00 FORMAT "%5.2" EXTENDED_LIMITS 0.00 255.0 /end CHARACTERISTIC
/begin CHARACTERISTIC EMCCD_tiM1BtwTst_C "Zeitabstand, in dem im Fehlerfall die Endstufe getestet wird" VALUE 0x1D4292 Kw_Wu16 29900.00 Time_ms 100.0000 30000.00 FORMAT "%8.2" EXTENDED_LIMITS 0.00 655350.0 /end CHARACTERISTIC
/begin CHARACTERISTIC EMCCD_tiM1PwrStgOn_C "Zeit für welche die Endstufe im Fehlerfall eingeschalten wird (nur nicht SPI kontrolliert)" VALUE 0x1D4294 Kw_Wu16 500.0000 Time_ms 0.00 500.0000 FORMAT "%8.4" EXTENDED_LIMITS 0.00 655350.0 /end CHARACTERISTIC
/begin CHARACTERISTIC EngMon_DebIrrCmbStepUp_C "Aufwärtsschrittweite für Entprellung des Fehlers irreguläre Verbrennung" VALUE 0x1D45A0 Kw_Wu8 3.000 OneToOne 0.00 3.000 FORMAT "%5.3" EXTENDED_LIMITS 0.00 255.0 /end CHARACTERISTIC
/begin CHARACTERISTIC EngMon_DebIrrCmbStepDown_C "Abwärtsschrittweite für Entprellung des Fehlers irreguläre Verbrennung" VALUE 0x1D45A1 Kw_Wu8 3.000 OneToOne 0.00 3.000 FORMAT "%5.3" EXTENDED_LIMITS 0.00 255.0 /end CHARACTERISTIC
/begin CHARACTERISTIC EngMon_DebIrrCmbDef_C "Grenze Fehlerentprellung für Fehler irreguläre Verbrennung" VALUE 0x1D45A2 Kw_Wu16 65535.00 OneToOne 0.00 65535.00 FORMAT "%8.2" /end CHARACTERISTIC
/begin CHARACTERISTIC EngMon_DebIrrCmbOk_C "Grenze Heilungsentprellung für Fehler irreguläre Verbrennung" VALUE 0x1D45A4 Kw_Wu16 65535.00 OneToOne 0.00 65535.00 FORMAT "%8.2" /end CHARACTERISTIC
/begin CHARACTERISTIC EngMon_nMonActv_C "Mindestdrehzahl für Aktivierung der Überwachung auf irreguläre Verbrennung" VALUE 0x1D45A6 Kw_Wu16 65535.00 EngN 0.00 65535.00 FORMAT "%8.2" /end CHARACTERISTIC
/begin CHARACTERISTIC EngMon_rO2MaxVal_C "Sauerstoffendwert der Schwellwertberechnung" VALUE 0x1D45A8 Kw_Ws16 0.6553500 O2 -0.3276800 0.3276700 FORMAT "%9.7" /end CHARACTERISTIC
/begin CHARACTERISTIC EngMon_stActv_C "Schalter der Funktion Verbrennungserkennung (1=aktiv, 0= nicht aktiv)" VALUE 0x1D45AA Kw_Wu8 1.000 OneToOne 0.00 1.000 FORMAT "%5.3" EXTENDED_LIMITS 0.00 255.0 /end CHARACTERISTIC
/begin CHARACTERISTIC EngMon_tiFltPT1_C "Filterzeitkonstante für Schwellwertberechnung" VALUE 0x1D45AC Kw_Wu32 4294.9673 TimeDelay_s 0.0000010000000 4294.9673 FORMAT "%9.4" /end CHARACTERISTIC
/begin CHARACTERISTIC EngMon_tiDel_C "Totzeit nach Schubbeginn für Aktivierung des Schwellwertfilters" VALUE 0x1D45B0 Kw_Wu16 655.3500 Time_s 0.00 655.3500 FORMAT "%8.4" /end CHARACTERISTIC
/begin CHARACTERISTIC EngMon_tiMonActv_C "Totzeit nach Schubbeginn für Aktivierung der Überwachung auf irreguläre Verbrennung" VALUE 0x1D45B2 Kw_Wu16 655.3500 Time_s 0.00 655.3500 FORMAT "%8.4" /end CHARACTERISTIC
/begin CHARACTERISTIC EngM_ctBackUpMaxCh_C "Maximal zugelassene Anzahl an Wechseln zwischen Not- und Normalbetrieb" VALUE 0x1D439C Kw_Wu8 255.0 OneToOne 0.00 255.0 FORMAT "%5.1" /end CHARACTERISTIC
/begin CHARACTERISTIC EngM_ctOfsCaSCrS_C "Anzahl von Interrupts mit CaS/CrS Verdrehung (> EngM_phiDelta_C) im WAIT_PHASE State bis Verdreherkennung" VALUE 0x1C1FF8 Kw_Wu8 255.0 OneToOne 0.00 255.0 FORMAT "%5.1" /end CHARACTERISTIC
/begin CHARACTERISTIC EngM_ctPhWhlRev_C "Anzahl von Phasenradumdrehungen bis zum Abbruch der Plausibilitätsprüfung" VALUE 0x1C1FF9 Kw_Wu8 255.0 OneToOne 0.00 255.0 FORMAT "%5.1" /end CHARACTERISTIC
/begin CHARACTERISTIC EngM_ctPostSync_C "Anzahl statischer Interrupts bis zum Verlassen des Zustands POST" VALUE 0x1C1FFA Kw_Wu8 255.0 OneToOne 0.00 255.0 FORMAT "%5.1" /end CHARACTERISTIC
/begin CHARACTERISTIC EngM_ctReSync_C "Max. Anzahl von Versuchen das System umzusynchronisieren" VALUE 0x1C1FFB Kw_Wu8 255.0 OneToOne 0.00 255.0 FORMAT "%5.1" /end CHARACTERISTIC
/begin CHARACTERISTIC EngM_ctSpdtoZero_C "Anzahl Timeoutinterrupts bis Motordrehzahl  = Null" VALUE 0x1D4380 Kw_Wu16 65535.00 OneToOne 0.00 65535.00 FORMAT "%8.2" /end CHARACTERISTIC
/begin CHARACTERISTIC EngM_ctVerSync_C "Anzahl der MAIN, PILOT, UPDATE, SEGMENT  Interrupts zur Plausibilisierung der Nockenwelle mit der Kurbelwelle" VALUE 0x1C1FFC Kw_Wu8 255.0 OneToOne 0.00 255.0 FORMAT "%5.1" /end CHARACTERISTIC
/begin CHARACTERISTIC EngM_dDivFacTmr_C "Bei jedem Heilungszyklus wird der Timerwert EngM_tiBackUpTmr_mp durch diesen Faktor geteilt" VALUE 0x1D439D Kw_Wu8 9.000 Fact2 1.000 10.00 FORMAT "%5.2" EXTENDED_LIMITS 0.00 15.94 /end CHARACTERISTIC
/begin CHARACTERISTIC EngM_DebIncCaSErrSigDef_C "Inkrementdefektentprellung  für Nockenwellen-Signalstörung" VALUE 0x1D4382 Kw_Wu16 65535.00 OneToOne 0.00 65535.00 FORMAT "%8.2" /end CHARACTERISTIC
/begin CHARACTERISTIC EngM_DebIncCaSErrSigOK_C "Inkrementheilungsentprellung bis NW-Position gueltig" VALUE 0x1D4384 Kw_Wu16 65535.00 OneToOne 0.00 65535.00 FORMAT "%8.2" /end CHARACTERISTIC
/begin CHARACTERISTIC EngM_DebIncCaSNoSigDef_C "Inkrementdefektentprellung für Nockenwellen-Signalausfall" VALUE 0x1D4386 Kw_Wu16 65535.00 OneToOne 0.00 65535.00 FORMAT "%8.2" /end CHARACTERISTIC
/begin CHARACTERISTIC EngM_DebIncCrSErrSigDef_C "Inkrementdefektentprellung für gestörtes Kurbelwellen-Signal" VALUE 0x1D4388 Kw_Wu16 65535.00 OneToOne 0.00 65535.00 FORMAT "%8.2" /end CHARACTERISTIC
/begin CHARACTERISTIC EngM_DebIncCrSErrSigOK_C "Inkrementheilungsprellung für gestörtes Kurbelwellen-Signal" VALUE 0x1D438A Kw_Wu16 65535.00 OneToOne 0.00 65535.00 FORMAT "%8.2" /end CHARACTERISTIC
/begin CHARACTERISTIC EngM_DebIncOfsSigCaSCrSDef_C "Inkremententprellung zur Unterdrückung doppelter Fehlereinträge von Signal Störung / Verdrehung" VALUE 0x1D438C Kw_Wu16 65535.00 OneToOne 0.00 65535.00 FORMAT "%8.2" /end CHARACTERISTIC
/begin CHARACTERISTIC EngM_DebPhCrSErrSigDef_C "Entprellung des Kurbelwellensignalausfalls über die Anzahl von Nockenwellenzaehnen" VALUE 0x1D438E Kw_Wu16 65535.00 OneToOne 0.00 65535.00 FORMAT "%8.2" /end CHARACTERISTIC
/begin CHARACTERISTIC EngM_DebPhRevCaSDrvDef_C "Entprellschwelle in Nockenwellenumdrehungen bis Nockenwellenstörerkennung im Fahrbetrieb erkannt" VALUE 0x1D4396 Kw_Wu16 65535.00 OneToOne 0.00 65535.00 FORMAT "%8.2" /end CHARACTERISTIC
/begin CHARACTERISTIC EngM_DebPhRevCaSDrvOk_C "Entprellschwelle in Nockenwellenumdrehungen bis Nockenwellenstörerkennung im Fahrbetrieb geheilt" VALUE 0x1D4398 Kw_Wu16 65535.00 OneToOne 0.00 65535.00 FORMAT "%8.2" /end CHARACTERISTIC
/begin CHARACTERISTIC EngM_dLimitCond_ASD_CA "Abschrankbedingung fuer die ASD-Task" VAL_BLK 0x1D434E Kwb_Wu8 255.0 OneToOne 0.00 255.0 FORMAT "%5.1" NUMBER 3 /end CHARACTERISTIC
/begin CHARACTERISTIC EngM_dLimitCond_Common_CA "Abschrankbedingung fuer die Common-Task" VAL_BLK 0x1D4351 Kwb_Wu8 255.0 OneToOne 0.00 255.0 FORMAT "%5.1" NUMBER 3 /end CHARACTERISTIC
/begin CHARACTERISTIC EngM_dLimitCond_FBC_CA "Abschrankbedingung fuer die FBC-Task" VAL_BLK 0x1D4354 Kwb_Wu8 255.0 OneToOne 0.00 255.0 FORMAT "%5.1" NUMBER 3 /end CHARACTERISTIC
/begin CHARACTERISTIC EngM_dLimitCond_Joint_CA "Abschrankbedingung fuer die Joint-Task" VAL_BLK 0x1D4357 Kwb_Wu8 255.0 OneToOne 0.00 255.0 FORMAT "%5.1" NUMBER 3 /end CHARACTERISTIC
/begin CHARACTERISTIC EngM_dLimitCond_LiGov_CA "Abschrankbedingung fuer die LiGov-Task" VAL_BLK 0x1D435A Kwb_Wu8 255.0 OneToOne 0.00 255.0 FORMAT "%5.1" NUMBER 3 /end CHARACTERISTIC
/begin CHARACTERISTIC EngM_dLimitCond_Pilot_CA "Abschrankbedingung fuer die Pilot-Task" VAL_BLK 0x1D435D Kwb_Wu8 255.0 OneToOne 0.00 255.0 FORMAT "%5.1" NUMBER 3 /end CHARACTERISTIC
/begin CHARACTERISTIC EngM_dMulFacTmr_C "Bei jedem Heilungszyklus wird der Timerwert EngM_tiBackUpTmr_mp mit diesem Faktor multipiziert" VALUE 0x1D439E Kw_Wu8 9.000 Fact2 1.000 10.00 FORMAT "%5.2" EXTENDED_LIMITS 0.00 15.94 /end CHARACTERISTIC
/begin CHARACTERISTIC EngM_facCaSOfsCor_C "Temperaturkorrektur-Koeffizient des Nockenwellen-Verdrehwinkels" VALUE 0x1D43C4 Kw_Ws16 0.1007080 AngleCrSPerTemp -0.1007080 0.00 FORMAT "%9.7" EXTENDED_LIMITS -30.00000 29.99908 /end CHARACTERISTIC
/begin CHARACTERISTIC EngM_facMaxSim2Real_C "Faktor um die maximale Differenz zwischen den realen - und den simulierten Inkrementen zu berechnen" VALUE 0x1D439F Kw_Ws8 1.000 Fact1 0.00 1.000 FORMAT "%5.3" EXTENDED_LIMITS -1.000 0.9922 /end CHARACTERISTIC
/begin CHARACTERISTIC EngM_facMinSim2Real_C "Faktor um die minimale Differenz zwischen den realen - und den simulierten Inkrementen zu berechnen" VALUE 0x1D43A0 Kw_Ws8 1.000 Fact1 0.00 1.000 FORMAT "%5.3" EXTENDED_LIMITS -1.000 0.9922 /end CHARACTERISTIC
/begin CHARACTERISTIC EngM_nCaSOfsMax_C "maximale Drehzahl für Lernfunktion des Nockenwellen-Verdrehwinkels" VALUE 0x1D43C6 Kw_Ws16 5960.000 EngN 40.00000 6000.000 FORMAT "%8.3" EXTENDED_LIMITS -32768.00 32767.00 /end CHARACTERISTIC
/begin CHARACTERISTIC EngM_nCaSOfsMin_C "minimale Drehzahl für Lernfunktion des Nockenwellen-Verdrehwinkels" VALUE 0x1D43C8 Kw_Ws16 5960.000 EngN 40.00000 6000.000 FORMAT "%8.3" EXTENDED_LIMITS -32768.00 32767.00 /end CHARACTERISTIC
/begin CHARACTERISTIC EngM_nLimitInj_C "Drehzahlschwelle zur Abschrankung der Mengen- und Ansteuerbeginnberechnung" VALUE 0x1D4360 Kw_Wu16 6000.000 EngN 0.00 6000.000 FORMAT "%8.3" EXTENDED_LIMITS 0.00 65535.00 /end CHARACTERISTIC
/begin CHARACTERISTIC EngM_nLimitThreshHyst_CA "Hysteresebreite der Abschrankdrehzahl" VAL_BLK 0x1D4362 Kwb_Wu16 600.0000 EngN 0.00 600.0000 FORMAT "%8.4" EXTENDED_LIMITS 0.00 65535.00 NUMBER 3 /end CHARACTERISTIC
/begin CHARACTERISTIC EngM_nLimitThresh_CA "Drehzahlschwellen zur Taskabschrankung" VAL_BLK 0x1D4368 Kwb_Wu16 6000.000 EngN 0.00 6000.000 FORMAT "%8.3" EXTENDED_LIMITS 0.00 65535.00 NUMBER 3 /end CHARACTERISTIC
/begin CHARACTERISTIC EngM_nLimitTimeout_C "Drehzahlschwelle für die Änderung des Schedulings der drehzahlsynchronen Interrupts" VAL_BLK 0x1D436E Kwb_Ws16 4000.000 EngN 2000.000 6000.000 FORMAT "%8.3" EXTENDED_LIMITS -32768.00 32767.00 NUMBER 3 /end CHARACTERISTIC
/begin CHARACTERISTIC EngM_nMaxBackUp2SyncOk_C "Bei einem zurückschalten von BackUp nach OK muß die Drehzahl kleiner sein als dieses Label" VALUE 0x1D43A2 Kw_Ws16 6000.000 EngN 0.00 6000.000 FORMAT "%8.3" EXTENDED_LIMITS -32768.00 32767.00 /end CHARACTERISTIC
/begin CHARACTERISTIC EngM_nMaxBackUp_C "Maximale Motordrehzahl im Notfahren" VALUE 0x1D43A4 Kw_Ws16 6000.000 EngN 0.00 6000.000 FORMAT "%8.3" EXTENDED_LIMITS -32768.00 32767.00 /end CHARACTERISTIC
/begin CHARACTERISTIC EngM_nMaxFrstInj_C "Maximale Drehzahlschwelle zur nachträglichen Berechnung der ersten Einspritzung im Start" VALUE 0x1C1FFE Kw_Ws16 6000.000 EngN 0.00 6000.000 FORMAT "%8.3" EXTENDED_LIMITS -32768.00 32767.00 /end CHARACTERISTIC
/begin CHARACTERISTIC EngM_nMaxStrtBackUp_C "Max. Drehzahl für Start nur mit Nockenwellensignal" VALUE 0x1D43A6 Kw_Ws16 6000.000 EngN 0.00 6000.000 FORMAT "%8.3" EXTENDED_LIMITS -32768.00 32767.00 /end CHARACTERISTIC
/begin CHARACTERISTIC EngM_nMinDiag_C "Nockenwellendiagnose ab minimale Motordrehzahl" VALUE 0x1C0D24 Kw_Ws16 480.0000 EngN 20.00000 500.0000 FORMAT "%8.4" EXTENDED_LIMITS -32768.00 32767.00 /end CHARACTERISTIC
/begin CHARACTERISTIC EngM_nPolling_C "Drehzahlschwelle für die Änderung des Abtastwinkels von 60 auf 90 ° Kurbelwelle" VALUE 0x1D4374 Kw_Ws16 6000.000 EngN 0.00 6000.000 FORMAT "%8.3" EXTENDED_LIMITS -32768.00 32767.00 /end CHARACTERISTIC
/begin CHARACTERISTIC EngM_nSwtCoMa1_C "Schwellendrehzahl für die Umschaltung der Aufrufreihenfolge von Common- und MainInj-Task im Notfahren" VALUE 0x1D4376 Kw_Ws16 6000.000 EngN 0.00 6000.000 FORMAT "%8.3" EXTENDED_LIMITS -32768.00 32767.00 /end CHARACTERISTIC
/begin CHARACTERISTIC EngM_nSwtCoMa_C "Schwellendrehzahl für die Umschaltung der Aufrufreihenfolge von Common- und MainInj-Task" VALUE 0x1D4378 Kw_Wu16 6000.000 EngN 0.00 6000.000 FORMAT "%8.3" EXTENDED_LIMITS 0.00 65535.00 /end CHARACTERISTIC
/begin CHARACTERISTIC EngM_nSwtErrSigDiagCrSOff_C "Drehzahlschwelle zum Abschalten der CrS Störerkennung" VALUE 0x1D4390 Kw_Ws16 2000.000 EngN 0.00 2000.000 FORMAT "%8.3" EXTENDED_LIMITS -32768.00 32767.00 /end CHARACTERISTIC
/begin CHARACTERISTIC EngM_nSwtErrSigDiagCrSOn_C "Drehzahlschwelle zum Einschalten der CrS Störerkennung" VALUE 0x1D4392 Kw_Ws16 2000.000 EngN 0.00 2000.000 FORMAT "%8.3" EXTENDED_LIMITS -32768.00 32767.00 /end CHARACTERISTIC
/begin CHARACTERISTIC EngM_nSyncNoInjRls_C "Drehzahlschwelle über der die Einspritzung unterdrückt wird für die Verifiaktionsphase" VALUE 0x1C2002 Kw_Ws16 6000.000 EngN 0.00 6000.000 FORMAT "%8.3" EXTENDED_LIMITS -32768.00 32767.00 /end CHARACTERISTIC
/begin CHARACTERISTIC EngM_nThresBackUpMin_C "Minimale Drehzahlschwelle für Notfahrvariante 2 um Backupmode zu aktivieren." VALUE 0x1D43A8 Kw_Ws16 6000.000 EngN 0.00 6000.000 FORMAT "%8.3" EXTENDED_LIMITS -32768.00 32767.00 /end CHARACTERISTIC
/begin CHARACTERISTIC EngM_numLimitInj_C "Berechnungshäufigkeit bei aktiver Abschrankung der Mengen- und Ansteuerbeginnberechnung" VALUE 0x1D437A Kw_Wu8 9.000 OneToOne 1.000 10.00 FORMAT "%5.2" EXTENDED_LIMITS 0.00 255.0 /end CHARACTERISTIC
/begin CHARACTERISTIC EngM_numLimitTimeout_C "Begrenzungsfaktoren für die Änderung der Aktivierreihenfolge der drehzahlsynchronen Interrupts" VAL_BLK 0x1D437B Kwb_Wu8 255.0 OneToOne 0.00 255.0 FORMAT "%5.1" NUMBER 3 /end CHARACTERISTIC
/begin CHARACTERISTIC EngM_numPin_C "Zuordnungstabelle phyikalischer Zylinder zu SG-Endstufe (SG-Pin)" VAL_BLK 0x1C0D0E Kwb_Wu8 255.0 OneToOne 0.00 255.0 FORMAT "%5.1" NUMBER 4 /end CHARACTERISTIC
/begin CHARACTERISTIC EngM_numSegTooth2SyncOk_C "Flankennummer an der das Zurückschalten erfolgen soll (Sollte 24°KW von der Lücke entfernt sein)" VALUE 0x1D43AA Kw_Wu8 11.00 OneToOne 1.000 12.00 FORMAT "%5.2" EXTENDED_LIMITS 0.00 255.0 /end CHARACTERISTIC
/begin CHARACTERISTIC EngM_nWaitIncSig_C "Inkrementdrehzahl ab der das Signal im Start ausgeblendet wird" VALUE 0x1C2004 Kw_Ws16 6000.000 EngN 0.00 6000.000 FORMAT "%8.3" EXTENDED_LIMITS -32768.00 32767.00 /end CHARACTERISTIC
/begin CHARACTERISTIC EngM_tiCaSOfs1PT1_C "Zeitkonstante für die erste PT1-Filterung des Nockenwellen-Verdrehwinkels" VALUE 0x1D43CC Kw_Wu32 99.882958 TimeDelay_s 0.0000020000000 99.882960 FORMAT "%9.5" EXTENDED_LIMITS 0.0000010000000 4294.9673 /end CHARACTERISTIC
/begin CHARACTERISTIC EngM_tiCaSOfs2PT1_C "Zeitkonstante für die zweite PT1-Filterung des Nockenwellen-Verdrehwinkels" VALUE 0x1D43D0 Kw_Wu32 99.882958 TimeDelay_s 0.0000020000000 99.882960 FORMAT "%9.5" EXTENDED_LIMITS 0.0000010000000 4294.9673 /end CHARACTERISTIC
/begin CHARACTERISTIC EngM_phiCaSOfs_CUR "Korrekturwinkel-Kennlinie des Nockenwellen-Verdrehwinkels" CURVE 0x1D43D4 Kl_Xs16_Ws16 60.00000 AngleCrS -30.00000 30.00000 FORMAT "%8.5" EXTENDED_LIMITS -768.0000 767.9766
 /begin AXIS_DESCR STD_AXIS EngM_phiCaSOfsLrn_mp AngleCrS 7 -30.00000 30.00000 FORMAT "%8.5" EXTENDED_LIMITS -768.0000 767.9766 DEPOSIT ABSOLUTE /end AXIS_DESCR
/end CHARACTERISTIC
/begin CHARACTERISTIC EngM_phiDelayPhNoSig_C "Winkelverzoegerung für die Erkennung kein Nockenwellensignal" VALUE 0x1C2006 Kw_Ws16 720.0000 AngleCrS 0.00 720.0000 FORMAT "%8.4" EXTENDED_LIMITS -768.0000 767.9766 /end CHARACTERISTIC
/begin CHARACTERISTIC EngM_phiDeltaExtSync_C "Toleranz zwischen Kurbelwelle und Nockenwelle bei freigeschalteten CAN-Synchronisation" VALUE 0x1C2008 Kw_Ws16 720.0000 AngleCrS 0.00 720.0000 FORMAT "%8.4" EXTENDED_LIMITS -768.0000 767.9766 /end CHARACTERISTIC
/begin CHARACTERISTIC EngM_phiDelta_C "Toleranz zwischen Kurbelwelle und Nockenwelle" VALUE 0x1C200A Kw_Ws16 720.0000 AngleCrS 0.00 720.0000 FORMAT "%8.4" EXTENDED_LIMITS -768.0000 767.9766 /end CHARACTERISTIC
/begin CHARACTERISTIC EngM_phiFrstInjInt_C "Position des ersten Interrupts vor OT zur Berechnung der ersten Einspritzung" VALUE 0x1C200C Kw_Ws16 0.00 AngleCrS 739.9922 739.9922 FORMAT "%8.4" EXTENDED_LIMITS -768.0000 767.9766 /end CHARACTERISTIC
/begin CHARACTERISTIC EngM_phiIntBackUp_C "Position der statischen Interrupts im BackUp-mode" VAL_BLK 0x1D43AC Kwb_Ws16 720.0000 AngleCrS 0.00 720.0000 FORMAT "%8.4" EXTENDED_LIMITS -768.0000 767.9766 NUMBER 2 /end CHARACTERISTIC
/begin CHARACTERISTIC EngM_phiIntMin_C "Minimale Interruptpositionen bezüglich OT für die erste Einspritzung." VAL_BLK 0x1C200E Kwb_Ws16 720.0000 AngleCrS 0.00 720.0000 FORMAT "%8.4" EXTENDED_LIMITS -768.0000 767.9766 NUMBER 5 /end CHARACTERISTIC
/begin CHARACTERISTIC EngM_phiInt_C "Positionen der stat. Interrupts vor jedem OT" VAL_BLK 0x1C2018 Kwb_Ws16 720.0000 AngleCrS 0.00 720.0000 FORMAT "%8.4" EXTENDED_LIMITS -768.0000 767.9766 NUMBER 5 /end CHARACTERISTIC
/begin CHARACTERISTIC EngM_phiMax_C "Max. physikalischer Winkel im System" VALUE 0x1C0D14 Kw_Ws32 360.000000000 AngleCrS 360.000000000 720.000000000 FORMAT "%13.9" EXTENDED_LIMITS -50331648.0000 50331647.9766 /end CHARACTERISTIC
/begin CHARACTERISTIC EngM_phiTDC_C "Vektor der OT-Winkel aller Zylinder" VAL_BLK 0x1C0D18 Kwb_Ws16 720.0000 AngleCrS 0.00 720.0000 FORMAT "%8.4" EXTENDED_LIMITS -768.0000 767.9766 NUMBER 4 /end CHARACTERISTIC
/begin CHARACTERISTIC EngM_qCaSOfsMax_C "maximale Einspritzmenge für Lernfunktion des Nockenwellen-Verdrehwinkels" VALUE 0x1D43F2 Kw_Ws16 327.6700 InjMass 0.00 327.6700 FORMAT "%8.4" EXTENDED_LIMITS -327.6800 327.6700 /end CHARACTERISTIC
/begin CHARACTERISTIC EngM_qCaSOfsMin_C "minimale Einspritzmenge für Lernfunktion des Nockenwellen-Verdrehwinkels" VALUE 0x1D43F4 Kw_Ws16 327.6700 InjMass 0.00 327.6700 FORMAT "%8.4" EXTENDED_LIMITS -327.6800 327.6700 /end CHARACTERISTIC
/begin CHARACTERISTIC EngM_rCrSBackUpMax_C "Das Verhältnis EngM_rCas_mp muß kleiner sein als  EngM_rCrSBackUpMax_C um vom BackUp - in Ok-mode umzuschalten" VALUE 0x1D43B0 Kw_Ws16 0.2031250 Fact1 1.000000 1.203125 FORMAT "%8.6" EXTENDED_LIMITS -256.0000 255.9922 /end CHARACTERISTIC
/begin CHARACTERISTIC EngM_rCrSBackUpMin_C "Das Verhältnis EngM_rCas_mp muß größer sein als  EngM_rCrSBackUpMin_C um vom BackUp - in Ok-mode umzuschalten" VALUE 0x1D43B2 Kw_Ws16 0.2031250 Fact1 0.7968750 1.000000 FORMAT "%8.6" EXTENDED_LIMITS -256.0000 255.9922 /end CHARACTERISTIC
/begin CHARACTERISTIC EngM_rNOnOffML_CUR "Drehzahlabhängige Lagersteuerung (Motorlager)" CURVE 0x1D43FC Kl_Xs16_Ws16 1.000000 Fact 0.00 1.000000 FORMAT "%8.6" EXTENDED_LIMITS -4.000000 3.999878
 /begin AXIS_DESCR STD_AXIS Eng_nAvrg EngN 12 40.00000 6000.000 FORMAT "%8.3" EXTENDED_LIMITS -32768.00 32767.00 DEPOSIT ABSOLUTE /end AXIS_DESCR
/end CHARACTERISTIC
/begin CHARACTERISTIC EngM_stBackUpVar_C "Variante: 0->Wechsel in BU-mode erfolgt bei einen Timeout von CrSCD  1->Wechsel erfolgt sobald Fehlerpf. CrS1 gesetzt ist" VALUE 0x1D43B4 Kw_Wu8 1.000 OneToOne 0.00 1.000 FORMAT "%5.3" EXTENDED_LIMITS 0.00 255.0 /end CHARACTERISTIC
/begin CHARACTERISTIC EngM_stEnaBackUp_C "Schalter zur Aktivierung des Betriebsmodus nur mit Nockenwellensignal" VALUE 0x1D43B5 Kw_Wu8 1.000 OneToOne 0.00 1.000 FORMAT "%5.3" EXTENDED_LIMITS 0.00 255.0 /end CHARACTERISTIC
/begin CHARACTERISTIC EngM_stStrtBackup_C "Aktivierung des Algorithmus zum Beschleunigungslernen" VALUE 0x1D43B7 Kw_Wu8 1.000 OneToOne 0.00 1.000 FORMAT "%5.3" EXTENDED_LIMITS 0.00 255.0 /end CHARACTERISTIC
/begin CHARACTERISTIC EngM_stSyncBefGap_C "Synchronisation ohne  Luecke" VALUE 0x1C2022 Kw_Wu8 1.000 OneToOne 0.00 1.000 FORMAT "%5.3" EXTENDED_LIMITS 0.00 255.0 /end CHARACTERISTIC
/begin CHARACTERISTIC EngM_swtEngMntCtlVal_C "Softwareschalter für Motorlagersteuerung" VALUE 0x1D442E Kw_Wu8 1.000 OneToOne 0.00 1.000 FORMAT "%5.3" EXTENDED_LIMITS 0.00 255.0 /end CHARACTERISTIC
/begin CHARACTERISTIC EngM_swtEngMntCtlType_C "Auswahl Wert aus Datensatz oder EEPROM für Softwareschalter Motorlagersteuerung" VALUE 0x1D442F Kw_Wu8 0.00 OneToOne 2.000 2.000 FORMAT "%5.3" EXTENDED_LIMITS 0.00 255.0 /end CHARACTERISTIC
/begin CHARACTERISTIC EngM_swtExitOfs_C "Aussprungbedingung aus dem SYNC_OFFSET State (0x00: Keyless Go, 0x01: Kl. 15 AUS/EIN, 0x10: SYNC_VERIFY_INC)" VALUE 0x1C2023 Kw_Wu8 255.0 OneToOne 0.00 255.0 FORMAT "%5.1" /end CHARACTERISTIC
/begin CHARACTERISTIC EngM_swtModeML_C "Betriebsart für Leerlauf  und Klimamoment (Motorlager)" VALUE 0x1D4430 Kw_Wu8 3.000 OneToOne 0.00 3.000 FORMAT "%5.3" EXTENDED_LIMITS 0.00 255.0 /end CHARACTERISTIC
/begin CHARACTERISTIC EngM_swtNumCylVal_C "Zylinderanzahl, bei Applikation nicht verändern" VALUE 0x1C1FF4 Kw_Wu8 9.000 OneToOne 3.000 12.00 FORMAT "%5.2" EXTENDED_LIMITS 0.00 255.0 /end CHARACTERISTIC
/begin CHARACTERISTIC EngM_swtSyncViaCAN_C "Ein-, Ausschalten 1/0 der Master-Slave Synchronisation via CAN" VALUE 0x1C2024 Kw_Wu8 1.000 OneToOne 0.00 1.000 FORMAT "%5.3" EXTENDED_LIMITS 0.00 255.0 /end CHARACTERISTIC
/begin CHARACTERISTIC EngM_swtT50CDDiag_C "0 = Diagnosezähler werden mit T50CD_stDebVal nicht geresetet  1= Diagnosezähler werden mit T50CD_stDebVal geresetet" VALUE 0x1D4394 Kw_Wu8 1.000 OneToOne 0.00 1.000 FORMAT "%5.3" EXTENDED_LIMITS 0.00 255.0 /end CHARACTERISTIC
/begin CHARACTERISTIC EngM_swtTempTrqFrc2_C "Schalter der Temperaturwert des Arrays auswählt" VALUE 0x1D443E Kw_Wu8 4.00000000000 EngTempFldSel 0.00 4.00000000000 FORMAT "%13.11" /end CHARACTERISTIC
/begin CHARACTERISTIC EngM_swtTempTrqFrc3_C "Schalter der Temperaturwert des Arrays auswählt" VALUE 0x1D443F Kw_Wu8 4.00000000000 EngTempFldSel 0.00 4.00000000000 FORMAT "%13.11" /end CHARACTERISTIC
/begin CHARACTERISTIC EngM_swtTempTrqFrc_C "Schalter der Temperaturwert des Arrays auswählt" VALUE 0x1D4440 Kw_Wu8 4.00000000000 EngTempFldSel 0.00 4.00000000000 FORMAT "%13.11" /end CHARACTERISTIC
/begin CHARACTERISTIC EngM_swtUpdTDC_C "Schalter für TDC Umschaltung / Standard: False     nur 8-Zyl. Single ECU = TRUE" VALUE 0x1C2025 Kw_Wu8 1.000 OneToOne 0.00 1.000 FORMAT "%5.3" EXTENDED_LIMITS 0.00 255.0 /end CHARACTERISTIC
/begin CHARACTERISTIC EngM_tCaSOfsBas_C "Kühlwasser-Bezugstemperatur der Temperaturkorrektur des Nockenwellen-Verdrehwinkels" VALUE 0x1D43F6 Kw_Ws16 200.0000 Temp_Cels -50.14000 149.8600 FORMAT "%8.4" EXTENDED_LIMITS -3549.940 3003.560 /end CHARACTERISTIC
/begin CHARACTERISTIC EngM_tCaSOfsMin_C "minimale Kühlwassertemperatur für Lernfunktion des Nockenwellen-Verdrehwinkels" VALUE 0x1D43F8 Kw_Ws16 200.0000 Temp_Cels -50.14000 149.8600 FORMAT "%8.4" EXTENDED_LIMITS -3549.940 3003.560 /end CHARACTERISTIC
/begin CHARACTERISTIC EngM_tiBackUpTmrMax_C "Timerwert EngM_tiBackUpTmr_mp wird auf dieses Maximum begrenzt" VALUE 0x1D43B8 Kw_Wu32 42949672950.0 Time_ms 0.00 42949672950.0 FORMAT "%13.1" /end CHARACTERISTIC
/begin CHARACTERISTIC EngM_tiBackUpTmrMin_C "Timerwert EngM_tiBackUpTmr_mp wird auf dieses Minimum begrenzt" VALUE 0x1D43BC Kw_Wu32 42949672950.0 Time_ms 0.00 42949672950.0 FORMAT "%13.1" /end CHARACTERISTIC
/begin CHARACTERISTIC EngM_tiCpuTimeOut_C "CPU timeout Periode" VALUE 0x1C0D20 Kw_Wu32 100000.000000 TimeDT 0.00 100000.000000 FORMAT "%13.6" EXTENDED_LIMITS 0.00 4294967295.00 /end CHARACTERISTIC
/begin CHARACTERISTIC EngM_tiDiffInt_C "Minimaler Abstand swischen zwei stat. Interrupts" VALUE 0x1C2028 Kw_Wu32 1228361874.73 TimeSys_us 0.00 1228361874.73 FORMAT "%13.2" /end CHARACTERISTIC
/begin CHARACTERISTIC EngM_tiHealBackUp_C "Heilungszeit im SyncOk-Mode" VALUE 0x1D43C0 Kw_Wu16 655350.0 Time_ms 0.00 655350.0 FORMAT "%8.1" /end CHARACTERISTIC
/begin CHARACTERISTIC EngM_tiSegMin_C "Minimale Segmentzeit zur Berechnung der Motorbeschleunigung" VALUE 0x1D437E Kw_Wu16 65535.00 TimeDT 0.00 65535.00 FORMAT "%8.2" /end CHARACTERISTIC
/begin CHARACTERISTIC EngM_tiWaitIncSig_C "Zeit zum Ausblenden des Inkrementsignals im Start" VALUE 0x1C202C Kw_Wu16 20000.00 Time_ms 0.00 20000.00 FORMAT "%8.2" EXTENDED_LIMITS 0.00 655350.0 /end CHARACTERISTIC
/begin CHARACTERISTIC EngM_trqFrcMin_CUR "Kennlinie für die Berechnung des minimum Reibmoments" CURVE 0x1D4442 Kl_Xs16_Ws16 500.0000 Trq -500.0000 0.00 FORMAT "%8.4" EXTENDED_LIMITS -3276.800 3276.700
 /begin AXIS_DESCR STD_AXIS Eng_nAvrg EngN 25 0.00 6000.000 FORMAT "%8.3" EXTENDED_LIMITS -32768.00 32767.00 DEPOSIT ABSOLUTE /end AXIS_DESCR
/end CHARACTERISTIC
/begin CHARACTERISTIC EngM_trqFrc_MAP "Schleppkennfeld, Reibkennfeld" MAP 0x1D44A8 Kf_Xs16_Ys16_Ws16 6553.500 Trq -3276.800 3276.700 FORMAT "%8.3"
 /begin AXIS_DESCR STD_AXIS Eng_nAvrg EngN 10 0.00 32767.00 FORMAT "%8.2" EXTENDED_LIMITS -32768.00 32767.00 DEPOSIT ABSOLUTE /end AXIS_DESCR
 /begin AXIS_DESCR STD_AXIS EngM_tTrqFrc_mp Temp_Cels 10 -273.1400 3003.560 FORMAT "%8.3" EXTENDED_LIMITS -3549.940 3003.560 DEPOSIT ABSOLUTE /end AXIS_DESCR
/end CHARACTERISTIC
/begin CHARACTERISTIC EngM_trqHysML_C "Hysterese für Schwelle Klimamoment (Motorlager)" VALUE 0x1D4432 Kw_Ws16 630.0000 Trq 0.00 630.0000 FORMAT "%8.4" EXTENDED_LIMITS -3276.800 3276.700 /end CHARACTERISTIC
/begin CHARACTERISTIC EngM_trqValML_C "Schwelle Klimamoment (Motorlager)" VALUE 0x1D4434 Kw_Ws16 630.0000 Trq 0.00 630.0000 FORMAT "%8.4" EXTENDED_LIMITS -3276.800 3276.700 /end CHARACTERISTIC
/begin CHARACTERISTIC EngM_tTrqFrcDef_C "Ersatzwert bei Ausfall der Maximaltemperaturbildung für Mindestreibmoment" VALUE 0x1D459C Kw_Ws16 6553.500 Temp_Cels -3549.940 3003.560 FORMAT "%8.3" /end CHARACTERISTIC
/begin CHARACTERISTIC EngM_vHiHysML_C "Hysterese für Schwelle Klimamoment (Motorlager)" VALUE 0x1D4436 Kw_Ws16 655.3500 Vel -327.6800 327.6700 FORMAT "%8.4" /end CHARACTERISTIC
/begin CHARACTERISTIC EngM_vHiValML_C "obere Schwelle Geschwindigkeit (Motorlager)" VALUE 0x1D4438 Kw_Ws16 655.3500 Vel -327.6800 327.6700 FORMAT "%8.4" /end CHARACTERISTIC
/begin CHARACTERISTIC EngM_vLoHysML_C "Hysterese für untere Schwelle Geschwindigkeit (Motorlager)" VALUE 0x1D443A Kw_Ws16 655.3500 Vel -327.6800 327.6700 FORMAT "%8.4" /end CHARACTERISTIC
/begin CHARACTERISTIC EngM_vLoValML_C "untere Schwelle Geschwindigkeit (Motorlager)" VALUE 0x1D443C Kw_Ws16 655.3500 Vel -327.6800 327.6700 FORMAT "%8.4" /end CHARACTERISTIC
/begin CHARACTERISTIC EngPrt_DebSigDef_C "Fehlerentprellzeit fuer Ueberdrehzahlerkennung" VALUE 0x1D45B4 Kw_Wu16 655350.0 Time_ms 0.00 655350.0 FORMAT "%8.1" /end CHARACTERISTIC
/begin CHARACTERISTIC EngPrt_DebSigOk_C "Heilungsentprellzeit fuer Ueberdrehzahlerkennung" VALUE 0x1D45B6 Kw_Wu16 655350.0 Time_ms 0.00 655350.0 FORMAT "%8.1" /end CHARACTERISTIC
/begin CHARACTERISTIC EngPrt_nOvrSpd_C "Schwelle für Überdrehzahlerkennung" VALUE 0x1D45E8 Kw_Ws16 6000.000 EngN 0.00 6000.000 FORMAT "%8.3" EXTENDED_LIMITS -32768.00 32767.00 /end CHARACTERISTIC
/begin CHARACTERISTIC EngPrt_nThrClo_C "Drehzahlschwelle für Schließen der Drosselklappe" VALUE 0x1D45EA Kw_Ws16 6000.000 EngN 0.00 6000.000 FORMAT "%8.3" EXTENDED_LIMITS -32768.00 32767.00 /end CHARACTERISTIC
/begin CHARACTERISTIC EngPrt_nThrOpen_C "Drehzahlschwelle für Öffnen der Drosselklappe" VALUE 0x1D45EC Kw_Ws16 6000.000 EngN 0.00 6000.000 FORMAT "%8.3" EXTENDED_LIMITS -32768.00 32767.00 /end CHARACTERISTIC
/begin CHARACTERISTIC EngPrt_rThrCloAct_C "PWG-Schwelle für Schließen der Drosselklappe bei Überdrehzahl" VALUE 0x1D4710 Kw_Ws16 100.0000 Prc 0.00 100.0000 FORMAT "%8.4" EXTENDED_LIMITS -327.6800 327.6700 /end CHARACTERISTIC
/begin CHARACTERISTIC EngPrt_rThrClo_C "PWG-Schwelle für Überdrehzahl-Überwachung ( Funktion: Schließen der Drosselklappe bei Überdrehzahl )" VALUE 0x1D4712 Kw_Ws16 100.0000 Prc 0.00 100.0000 FORMAT "%8.4" EXTENDED_LIMITS -327.6800 327.6700 /end CHARACTERISTIC
/begin CHARACTERISTIC EngPrt_tiDelOvrSpd_C "Ausblendzeit fuer Ueberdrehzahlerkennung" VALUE 0x1D471A Kw_Wu16 10000000. Time_us 0.00 10000000. EXTENDED_LIMITS 0.00 655350000. /end CHARACTERISTIC
/begin CHARACTERISTIC EngPrt_tiThrClo_C "Entprellzeit für Schließen der Drosselklappe" VALUE 0x1D471C Kw_Wu16 650000.0 Time_us 0.00 650000.0 FORMAT "%8.1" EXTENDED_LIMITS 0.00 655350000. /end CHARACTERISTIC
/begin CHARACTERISTIC ESS_nBattIncrMin_C "Anforderungwert zur Erhöhung der Leerlaufsolldrehzahl bei schwacher Batterie" VALUE 0x1D5100 Kw_Ws16 6000.000 EngN 0.00 6000.000 FORMAT "%8.3" EXTENDED_LIMITS -32768.00 32767.00 /end CHARACTERISTIC
/begin CHARACTERISTIC ESS_nBattMinThres_C "Threshold to avoid a sudden increase of torque" VALUE 0x1D5102 Kw_Ws16 6000.000 EngN 0.00 6000.000 FORMAT "%8.3" EXTENDED_LIMITS -32768.00 32767.00 /end CHARACTERISTIC
/begin CHARACTERISTIC ESS_nBattMin_C "Wert der geforderten Drehzahl nach Freigabe" VALUE 0x1D5104 Kw_Ws16 6000.000 EngN 0.00 6000.000 FORMAT "%8.3" EXTENDED_LIMITS -32768.00 32767.00 /end CHARACTERISTIC
/begin CHARACTERISTIC ESS_nLIBattThres_C "Schwelle Drehzahl zur Aktivierung der Drehzahlforderung" VALUE 0x1D5106 Kw_Ws16 6000.000 EngN 0.00 6000.000 FORMAT "%8.3" EXTENDED_LIMITS -32768.00 32767.00 /end CHARACTERISTIC
/begin CHARACTERISTIC ESS_tiDelayStrtDoneFFSet_C "Zeit bis Freigabe des Startabwurfs" VALUE 0x1D510C Kw_Ws16 327.6700 Time_s 0.00 327.6700 FORMAT "%8.4" EXTENDED_LIMITS -327.6800 327.6700 /end CHARACTERISTIC
/begin CHARACTERISTIC ESS_tiDelayUBattFFRes_C "Zeit bis Rücknahme der Drehzahlforderung nach Deaktivierung" VALUE 0x1D510E Kw_Ws16 327.6700 Time_s 0.00 327.6700 FORMAT "%8.4" EXTENDED_LIMITS -327.6800 327.6700 /end CHARACTERISTIC
/begin CHARACTERISTIC ESS_tiDelayUBattFFSet_C "Zeit bis Freigabe der Drehzahlforderung nach Aktivierung" VALUE 0x1D5108 Kw_Ws16 327.6700 Time_s 0.00 327.6700 FORMAT "%8.4" EXTENDED_LIMITS -327.6800 327.6700 /end CHARACTERISTIC
/begin CHARACTERISTIC ESS_uLIBattThresFFRes_C "Schwelle Batteriespannung zur Deaktivierung der Drehzahlforderung" VALUE 0x1D5110 Kw_Ws16 665653.8 Volt_Batt 0.00 665653.8 FORMAT "%8.1" EXTENDED_LIMITS -665674.1 665653.8 /end CHARACTERISTIC
/begin CHARACTERISTIC ESS_uLIBattThresFFSet_C "Schwelle Batteriespannung zur Aktivierung der Drehzahlforderung" VALUE 0x1D510A Kw_Ws16 665653.8 Volt_Batt 0.00 665653.8 FORMAT "%8.1" EXTENDED_LIMITS -665674.1 665653.8 /end CHARACTERISTIC
/begin CHARACTERISTIC SigTst_EGREn_C "Stellertestüberwachung Freigabemaske für Abgasrückführpositionssteller" VALUE 0x1F049B Kw_Wu8 7.000 OneToOne 0.00 7.000 FORMAT "%5.3" EXTENDED_LIMITS 0.00 255.0 /end CHARACTERISTIC
/begin CHARACTERISTIC SigTst_EGRClgBypVlvEn_C "Stelltestüberwachung Freigabemaske für den Kühlerbypass der Abgasrückführungventils" VALUE 0x1F049C Kw_Wu8 7.000 OneToOne 0.00 7.000 FORMAT "%5.3" EXTENDED_LIMITS 0.00 255.0 /end CHARACTERISTIC
/begin COMPU_METHOD AirMass "Luftmasse" RAT_FUNC "%6.4" "[g]" COEFFS 0 100 0 0 0 1 /end COMPU_METHOD
/begin COMPU_METHOD AirMassPerCyl "Luftmasse pro Zylinder" RAT_FUNC "%6.3" "[mg/Hub Luft]" COEFFS 0 10 0 0 0 1 /end COMPU_METHOD
/begin COMPU_METHOD AirMassPerTime "Luftmasse pro Zeit" RAT_FUNC "%6.3" "[Kg/h Luft]" COEFFS 0 10 0 0 0 1 /end COMPU_METHOD
/begin COMPU_METHOD AngleCaS "Winkel Nockenwelle" RAT_FUNC "%6.4" "[deg CaS]" COEFFS 0 85.3333333333334 0 0 0 1 /end COMPU_METHOD
/begin COMPU_METHOD AngleCrS "Winkel Kurbelwelle" RAT_FUNC "%6.4" "[deg CrS]" COEFFS 0 42.6666666666667 0 0 0 1 /end COMPU_METHOD
/begin COMPU_METHOD AngleCrSPerTemp "Grad Kurbelwelle pro Grad Celsius" RAT_FUNC "%6.5" "[deg CrS/deg C]" COEFFS 0 1092.26666666667 0 0 0 1 /end COMPU_METHOD
/begin COMPU_METHOD Area_Low "Area Messwert" RAT_FUNC "%7.6" "[m*m]" COEFFS 0 10000 0 0 0 1 /end COMPU_METHOD
/begin COMPU_METHOD Calory "Heizwert" RAT_FUNC "%6.2" "[J/g]" COEFFS 0 1 0 0 0 1 /end COMPU_METHOD
/begin COMPU_METHOD Calory_Low "Kalorie" RAT_FUNC "%6.1" "[J/g]" COEFFS 0 0.1 0 0 0 1 /end COMPU_METHOD
/begin COMPU_METHOD CubMtrPerHr "Volumsstrom in m^3/h" RAT_FUNC "%6.3" "[m^3/h]" COEFFS 0 10 0 0 0 1 /end COMPU_METHOD
/begin COMPU_METHOD Curr_A "Umrechnung für Strom in Ampere" RAT_FUNC "%6.4" "A" COEFFS 0 100 0 0 0 1 /end COMPU_METHOD
/begin COMPU_METHOD DfpName "Verbale Umrechnung für Fehlerpfadnamen" TAB_VERB "%6.3" "[-]" COMPU_TAB_REF DfpName /end COMPU_METHOD
/begin COMPU_VTAB DfpName "Verbale Umrechnung für Fehlerpfadnamen" TAB_VERB 385 0 "Dfp_unused" 1 "Dfp_ACCCD" 2 "Dfp_ACCCDBrkErr" 3 "Dfp_ACCCDBrkNPL" 4 "Dfp_ACCCDSensErr" 5 "Dfp_ACCCDWrongCoded" 6 "Dfp_ACCD" 7 "Dfp_ACCD_PAC" 8 "Dfp_ACCD_pCAN" 9 "Dfp_ACCD_trqCAN" 10 "Dfp_ACCIRevPanErr" 11 "Dfp_ACCIRevShOff" 12 "Dfp_ACCnotPlaus" 13 "Dfp_ADCMon" 14 "Dfp_AFSCD_PlOffsDrft" 15 "Dfp_AFSCD_PlSetyDrft" 16 "Dfp_AFSCD_SRCAirm" 17 "Dfp_AFVCD_Actr" 18 "Dfp_AOHtCDHt1" 19 "Dfp_AOHtCDHt2" 20 "Dfp_AOHtCDHt3" 21 "Dfp_APP1" 22 "Dfp_APP2" 23 "Dfp_APPCD_KickDown" 24 "Dfp_APPCD_PWGDrft" 25 "Dfp_APPSync" 26 "Dfp_APP_Npl" 27 "Dfp_APSCD" 28 "Dfp_AccPedPlausBrk" 29 "Dfp_AirCtl_GovDevMax" 30 "Dfp_AirCtl_GovDevMin" 31 "Dfp_AirCtl_GovDevRgnMax" 32 "Dfp_AirCtl_GovDevRgnMin" 33 "Dfp_AirbCDCrash" 34 "Dfp_AirbCDCrashCrCtl" 35 "Dfp_AirbCDCrashPSP" 36 "Dfp_AltCDExc" 37 "Dfp_AltCD_Load" 38 "Dfp_AltPwrCan" 39 "Dfp_BIP01" 40 "Dfp_BIP02" 41 "Dfp_BIP03" 42 "Dfp_BIP04" 43 "Dfp_BIP05" 44 "Dfp_BIP06" 45 "Dfp_BIP07" 46 "Dfp_BIP08" 47 "Dfp_BIP09" 48 "Dfp_BIP10" 49 "Dfp_BIP11" 50 "Dfp_BIP12" 51 "Dfp_BIP_Con" 52 "Dfp_BPACD_Max" 53 "Dfp_BPACD_Max2" 54 "Dfp_BPACD_Min" 55 "Dfp_BPACD_Min2" 56 "Dfp_BPACD_SigNpl" 57 "Dfp_BPACD_SigNpl2" 58 "Dfp_BPASCD" 59 "Dfp_BPSCD" 60 "Dfp_BPSCDPlaus" 61 "Dfp_BattCD" 62 "Dfp_BrkCD" 63 "Dfp_BrkCDBPTInvld" 64 "Dfp_BrkCDdynPl" 65 "Dfp_CANA" 66 "Dfp_CANB" 67 "Dfp_CANBus1" 68 "Dfp_CANBus2" 69 "Dfp_CANBus3" 70 "Dfp_CANC" 71 "Dfp_CANErrActA" 72 "Dfp_CANErrActB" 73 "Dfp_CANErrActC" 74 "Dfp_COTSCD" 75 "Dfp_CTSCD" 76 "Dfp_CTSCDCanInac" 77 "Dfp_CTSCDCanSig" 78 "Dfp_Clg_DynTst" 79 "Dfp_CmbChbMisfire1" 80 "Dfp_CmbChbMisfire2" 81 "Dfp_CmbChbMisfire3" 82 "Dfp_CmbChbMisfire4" 83 "Dfp_CmbChbMisfire5" 84 "Dfp_CmbChbMisfire6" 85 "Dfp_CmbChbMisfireMul" 86 "Dfp_CoVMDCSErr" 87 "Dfp_CoVMDCSh" 88 "Dfp_CoVMDCSp" 89 "Dfp_CoVMSumErr" 90 "Dfp_CoVMTCSErr" 91 "Dfp_CoVehLvl2" 92 "Dfp_ConvCD" 93 "Dfp_ConvCD_ConvErr" 94 "Dfp_ConvCD_EPB1" 95 "Dfp_CrCCDPanErrMSG" 96 "Dfp_CrCCDPanErrSMLS" 97 "Dfp_CrCCDPanMainSwtErr" 98 "Dfp_CrCtlDsplErrPat" 99 "Dfp_CrCtlDsplNotPlaus" 100 "Dfp_CrCtlPECDErr" 101 "Dfp_CrCtlPLmpDef" 102 "Dfp_CrCtlPShutOff" 103 "Dfp_CrCtlPTlrDef" 104 "Dfp_CrCtlVDsplNotPlaus" 105 "Dfp_CtApCD" 106 "Dfp_CtTCD" 107 "Dfp_CtT_Mon" 108 "Dfp_DifftrqLimErrPat" 109 "Dfp_EATSCD" 110 "Dfp_EATSCDCanInac" 111 "Dfp_EATSCDCanSig" 112 "Dfp_EEPCDVarMng" 113 "Dfp_EGPpCDTPreTrbn" 114 "Dfp_EGRCD_CBV" 115 "Dfp_EGRCD_Max" 116 "Dfp_EGRCD_Min" 117 "Dfp_EGRCD_Sig" 118 "Dfp_EGRCD_SigNpl" 119 "Dfp_EGRSCD" 120 "Dfp_EGRSCD_JamVlv" 121 "Dfp_EGRSCD_LgTimeDrft" 122 "Dfp_EGRSCD_ShTimeDrft" 123 "Dfp_EGRVlvGvnrDvt" 124 "Dfp_EGRVlv_JamVlv" 125 "Dfp_EMCCD_MLS1" 126 "Dfp_EngMBackUp" 127 "Dfp_EngMCaS1" 128 "Dfp_EngMCaSDrv" 129 "Dfp_EngMCrS1" 130 "Dfp_EngMOfsCaSCrS" 131 "Dfp_EngMonIrrCmb" 132 "Dfp_EngPrt" 133 "Dfp_ErLpCDMILReqON" 134 "Dfp_FMAErrMod" 135 "Dfp_FMTC_NonMonotonMap" 136 "Dfp_FQTSCD" 137 "Dfp_FQlSCD" 138 "Dfp_FTSCD" 139 "Dfp_FTSCDNpl" 140 "Dfp_FanCD_Fan1Ctlr1" 141 "Dfp_FanCD_Fan1Ctlr2" 142 "Dfp_FanCD_Fan2Ctlr1" 143 "Dfp_FanCD_Fan2Ctlr2" 144 "Dfp_FanCD_FanCtlr1" 145 "Dfp_FanCD_FanCtlr2" 146 "Dfp_FanCD_OutFanCtlr1" 147 "Dfp_FanCD_OutFanCtlr2" 148 "Dfp_FlClgCD" 149 "Dfp_FlPpCD" 150 "Dfp_FlSCDT1" 151 "Dfp_FrmMngAAGNpl" 152 "Dfp_FrmMngAAGTO" 153 "Dfp_FrmMngAC1Npl" 154 "Dfp_FrmMngAC1TO" 155 "Dfp_FrmMngACCNpl" 156 "Dfp_FrmMngACCTO" 157 "Dfp_FrmMngAIRBGNpl" 158 "Dfp_FrmMngAIRBGTO" 159 "Dfp_FrmMngAWD1Npl" 160 "Dfp_FrmMngAWD1TO" 161 "Dfp_FrmMngBEM1Npl" 162 "Dfp_FrmMngBEM1TO" 163 "Dfp_FrmMngBRK1Npl" 164 "Dfp_FrmMngBRK1TO" 165 "Dfp_FrmMngBRK2Npl" 166 "Dfp_FrmMngBRK2TO" 167 "Dfp_FrmMngBRK8Npl" 168 "Dfp_FrmMngBRK8TO" 169 "Dfp_FrmMngBSG3TO" 170 "Dfp_FrmMngCANVerErr" 171 "Dfp_FrmMngCCSel" 172 "Dfp_FrmMngCCTLNpl" 173 "Dfp_FrmMngCCTLTO" 174 "Dfp_FrmMngCHRGR1Npl" 175 "Dfp_FrmMngCHRGR1TO" 176 "Dfp_FrmMngCHRGR2Npl" 177 "Dfp_FrmMngCHRGR2TO" 178 "Dfp_FrmMngChrgr1A" 179 "Dfp_FrmMngChrgr1C" 180 "Dfp_FrmMngChrgr1N" 181 "Dfp_FrmMngChrgr1T" 182 "Dfp_FrmMngChrgr1V" 183 "Dfp_FrmMngChrgr2A" 184 "Dfp_FrmMngChrgr2C" 185 "Dfp_FrmMngChrgr2N" 186 "Dfp_FrmMngChrgr2T" 187 "Dfp_FrmMngChrgr2V" 188 "Dfp_FrmMngDIA1Npl" 189 "Dfp_FrmMngDIA1TO" 190 "Dfp_FrmMngDSP1Npl" 191 "Dfp_FrmMngDSP1TO" 192 "Dfp_FrmMngDSP2Npl" 193 "Dfp_FrmMngDSP2TO" 194 "Dfp_FrmMngDSP3Npl" 195 "Dfp_FrmMngDSP3TO" 196 "Dfp_FrmMngEPB1Npl" 197 "Dfp_FrmMngEPB1TO" 198 "Dfp_FrmMngESCUNpl" 199 "Dfp_FrmMngESCUTO" 200 "Dfp_FrmMngErrValDFM" 201 "Dfp_FrmMngGW1Npl" 202 "Dfp_FrmMngGW1TO" 203 "Dfp_FrmMngILMNpl" 204 "Dfp_FrmMngILMTO" 205 "Dfp_FrmMngLICHT1TO" 206 "Dfp_FrmMngLICHT2TO" 207 "Dfp_FrmMngNIV1WrngCod" 208 "Dfp_FrmMngNIVEAU1Npl" 209 "Dfp_FrmMngNIVEAU1TO" 210 "Dfp_FrmMngSA1Npl" 211 "Dfp_FrmMngSA1TO" 212 "Dfp_FrmMngSTIGNNpl" 213 "Dfp_FrmMngStIgnTO" 214 "Dfp_FrmMngTOSNpl" 215 "Dfp_FrmMngTOSTO" 216 "Dfp_FrmMngTSC1Npl" 217 "Dfp_FrmMngTSC1TO" 218 "Dfp_FrmMngTSC2Npl" 219 "Dfp_FrmMngTSC2TO" 220 "Dfp_FrmMngTSC3Npl" 221 "Dfp_FrmMngTSC3TO" 222 "Dfp_FrmMngTSC6Npl" 223 "Dfp_FrmMngTSC6TO" 224 "Dfp_FrmMngTrbnSpdErr" 225 "Dfp_FrmMngWIPERTO" 226 "Dfp_GbSSCD" 227 "Dfp_GbSSCD_HW" 228 "Dfp_GearbxCVTnMax" 229 "Dfp_GearbxClthPlaus" 230 "Dfp_GearbxINCCup" 231 "Dfp_GearbxNMinMon" 232 "Dfp_GearbxTSC" 233 "Dfp_GearbxTransConv" 234 "Dfp_GearbxTypeMTErr" 235 "Dfp_GlwCDDIAG" 236 "Dfp_GlwCDErr1" 237 "Dfp_GlwCDErr2" 238 "Dfp_GlwCDEvalCod" 239 "Dfp_GlwCDGSK2" 240 "Dfp_GlwCDGSK3" 241 "Dfp_GlwCDLmp" 242 "Dfp_GlwCDPLUG0" 243 "Dfp_GlwCDPLUG1" 244 "Dfp_GlwCDPLUG2" 245 "Dfp_GlwCDPLUG3" 246 "Dfp_GlwCDPLUG4" 247 "Dfp_GlwCDPLUG5" 248 "Dfp_GlwCD_LampCan" 249 "Dfp_GlwCDsfd" 250 "Dfp_HDSCD" 251 "Dfp_HWEMonCom" 252 "Dfp_HWEMonEEPROM" 253 "Dfp_HWEMonRcyLocked" 254 "Dfp_HWEMonRcySuppressed" 255 "Dfp_HWEMonRcyVisible" 256 "Dfp_HWEMonUMaxSupply" 257 "Dfp_HWEMonUMinSupply" 258 "Dfp_IATSCD" 259 "Dfp_IFCD" 260 "Dfp_ImmCtl" 261 "Dfp_IndSysMonIntMnf" 262 "Dfp_InjCrvT3DiaMax" 263 "Dfp_InjCrvT3DiaMin" 264 "Dfp_InjVlvBnk1A" 265 "Dfp_InjVlvBnk2A" 266 "Dfp_InjVlvCyl10A" 267 "Dfp_InjVlvCyl11A" 268 "Dfp_InjVlvCyl12A" 269 "Dfp_InjVlvCyl1A" 270 "Dfp_InjVlvCyl2A" 271 "Dfp_InjVlvCyl3A" 272 "Dfp_InjVlvCyl4A" 273 "Dfp_InjVlvCyl5A" 274 "Dfp_InjVlvCyl6A" 275 "Dfp_InjVlvCyl7A" 276 "Dfp_InjVlvCyl8A" 277 "Dfp_InjVlvCyl9A" 278 "Dfp_LASCD" 279 "Dfp_LSUCDCircNernst0" 280 "Dfp_LSUCDCircPumpCur0" 281 "Dfp_LSUCDCircVirtGnd0" 282 "Dfp_LSUCDHeater0" 283 "Dfp_LSUCDHtCoup0" 284 "Dfp_LSUCDO20" 285 "Dfp_LSUCDO2Clb0" 286 "Dfp_LSUCDRiClb0" 287 "Dfp_LSUCDSPI0" 288 "Dfp_LSUCDSPIBattLow0" 289 "Dfp_LSUCDWireIP0" 290 "Dfp_LSUCtlRiExc0" 291 "Dfp_LSUMonDyn0" 292 "Dfp_LSUMonFullLd0" 293 "Dfp_LSUMonOvrRun0" 294 "Dfp_LSUMonPartLd0" 295 "Dfp_MIL" 296 "Dfp_MRlyCD" 297 "Dfp_Montr" 298 "Dfp_OTSCD" 299 "Dfp_OTSCDCanInac" 300 "Dfp_OTSCDCanSig" 301 "Dfp_OTSCD_DynTst" 302 "Dfp_OvRMon" 303 "Dfp_OvRMonCrCtlP" 304 "Dfp_OvRMonSigA" 305 "Dfp_OxiCCDTPre" 306 "Dfp_OxiCCDTPre1" 307 "Dfp_PCR_BalGovDev" 308 "Dfp_PCR_GovDev" 309 "Dfp_PFltAPSens" 310 "Dfp_PFltCDHtg" 311 "Dfp_PFltCDHtg1" 312 "Dfp_PFltCDPDiff" 313 "Dfp_PFltCDTempPre" 314 "Dfp_PFltCDTempPre1" 315 "Dfp_PFltCDTempPst" 316 "Dfp_PFltChar" 317 "Dfp_PFltEngPrt" 318 "Dfp_PFltPresDynPlaus" 319 "Dfp_PFltPresHsChng" 320 "Dfp_PFltPresSens" 321 "Dfp_PFltPresSensFrz" 322 "Dfp_PFltPresSensHsLn" 323 "Dfp_PFltPresSensSot" 324 "Dfp_PFltRgnLckPerm" 325 "Dfp_PFltRgnLckPermTstr" 326 "Dfp_PFltRgnPerm" 327 "Dfp_PFltSotSimPresPerm" 328 "Dfp_PFltTempDwnStrm" 329 "Dfp_PFltTempDwnStrmMax" 330 "Dfp_PFltTempDwnStrmMin" 331 "Dfp_PFltTempPreOxiC" 332 "Dfp_PFltTempPrePFlt" 333 "Dfp_PFltTempPreTrbn" 334 "Dfp_PFltTempPst" 335 "Dfp_PFltTempPstPFlt" 336 "Dfp_PFltTempSens" 337 "Dfp_PFltTempSens2" 338 "Dfp_PFltTempUpStrm" 339 "Dfp_PFltTempUpStrmMax" 340 "Dfp_PFltTempUpStrmMin" 341 "Dfp_PSPCD_Actr" 342 "Dfp_PrpCtlvLimErrPat" 343 "Dfp_SOPTst" 344 "Dfp_SSpMon1" 345 "Dfp_SSpMon2" 346 "Dfp_SSpMon3" 347 "Dfp_Shtrp_EGRBA" 348 "Dfp_Shtrp_PCRBA" 349 "Dfp_SrvPmpStSAEcu" 350 "Dfp_StSysCtlShCirBatt" 351 "Dfp_StrtCDOffRly" 352 "Dfp_StrtCDOnRly" 353 "Dfp_StrtCtlIlsNotPlaus" 354 "Dfp_StrtCtlT50ROneRly1" 355 "Dfp_StrtCtlT50ROneRly2" 356 "Dfp_StrtCtlT50RZero" 357 "Dfp_SysLamp" 358 "Dfp_T15CD" 359 "Dfp_T50CD" 360 "Dfp_TPUMon" 361 "Dfp_TVACD_Max" 362 "Dfp_TVACD_Min" 363 "Dfp_TVACD_Sig" 364 "Dfp_TVACD_SigNpl" 365 "Dfp_TVACD_stLineDef" 366 "Dfp_TVASCD" 367 "Dfp_TVASCD_Drft" 368 "Dfp_ThrVlvGvnrDvt" 369 "Dfp_ThrVlvJamVlv" 370 "Dfp_UAcc_CodeBitErr" 371 "Dfp_USAp_DataVariant" 372 "Dfp_USAp_FuncCodeRead" 373 "Dfp_VSACD_Max" 374 "Dfp_VSACD_Min" 375 "Dfp_VSACD_SigNpl" 376 "Dfp_VSSCD" 377 "Dfp_VSSCD1" 378 "Dfp_VSSCD2" 379 "Dfp_VSSCD4" 380 "Dfp_VSSCDBrkLowVltg" 381 "Dfp_VSSCDCAN" 382 "Dfp_VSSCDNpl" 383 "Dfp_WDALCD" 384 "Dfp_WdCom" /end COMPU_VTAB
/begin COMPU_METHOD DtyCyc "Tastverhaeltnis" RAT_FUNC "%6.4" "[%]" COEFFS 0 100 0 0 0 1 /end COMPU_METHOD
/begin COMPU_METHOD EepBlock "Umrechnung von Eep-Blockname in Eep-Blocknummer" TAB_VERB "%6.3" "" COMPU_TAB_REF EepBlock /end COMPU_METHOD
/begin COMPU_VTAB EepBlock "Umrechnung von Eep-Blockname in Eep-Blocknummer" TAB_VERB 36 1 "CustomFlash_Data" 2 "Prog_Data" 3 "IMS_Data_3" 4 "IMS_Data_2" 5 "DSM1" 6 "DSM2" 7 "Dummyblock_7" 8 "DSM_Reserved" 9 "Mon_Data" 10 "DynTst_Dia" 11 "AdjValues" 12 "LongTermVal" 13 "FbcData" 14 "Lsu_Data" 15 "FMA_qAdaptMap" 16 "EGSys_tShOff" 17 "EGSys_DewDet" 18 "ADD_EGSys_EepData" 19 "VarCode_data" 20 "IMS4_Data" 21 "IFCM" 22 "TO_DELETE_PFlt_EepData" 23 "EGSys_EepData" 24 "PFlt_EepData" 25 "Variants" 26 "DynTst_Dia_2" 27 "DSM3" 28 "DIUMPR" 29 "SHTRP" 30 "Airbg_Crash_Info" 31 "DSM_DTR" 32 "DSM4" 33 "Dummyblock_6" 34 "Dummyblock_8" 35 "TAA" 36 "NOT INIT" /end COMPU_VTAB
/begin COMPU_METHOD Energy "Energie in Joule" RAT_FUNC "%6.2" "[kJ]" COEFFS 0 1 0 0 0 1 /end COMPU_METHOD
/begin COMPU_METHOD EngN "Motordrehzahl" RAT_FUNC "%6.2" "[rpm]" COEFFS 0 1 0 0 0 1 /end COMPU_METHOD
/begin COMPU_METHOD EngTempFldSel "Verbale Umrechnung für Auswahl aus dem Motortemperatur-Feld Eng_tFld" TAB_VERB "%6.3" "" COMPU_TAB_REF EngTempFldSel /end COMPU_METHOD
/begin COMPU_VTAB EngTempFldSel "Verbale Umrechnung für Auswahl aus dem Motortemperatur-Feld Eng_tFld" TAB_VERB 5 0 "Coolant_Temperature" 1 "Oil_Temperature" 2 "Engine_Temperature" 3 "Fuel_Temperature" 4 "Coolant_Temperature_CAN" /end COMPU_VTAB
/begin COMPU_METHOD Fact "Faktor mit Auflösung 1 / 8192, hauptsächlich für einen Faktorenbereich 0...1 verwendet" RAT_FUNC "%6.5" "[-]" COEFFS 0 8192 0 0 0 1 /end COMPU_METHOD
/begin COMPU_METHOD Fact1 "Faktor mit Auflösung 0,01 (100 mal höherer Bereich als Fact)" RAT_FUNC "%6.4" "[-]" COEFFS 0 128 0 0 0 1 /end COMPU_METHOD
/begin COMPU_METHOD Fact100 "Faktor mit einer Auflösung von 0,01" RAT_FUNC "%6.4" "-" COEFFS 0 100 0 0 0 1 /end COMPU_METHOD
/begin COMPU_METHOD Fact2 "Faktor mit Auflösung 0.001, für einen Faktorenbereich 0...5,46117 verwendet" RAT_FUNC "%6.4" "-" COEFFS 0 16 0 0 0 1 /end COMPU_METHOD
/begin COMPU_METHOD HeatCapacity "Waermekapazitaet einer Substanz" RAT_FUNC "%6.3" "[J/K]" COEFFS 0 10 0 0 0 1 /end COMPU_METHOD
/begin COMPU_METHOD HeatCapacity_Low "Wärmekapazität einer Substanz" RAT_FUNC "%6.1" "[J/K]" COEFFS 0 0.1 0 0 0 1 /end COMPU_METHOD
/begin COMPU_METHOD InjMass "Einspritzmenge" RAT_FUNC "%6.4" "[mg/hub]" COEFFS 0 100 0 0 0 1 /end COMPU_METHOD
/begin COMPU_METHOD InjMassCyc "Einspritzmenge pro Zyklus (mg/Zyklus)" RAT_FUNC "%6.4" "[mg/cyc]" COEFFS 0 100 0 0 0 1 /end COMPU_METHOD
/begin COMPU_METHOD InjMassPerTimeHigh " Kraftstoffmassenstrom hohe Auflösung" RAT_FUNC "%6.5" "[kg/h]" COEFFS 0 1000 0 0 0 1 /end COMPU_METHOD
/begin COMPU_METHOD Kd "Differentialverstärkung Kd (gleiche Einheit/Umrechnungsformel an Ein- und Ausgang)" RAT_FUNC "%7.6" "[1/1]" COEFFS 0 65536 0 0 0 1 /end COMPU_METHOD
/begin COMPU_METHOD Ki "Integrale Verstärkung Ki (gleiche Einheit/Umrechnungsregel an Ein- und Ausgang)" RAT_FUNC "%6.5" "[1/s]" COEFFS 0 4294.967296 0 0 0 1 /end COMPU_METHOD
/begin COMPU_METHOD Ki_EGRVlv "Umrechnung für Losreiß- und Pull Down Funktion" RAT_FUNC "%6.5" "1/s" COEFFS 0 6553.6 0 0 0 1 /end COMPU_METHOD
/begin COMPU_METHOD Ki_Kelv_Sec "Verstärkungskonstante für Integrator für zeitliche Ableitung der Temperatur" RAT_FUNC "%6.4" "1/s" COEFFS 0 429.4967296 0 0 0 1 /end COMPU_METHOD
/begin COMPU_METHOD Kp "proportionale Verstärkung Kp (gleiche Einheit/Umrechnungsregel an Ein- und Ausgang)" RAT_FUNC "%7.6" "[1/1]" COEFFS 0 65536 0 0 0 1 /end COMPU_METHOD
/begin COMPU_METHOD lambda "Lambda" RAT_FUNC "%6.5" "[-]" COEFFS 0 1000 0 0 0 1 /end COMPU_METHOD
/begin COMPU_METHOD Length1 "Abstand in Meter" RAT_FUNC "%6.4" "[m]" COEFFS 0 128 0 0 0 1 /end COMPU_METHOD
/begin COMPU_METHOD LimKLine "umrechnung für K-Linie mode6 service, um anzuzeigen, welche Testgrenzen (min oder max oder min und max) vorhanden sind" TAB_VERB "%6.3" "" COMPU_TAB_REF LimKLine /end COMPU_METHOD
/begin COMPU_VTAB LimKLine "umrechnung für K-Linie mode6 service, um anzuzeigen, welche Testgrenzen (min oder max oder min und max) vorhanden sind" TAB_VERB 3 0 "Max Limit available" 1 "Min Limit available" 2 "Both Limits available" /end COMPU_VTAB
/begin COMPU_METHOD numAirSys "Menge der separaten Ansaugflutwege im Luftsystem" TAB_VERB "%6.3" "" COMPU_TAB_REF numAirSys /end COMPU_METHOD
/begin COMPU_VTAB numAirSys "Menge der separaten Ansaugflutwege im Luftsystem" TAB_VERB 3 0 "Mono" 1 "Bank1" 2 "Bank2" /end COMPU_VTAB
/begin COMPU_METHOD NumPinAdc "verbale Umrechnung für ADC Signale" TAB_VERB "%6.3" "" COMPU_TAB_REF NumPinAdc /end COMPU_METHOD
/begin COMPU_VTAB NumPinAdc "verbale Umrechnung für ADC Signale" TAB_VERB 5 2 "Exhaust_Gas_Recirculation_Sensor" 14 "Throttle_Valve_Position_Sensor" 17 "Fuel_Temperature_Sensor" 24 "1st_APP_Sensor" 25 "2nd_APP_Sensor" /end COMPU_VTAB
/begin COMPU_METHOD NumPinDia "Verbale Umrechnung für Diagnose Signale" TAB_VERB "%6.3" "" COMPU_TAB_REF NumPinDia /end COMPU_METHOD
/begin COMPU_VTAB NumPinDia "Verbale Umrechnung für Diagnose Signale" TAB_VERB 4 1 "Glow_Relay_DiaSig" 8 "EGR_Actuator_DiaSig" 13 "Throttle_Valve_Actuator_DiaSig" 21 "Glw_Sys_GSK3_DiaSig" /end COMPU_VTAB
/begin COMPU_METHOD NumPinDioIn "Verbale Umrechnung für Digitaleingang Signale" TAB_VERB "%6.3" "" COMPU_TAB_REF NumPinDioIn /end COMPU_METHOD
/begin COMPU_VTAB NumPinDioIn "Verbale Umrechnung für Digitaleingang Signale" TAB_VERB 2 13 "TVA_Status_Flag" 13 "EGR_Status_Flag" /end COMPU_VTAB
/begin COMPU_METHOD NumPinDioOut "Verbale Umrechnung für Digitalausgang Signale" TAB_VERB "%6.3" "" COMPU_TAB_REF NumPinDioOut /end COMPU_METHOD
/begin COMPU_VTAB NumPinDioOut "Verbale Umrechnung für Digitalausgang Signale" TAB_VERB 4 0 "Glow_Relay" 20 "Glow_Lamp" 21 "EGR_Disable_HBridge" 22 "TVA_Disable_HBridge" /end COMPU_VTAB
/begin COMPU_METHOD NumPinPwmOut "Verbale Umrechnung für PWM-Ausgang Signale" TAB_VERB "%6.3" "" COMPU_TAB_REF NumPinPwmOut /end COMPU_METHOD
/begin COMPU_VTAB NumPinPwmOut "Verbale Umrechnung für PWM-Ausgang Signale" TAB_VERB 7 2 "GlwSys_GSK3_Actuator" 3 "Throttle_Valve_Actuator" 5 "EGR_Actuator1" 6 "EGR_Actuator2" 7 "Throttle_Valve_HBridge1" 8 "Throttle_Valve_HBridge2" 13 "EGR_Actuator" /end COMPU_VTAB
/begin COMPU_METHOD O2 "Sauerstoffkonzentration" RAT_FUNC "%8.7" "[-]" COEFFS 0 100000 0 0 0 1 /end COMPU_METHOD
/begin COMPU_METHOD OneToOne "eins zu eins (physikalischer Wert ist gleich dem internen Wert)" RAT_FUNC "%6.2" "[-]" COEFFS 0 1 0 0 0 1 /end COMPU_METHOD
/begin COMPU_METHOD Period "Periodendauer" RAT_FUNC "%6.3" "[ms]" COEFFS 0 10 0 0 0 1 /end COMPU_METHOD
/begin COMPU_METHOD Prc "Prozent, gleiche interne Auflösung wie Fact, aber Darstellung in Prozent (0...100%)" RAT_FUNC "%6.4" "[%]" COEFFS 0 100 0 0 0 1 /end COMPU_METHOD
/begin COMPU_METHOD Pres_hPa "Druck (angezeigt in [hPa])" RAT_FUNC "%6.2" "[hPa]" COEFFS 0 1 0 0 0 1 /end COMPU_METHOD
/begin COMPU_METHOD Pwr1 "Leistung mit Hoher Aufloesung" RAT_FUNC "%6.3" "[W]" COEFFS 0 10 0 0 0 1 /end COMPU_METHOD
/begin COMPU_METHOD RdyOnMilEnable "Verbale Umrechnung für DSM_RdyOnMilEnable_C" TAB_VERB "%6.3" "" COMPU_TAB_REF RdyOnMilEnable /end COMPU_METHOD
/begin COMPU_VTAB RdyOnMilEnable "Verbale Umrechnung für DSM_RdyOnMilEnable_C" TAB_VERB 2 0 "normal" 1 "set all Rdy bits on Mil ON" /end COMPU_VTAB
/begin COMPU_METHOD ReynoldsNum "Reynolds Nummer um den thermischen Koeffizienten zu bestimmen" RAT_FUNC "%6.0" "[-]" COEFFS 0 0.01 0 0 0 1 /end COMPU_METHOD
/begin COMPU_METHOD RmpDtyCyc "Rampengradient für Tastverhältnis" RAT_FUNC "%6.5" "[%/s]" COEFFS 0 6553.6 0 0 0 1 /end COMPU_METHOD
/begin COMPU_METHOD RmpTemp "Rampengradient für Temperatur" RAT_FUNC "%6.4" "[deg C/s]" COEFFS 0 655.36 0 0 0 1 /end COMPU_METHOD
/begin COMPU_METHOD RmpTransR "Umrechnung für die Rampensteigung des Triebstrangübersetzungverhältnisses" RAT_FUNC "%6.5" "[1/s]" COEFFS 0 6553.6 0 0 0 1 /end COMPU_METHOD
/begin COMPU_METHOD RmpTrqPrpHigh "Rampenanstieg für Vortriebsmoment [Nm/s]" RAT_FUNC "%6.4" "[Nm/s]" COEFFS 0 655.36 0 0 0 1 /end COMPU_METHOD
/begin COMPU_METHOD SigName "Verbale Umrechnung für Signal Referenz Nummern" TAB_VERB "%6.3" "[-]" COMPU_TAB_REF SigName /end COMPU_METHOD
/begin COMPU_VTAB SigName "Verbale Umrechnung für Signal Referenz Nummern" TAB_VERB 575 0 "Sig_unused" 4 "CoEng_rTrq__Carb_r_DLen1" 5 "CTSCD_tClntLin__Carb_t_DLen1" 11 "BPSCD_pLin__Carb_p_DLen1" 12 "Eng_nAvrg__Carb_n_DLen2" 13 "VSSCD_vCarb1__Carb_v_DLen1" 15 "IATSCD_tAirLin__Carb_t_DLen1" 16 "AFSCD_dmAirRawPerTime__Carb_mAirTim_DLen2" 17 "TVACD_rOut__Carb_r_DLen1" 28 "Signals_PID0x1C__OneToOne_DLen1" 29 "CARB_Mode1PID1D__OneToOne_DLen1" 31 "VehDa_tiCarbEngOn__OneToOne_DLen2" 33 "DSMDur_ctDfctDur1__Carb_l_DLen2" 44 "EGRCD_rOut__Carb_r_DLen1" 45 "EGRVlv_rGvnrDvtRel__Carb_rNeg_DLen1" 48 "DSM_ctWUC__OneToOne_DLen1" 49 "DSM_lDist__Carb_l_DLen2" 51 "APSCD_pSensorVal__Carb_p_DLen1" 60 "EGPpCD_tPreTrbn__Carb_tHighM1_DLen2" 62 "PFlt_tPre__Carb_tHighM1_DLen2" 65 "DSM_stPID41__LowByte_DLen4" 66 "BattCD_u__Carb_uBatt_DLen2" 69 "CARB_rRelThrVlvPos_PID45__Carb_r_DLen1" 70 "EATSCD_tAir__Carb_t_DLen1" 73 "CARB_rAPPCD_PID49__Carb_r_DLen1" 74 "CARB_rAPPCD_PID4A__Carb_r_DLen1" 76 "AirCtl_rTVA__Carb_r_DLen1" 79 "CARB_Mode1PID4F__LowByte_DLen4" 112 "CARB_LSU_rLmbd0__Carb_lr_DLen2" 113 "LSUCD_uO2Raw__Carb_u_DLen2" 114 "CARB_Mode1PID4FB__LowByte_DLen2" 115 "PFlt_tPst__Carb_tHighM1_DLen2" 116 "PFlt_tOxiPre__Carb_tHighM1_DLen2" 117 "PFlt_tOxiPst__Carb_tHighM1_DLen2" 118 "OxiCCD_tPre__Carb_tHighM1_DLen2" 119 "TVASCD_rNrm__Carb_r_DLen1" 120 "EGRVlv_rDesVal__Carb_r_DLen1" 122 "CARB_rNrmInvTVASCD__Carb_r_DLen1" 197 "Eng_nAvrg__n_DLen1" 198 "APPCD_stSwitchSig__OneToOne_DLen1" 199 "APPCD_uRawAPP1__u_DLen1" 200 "APPCD_uRawAPP2__u_DLen1" 201 "APPCD_rAPP1UnFlt__r_DLen1" 202 "BPSCD_uRawVal__u_DLen1" 203 "BPSCD_pOutVal__p_DLen1" 204 "APSCD_pVal__p_DLen1" 205 "APSCD_uRaw__u_DLen1" 206 "IATSCD_tAirLin__t_DLen1" 207 "IATSCD_uRaw__u_DLen1" 208 "FTSCD_tFuel__t_DLen1" 209 "CTSCD_uRaw__u_DLen1" 210 "CTSCD_tClnt__t_DLen1" 211 "OTSCD_tEngOil__t_DLen1" 212 "VSSCD_v__v_DLen1" 213 "AFSCD_dmAirRawPerTime__mAirTim_DLen1" 214 "AFSCD_uRaw__u_DLen1" 215 "AFSCD_dmAirPerTime__mAirTim_DLen1" 216 "BrkCD_stMnSwtRawVal__OneToOne_DLen1" 217 "BrkCD_stRedSwtRawVal__OneToOne_DLen1" 218 "ConvCD_stRawVal__OneToOne_DLen1" 219 "T15CD_stRawVal__OneToOne_DLen1" 220 "BattCD_uRaw__uBatt_DLen1" 221 "IndSys_rVSA__dcyc_DLen1" 222 "InjCtl_qCurr__q_DLen1" 223 "InjCtl_qSetUnBal__q_DLen1" 224 "BPACD_rOut__dcyc_DLen1" 225 "EGRCD_rOut__dcyc_DLen1" 226 "ACCtl_stLogicOut__OneToOne_DLen1" 227 "AOHt_stHt1Out__OneToOne_DLen1" 228 "GlwCtl_stLmpOut__OneToOne_DLen1" 229 "GlwCtl_stActrOut__OneToOne_DLen1" 230 "InjVlv_nCyl1__nCmpTst_DLen1" 231 "InjVlv_nCyl2__nCmpTst_DLen1" 232 "InjVlv_nCyl3__nCmpTst_DLen1" 233 "InjVlv_nCyl4__nCmpTst_DLen1" 234 "InjVlv_nCyl5__nCmpTst_DLen1" 235 "InjVlv_nCyl6__nCmpTst_DLen1" 236 "InjVlv_qFBCCyl1__q_DLen1" 237 "InjVlv_qFBCCyl2__q_DLen1" 238 "InjVlv_qFBCCyl3__q_DLen1" 239 "InjVlv_qFBCCyl4__q_DLen1" 240 "InjVlv_qFBCCyl5__q_DLen1" 241 "InjVlv_qFBCCyl6__q_DLen1" 242 "CaSCD_nPeriod__n_DLen1" 243 "FBC_qDvtCyl[0]__qdiff_DLen1" 244 "FBC_qDvtCyl[1]__qdiff_DLen1" 245 "FBC_qDvtCyl[2]__qdiff_DLen1" 246 "FBC_qDvtCyl[3]__qdiff_DLen1" 247 "FBC_qDvtCyl[4]__qdiff_DLen1" 248 "FBC_qDvtCyl[5]__qdiff_DLen1" 249 "FBC_qDvtCyl[6]__qdiff_DLen1" 250 "FBC_qDvtCyl[7]__qdiff_DLen1" 251 "FBC_qDvtCyl[8]__qdiff_DLen1" 252 "FBC_qDvtCyl[9]__qdiff_DLen1" 253 "InjCrv_phiMI1Des__phiHResol_DLen1" 254 "InjVlv_phiMI1DurCorr__phi_DLen1" 255 "PSP_stLogicOut__OneToOne_DLen1" 256 "ACCD_stMnSwtRawVal__OneToOne_DLen1" 257 "AOHt_stHt2Out__OneToOne_DLen1" 258 "AFSCD_mAirPerCyl__mAirCyl_DLen1" 259 "AFSCD_dmAirNorm__mAirTim_DLen1" 260 "AirCtl_mGovDev__mAirCylGov_DLen1" 261 "AirCtl_rEGR__r_DLen1" 262 "PCR_rBPACD__r_DLen1" 263 "Dfp_LSUCDCircNernst0_Low__OneToOne_DLen1" 264 "GlwCD_stRawVal__OneToOne_DLen1" 265 "APPCD_rFlt__r_DLen1" 266 "HWEMon_numRecovery__OneToOne_DLen1" 281 "DSM_stSysLamp__OneToOne_DLen1" 282 "DSM_stMIL__OneToOne_DLen1" 283 "BattCD_u__uBatt_DLen1" 284 "LIGov_nSetpoint__n_DLen1" 285 "VSSCD_a__a_DLen1" 286 "Tst_Zyklflag_SB5__OneToOne_DLen1" 287 "IATSCD_tAir__t_DLen1" 288 "AccPed_stPlaAPPBrk__OneToOne_DLen1" 289 "AccPed_trqDes__trqhigh_DLen1" 290 "COTSCD_tClnt__t_DLen1" 291 "AccPed_trqInrDesSig__trq_DLen1" 292 "Gearbx_stGear__OneToOne_DLen1" 293 "LSU_rLmbd[0]__rLmbd_DLen1" 294 "LSU_rLmbd[1]__rLmbd_DLen1" 295 "Tst_Zyklflag_SB1__OneToOne_DLen1" 296 "Tst_Zyklflag_SB2__OneToOne_DLen1" 297 "Tst_Zyklflag_SB3__OneToOne_DLen1" 298 "Tst_Zyklflag_SB4__OneToOne_DLen1" 299 "Tst_Zyklflag_SB6__OneToOne_DLen1" 300 "AirCtl_mDesVal__mAirCyl_DLen1" 301 "Tst_Zyklflag_SB7__OneToOne_DLen1" 302 "CtTCtl_tClntDes__t_DLen1" 303 "PCR_pBDes__p_DLen1" 304 "BPSCD_pFltVal__p_DLen1" 305 "FrmMng_lOil_mp__lLvl_DLen1" 306 "FlMng_stMon_mp__OneToOne_DLen1" 307 "FrmMng_stChrgr1Err1__OneToOne_DLen1" 308 "FrmMng_stChrgr1Err2__OneToOne_DLen1" 309 "FrmMng_stChrgr2Err1__OneToOne_DLen1" 310 "FrmMng_stChrgr2Err2__OneToOne_DLen1" 311 "FMTC_qStrt__q_DLen1" 312 "CrCtl_trqDes__trqhigh_DLen1" 313 "CoVM_trqInc__trqhigh_DLen1" 314 "CoEng_trqInrLim__trq_DLen1" 315 "FMTC_trqInrLimSmk__trq_DLen1" 316 "EngPrt_trqLim__trq_DLen1" 317 "CoVM_trqDec__trqhigh_DLen1" 318 "FlMng_qLimSmk__q_DLen1" 319 "CrCtl_vSetPointTrgt__v_DLen1" 320 "AltCD_rAltLoad__r_DLen1" 321 "CoEng_trqInrSet__trq_DLen1" 322 "CoEng_dvolFlConsum__Cnsmp_DLen1" 323 "AirCtl_stMonitor__OneToOne_DLen1" 324 "ACCtl_stLowByte_mp__OneToOne_DLen1" 325 "EngM_stSync__OneToOne_DLen1" 326 "NetMng_stCAN__LowByte_DLen1" 327 "LSUCD_resRiClb__res_DLen1" 328 "LSUCD_uO2Clb__u_DLen1" 329 "FrmMng_stTSC__LowByte_DLen1" 330 "FrmMng_stDCS__LowByte_DLen1" 331 "LSUCD_stAdpt__OneToOne_DLen1" 332 "LSUCD_uRiRaw__u_DLen1" 333 "LSUCD_mAirAftOvrrun__mAir_DLen1" 334 "GlwCtl_tiPst_mp__tiGlw_DLen1" 335 "PCR_stPCR_mp__LowByte_DLen1" 336 "AOHt_stShutOff_mp__LowByte_DLen1" 337 "FrmMng_stTCS__LowByte_DLen1" 338 "FrmMng_trqTSC__trq_DLen1" 339 "FrmMng_trqDCS__trqhigh_DLen1" 340 "CrCCD_stKeySig__OneToOne_DLen1" 341 "CrCtl_stKeyStateSig__OneToOne_DLen1" 342 "PrpCtl_vCurrTrack_mp__v_DLen1" 343 "CtApCD_rHWE_mp__dcyc_DLen1" 344 "Gearbx_trqDec__trq_DLen1" 345 "CrCtl_stShutOffrev__LowByte_DLen1" 346 "AirCtl_stAirCtl_mp__OneToOne_DLen1" 347 "DSM_stRdyAB__LowByte_DLen1" 348 "DSM_stRdyAB__HighByte_DLen1" 349 "DSM_stRdyCD__LowByte_DLen1" 350 "DSM_stRdyCD__HighByte_DLen1" 351 "PrpBrk_trqDes__trqhigh_DLen1" 352 "DSM_ctOBDPath__OneToOne_DLen1" 353 "DSM_ctRdyActCyc_mp__OneToOne_DLen1" 354 "GlwCtl_stLogic__LowByte_DLen1" 355 "GlwCtl_tiPre__tiGlw_DLen1" 356 "FMTC_trqInr__trq_DLen1" 357 "ACCtl_stBitStructure__HighByte_DLen1" 358 "AOHt_stShutOff_mp__HighByte_DLen1" 359 "FrmMng_stTSC__HighByte_DLen1" 360 "FrmMng_stDCS__HighByte_DLen1" 361 "FrmMng_stTCS__HighByte_DLen1" 362 "CrCtl_stSwitchSig__OneToOne_DLen1" 363 "EGSys_tEGLSU__tExhaust_DLen1" 364 "AOHt_NumRly_mp__OneToOne_DLen1" 365 "DSM_ctFcmEntry__OneToOne_DLen1" 368 "GlwCtl_stLogic__HighByte_DLen1" 369 "Dfp_HWEMonUMinSupply_Low__OneToOne_DLen1" 370 "Dfp_HWEMonUMaxSupply_Low__OneToOne_DLen1" 371 "PCR_rBalGvnrDiff__r_DLen1" 372 "Dfp_SOPTst_Low__OneToOne_DLen1" 373 "UAcc_SWPartNum_cs__OneToOne_DLen1" 374 "UAcc_ECUIdentEep_cs__OneToOne_DLen1" 375 "Gearbx_stTSC_mp__OneToOne_DLen1" 376 "CoVM_stActDem__OneToOne_DLen1" 377 "CrCCD_stKey__OneToOne_DLen1" 378 "CrCtl_stShutOff__OneToOne_DLen1" 379 "FanCtl_dcycFan1__dcyc_DLen1" 380 "FanCtl_dcycFan2__dcyc_DLen1" 381 "ACCD_p__pAC_DLen1" 382 "EngPrt_trqPrtLim__trq_DLen1" 383 "ImmCtl_tiLockCount__OneToOne_DLen1" 384 "UAcc_Vin_cs__OneToOne_DLen1" 385 "UAcc_dBGWVin_cs__OneToOne_DLen1" 386 "UAcc_SigBlk80_cs__OneToOne_DLen1" 387 "UAcc_SigBlk82_cs__OneToOne_DLen1" 388 "FlSys_stFlPp__OneToOne_DLen1" 389 "AOHtCD_volFlConsum__Cnsmp_DLen1" 390 "UAcc_MWB26sum_checksum_cs__OneToOne_DLen1" 391 "BPSCD_pLin__p_DLen1" 392 "CoEng_rTrq__r_DLen1" 393 "EngM_stEngMntCtl_MLS1__OneToOne_DLen1" 394 "EngM_stEngMntCtl_MLS2__OneToOne_DLen1" 395 "EngM_stEngMntCtl_GTL1__OneToOne_DLen1" 396 "EngM_stEngMntCtl_GTL2__OneToOne_DLen1" 397 "FanCD_rFan1HWE_mp__dcyc_DLen1" 398 "FanCD_rFan2HWE_mp__dcyc_DLen1" 399 "ACCD_trqCompr__trq_DLen1" 400 "TVACD_rOut__dcyc_DLen1" 401 "PFltCD_tPre__tExhaust_DLen1" 402 "PFltCD_pDiff__p_DLen1" 403 "EGPpCD_tPreTrbn__tExhaust_DLen1" 404 "AC_pwrDes__pwr_DLen1" 405 "Alt_pwrDes__pwr_DLen1" 406 "SrvPmp_pwrDes__pwr_DLen1" 407 "SvLp_dOilLoad__NoUnit_DLen1" 408 "SvLp_dSootLoad__NoUnit_DLen1" 409 "Dfp_LSUCDCircPumpCur0_Low__OneToOne_DLen1" 410 "Dfp_LSUCDCircVirtGnd0_Low__OneToOne_DLen1" 411 "Dfp_LSUCDHtCoup0_Low__OneToOne_DLen1" 412 "Dfp_LSUCDO20_Low__OneToOne_DLen1" 413 "Dfp_LSUCDHeater0_Low__OneToOne_DLen1" 414 "Dfp_LSUCDO2Clb0_Low__OneToOne_DLen1" 415 "Dfp_LSUCDRiClb0_Low__OneToOne_DLen1" 416 "Dfp_LSUCDSPI0_Low__OneToOne_DLen1" 417 "Dfp_LSUCDWireIP0_Low__OneToOne_DLen1" 418 "Dfp_LSUCtlRiExc0_Low__OneToOne_DLen1" 419 "Dfp_LSUMonFullLd_Low__LowByte_DLen1" 420 "Dfp_LSUMonPartLd_Low__LowByte_DLen1" 421 "Dfp_HWEMonEEPROM_Low__OneToOne_DLen1" 422 "Dfp_HWEMonCom_Low__OneToOne_DLen1" 423 "Ad_NumTyp_FreeApplic1_CSTR__FreeApplic1_DLen1" 424 "Ad_NumTyp_FreeApplic2_CSTR__FreeApplic2_DLen1" 425 "Ad_NumTyp_FreeApplic3_CSTR__FreeApplic3_DLen1" 426 "Ad_NumTyp_FreeApplic4_CSTR__FreeApplic4_DLen1" 427 "AFSCD_dmAirPerTimeB2__mAirTim_DLen1" 428 "AFSCD_mAirPerCylB1__mAirCyl_DLen1" 429 "AFSCD_mAirPerCylB2__mAirCyl_DLen1" 431 "BPACD_rOut2__dcyc_DLen1" 432 "AFSCD_dmAirPerTimeB1__mAirTim_DLen1" 468 "FrmMng_stNumTOOvrFlowECU[0]__OneToOne_DLen1" 469 "FrmMng_stNumTOOvrFlowECU[1]__OneToOne_DLen1" 470 "FrmMng_stNumTOOvrFlowECU[2]__OneToOne_DLen1" 471 "FrmMng_stNumTOOvrFlowECU[3]__OneToOne_DLen1" 472 "FrmMng_stNumTOOvrFlowECU[4]__OneToOne_DLen1" 473 "FrmMng_stNumTOOvrFlowECU[5]__OneToOne_DLen1" 474 "FrmMng_stNumTOOvrFlowECU[6]__OneToOne_DLen1" 475 "FrmMng_stNumTOOvrFlowECU[7]__OneToOne_DLen1" 476 "FrmMng_stNumTOOvrFlowECU[8]__OneToOne_DLen1" 477 "FrmMng_stNumTOOvrFlowECU[9]__OneToOne_DLen1" 478 "FrmMng_stNumTOOvrFlowECU[10]__OneToOne_DLen1" 479 "FrmMng_stNumTOOvrFlowECU[11]__OneToOne_DLen1" 480 "FrmMng_stNumTOOvrFlowECU[12]__OneToOne_DLen1" 481 "FrmMng_stNumTOOvrFlowECU[13]__OneToOne_DLen1" 482 "FrmMng_stNumTOOvrFlowECU[14]__OneToOne_DLen1" 483 "FrmMng_stNumTOOvrFlowECU[15]__OneToOne_DLen1" 484 "FrmMng_stNumTOOvrFlowECU[16]__OneToOne_DLen1" 485 "FrmMng_stNumTOOvrFlowECU[17]__OneToOne_DLen1" 486 "FrmMng_stNumTOOvrFlowECU[18]__OneToOne_DLen1" 487 "FrmMng_stNumTOOvrFlowECU[19]__OneToOne_DLen1" 488 "FrmMng_stNumTOOvrFlowECU[20]__OneToOne_DLen1" 489 "FrmMng_stNumTOOvrFlowECU[21]__OneToOne_DLen1" 490 "FrmMng_stNumTOOvrFlowECU[22]__OneToOne_DLen1" 491 "FrmMng_stNumTOOvrFlowECU[23]__OneToOne_DLen1" 492 "FrmMng_stNumTOOvrFlowECU[24]__OneToOne_DLen1" 493 "FrmMng_stNumTOOvrFlowECU[25]__OneToOne_DLen1" 494 "FrmMng_stNumTOOvrFlowECU[26]__OneToOne_DLen1" 495 "FrmMng_stNumTOOvrFlowECU[27]__OneToOne_DLen1" 496 "FrmMng_stNumTOOvrFlowECU[28]__OneToOne_DLen1" 497 "FrmMng_stNumTOOvrFlowECU[29]__OneToOne_DLen1" 498 "FrmMng_stNumTOOvrFlowECU[30]__OneToOne_DLen1" 499 "FrmMng_stNumTOOvrFlowECU[31]__OneToOne_DLen1" 526 "EGRVlv_rEGR__r_DLen1" 527 "EGRSCD_rRelPos__dcyc_DLen1" 532 "BPSCD_pIntVal__p_DLen1" 533 "EGRVlv_rDesVal__dcyc_DLen1" 535 "BPASCD_rRelPos__rNeg_DLen1" 536 "FMA_qRaw_mp__qNeg_DLen1" 538 "FMA_facSwtOff__Fact_DLen1" 601 "T50CD_stRxDebVal__OneToOne_DLen1" 602 "CoEng_stEng__OneToOne_DLen1" 603 "StSysCtl_stStrtCncl__LowByte_DLen1" 604 "PrpCtl_stSPTrack_mp__OneToOne_DLen1" 605 "ACCCD_stACC__OneToOne_DLen1" 606 "InjCrv_qLmbdCtl__q_DLen1" 607 "EGSys_stHtgLSU__OneToOne_DLen1" 608 "LSUCD_dcycHtCor__dcyc_DLen1" 609 "EGSys_pExhGas__p_DLen1" 610 "EGSys_dmEG__mAirTim_DLen1" 611 "LSUCD_drO2Adpt__O2diff_DLen1" 612 "LSUCD_stCircModeNewLow__OneToOne_DLen1" 613 "LSU_stPlausChk__OneToOne_DLen1" 614 "LSU_stO2Err__LowByte_DLen1" 615 "PFlt_pPre__p_DLen1" 616 "PFlt_pDiff__pPFlt_DLen1" 617 "PFlt_tPre__tExhaust_DLen1" 623 "PFlt_pDiffOfsValAct_mp__pPFlt_DLen1" 624 "PFlt_qFl_mp__q_DLen1" 625 "PFlt_tiSnceRgn_mp__ti_DLen1" 626 "PFlt_lSnceRgn_mp__l_DLen1" 627 "PFlt_stCntRes__OneToOne_DLen1" 628 "PFlt_numEngPOp_mp__OneToOne_DLen1" 629 "FMA_qIC__qdiff_DLen1" 630 "FMA_stSwtOff__LowByte_DLen1" 631 "EEPCD_stErrSet__OneToOne_DLen1" 632 "EEPCD_stOptErrCodSet__OneToOne_DLen1" 633 "CtTCtl_dcycThst__dcyc_DLen1" 634 "CtTCtl_stCtl__OneToOne_DLen1" 635 "EATSCD_tAir__t_DLen1" 636 "HDSCD_prcAir__r_DLen1" 638 "LSUCD_uO2Raw__u_DLen1" 639 "LSUCD_rO2Adpt__r_DLen1" 640 "PFlt_pDiffOfsValOld_mp__pPFlt_DLen1" 643 "ConvCD_stIlsDebVal__OneToOne_DLen1" 644 "StSysCtl_stT50CDOn__OneToOne_DLen1" 645 "StSysCtl_stT50CDOff__OneToOne_DLen1" 646 "T50CD_stDebVal__OneToOne_DLen1" 653 "AirCtl_mMaxDev_mp__mAirCylGov_DLen1" 654 "AirCtl_mMinDev_mp__mAirCylGov_DLen1" 655 "AirCtl_stDebDef__OneToOne_DLen1" 656 "AFSCD_stPlSetyDrft_mp__LowByte_DLen1" 657 "AFSCD_rAirNorm__Fact_DLen1" 658 "NetMng_stCAN__HighByte_DLen1" 659 "NetMng_stCAN__Byte2_DLen1" 660 "NetMng_stCAN__Byte3_DLen1" 661 "PCR_stPCR_mp__HighByte_DLen1" 662 "CrCtl_stShutOffrev__HighByte_DLen1" 663 "CrCtl_stShutOffrev__Byte2_DLen1" 664 "CrCtl_stShutOffrev__Byte3_DLen1" 665 "LSU_stO2Err__HighByte_DLen1" 666 "FMA_stSwtOff__HighByte_DLen1" 667 "AFSCD_stPlSetyDrft_mp__HighByte_DLen1" 671 "CARB_TstNotUsedMaxU__LowByte_DLen2" 672 "CARB_TstNotUsedMinU__LowByte_DLen2" 673 "CARB_TstNotUsedMaxS__LowByte_DLen2" 674 "CARB_TstNotUsedMinS__LowByte_DLen2" 675 "CARB_TstNotUsedTrue__LowByte_DLen2" 676 "CARB_TstNotUsedFalse__LowByte_DLen2" 681 "CoEng_dvolFlConsAllTot__Cnsmp_DLen1" 682 "EGT_st__Byte3_DLen1" 683 "EGT_st__Byte2_DLen1" 684 "EGT_st__HighByte_DLen1" 685 "EGT_st__LowByte_DLen1" 687 "LSUCD_stO2Valid__LowByte_DLen1" 688 "AirCtl_stEGRClgBypVlv__LowByte_DLen1" 689 "FQlSCD_rFlQlLin__ratio_DLen1" 690 "GlwCD_stLampOut__LowByte_DLen1" 691 "GlwCD_stOutHWE_mp__LowByte_DLen1" 692 "GlwCD_rGSK__dcyc_DLen1" 693 "FlPpCD_stFlPp__LowByte_DLen1" 694 "AFVCD_stActrOut__LowByte_DLen1" 695 "FrmMng_prcFan__dcyc_DLen1" 696 "EGPpCD_tLinPreTrbn__tExhaust_DLen1" 697 "EngPrt_facPrtLimCorr__Fact_DLen1" 698 "EngPrt_tPreTrbn__t_DLen1" 699 "FrmMng_trqFrcCan__trq_DLen1" 700 "CoVeh_trqAcs__trq_DLen1" 701 "CoEng_trqMin__trq_DLen1" 702 "BPSCD_pAvgDiff__pDiff_DLen1" 703 "IndSys_pAdj__pDiff_DLen1" 704 "BPSCD_ctAvg__OneToOne_DLen1" 705 "CtT_stCondMon__LowByte_DLen1" 706 "CtT_tAir__t_DLen1" 707 "SvLp_dOilLoadWIV2__NoUnitII_DLen1" 708 "SvLp_dSootLoadWIV2__NoUnitII_DLen1" 709 "CARB_stRdyCurrABCD__LowByte_DLen1" 710 "CARB_stRdyCurrABCD__HighByte_DLen1" 711 "CARB_stRdyCurrABCD__Byte2_DLen1" 712 "CARB_stRdyCurrABCD__Byte3_DLen1" 713 "CtT_stCondMon__HighByte_DLen1" 714 "CoEng_ctUnpla__OneToOne_DLen1" 716 "SvLpCD_ltmpMin2__lLvl2_DLen1" 717 "FanCtl_prcAddReq__r_DLen1" 718 "Dfp_LSUMonOvrRun_Low__LowByte_DLen1" 719 "Dfp_LSUMonDyn_Low__LowByte_DLen1" 720 "APPCD_rRawAPP1__r_DLen1" 721 "APPCD_rRawAPP2__r_DLen1" 722 "APPCD_rKDThres__r_DLen1" 727 "Shtrp_ctRemain__OneToOne_DLen1" 728 "Shtrp_numCurrTst__OneToOne_DLen1" 729 "CrCtl_stShutOffrevSig__LowByte_DLen1" 730 "CrCtl_stShutOffirevSig__LowByte_DLen1" 731 "ACCCD_trqDes__trqhigh_DLen1" 732 "ACC_trqDes__trqhigh_DLen1" 733 "ACC_trqBrk__trqhigh_DLen1" 734 "ACCCD_stACC__OneToOne_DLen1__2" 735 "ACCCD_stBrkErr_mp__OneToOne_DLen1" 736 "ACCCD_stSensErr_mp__OneToOne_DLen1" 737 "ACC_stState__OneToOne_DLen1" 738 "ACCCD_aDes__a_DLen1" 739 "ACCCD_phiRoad__phi2_DLen1" 740 "ACC_rBrkDes__r_DLen1" 748 "TVASCD_rRelPos__dcyc_DLen1" 750 "ThrVlv_rDesVal__dcyc_DLen1" 751 "ThrVlv_stMon__LowByte_DLen1" 752 "ThrVlv_stMon__HighByte_DLen1" 753 "ThrVlv_rTVA__dcyc_DLen1" 755 "StSysCtl_stStrtCncl_mp__LowByte_DLen1" 756 "StSysCtl_stStrtCncl_mp__HighByte_DLen1" 757 "FrmMng_rChrgr1Actr__dcyc_DLen1" 758 "FrmMng_tChrgr1ASIC__tExhaust_DLen1" 759 "FrmMng_rChrgr2Actr__dcyc_DLen1" 760 "FrmMng_tChrgr2ASIC__tExhaust_DLen1" 761 "Shtrp_ActFreeTstTog__OneToOne_DLen1" 762 "PFlt_tSimPstPFlt_mp__tExhaust_DLen1" 763 "FrmMng_volFuelFil__volLiter_DLen1" 764 "CtT_tClntMod__t_DLen1" 765 "InjCrv_stT3Dia_mp__LowByte_DLen1" 766 "InjCrv_stT3Dia_mp__HighByte_DLen1" 767 "InjCrv_ctT3DiaMin_mp__OneToOne_DLen1" 768 "InjCrv_tT3DiaMin_mp__tExhaust_DLen1" 769 "EGRCD_stCBVOutHWE_mp__LowByte_DLen1" 770 "FlClgCD_stFlClg__LowByte_DLen1" 771 "DIUMPR_ctIgn_mp__ct_DLen1" 772 "DIUMPR_ctGenDenom_mp__ct_DLen1" 773 "TVASCD_rDrftOpn_mp__dcycNeghighres_DLen1" 774 "TVASCD_rDrftCls_mp__dcycNeghighres_DLen1" 775 "WDASCD_stWntrSwtVal__LowByte_DLen1" 776 "WDASCD_stWntrLogVal_mp__LowByte_DLen1" 777 "PFlt_stRlsPlausTemp__OneToOne_DLen1" 778 "PFlt_stRlsPlausTempPrePFlt__OneToOne_DLen1" 779 "PFlt_stRlsPlausTempPreOxiC__OneToOne_DLen1" 780 "PFlt_stRlsPlausTempPreTrbn__OneToOne_DLen1" 781 "PFlt_stRlsPlausTempPstPFlt__OneToOne_DLen1" 1000 "BIP_tiDvtFltMI1[1]__tius_DLen1" 1001 "BIP_tiDvtFltMI1[2]__tius_DLen1" 1002 "BIP_tiDvtFltMI1[3]__tius_DLen1" 1003 "BIP_tiDvtFltMI1[4]__tius_DLen1" 1004 "BIP_tiDvtFltMI1[5]__tius_DLen1" 1005 "BIP_tiDvtFltMI1[6]__tius_DLen1" 1006 "BIP_tiDvtFltMI1[7]__tius_DLen1" 1007 "BIP_tiDvtFltMI1[8]__tius_DLen1" 1008 "BIP_tiDvtFltMI1[9]__tius_DLen1" 1009 "BIP_tiDvtFltMI1[10]__tius_DLen1" 1010 "BIPCD_stBIPDetMI1[1]__OneToOne_DLen1" 1011 "BIPCD_stBIPDetMI1[2]__OneToOne_DLen1" 1012 "BIPCD_stBIPDetMI1[3]__OneToOne_DLen1" 1013 "BIPCD_stBIPDetMI1[4]__OneToOne_DLen1" 1014 "BIPCD_stBIPDetMI1[5]__OneToOne_DLen1" 1015 "BIPCD_stBIPDetMI1[6]__OneToOne_DLen1" 1016 "BIPCD_stBIPDetMI1[7]__OneToOne_DLen1" 1017 "BIPCD_stBIPDetMI1[8]__OneToOne_DLen1" 1018 "BIPCD_stBIPDetMI1[9]__OneToOne_DLen1" 1019 "BIPCD_stBIPDetMI1[10]__OneToOne_DLen1" 1020 "EngM_phiCaSOfsCorr__phi_DLen1" 1021 "InjVCD_stInjVlv_mp__OneToOne_DLen1" 1022 "AFSCD_rAirThrHiPlHi_mp__Fact_DLen1" 1023 "AFSCD_rAirThrLoPlLo_mp__Fact_DLen1" 1024 "InjCrv_qPoI2Des__q_DLen1" 1025 "InjCrv_phiPoI2Des__phiHResol_DLen1" 1026 "InjVlv_phiPoI2Dur__phi_DLen1" 1027 "InjVlv_phiPiI1DurCorr__phi_DLen1" 1028 "InjCrv_qPiI1Des__q_DLen1" 1029 "InjCrv_phiPiI1Des__phiHResol_DLen1" 1030 "InjCrv_qPoI2LmbdOfs__q_DLen1" 1031 "PFlt_tiSumRgnMaxTmr__tisecond_DLen1" 1032 "PFlt_rAshLdLrn_mp__r_DLen1" 1033 "PFlt_rSotSimPres__r_DLen1" 1034 "PFlt_lSum_mp__l_DLen1" 1035 "PFlt_ctRgnLck__LowByte_DLen1" 1036 "PFlt_stCntRes__LowByte_DLen1" 1037 "PFlt_tiOp_mp__tiHour_DLen1" 1038 "IndSys_swtVacMonOn__OneToOne_DLen1" 1044 "BPASCD_rLinRelPos__r_DLen1" 1045 "VSACD_rOut__rNeg_DLen1" 1046 "BIPCD_stBIPDetPiI1[1]__OneToOne_DLen1" 1047 "BIPCD_stBIPDetPiI1[2]__OneToOne_DLen1" 1048 "BIPCD_stBIPDetPiI1[3]__OneToOne_DLen1" 1049 "BIPCD_stBIPDetPiI1[4]__OneToOne_DLen1" 1050 "BIPCD_stBIPDetPiI1[5]__OneToOne_DLen1" 1051 "BIPCD_stBIPDetPiI1[6]__OneToOne_DLen1" 1052 "BIPCD_stBIPDetPiI1[7]__OneToOne_DLen1" 1053 "BIPCD_stBIPDetPiI1[8]__OneToOne_DLen1" 1054 "BIPCD_stBIPDetPiI1[9]__OneToOne_DLen1" 1055 "BIPCD_stBIPDetPiI1[10]__OneToOne_DLen1" 1056 "BIPCD_stBIPDetPoI2[1]__OneToOne_DLen1" 1057 "BIPCD_stBIPDetPoI2[2]__OneToOne_DLen1" 1058 "BIPCD_stBIPDetPoI2[3]__OneToOne_DLen1" 1059 "BIPCD_stBIPDetPoI2[4]__OneToOne_DLen1" 1060 "BIPCD_stBIPDetPoI2[5]__OneToOne_DLen1" 1061 "BIPCD_stBIPDetPoI2[6]__OneToOne_DLen1" 1062 "BIPCD_stBIPDetPoI2[7]__OneToOne_DLen1" 1063 "BIPCD_stBIPDetPoI2[8]__OneToOne_DLen1" 1064 "BIPCD_stBIPDetPoI2[9]__OneToOne_DLen1" 1065 "BIPCD_stBIPDetPoI2[10]__OneToOne_DLen1" 1066 "BIP_tiDvtFltPiI1[1]__tius_DLen1" 1067 "BIP_tiDvtFltPiI1[2]__tius_DLen1" 1068 "BIP_tiDvtFltPiI1[3]__tius_DLen1" 1069 "BIP_tiDvtFltPiI1[4]__tius_DLen1" 1070 "BIP_tiDvtFltPiI1[5]__tius_DLen1" 1071 "BIP_tiDvtFltPiI1[6]__tius_DLen1" 1072 "BIP_tiDvtFltPiI1[7]__tius_DLen1" 1073 "BIP_tiDvtFltPiI1[8]__tius_DLen1" 1074 "BIP_tiDvtFltPiI1[9]__tius_DLen1" 1075 "BIP_tiDvtFltPiI1[10]__tius_DLen1" 1076 "BIP_tiDvtFltPoI2[1]__tius_DLen1" 1077 "BIP_tiDvtFltPoI2[2]__tius_DLen1" 1078 "BIP_tiDvtFltPoI2[3]__tius_DLen1" 1079 "BIP_tiDvtFltPoI2[4]__tius_DLen1" 1080 "BIP_tiDvtFltPoI2[5]__tius_DLen1" 1081 "BIP_tiDvtFltPoI2[6]__tius_DLen1" 1082 "BIP_tiDvtFltPoI2[7]__tius_DLen1" 1083 "BIP_tiDvtFltPoI2[8]__tius_DLen1" 1084 "BIP_tiDvtFltPoI2[9]__tius_DLen1" 1085 "BIP_tiDvtFltPoI2[10]__tius_DLen1" 1086 "PFlt_tFlt__tExhaust_DLen1" 1087 "PFlt_mAshTrmTot__mAsh_DLen1" 1089 "PFlt_rSotRatFlt_mp__r_DLen1" 1091 "PFlt_stCntRes__OneToOne_DLen1__2" 1092 "AddPCD_numStrkRem_mp__stroke_DLen1" 1093 "AddPmp_volAddTotDia_mp__vol_DLen1" 1094 "AddPmp_volAddDia_mp__volHigh_DLen1" 1095 "AddPmp_rAdd_mp__MLperL_DLen1" 1096 "EGRSCD_rOfsLrnLst__dcycNeg_DLen1" 1097 "EGRSCD_stAdapt__LowByte_DLen1" 1098 "BPASCD_rOfs__dcycNeg_DLen1" 1099 "BPASCD_stOfs__LowByte_DLen1" 1100 "FlSCD_volTotal__volLiter_DLen1" 1101 "UAcc_sigEnvDat[0]__LowByte_DLen1" 1102 "UAcc_sigEnvDat[1]__LowByte_DLen1" 1103 "UAcc_sigEnvDat[2]__LowByte_DLen1" 1104 "UAcc_sigEnvDat[3]__LowByte_DLen1" 1105 "UAcc_sigEnvDat[4]__LowByte_DLen1" 1106 "UAcc_sigEnvDat[5]__LowByte_DLen1" 1107 "UAcc_sigEnvDat[6]__LowByte_DLen1" 1108 "PFlt_tPst__tExhaust_DLen1" 1109 "GlwCD_rGSK__r_DLen1" 1110 "AddPCD_uTnkLvlRawVal__u_DLen1" 1111 "InjCrv_stPoI2LmbdT3Ctl__LowByte_DLen1" 1112 "PFlt_tSimPreTrbn_mp__tExhaust_DLen1" 1113 "PFlt_tSimPrePFlt_mp__tExhaust_DLen1" 1114 "DIUMPR_rMBGrp[0]__rDIUMPR_DLen1" 1115 "DIUMPR_rMBGrp[1]__rDIUMPR_DLen1" 1116 "DIUMPR_rMBGrp[2]__rDIUMPR_DLen1" 1117 "DIUMPR_rMBGrp[3]__rDIUMPR_DLen1" 1118 "DIUMPR_rMBGrp[4]__rDIUMPR_DLen1" 1119 "DIUMPR_rMBGrp[5]__rDIUMPR_DLen1" 1120 "DIUMPR_rMBGrp[6]__rDIUMPR_DLen1" 1121 "DIUMPR_rMBGrp[7]__rDIUMPR_DLen1" 1122 "DIUMPR_rMBGrp[8]__rDIUMPR_DLen1" 1123 "DIUMPR_rMBGrp[9]__rDIUMPR_DLen1" 1124 "DIUMPR_rMBGrp[10]__rDIUMPR_DLen1" 1125 "DIUMPR_rMBGrp[11]__rDIUMPR_DLen1" 1126 "DIUMPR_rMBGrp[12]__rDIUMPR_DLen1" 1127 "DIUMPR_rMBGrp[13]__rDIUMPR_DLen1" 1128 "DIUMPR_rMBGrp[14]__rDIUMPR_DLen1" 1129 "PFlt_dvol__dvol_DLen1" 1130 "PFlt_pDiffMinSty_mp__pPFlt_DLen1" 1131 "PFltCD_tPst__tExhaust_DLen1" 1132 "InjCrv_stPoI2LmbdT3Ctl__LowByte_DLen1__2" 1133 "InjCrv_tT3DiaPreNomFlt_mp__tExhaust_DLen1" 1134 "EGRSCD_rTmpOfs__dcycNeghighres_DLen1" 1147 "PFlt_rSotSimMax__r_DLen1" 1148 "EGSys_tOxiCatBrik[0]__tExhaust_DLen1" 1149 "EGSys_tOxiCatBrik[1]__tExhaust_DLen1" 1150 "PFlt_rSotSimTemp__r_DLen1" 1151 "PFlt_facArrhThm_mp__facArrh_DLen1" 1152 "PFlt_mSotSimTemp__mSot_DLen1" /end COMPU_VTAB
/begin COMPU_METHOD SpecificHeat "spezifische Waermekapazitaet einer Substanz" RAT_FUNC "%7.6" "[J/g/K]" COEFFS 0 10000 0 0 0 1 /end COMPU_METHOD
/begin COMPU_METHOD SysLampMode "Verbale Umrechnung für DSM_SysLampMode_C" TAB_VERB "%6.3" "" COMPU_TAB_REF SysLampMode /end COMPU_METHOD
/begin COMPU_VTAB SysLampMode "Verbale Umrechnung für DSM_SysLampMode_C" TAB_VERB 3 0 "controlled by entry defect Status" 1 "controlled by FCM Statemachine" 2 "controlled by dfp Status" /end COMPU_VTAB
/begin COMPU_METHOD TempDiff_Kelv "Offsettemperatur dargestellt in [K]" RAT_FUNC "%6.3" "[ deg C ]" COEFFS 0 10 0 0 0 1 /end COMPU_METHOD
/begin COMPU_METHOD Temp_Cels "Temperatur dargestellt in °C (gleiche interne Darstellung wie Temp_Kelv)" RAT_FUNC "%6.1" "[deg C]" COEFFS 0 10 2731.4 0 0 1 /end COMPU_METHOD
/begin COMPU_METHOD ThermalCoEff "Waermekoeffiziens einer Substanz" RAT_FUNC "%6.3" "[W/m/m/K]" COEFFS 0 10 0 0 0 1 /end COMPU_METHOD
/begin COMPU_METHOD TimeDeb "Entprellzeit in Millisekunden für Libraryfunktion Debounce" RAT_FUNC "%6.1" "[ms]" COEFFS 0 0.1 0 0 0 1 /end COMPU_METHOD
/begin COMPU_METHOD TimeDelay_s "Zeitkonstante T1 (in s) für PT1, DT1, etc." RAT_FUNC "%9.3" "[s]" COEFFS 0 0 1 0 0.00023283064365387 0 /end COMPU_METHOD
/begin COMPU_METHOD TimeDsmDC "Skalierung Zeit DSM Driving cycle Verzögerung" RAT_FUNC "%6.2" "[s]" COEFFS 0 1 0 0 0 1 /end COMPU_METHOD
/begin COMPU_METHOD TimeDT "Abtastzeit (in us) für Library Regler, Filter, etc." RAT_FUNC "%6.2" "[us]" COEFFS 0 1 0 0 0 1 /end COMPU_METHOD
/begin COMPU_METHOD TimeEGTRmp "Umrechnung  Zeit in Rampensteigung,  Verwendet in EGT-Bibliothek" RAT_FUNC "%6.3" "[s]" COEFFS 0 0 1 0 0.0152587890625 0 /end COMPU_METHOD
/begin COMPU_METHOD TimeSys_us "Zeit in [us] mit Systemzeit-Auflösung" RAT_FUNC "%6.3" "us" COEFFS 0 3.4965 0 0 0 1 /end COMPU_METHOD
/begin COMPU_METHOD Time_ms "Zeit in ms für Fehlerentprellung (DSM) und SW-Timer" RAT_FUNC "%6.1" "[ms]" COEFFS 0 0.1 0 0 0 1 /end COMPU_METHOD
/begin COMPU_METHOD Time_s "Zeit in s für Fehlerentprellung (DSM) und SW-Timer" RAT_FUNC "%6.4" "[s]" COEFFS 0 100 0 0 0 1 /end COMPU_METHOD
/begin COMPU_METHOD Time_us "Zeit in Mikrosekunden für Fehlerentprellung (DSM) und SW-Timer" RAT_FUNC "%8.0" "[us]" COEFFS 0 0.0001 0 0 0 1 /end COMPU_METHOD
/begin COMPU_METHOD TransR "Übersetzungsverhältnis (Getriebe etc.)" RAT_FUNC "%6.4" "[-]" COEFFS 0 100 0 0 0 1 /end COMPU_METHOD
/begin COMPU_METHOD Trq "Motormoment" RAT_FUNC "%6.3" "[Nm]" COEFFS 0 10 0 0 0 1 /end COMPU_METHOD
/begin COMPU_METHOD TrqPrpHigh "vortriebsmoment" RAT_FUNC "%6.3" "[Nm]" COEFFS 0 10 0 0 0 1 /end COMPU_METHOD
/begin COMPU_METHOD TurboN "Turboladerdrehzahl" RAT_FUNC "%6.1" "[rpm]" COEFFS 0 1 0 0 0 10 /end COMPU_METHOD
/begin COMPU_METHOD Vel "Fahrzeuggeschwindigkeit, gleiche interne Auflösung wie Vel_SI" RAT_FUNC "%6.4" "[km/h]" COEFFS 0 100 0 0 0 1 /end COMPU_METHOD
/begin COMPU_METHOD VlvVel "AGR Ventilgeschwindigkeit" RAT_FUNC "%6.3" "%/s" COEFFS 0 10 0 0 0 1 /end COMPU_METHOD
/begin COMPU_METHOD Volt "Spannung in V (von ADC)" RAT_FUNC "%6.2" "[mV]" COEFFS 0 0.2046 0 0 0 1 /end COMPU_METHOD
/begin COMPU_METHOD Volt_Batt "Batteriespannung" RAT_FUNC "%6.1" "[mV]" COEFFS 0 0.0492252911173131 0 0 0 1 /end COMPU_METHOD
/begin COMPU_METHOD defaultAscii "" RAT_FUNC "%6.2" "" COEFFS 0 1 0 0 0 1 /end COMPU_METHOD
/begin RECORD_LAYOUT Kf_Xs16_Ys16_Ws16 NO_AXIS_PTS_X 1 SWORD NO_AXIS_PTS_Y 2 SWORD AXIS_PTS_X 3 SWORD INDEX_INCR DIRECT AXIS_PTS_Y 4 SWORD INDEX_INCR DIRECT FNC_VALUES 5 SWORD COLUMN_DIR DIRECT /end RECORD_LAYOUT
/begin RECORD_LAYOUT Kl_Xs16_Ws16 NO_AXIS_PTS_X 1 SWORD AXIS_PTS_X 2 SWORD INDEX_INCR DIRECT FNC_VALUES 3 SWORD COLUMN_DIR DIRECT /end RECORD_LAYOUT
/begin RECORD_LAYOUT Ktx FNC_VALUES 1 UBYTE COLUMN_DIR DIRECT /end RECORD_LAYOUT
/begin RECORD_LAYOUT Kwb_Ws16 FNC_VALUES 1 SWORD COLUMN_DIR DIRECT /end RECORD_LAYOUT
/begin RECORD_LAYOUT Kwb_Wu16 FNC_VALUES 1 UWORD COLUMN_DIR DIRECT /end RECORD_LAYOUT
/begin RECORD_LAYOUT Kwb_Wu32 FNC_VALUES 1 ULONG COLUMN_DIR DIRECT /end RECORD_LAYOUT
/begin RECORD_LAYOUT Kwb_Wu8 FNC_VALUES 1 UBYTE COLUMN_DIR DIRECT /end RECORD_LAYOUT
/begin RECORD_LAYOUT Kw_Ws16 FNC_VALUES 1 SWORD COLUMN_DIR DIRECT /end RECORD_LAYOUT
/begin RECORD_LAYOUT Kw_Ws32 FNC_VALUES 1 SLONG COLUMN_DIR DIRECT /end RECORD_LAYOUT
/begin RECORD_LAYOUT Kw_Ws8 FNC_VALUES 1 SBYTE COLUMN_DIR DIRECT /end RECORD_LAYOUT
/begin RECORD_LAYOUT Kw_Wu16 FNC_VALUES 1 UWORD COLUMN_DIR DIRECT /end RECORD_LAYOUT
/begin RECORD_LAYOUT Kw_Wu32 FNC_VALUES 1 ULONG COLUMN_DIR DIRECT /end RECORD_LAYOUT
/begin RECORD_LAYOUT Kw_Wu8 FNC_VALUES 1 UBYTE COLUMN_DIR DIRECT /end RECORD_LAYOUT
/begin FUNCTION DSM_global "Globale DSM Konfigurationsparameter"
 /begin DEF_CHARACTERISTIC DSM_FCMClear_C DSM_FrzFrEnvironment_C DSM_FrzFrExtEnv_C DSM_RdyABForceMsk_C DSM_RdyCDForceMsk_C DSM_RdyOnMilEnable_C DSM_SysLampMode_C DSM_WucMinDiff_C DSM_WucMinTemp_C DSM_numSelDfp_C DSM_stStepWidth_CA DSM_tiDCMin_C DSM_tiWucDelay_C DTR_limKLine_CA DTR_numCANOBDMId_CA DTR_numCANTestId_CA DTR_numKLineCmpntId_CA DTR_numKLineTestId_CA /end DEF_CHARACTERISTIC
/end FUNCTION
/begin FUNCTION Diff_TrqLim "Momentenlimitierung für Planentennachgelege"
 /begin DEF_CHARACTERISTIC Diff_dtrqCANerrNeg_C Diff_dtrqCANerrPos_C Diff_trqCANerrMax_C /end DEF_CHARACTERISTIC
/end FUNCTION
/begin FUNCTION Driver "Fahrerwunsch" /begin SUB_FUNCTION AccPed /end SUB_FUNCTION /end FUNCTION
/begin FUNCTION Drivetrain "Antriebsstrang"
 /begin SUB_FUNCTION CoDT Conv DrvTrn_CalcRTransDT Gearbx VehDa_lSumCalc VehDa_rVnCalc /end SUB_FUNCTION
/end FUNCTION
/begin FUNCTION DrvTrn_CalcRTransDT "Berechnung der Triebstrangübersetzung"
 /begin DEF_CHARACTERISTIC DrvTrn_drSlpNeg_C DrvTrn_drSlpPos_C DrvTrn_rTransDTInit_C DrvTrn_stSigCVTVal_C DrvTrn_swtNotFrozen_C DrvTrn_swtSigCVT_C DrvTrn_swtSigVal_C /end DEF_CHARACTERISTIC
/end FUNCTION
/begin FUNCTION EATSCD "Umgebungslufttemperaturerfassung" /begin SUB_FUNCTION EATSCD_Co /end SUB_FUNCTION /end FUNCTION
/begin FUNCTION EATSCD_Co "Umgebungslufttemperaturerfassung"
 /begin DEF_CHARACTERISTIC EATSCD_DebCanDefOk_C EATSCD_DebCanInacDef_C EATSCD_DebCanInacOk_C EATSCD_DebCanNotImplDef_C EATSCD_DebCanNotImplOk_C EATSCD_DebSRCHighDef_C EATSCD_DebSRCHighOk_C EATSCD_DebSRCLowDef_C EATSCD_DebSRCLowOk_C EATSCD_dtRmpSlpDwn_C EATSCD_dtRmpSlpUp_C EATSCD_stSensIDWord_C EATSCD_swtSigType_C EATSCD_swtSigVal_C EATSCD_tDfl_C EATSCD_tLin_CUR EATSCD_uSRCMax_C EATSCD_uSRCMin_C /end DEF_CHARACTERISTIC
/end FUNCTION
/begin FUNCTION ECUMon "Überwachung Motorsteuerung" /begin SUB_FUNCTION ARnMon HWEMon TPUMon WDCom /end SUB_FUNCTION /end FUNCTION
/begin FUNCTION ECU_Grp "Motorsteuerung"
 /begin SUB_FUNCTION ADCMon CoEng_Afterrun CoEng_stEngCalc ECUMon ECU_SwtToBoot EepInit LockCnt MRlyCD_Co MS TstSeq /end SUB_FUNCTION
/end FUNCTION
/begin FUNCTION ECU_SwtToBoot "Umschalten zum Bootblock während normalen Fahrbetrieb über KW2000" /begin DEF_CHARACTERISTIC ECU_vPrgThres_C /end DEF_CHARACTERISTIC /end FUNCTION
/begin FUNCTION EEPCD_VarMng "Variantenmanager zur Unterstützung verschiedener Ausstattungsmerkmale durch Ablage im Eeprom"
 /begin DEF_CHARACTERISTIC EEPCD_DsSWT1_KSK_C EEPCD_DsSWT1_SWTCC_C EEPCD_DsSWT2_CCTYPE_C EEPCD_DsSWT2_EATS_C EEPCD_DsSWT2_OTS_C /end DEF_CHARACTERISTIC
/end FUNCTION
/begin FUNCTION EGPpCD_GetTempPreTrbn "Komponententreiber für die Abgastemperatur vor der Turbine"
 /begin DEF_CHARACTERISTIC EGPpCD_DebSRCHighDefTemp_C EGPpCD_DebSRCHighOkTemp_C EGPpCD_DebSRCLowDefTemp_C EGPpCD_DebSRCLowOkTemp_C EGPpCD_dtRmpSlpDwnTemp_C EGPpCD_dtRmpSlpUpTemp_C EGPpCD_stSensIDWordTemp_C EGPpCD_swtActvTPreTrbn_C EGPpCD_swtFltTempPreTrbn_C EGPpCD_tDflTemp_C EGPpCD_tLinTemp_CUR EGPpCD_uSRCMaxTemp_C EGPpCD_uSRCMinTemp_C /end DEF_CHARACTERISTIC
/end FUNCTION
/begin FUNCTION EGPp_PresCalc "Berechnung des Abgasdruckes"
 /begin DEF_CHARACTERISTIC EGPp_facGeoSil_C EGPp_facPow_CUR EGPp_facRhoEta_CUR EGPp_pPstPFltEG_MAP EGPp_pPstPFlt_MAP EGPp_swtPresCalcMod_C EGPp_swtPresCalc_C EGPp_tiPresFltPT1_C /end DEF_CHARACTERISTIC
/end FUNCTION
/begin FUNCTION EGRCD_ClgByp "Komponententreiber für den Kühlerbypass der Abgasrückführung" /begin DEF_CHARACTERISTIC SigTst_EGRClgBypVlvEn_C /end DEF_CHARACTERISTIC /end FUNCTION
/begin FUNCTION EGRCD_ClntByp "EGR-Kühler Bypass Ventilansteuerung"
 /begin DEF_CHARACTERISTIC EGRCD_CBVDebExcTempDef_C EGRCD_CBVDebExcTempOK_C EGRCD_CBVDebNoLoadDef_C EGRCD_CBVDebNoLoadOK_C EGRCD_CBVDebShortCircBatDef_C EGRCD_CBVDebShortCircBatOK_C EGRCD_CBVDebShortCircGndDef_C EGRCD_CBVDebShortCircGndOK_C EGRCD_ctCBVPwrStgOnMax_C EGRCD_stCBVInvOut_C EGRCD_stCBVPwrStgActv_C EGRCD_stCBVPwrStgDia_C EGRCD_stCBVSPICtl_C EGRCD_tiBtwTstCBV_C EGRCD_tiCBVPwrStgOn_C /end DEF_CHARACTERISTIC
/end FUNCTION
/begin FUNCTION EGRCD_Co "Komponententreiber Abgasrückführsteller"
 /begin DEF_CHARACTERISTIC EGRCD_DebExcTempDef_C EGRCD_DebExcTempOk_C EGRCD_DebNoLoadDef_C EGRCD_DebNoLoadOk_C EGRCD_DebShortCircBatDef_C EGRCD_DebShortCircBatOk_C EGRCD_DebShortCircGndDef_C EGRCD_DebShortCircGndOk_C EGRCD_DebSigDef_C EGRCD_DebSigOk_C EGRCD_ctPwrStgOnMax_C EGRCD_facLpGnStrt_C EGRCD_numDia_C EGRCD_numDisCJ220_C EGRCD_numPwmOut1_C EGRCD_numPwmOut2_C EGRCD_numPwmOut_C EGRCD_numStCJ220_C EGRCD_rCnv_MAP EGRCD_rOutDfl_C EGRCD_rOutMax_C EGRCD_rOutMin_C EGRCD_rTst_C EGRCD_stDisInvOut_C EGRCD_stInvOut_C EGRCD_stInvStCJ220_C EGRCD_stPwrStgActv_C EGRCD_stPwrStgDia_C EGRCD_stSPICtl_C EGRCD_swtLSPwrStgOn_C EGRCD_swt_C EGRCD_tiBtwTst_C EGRCD_tiPT1FacCor_C EGRCD_tiPer_C EGRCD_tiPwrStgOn_C SigTst_EGREn_C /end DEF_CHARACTERISTIC
/end FUNCTION
/begin FUNCTION EGRCD_Monitor_Proc "AGR klemmt in geschlossener Position,  positiv diagnostiziert"
 /begin DEF_CHARACTERISTIC ACCCD_tiBrkTrqDet_C ACCCD_tiWrongCodedDebDef_C ACCCD_tiWrongCodedDebOk_C ACCCD_trqBrkDetDwn_C ACCCD_trqBrkDetUp_C /end DEF_CHARACTERISTIC
/end FUNCTION
/begin FUNCTION EGRSCD_Co "Exhaust Gas actuator position Sensor"
 /begin DEF_CHARACTERISTIC EGRSCD_DebSRCHighDef_C EGRSCD_DebSRCHighOk_C EGRSCD_DebSRCLowDef_C EGRSCD_DebSRCLowOk_C EGRSCD_IKiDwn_C EGRSCD_IKiUp_C EGRSCD_drRmpSlpDwn_C EGRSCD_drRmpSlpUp_C EGRSCD_facAdaptClsStrt_C EGRSCD_facAdaptPosCls_C EGRSCD_numAdaptClsMax_C EGRSCD_numAdc_C EGRSCD_rAdaptAgOpnMax_C EGRSCD_rAdaptAgOpnMin_C EGRSCD_rAdaptDiffPlausLgTime_C EGRSCD_rAdaptDiffPlausShTime_C EGRSCD_rAdaptDiffPlaus_C EGRSCD_rAdaptInitOpn0_C EGRSCD_rAdaptInitOpn_C EGRSCD_rAdaptOpnBnd_C EGRSCD_rCmpNewCtlUn_C EGRSCD_rDfl_C EGRSCD_rLin_CUR EGRSCD_rMax_C EGRSCD_rMin_C EGRSCD_rPullDwnMax_C EGRSCD_rPullDwnMin_C EGRSCD_rPullDwnThres_C EGRSCD_rRelPosOfs_C EGRSCD_rSensVlvThres_C EGRSCD_rTmpOfsLrnMax_C EGRSCD_rTmpOfsLrnMin_C EGRSCD_stNewVlvTrg_C EGRSCD_stOfsLrnTrg_C EGRSCD_stSensIDWord_C EGRSCD_swtRelPosOfs_C EGRSCD_tEngMax_C EGRSCD_tEngMin_C EGRSCD_tiAdaptJamVlv_C EGRSCD_tiAdaptPullDwn_C EGRSCD_tiClsJamVlv_C EGRSCD_uBattMax_C EGRSCD_uBattMin_C EGRSCD_uRawSRCMax_C EGRSCD_uRawSRCMin_C /end DEF_CHARACTERISTIC
/end FUNCTION
/begin FUNCTION EGRVlv_Mon "Lageregelung für ARF-Ventil - Überwachung und Abschaltung"
 /begin DEF_CHARACTERISTIC EGRVlv_DebGvnrDvtMaxDef_C EGRVlv_DebGvnrDvtMaxOk_C EGRVlv_DebGvnrDvtMinDef_C EGRVlv_DebGvnrDvtMinOk_C EGRVlv_PullDwnIKi_C EGRVlv_RlsIKi_C EGRVlv_numEngTempMon_C EGRVlv_numLckdDetThres_C EGRVlv_rDvtMax_C EGRVlv_rDvtMin_C EGRVlv_rLSRelPosThresDwn_C EGRVlv_rLSRelPosThresInit_C EGRVlv_rLSThresDwn_C EGRVlv_rLSThresUp_C EGRVlv_rLckdDetThres_C EGRVlv_rPullDwnMax_C EGRVlv_rRlsMax_C EGRVlv_rStepThres_C EGRVlv_swtGvnrByp_C EGRVlv_tEngHi_C EGRVlv_tEngLo_C EGRVlv_tiActvPullDwn_C EGRVlv_tiPullDwn_C EGRVlv_tiRepRls_C EGRVlv_tiRls_C /end DEF_CHARACTERISTIC
/end FUNCTION
/begin FUNCTION EGRVlv_PosGvnr "Lageregler für Abgasrückführventil"
 /begin DEF_CHARACTERISTIC EGRVlv_DKdNeg_C EGRVlv_DKdPos_C EGRVlv_IKiNeg_C EGRVlv_IKiPos_C EGRVlv_PKpNeg_C EGRVlv_PKpPos_C EGRVlv_SlwClsDKd_C EGRVlv_SlwClsIKi_C EGRVlv_SlwClsPKp_C EGRVlv_SmlSigNegDKd_C EGRVlv_SmlSigNegIKi_C EGRVlv_SmlSigNegPKp_C EGRVlv_SmlSigPosDKd_C EGRVlv_SmlSigPosIKi_C EGRVlv_SmlSigPosPKp_C EGRVlv_drRelPosNeg_C EGRVlv_iEff_CUR EGRVlv_rGvnrDvtThres_C EGRVlv_rGvnrMax_CUR EGRVlv_rGvnrMin_CUR EGRVlv_rInitStep_C EGRVlv_rOutCurrMax_C EGRVlv_rOutDMax_C EGRVlv_rPIDWinNeg_C EGRVlv_rPIDWinPos_C EGRVlv_rRelPosNeg_C EGRVlv_tiCurrEffFlt_C EGRVlv_tiGvnrDT1_C EGRVlv_tiParDT1_C /end DEF_CHARACTERISTIC
/end FUNCTION
/begin FUNCTION EGSys_DewDet "Taupunktbestimmungslogik"
 /begin DEF_CHARACTERISTIC EGSys_dmPlsThresLSUSrvTst_C EGSys_dmPlsThresLSU_C EGSys_facCldStrtLSU_C EGSys_facPlsLSUSrvTst_C EGSys_facPlsLSU_C EGSys_facPlsThresLSU_C EGSys_facThresNoSftyFac_C EGSys_numECU_C EGSys_numMaxCldStrt_C EGSys_numPlsSrvTst_C EGSys_numTempEngDewDet_C EGSys_swtDewDetShOff_C EGSys_tIntegIniSrvTst_C EGSys_tIntegIni_C EGSys_tThresLSUActSrvTst_C EGSys_tThresLSUAct_C EGSys_tWtEquiv_C EGSys_tiDebLSU0_C EGSys_tiDebNrmTransOk_C EGSys_tiHtgDelLSU_C EGSys_tiPlsLSUSrvTst_C EGSys_tiPlsLSU_C EGSys_wLSUIKi_C EGSys_wThresLSU0_MAP /end DEF_CHARACTERISTIC
/end FUNCTION
/begin FUNCTION EGSys_IntfcDiaLSU "LSU-Diagnosesteuerung für Servicetest und Short Trip" /begin DEF_CHARACTERISTIC EGSys_stMsgDiaLSU_C /end DEF_CHARACTERISTIC /end FUNCTION
/begin FUNCTION EGSys_Lib "Abgassystembibliothek" /begin DEF_CHARACTERISTIC AirSys_swtOLDAvisible_C /end DEF_CHARACTERISTIC /end FUNCTION
/begin FUNCTION EGSys_ModPreTrbn "Modell des Abgasgegendrucks vor Turbine" /begin DEF_CHARACTERISTIC EGSys_dmExhGas_MAP EGSys_nTrbnMax_MAP EGSys_rPres_MAP /end DEF_CHARACTERISTIC /end FUNCTION
/begin FUNCTION EGSys_mdlbackpres "Berechnung des Abgasgegendrucks"
 /begin DEF_CHARACTERISTIC EGSys_pExhGas_MAP EGSys_swtPresSel_C EGSys_swtPstPFltActv_C /end DEF_CHARACTERISTIC
/end FUNCTION
/begin FUNCTION EGSys_tEGCo "Schnittstellenkoordinator für Abgastemperaturmodell"
 /begin DEF_CHARACTERISTIC EGSys_dmHCCldStrt_CUR EGSys_facHCPoI1Gvnr_MAP EGSys_facHCPoI2Gvnr_MAP EGSys_numRdPosLSU2_C EGSys_numRdPosLSUWall_C EGSys_numRdPosLSU_C EGSys_numRdPosMon_C EGSys_numRdPosNSC2_C EGSys_numRdPosNSC_C EGSys_numRdPosOxiCat2_C EGSys_numRdPosOxiCatBrik2_C EGSys_numRdPosOxiCatBrik_C EGSys_numRdPosOxiCat_C EGSys_numRdPosTrbn2_C EGSys_numRdPosTrbn_C EGSys_numRdPosTube2_C EGSys_numRdPosTube_C EGSys_numTempCldStrt_C EGSys_numTempEng_C EGSys_qHCNrm_MAP EGSys_qHCOxiCatMon_MAP EGSys_qHCRgn1_MAP EGSys_qHCRgn2_MAP EGSys_stMskOxiCatMon_C EGSys_stMskRgn1_C EGSys_stMskRgn2_C EGSys_swtHCCtlOxiCatActv_C EGSys_swtUI_C EGSys_tExcClntDfl_C EGSys_tThresCldStrt_C /end DEF_CHARACTERISTIC
/end FUNCTION
/begin FUNCTION EGSys_tEGMod "Abgastemperaturmodell"
 /begin DEF_CHARACTERISTIC EGSys_cpEG_MAP EGSys_dmAir_MAP EGSys_dmEGMinVal_C EGSys_facAirMass_CUR EGSys_facCorrCldEng_CUR EGSys_facIAT_CUR EGSys_facStrtDlv_CUR EGSys_pValDfl_C EGSys_phiStrtDlv_MAP EGSys_rTempAdbt_CUR EGSys_tEGPstTrbnDfl_C EGSys_tEngStat_C EGSys_tIAT_MAP EGSys_tManfDfl_C EGSys_tManfStat_MAP /end DEF_CHARACTERISTIC
/end FUNCTION
/begin FUNCTION EGSys_tNSCMod "Temperaturmodell für NOx-Speicherkatalysator"
 /begin DEF_CHARACTERISTIC EGSys_cpNSC_C EGSys_swtTimeNSC_C EGSys_tNSCDfl_C EGSys_tNSCExoIncr_MAP EGSys_tiPT1NSC_C /end DEF_CHARACTERISTIC
/end FUNCTION
/begin FUNCTION EGSys_tOxiCatMod "Temperaturmodel für Oxidationskatalysator"
 /begin DEF_CHARACTERISTIC EGSys_AlpOxiCat_MAP EGSys_CalHCOxiCat_C EGSys_CalValFl_C EGSys_cpEGOxiCatDfl_C EGSys_cpOxiCatHCMod_C EGSys_cpOxiCat_C EGSys_dwEnvOxiCatDfl_C EGSys_dwEnvOxiCatOutDfl_C EGSys_dwEnvOxiCatSurfDfl_C EGSys_facBrickOxiCat_C EGSys_facHCCnvOxiCat1_CUR EGSys_facHCCnvOxiCat2_CUR EGSys_facTempCmb_CUR EGSys_numOxiCatMod_C EGSys_sqOxiCat_C EGSys_swtTimeOxiCat_C EGSys_tOxiCatDfl_C EGSys_tOxiCatExoIncr_MAP EGSys_tOxiCatHCModDfl_C EGSys_tOxiCatHCModOutDfl_C EGSys_tOxiCatHCModSurfDfl_C EGSys_tOxiCatIKiNeg_C EGSys_tOxiCatIKiPos_C EGSys_tOxiCatIKi_C EGSys_tOxiCatIWinNeg_C EGSys_tOxiCatIWinPos_C EGSys_tiPT1OxiCat_C /end DEF_CHARACTERISTIC
/end FUNCTION
/begin FUNCTION EGSys_tStrtCalc "Temperaturmodell für Fahrzeugstillstand"
 /begin DEF_CHARACTERISTIC EGSys_facTempClg_CUR EGSys_facTimeClg_CUR EGSys_swtTAirSens_C EGSys_tStrtCsRepl_C EGSys_tiHaValClnt_C EGSys_tiHaValNSC_C EGSys_tiHaValOxiCatBrik_C EGSys_tiHaValOxiCat_C EGSys_tiHaValTrb_C EGSys_tiHaValTube_C EGSys_tiOfsClg_C /end DEF_CHARACTERISTIC
/end FUNCTION
/begin FUNCTION EGSys_tTrbMod "Turboladerabgastemperaturmodell"
 /begin DEF_CHARACTERISTIC EGSys_etaChrg1_MAP EGSys_etaChrg2_MAP EGSys_swtTrbModSel_C EGSys_tiChrgMOD1PT1_C EGSys_tiChrgMOD2PT1_C /end DEF_CHARACTERISTIC
/end FUNCTION
/begin FUNCTION EGSys_tTubeMod "Temperaturmodell für Abgasrohr"
 /begin DEF_CHARACTERISTIC EGSys_AlpFreeCnvtTube_C EGSys_NuTubeEnv_CUR EGSys_NuTube_CUR EGSys_cndHtEG_CUR EGSys_cpTube_C EGSys_lDiamTube_C EGSys_lLngthTube_C EGSys_rSqTube_C EGSys_tEGTubeDfl_C EGSys_tTubeDfl_C EGSys_tTubeIKiNeg_C EGSys_tTubeIKiPos_C EGSys_tTubeIKi_C EGSys_tTubeIWinNeg_C EGSys_tTubeIWinPos_C EGSys_vscDynEG_CUR EGSys_vscKinEG_CUR /end DEF_CHARACTERISTIC
/end FUNCTION
/begin FUNCTION EGT_CoRgn "Regenerationskoordinator Abgasnachbehandlung" /begin DEF_CHARACTERISTIC EGT_stTSync_Channel EGT_stTSync_Vector EGT_swtEGTActv_C /end DEF_CHARACTERISTIC /end FUNCTION
/begin FUNCTION EGT_CoRgnTSync "Regenerationskoordinator Abgasnachbehandlung (zeitsynchron)" /begin DEF_CHARACTERISTIC EGT_tiRmpSlpMax_C /end DEF_CHARACTERISTIC /end FUNCTION
/begin FUNCTION EGT_Copy2NSync "Copying message from TSync process to NSync process" /begin DEF_CHARACTERISTIC EGT_tiRmpSlp_C /end DEF_CHARACTERISTIC /end FUNCTION
/begin FUNCTION EMCCD_Co "Komponententreiber der Motorlagersteuerung"
 /begin DEF_CHARACTERISTIC EMCCD_DebExcTempDef_C EMCCD_DebExcTempOk_C EMCCD_DebNoLoadDef_C EMCCD_DebNoLoadOk_C EMCCD_DebShortCircBatDef_C EMCCD_DebShortCircBatOk_C EMCCD_DebShortCircGndDef_C EMCCD_DebShortCircGndOk_C EMCCD_ctM1PwrStgOnMax_C EMCCD_stEngMntCtl_Init_C EMCCD_stM1SPICtl_C EMCCD_swtEnOut_C EMCCD_swtInvOut_C EMCCD_tiM1BtwTst_C EMCCD_tiM1PwrStgOn_C /end DEF_CHARACTERISTIC
/end FUNCTION
/begin FUNCTION ESS_GetNMin "Leerlaufanhebung bei schwacher Batterie"
 /begin DEF_CHARACTERISTIC ESS_nBattMin_C ESS_nLIBattThres_C ESS_tiDelayStrtDoneFFSet_C ESS_tiDelayUBattFFRes_C ESS_tiDelayUBattFFSet_C ESS_uLIBattThresFFRes_C ESS_uLIBattThresFFSet_C /end DEF_CHARACTERISTIC
/end FUNCTION
/begin FUNCTION ESS_nMinDem "Leerlaufanhebung bei schwacher Batterie" /begin DEF_CHARACTERISTIC ESS_nBattIncrMin_C ESS_nBattMinThres_C /end DEF_CHARACTERISTIC /end FUNCTION
/begin FUNCTION EepInit "EEPROM Erstinitialisierung" /begin SUB_FUNCTION EepInit_CpyDs EepInit_Develop /end SUB_FUNCTION /end FUNCTION
/begin FUNCTION EepInit_CpyDs "Funktion zum sichern von Daten ins EEPROM fuer die erste Intialisierung" /begin DEF_CHARACTERISTIC EcuInit_tiTimestampTO_C /end DEF_CHARACTERISTIC /end FUNCTION
/begin FUNCTION EepInit_Develop "ließt Bloecke vom EEPROM und schreibt ein Byte an waelbare Positionen"
 /begin DEF_CHARACTERISTIC EepDev_dVal_C EepDev_dWrInitPattern_C EepDev_numBlock_C EepDev_numInitBlocks_CA EepDev_numOffset_C EepDev_stJob_C EepInit_AirCtlTrm_C EepInit_SWT1_C EepInit_SWT2_C EepInit_dCodeTbl_C EepInit_dHwPartNum_C EepInit_dPartNr_C EepInit_dPrgVer_C EepInit_dSysName_C EepInit_dnCoVehLvl1_C EepInit_dnCoVehLvl2_C EepInit_dnSetpointTrm_C EepInit_factAltDemTrm_C EepInit_factSvrPmpDemTrm_C EepInit_factTrqACTrm_C EepInit_factTrqLimTrm_C EepInit_tGlwCtlTrm_C EepInit_trqStartTrm_C EepInit_vSpdLimMax2_C EepInit_vSpdLimMax_C /end DEF_CHARACTERISTIC
/end FUNCTION
/begin FUNCTION EngM_AngDiag "Diagnose des Kurbelwellen- und Nockenwellensignals"
 /begin DEF_CHARACTERISTIC EngM_DebIncCaSErrSigDef_C EngM_DebIncCaSErrSigOK_C EngM_DebIncCaSNoSigDef_C EngM_DebIncCrSErrSigDef_C EngM_DebIncCrSErrSigOK_C EngM_DebIncOfsSigCaSCrSDef_C EngM_DebPhCrSErrSigDef_C EngM_DebPhRevCaSDrvDef_C EngM_DebPhRevCaSDrvOk_C EngM_ctSpdtoZero_C EngM_nMinDiag_C EngM_nSwtErrSigDiagCrSOff_C EngM_nSwtErrSigDiagCrSOn_C EngM_swtT50CDDiag_C /end DEF_CHARACTERISTIC
/end FUNCTION
/begin FUNCTION EngM_BackUp "Start und Betrieb des Motors nur mit Nockenwellensignal"
 /begin DEF_CHARACTERISTIC CaSCD_ctLrnDiffMax_C CaSCD_dKLrn_C CaSCD_nBackUpLrnDiff_C CaSCD_phiDvnDiffLrn_C CaSCD_phiSeg2Seg_C CaSCD_phiSegToothTolc_C CaSCD_phiSync2Seg_C CaSCD_phiSync2Zero_C CaSCD_rSeg2SegMax_CUR CaSCD_rSeg2SegMin_CUR CaSCD_stEdgeTrigBackup_C CaSCD_stEnaLrnDiffBackUp_C CrSCD_ctIncTolcBackUp_C EngM_ctBackUpMaxCh_C EngM_dDivFacTmr_C EngM_dMulFacTmr_C EngM_facMaxSim2Real_C EngM_facMinSim2Real_C EngM_nMaxBackUp2SyncOk_C EngM_nMaxBackUp_C EngM_nMaxStrtBackUp_C EngM_nThresBackUpMin_C EngM_numSegTooth2SyncOk_C EngM_phiIntBackUp_C EngM_rCrSBackUpMax_C EngM_rCrSBackUpMin_C EngM_stBackUpVar_C EngM_stEnaBackUp_C EngM_stStrtBackup_C EngM_tiBackUpTmrMax_C EngM_tiBackUpTmrMin_C EngM_tiHealBackUp_C /end DEF_CHARACTERISTIC
/end FUNCTION
/begin FUNCTION EngM_CaSOfs "Korrekturwinkel bei verdrehter Nockenwelle"
 /begin DEF_CHARACTERISTIC CaSCD_phiOfsTolc_C EngM_facCaSOfsCor_C EngM_nCaSOfsMax_C EngM_nCaSOfsMin_C EngM_phiCaSOfs_CUR EngM_qCaSOfsMax_C EngM_qCaSOfsMin_C EngM_tCaSOfsBas_C EngM_tCaSOfsMin_C EngM_tiCaSOfs1PT1_C EngM_tiCaSOfs2PT1_C /end DEF_CHARACTERISTIC
/end FUNCTION
/begin FUNCTION EngM_EngDat "Motordaten"
 /begin DEF_CHARACTERISTIC EngM_numPin_C EngM_phiMax_C EngM_phiTDC_C EngM_swtNumCylVal_C /end DEF_CHARACTERISTIC
/end FUNCTION
/begin FUNCTION EngM_EngMntCtl "Motorlagersteuerung"
 /begin DEF_CHARACTERISTIC EngM_rNOnOffML_CUR EngM_swtEngMntCtlType_C EngM_swtEngMntCtlVal_C EngM_swtModeML_C EngM_trqHysML_C EngM_trqValML_C EngM_vHiHysML_C EngM_vHiValML_C EngM_vLoHysML_C EngM_vLoValML_C /end DEF_CHARACTERISTIC
/end FUNCTION
/begin FUNCTION EngM_Sched "Handling of the segment synchronous interrupt system"
 /begin DEF_CHARACTERISTIC EngM_dLimitCond_ASD_CA EngM_dLimitCond_Common_CA EngM_dLimitCond_FBC_CA EngM_dLimitCond_Joint_CA EngM_dLimitCond_LiGov_CA EngM_dLimitCond_Pilot_CA EngM_nLimitInj_C EngM_nLimitThreshHyst_CA EngM_nLimitThresh_CA EngM_nLimitTimeout_C EngM_nPolling_C EngM_nSwtCoMa1_C EngM_nSwtCoMa_C EngM_nSyncNoInjRls_C EngM_numLimitInj_C EngM_numLimitTimeout_C EngM_tiDiffInt_C /end DEF_CHARACTERISTIC
/end FUNCTION
/begin FUNCTION EngM_Sync "Synchronisation zwischen Inkrement und Phasensignal und bereitstellen der Motorposition"
 /begin DEF_CHARACTERISTIC CaSCD_ctEdgOfs_C CaSCD_ctErrSync_C CaSCD_ctShftSync_C EngM_ctOfsCaSCrS_C EngM_ctPhWhlRev_C EngM_ctPostSync_C EngM_ctReSync_C EngM_ctVerSync_C EngM_nMaxFrstInj_C EngM_nWaitIncSig_C EngM_phiDelayPhNoSig_C EngM_phiDeltaExtSync_C EngM_phiDelta_C EngM_phiFrstInjInt_C EngM_phiIntMin_C EngM_phiInt_C EngM_stSyncBefGap_C EngM_swtExitOfs_C EngM_swtSyncViaCAN_C EngM_swtUpdTDC_C EngM_tiCpuTimeOut_C EngM_tiSegMin_C EngM_tiWaitIncSig_C /end DEF_CHARACTERISTIC
/end FUNCTION
/begin FUNCTION EngM_trqFrcCalc "Reibmomentenberechnung"
 /begin DEF_CHARACTERISTIC EngM_swtTempTrqFrc2_C EngM_swtTempTrqFrc3_C EngM_swtTempTrqFrc_C EngM_tTrqFrcDef_C EngM_trqFrcMin_CUR EngM_trqFrc_MAP /end DEF_CHARACTERISTIC
/end FUNCTION
/begin FUNCTION EngMon_IrrCmb "Verbrennungserkennung mit Lambdasonde"
 /begin DEF_CHARACTERISTIC EngMon_DebIrrCmbDef_C EngMon_DebIrrCmbOk_C EngMon_DebIrrCmbStepDown_C EngMon_DebIrrCmbStepUp_C EngMon_nMonActv_C EngMon_rO2MaxVal_C EngMon_stActv_C EngMon_tiDel_C EngMon_tiFltPT1_C EngMon_tiMonActv_C /end DEF_CHARACTERISTIC
/end FUNCTION
/begin FUNCTION EngPrt "Motormechanikschutz" /begin SUB_FUNCTION EngPrt_OvrSpd EngPrt_PrtLim /end SUB_FUNCTION /end FUNCTION
/begin FUNCTION EngPrt_OvrSpd "Überdrehzahlerkennung"
 /begin DEF_CHARACTERISTIC EngPrt_DebSigDef_C EngPrt_DebSigOk_C EngPrt_nOvrSpd_C EngPrt_nThrClo_C EngPrt_nThrOpen_C EngPrt_rThrCloAct_C EngPrt_rThrClo_C EngPrt_tiDelOvrSpd_C EngPrt_tiThrClo_C /end DEF_CHARACTERISTIC
/end FUNCTION
/end MODULE
/end PROJECT
