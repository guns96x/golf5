ASAP2_VERSION 1 3
/begin PROJECT X447 "EDC16U34"
/begin HEADER "" VERSION "VAA1" PROJECT_NO X447 /end HEADER
/begin MODULE DIM ""
/begin MOD_COMMON "" BYTE_ORDER MSB_FIRST ALIGNMENT_BYTE 1 ALIGNMENT_WORD 2 ALIGNMENT_LONG 4 ALIGNMENT_FLOAT32_IEEE 4 /end MOD_COMMON
/begin CHARACTERISTIC ACCCD_stACCnew_Vector "Konfigurationslabel für Bypass Freischnitt" VALUE 0x1C0A1A Kw_Wu8 255.0 OneToOne 0.00 255.0 FORMAT "%5.1" /end CHARACTERISTIC
/begin CHARACTERISTIC ACCCD_stACCnew_Channel "Konfigurationslabel für Bypass Freischnitt" VALUE 0x1C0A1B Kw_Wu8 255.0 OneToOne 0.00 255.0 FORMAT "%5.1" /end CHARACTERISTIC
/begin CHARACTERISTIC ACCCD_stACC_Vector "Konfigurationslabel für Bypass Freischnitt" VALUE 0x1C0A1C Kw_Wu8 255.0 OneToOne 0.00 255.0 FORMAT "%5.1" /end CHARACTERISTIC
/begin CHARACTERISTIC ACCCD_stACC_Channel "Konfigurationslabel für Bypass Freischnitt" VALUE 0x1C0A1D Kw_Wu8 255.0 OneToOne 0.00 255.0 FORMAT "%5.1" /end CHARACTERISTIC
/begin CHARACTERISTIC ACCCD_stBrk_Vector "Konfigurationslabel für Bypass Freischnitt" VALUE 0x1C0A1E Kw_Wu8 255.0 OneToOne 0.00 255.0 FORMAT "%5.1" /end CHARACTERISTIC
/begin CHARACTERISTIC ACCCD_stBrk_Channel "Konfigurationslabel für Bypass Freischnitt" VALUE 0x1C0A1F Kw_Wu8 255.0 OneToOne 0.00 255.0 FORMAT "%5.1" /end CHARACTERISTIC
/begin CHARACTERISTIC AccPed_rChkdVal_Vector "Konfigurationslabel für Bypass Freischnitt" VALUE 0x1C0A26 Kw_Wu8 255.0 OneToOne 0.00 255.0 FORMAT "%5.1" /end CHARACTERISTIC
/begin CHARACTERISTIC AccPed_rChkdVal_Channel "Konfigurationslabel für Bypass Freischnitt" VALUE 0x1C0A27 Kw_Wu8 255.0 OneToOne 0.00 255.0 FORMAT "%5.1" /end CHARACTERISTIC
/begin CHARACTERISTIC AccPed_trqDes_Vector "Bypass Label, nicht ändern!" VALUE 0x1C0A22 Kw_Wu8 255.0 OneToOne 0.00 255.0 FORMAT "%5.1" /end CHARACTERISTIC
/begin CHARACTERISTIC AccPed_trqDes_Channel "Bypass Label, nicht ändern!" VALUE 0x1C0A23 Kw_Wu8 255.0 OneToOne 0.00 255.0 FORMAT "%5.1" /end CHARACTERISTIC
/begin CHARACTERISTIC AccPed_trqLead_Vector "Konfigurationslabel für Bypass" VALUE 0x1C0A24 Kw_Wu8 255.0 OneToOne 0.00 255.0 FORMAT "%5.1" /end CHARACTERISTIC
/begin CHARACTERISTIC AccPed_trqLead_Channel "Konfigurationslabel für Bypass" VALUE 0x1C0A25 Kw_Wu8 255.0 OneToOne 0.00 255.0 FORMAT "%5.1" /end CHARACTERISTIC
/begin CHARACTERISTIC ACC_stCrCtl_Vector "Konfigurationslabel für Bypass" VALUE 0x1C0A10 Kw_Wu8 255.0 OneToOne 0.00 255.0 FORMAT "%5.1" /end CHARACTERISTIC
/begin CHARACTERISTIC ACC_stCrCtl_Channel "Konfigurationslabels für Bypass" VALUE 0x1C0A11 Kw_Wu8 255.0 OneToOne 0.00 255.0 FORMAT "%5.1" /end CHARACTERISTIC
/begin CHARACTERISTIC ACC_stDrvBrk_Vector "Konfigurationslabel für Bypass" VALUE 0x1C0A12 Kw_Wu8 255.0 OneToOne 0.00 255.0 FORMAT "%5.1" /end CHARACTERISTIC
/begin CHARACTERISTIC ACC_stDrvBrk_Channel "Konfigurationslabel für Bypass" VALUE 0x1C0A13 Kw_Wu8 255.0 OneToOne 0.00 255.0 FORMAT "%5.1" /end CHARACTERISTIC
/begin CHARACTERISTIC ACC_stOvrRun_Vector "Konfigurationslabel für Bypass Freischnitt" VALUE 0x1C0A14 Kw_Wu8 255.0 OneToOne 0.00 255.0 FORMAT "%5.1" /end CHARACTERISTIC
/begin CHARACTERISTIC ACC_stOvrRun_Channel "Konfigurationslabel für Bypass Freischnitt" VALUE 0x1C0A15 Kw_Wu8 255.0 OneToOne 0.00 255.0 FORMAT "%5.1" /end CHARACTERISTIC
/begin CHARACTERISTIC ACC_trqDes_Vector "Konfigurationslabel für Bypass" VALUE 0x1C0A16 Kw_Wu8 255.0 OneToOne 0.00 255.0 FORMAT "%5.1" /end CHARACTERISTIC
/begin CHARACTERISTIC ACC_trqDes_Channel "Konfigurationslabel für Bypass" VALUE 0x1C0A17 Kw_Wu8 255.0 OneToOne 0.00 255.0 FORMAT "%5.1" /end CHARACTERISTIC
/begin CHARACTERISTIC ACC_trqLead_Vector "Meßpunkt für Bypass" VALUE 0x1C0A18 Kw_Wu8 255.0 OneToOne 0.00 255.0 FORMAT "%5.1" /end CHARACTERISTIC
/begin CHARACTERISTIC ACC_trqLead_Channel "Konfigurationslabel für Bypass" VALUE 0x1C0A19 Kw_Wu8 255.0 OneToOne 0.00 255.0 FORMAT "%5.1" /end CHARACTERISTIC
/begin CHARACTERISTIC AFSCD_dmAirPerTime_Vector "Konfigurationslabel für Bypass" VALUE 0x1C0A2C Kw_Wu8 255.0 OneToOne 0.00 255.0 FORMAT "%5.1" /end CHARACTERISTIC
/begin CHARACTERISTIC AFSCD_dmAirPerTime_Channel "Konfigurationslabel für Bypass" VALUE 0x1C0A2D Kw_Wu8 255.0 OneToOne 0.00 255.0 FORMAT "%5.1" /end CHARACTERISTIC
/begin CHARACTERISTIC AFSCD_mAirPerCylPlsCor_Vector "Konfigurationslabel für Bypass Freischnitt" VALUE 0x1C0A28 Kw_Wu8 255.0 OneToOne 0.00 255.0 FORMAT "%5.1" /end CHARACTERISTIC
/begin CHARACTERISTIC AFSCD_mAirPerCylPlsCor_Channel "Konfigurationslabel für Bypass Freischnitt" VALUE 0x1C0A29 Kw_Wu8 255.0 OneToOne 0.00 255.0 FORMAT "%5.1" /end CHARACTERISTIC
/begin CHARACTERISTIC AFSCD_mAirPerCyl_Vector "Konfigurationslabel für Bypass message" VALUE 0x1C0A2A Kw_Wu8 255.0 OneToOne 0.00 255.0 FORMAT "%5.1" /end CHARACTERISTIC
/begin CHARACTERISTIC AFSCD_mAirPerCyl_Channel "Konfigurationslabel für Bypass message" VALUE 0x1C0A2B Kw_Wu8 255.0 OneToOne 0.00 255.0 FORMAT "%5.1" /end CHARACTERISTIC
/begin CHARACTERISTIC BasAdj_AFVCDnSetpoint_C "Leerlaufsohldrehzahl bei AFVCD-Grundeinstellung" VALUE 0x1CBEF8 Kw_Ws16 65535.00 EngN -32768.00 32767.00 FORMAT "%8.2" /end CHARACTERISTIC
/begin CHARACTERISTIC BasAdj_AFVCDtime_C "Zeit nach der zwischen den beiden Tastverhältnissen bei AFVCD-Grundeinstellung umgeschalten wird" VALUE 0x1CBEFA Kw_Wu16 655350.0 Time_ms 0.00 655350.0 FORMAT "%8.1" /end CHARACTERISTIC
/begin CHARACTERISTIC BasAdj_AFVCDBits_C "BasAdj_st bei AFVCD-Grundeinstellung" VALUE 0x1CBEFC Kw_Wu16 65535.00 OneToOne 0.00 65535.00 FORMAT "%8.2" READ_ONLY /end CHARACTERISTIC
/begin CHARACTERISTIC AirCtl_mDesValAdd_Vector "Bypass-Label für additiven Bypass von AirCtl_mDesVal (Nicht verstellen!)" VALUE 0x1C0A32 Kw_Wu8 255.0 OneToOne 0.00 255.0 FORMAT "%5.1" /end CHARACTERISTIC
/begin CHARACTERISTIC AirCtl_mDesValAdd_Channel "Bypass-Label für additiven Bypass von AirCtl_mDesVal (Nicht verstellen!)" VALUE 0x1C0A33 Kw_Wu8 255.0 OneToOne 0.00 255.0 FORMAT "%5.1" /end CHARACTERISTIC
/begin CHARACTERISTIC AirCtl_mDesVal_Vector "Bypass-Label für AirCtl_mDesVal (Nicht verstellen!)" VALUE 0x1C0A34 Kw_Wu8 255.0 OneToOne 0.00 255.0 FORMAT "%5.1" /end CHARACTERISTIC
/begin CHARACTERISTIC AirCtl_mDesVal_Channel "Bypass-Label für AirCtl_mDesVal (Nicht verstellen!)" VALUE 0x1C0A35 Kw_Wu8 255.0 OneToOne 0.00 255.0 FORMAT "%5.1" /end CHARACTERISTIC
/begin CHARACTERISTIC AirCtl_rCtlVal_Vector "Bypass-Label für Bypass von AirCtl_rCtlVal (NICHT veraendern!)" VALUE 0x1C0A30 Kw_Wu8 255.0 OneToOne 0.00 255.0 FORMAT "%5.1" /end CHARACTERISTIC
/begin CHARACTERISTIC AirCtl_rCtlVal_Channel "Bypass-Label für Bypass von AirCtl_rCtlVal (NICHT veraendern!)" VALUE 0x1C0A31 Kw_Wu8 255.0 OneToOne 0.00 255.0 FORMAT "%5.1" /end CHARACTERISTIC
/begin CHARACTERISTIC AirCtl_rEGRAdd_Vector "Bypass-Label für additiven Bypass von AirCtl_rEGR (Nicht verstellen!)" VALUE 0x1C0A3A Kw_Wu8 255.0 OneToOne 0.00 255.0 FORMAT "%5.1" /end CHARACTERISTIC
/begin CHARACTERISTIC AirCtl_rEGRAdd_Channel "Bypass-Label für additiven Bypass von AirCtl_rEGR (Nicht verstellen!)" VALUE 0x1C0A3B Kw_Wu8 255.0 OneToOne 0.00 255.0 FORMAT "%5.1" /end CHARACTERISTIC
/begin CHARACTERISTIC AirCtl_rEGR_Vector "Bypass-Label für AirCtl_rEGR (Nicht verstellen!)" VALUE 0x1C0A3C Kw_Wu8 255.0 OneToOne 0.00 255.0 FORMAT "%5.1" /end CHARACTERISTIC
/begin CHARACTERISTIC AirCtl_rEGR_Channel "Bypass-Label für AirCtl_rEGR (Nicht verstellen!)" VALUE 0x1C0A3D Kw_Wu8 255.0 OneToOne 0.00 255.0 FORMAT "%5.1" /end CHARACTERISTIC
/begin CHARACTERISTIC AirCtl_rTVAAdd_Vector "Bypass-Label für additiven Bypass von AirCtl_rTVA (Nicht verstellen!)" VALUE 0x1C0A3E Kw_Wu8 255.0 OneToOne 0.00 255.0 FORMAT "%5.1" /end CHARACTERISTIC
/begin CHARACTERISTIC AirCtl_rTVAAdd_Channel "Bypass-Label für additiven Bypass von AirCtl_rTVA (Nicht verstellen!)" VALUE 0x1C0A3F Kw_Wu8 255.0 OneToOne 0.00 255.0 FORMAT "%5.1" /end CHARACTERISTIC
/begin CHARACTERISTIC AirCtl_rTVA_Vector "Bypass-Label für AirCtl_rTVA (Nicht verstellen!)" VALUE 0x1C0A40 Kw_Wu8 255.0 OneToOne 0.00 255.0 FORMAT "%5.1" /end CHARACTERISTIC
/begin CHARACTERISTIC AirCtl_rTVA_Channel "Bypass-Label für AirCtl_rTVA (Nicht verstellen!)" VALUE 0x1C0A41 Kw_Wu8 255.0 OneToOne 0.00 255.0 FORMAT "%5.1" /end CHARACTERISTIC
/begin CHARACTERISTIC AirCtl_stEGRClgBypVlv_Vector "Konfigurationslabel für Bypass Freischnitt" VALUE 0x1C0A2E Kw_Wu8 255.0 OneToOne 0.00 255.0 FORMAT "%5.1" /end CHARACTERISTIC
/begin CHARACTERISTIC AirCtl_stEGRClgBypVlv_Channel "Konfigurationslabel für Bypass Freischnitt" VALUE 0x1C0A2F Kw_Wu8 255.0 OneToOne 0.00 255.0 FORMAT "%5.1" /end CHARACTERISTIC
/begin CHARACTERISTIC Alt_pwrDes_Vector "Bypass Label, nicht ändern!" VALUE 0x1C0A42 Kw_Wu8 255.0 OneToOne 0.00 255.0 FORMAT "%5.1" /end CHARACTERISTIC
/begin CHARACTERISTIC Alt_pwrDes_Channel "Bypass Label, nicht ändern!" VALUE 0x1C0A43 Kw_Wu8 255.0 OneToOne 0.00 255.0 FORMAT "%5.1" /end CHARACTERISTIC
/begin CHARACTERISTIC ASDdc_trq_Vector "Bypass Label, nicht ändern!" VALUE 0x1C0A4E Kw_Wu8 255.0 OneToOne 0.00 255.0 FORMAT "%5.1" /end CHARACTERISTIC
/begin CHARACTERISTIC ASDdc_trq_Channel "Bypass Label, nicht ändern!" VALUE 0x1C0A4F Kw_Wu8 255.0 OneToOne 0.00 255.0 FORMAT "%5.1" /end CHARACTERISTIC
/begin CHARACTERISTIC ASDrf_trqInr_Vector "Bypass Label, nicht ändern!" VALUE 0x1C0A52 Kw_Wu8 255.0 OneToOne 0.00 255.0 FORMAT "%5.1" /end CHARACTERISTIC
/begin CHARACTERISTIC ASDrf_trqInr_Channel "Bypass Label, nicht ändern!" VALUE 0x1C0A53 Kw_Wu8 255.0 OneToOne 0.00 255.0 FORMAT "%5.1" /end CHARACTERISTIC
/begin CHARACTERISTIC BasAdj_K2SigBlkVal0_MAP "Testeranzeige für Meßwertausgabe ohne Grundeinstellung  (Diagnose)" MAP 0x1CBEFE Kf_Xs16_Ys16_Ws16 32766.00 OneToOne 0.00 32766.00 FORMAT "%8.2" EXTENDED_LIMITS -32768.00 32767.00
 /begin AXIS_DESCR STD_AXIS BasAdj_DispMode_mp OneToOne 5 0.00 4.000 FORMAT "%5.3" EXTENDED_LIMITS 0.00 255.0 DEPOSIT ABSOLUTE /end AXIS_DESCR
 /begin AXIS_DESCR STD_AXIS BasAdj_ActRout_mp OneToOne 14 0.00 15.00 FORMAT "%5.2" EXTENDED_LIMITS 0.00 255.0 DEPOSIT ABSOLUTE /end AXIS_DESCR
/end CHARACTERISTIC
/begin CHARACTERISTIC BasAdj_K2SigBlkVal1_MAP "Testeranzeige bei Meßwertausgabe mit Grundeinstellung für das Tastverhältnis 1  (Diagnose)" MAP 0x1CBFB4 Kf_Xs16_Ys16_Ws16 32766.00 OneToOne 0.00 32766.00 FORMAT "%8.2" EXTENDED_LIMITS -32768.00 32767.00
 /begin AXIS_DESCR STD_AXIS BasAdj_DispMode_mp OneToOne 5 0.00 4.000 FORMAT "%5.3" EXTENDED_LIMITS 0.00 255.0 DEPOSIT ABSOLUTE /end AXIS_DESCR
 /begin AXIS_DESCR STD_AXIS BasAdj_ActRout_mp OneToOne 14 0.00 15.00 FORMAT "%5.2" EXTENDED_LIMITS 0.00 255.0 DEPOSIT ABSOLUTE /end AXIS_DESCR
/end CHARACTERISTIC
/begin CHARACTERISTIC BasAdj_K2SigBlkVal2_MAP "Testeranzeige bei Meßwertausgabe mit Grundeinstellung für das Tastverhältnis 2  (Diagnose)" MAP 0x1CC06A Kf_Xs16_Ys16_Ws16 32766.00 OneToOne 0.00 32766.00 FORMAT "%8.2" EXTENDED_LIMITS -32768.00 32767.00
 /begin AXIS_DESCR STD_AXIS BasAdj_DispMode_mp OneToOne 5 0.00 4.000 FORMAT "%5.3" EXTENDED_LIMITS 0.00 255.0 DEPOSIT ABSOLUTE /end AXIS_DESCR
 /begin AXIS_DESCR STD_AXIS BasAdj_ActRout_mp OneToOne 14 0.00 15.00 FORMAT "%5.2" EXTENDED_LIMITS 0.00 255.0 DEPOSIT ABSOLUTE /end AXIS_DESCR
/end CHARACTERISTIC
/begin CHARACTERISTIC BasAdj_nHighEngSpeed_C "Drehzahlschwelle zur Umschaltung der Grundeinstellung mit oder ohne Sicherheitsbedingungen" VALUE 0x1CC120 Kw_Ws16 65535.00 EngN -32768.00 32767.00 FORMAT "%8.2" /end CHARACTERISTIC
/begin CHARACTERISTIC BasAdj_nMaxShortTrip_C "Obere Drehzahlschwelle bei Grundeinstellungstest" VALUE 0x1CC122 Kw_Ws16 32767.00 EngN 0.00 32767.00 FORMAT "%8.2" EXTENDED_LIMITS -32768.00 32767.00 /end CHARACTERISTIC
/begin CHARACTERISTIC BasAdj_nMax_C "Drehzahlschwelle zum Ausführen der Grundeinstellung  (Diagnose)" VALUE 0x1CC124 Kw_Ws16 32767.00 EngN 0.00 32767.00 FORMAT "%8.2" EXTENDED_LIMITS -32768.00 32767.00 /end CHARACTERISTIC
/begin CHARACTERISTIC BasAdj_nRmpSlpDwn_C "Rampensteigung für verringernde Drehzahlwerte für BasAdj" VALUE 0x1CC128 Kw_Wu32 9362278.57317 RmpEngN_LIGov 7.13893345424 9362285.71211 FORMAT "%13.5" EXTENDED_LIMITS 0.00 9362285.71211 /end CHARACTERISTIC
/begin CHARACTERISTIC BasAdj_nRmpSlpUp_C "Rampensteigung für erhöhende Drehzahlwerte für BasAdj" VALUE 0x1CC12C Kw_Wu32 9362278.57317 RmpEngN_LIGov 7.13893345424 9362285.71211 FORMAT "%13.5" EXTENDED_LIMITS 0.00 9362285.71211 /end CHARACTERISTIC
/begin CHARACTERISTIC BasAdj_qMax_C "Mengenschwelle zum Ausführen der Grundeinstellung  (Diagnose)" VALUE 0x1CC130 Kw_Ws16 327.6700 InjMass 0.00 327.6700 FORMAT "%8.4" EXTENDED_LIMITS -327.6800 327.6700 /end CHARACTERISTIC
/begin CHARACTERISTIC BasAdj_rAccPedMinTresh_C "PWG-Schwelle fuer den Grundeinstellungstests" VALUE 0x1CC132 Kw_Ws16 100.0000 Prc 0.00 100.0000 FORMAT "%8.4" EXTENDED_LIMITS -327.6800 327.6700 /end CHARACTERISTIC
/begin CHARACTERISTIC BasAdj_rAirCtlEGR_C "erster [0] und zweiter [1] Sollwert des EGR-Ventils bei EGR Grundeinstellung  (Diagnose)" VAL_BLK 0x1CC134 Kwb_Ws16 655.3500 Prc -327.6800 327.6700 FORMAT "%8.4" NUMBER 2 /end CHARACTERISTIC
/begin CHARACTERISTIC BasAdj_rAirCtlTVA_C "erster [0] und zweiter [1] Sollwert der Drosselklappe bei EGR Grundeinstellung  (Diagnose)" VAL_BLK 0x1CC138 Kwb_Ws16 655.3500 Prc -327.6800 327.6700 FORMAT "%8.4" NUMBER 2 /end CHARACTERISTIC
/begin CHARACTERISTIC BasAdj_rPCRBiT_C "Erster [0] und zweiter [1] Sollwert des PCR-Stellglieds bei BiT Grundeinstellung  (Diagnose)" VAL_BLK 0x1CC13C Kwb_Ws16 655.3500 Prc -327.6800 327.6700 FORMAT "%8.4" NUMBER 2 /end CHARACTERISTIC
/begin CHARACTERISTIC BasAdj_rPCR_C "erster [0] und zweiter [1] Sollwert des PCR-Stellglieds bei PCR Grundeinstellung  (Diagnose)" VAL_BLK 0x1CC140 Kwb_Ws16 655.3500 Prc -327.6800 327.6700 FORMAT "%8.4" NUMBER 2 /end CHARACTERISTIC
/begin CHARACTERISTIC BasAdj_rTVA_C "Sollwert des TVA-Stellglieds bei TVA Grundeinstellung  (Diagnose)" VAL_BLK 0x1CC144 Kwb_Ws16 655.3500 Prc -327.6800 327.6700 FORMAT "%8.4" NUMBER 2 /end CHARACTERISTIC
/begin CHARACTERISTIC BasAdj_stAFVCD_C "Tastverhältnis für das AFVCD bei AFVCD-Grundeinstellung" VAL_BLK 0x1CC14C Kwb_Wu8 255.0 OneToOne 0.00 255.0 FORMAT "%5.1" NUMBER 2 /end CHARACTERISTIC
/begin CHARACTERISTIC BasAdj_stCmp2TstNum_C "Testroutinen Nummer für Kompressions Test" VALUE 0x1CC14E Kw_Wu8 255.0 OneToOne 0.00 255.0 FORMAT "%5.1" /end CHARACTERISTIC
/begin CHARACTERISTIC BasAdj_stCmpTstNum_C "Testroutine Nummer für Kompressionstest" VALUE 0x1CC14F Kw_Wu8 255.0 OneToOne 0.00 255.0 FORMAT "%5.1" /end CHARACTERISTIC
/begin CHARACTERISTIC BasAdj_stKickDownlrnNum_C "Testroutinenummer für den Kick-Down lernen" VALUE 0x1CC150 Kw_Wu8 255.0 OneToOne 0.00 255.0 FORMAT "%5.1" /end CHARACTERISTIC
/begin CHARACTERISTIC BasAdj_stPSP_C "Tastverhaeltnis fuer die Elektrische Vorfoerderpumpe bei PSP Grundeinstellung  (Diagnose)" VAL_BLK 0x1CC151 Kwb_Wu8 255.0 OneToOne 0.00 255.0 FORMAT "%5.1" NUMBER 2 /end CHARACTERISTIC
/begin CHARACTERISTIC BasAdj_swtCondSave_C "Schalter zur Umschaltung zwischen Grundeinstellung mit oder ohne Sicherheitsbedingungen" VALUE 0x1CC153 Kw_Wu8 1.000 OneToOne 0.00 1.000 FORMAT "%5.3" EXTENDED_LIMITS 0.00 255.0 /end CHARACTERISTIC
/begin CHARACTERISTIC BasAdj_swtFcmIgnore_C "Schalter zum Ignorieren der Fehlerspeichereinträge für die Aktivierung der Grundeinstellung mit Sicherheitsbedingungen" VALUE 0x1CC154 Kw_Wu8 1.000 OneToOne 0.00 1.000 FORMAT "%5.3" EXTENDED_LIMITS 0.00 255.0 /end CHARACTERISTIC
/begin CHARACTERISTIC BasAdj_tiEnd_C "Maximalzeit des Grundeinstellungstest  (Diagnose)" VALUE 0x1CC156 Kw_Wu16 655350.0 Time_ms 0.00 655350.0 FORMAT "%8.1" /end CHARACTERISTIC
/begin CHARACTERISTIC BasAdj_tiRoutDemMax_C "Zeit in der der Tester eine neue Anforderung senden muß, um nicht ins Timeout zu gelangen" VALUE 0x1CC158 Kw_Wu16 655350.0 Time_ms 0.00 655350.0 FORMAT "%8.1" /end CHARACTERISTIC
/begin CHARACTERISTIC BasAdj_tiTmrBRK_C "Timer für Bremse erkannt bei Grundeinstellung" VALUE 0x1CC15A Kw_Wu16 655.3500 Time_s 0.00 655.3500 FORMAT "%8.4" /end CHARACTERISTIC
/begin CHARACTERISTIC BasAdj_tiTmrPWG_C "Timer für PWG erkannt bei Grundeinstellung" VALUE 0x1CC15C Kw_Wu16 655.3500 Time_s 0.00 655.3500 FORMAT "%8.4" /end CHARACTERISTIC
/begin CHARACTERISTIC BattCD_uSRCMin_C "SRC-Min der Batteriespannung" VALUE 0x1CC1A4 Kw_Ws16 20782.00 Volt_Batt 0.00 20782.00 FORMAT "%8.2" EXTENDED_LIMITS -665674.1 665653.8 /end CHARACTERISTIC
/begin CHARACTERISTIC BattCD_uSRCMax_C "SRC-Max der Batteriespannung" VALUE 0x1CC1A6 Kw_Ws16 20782.00 Volt_Batt 0.00 20782.00 FORMAT "%8.2" EXTENDED_LIMITS -665674.1 665653.8 /end CHARACTERISTIC
/begin CHARACTERISTIC BattCD_uLin_CUR "Linearisierungskennlinie" CURVE 0x1CC1A8 Kl_Xs16_Ws16 28603.18 Volt_Batt 0.00 28603.18 FORMAT "%8.2" EXTENDED_LIMITS -665674.1 665653.8
 /begin AXIS_DESCR STD_AXIS BattCD_uRaw Volt_Batt 5 0.00 28603.18 FORMAT "%8.2" EXTENDED_LIMITS -665674.1 665653.8 DEPOSIT ABSOLUTE /end AXIS_DESCR
/end CHARACTERISTIC
/begin CHARACTERISTIC BattCD_duRmpSlpUp_C "Rampe Zunahme Batteriespannung negative Steigung" VALUE 0x1CC1C0 Kw_Wu32 1331348144.36 RmpVoltBatt 0.00 1331348144.36 FORMAT "%13.2" /end CHARACTERISTIC
/begin CHARACTERISTIC BattCD_duRmpSlpDwn_C "Rampe Zunahme Batteriespannung positive Steigung" VALUE 0x1CC1C4 Kw_Wu32 1331348144.36 RmpVoltBatt 0.00 1331348144.36 FORMAT "%13.2" /end CHARACTERISTIC
/begin CHARACTERISTIC BattCD_tiDebSRCHighDef_C "Entprellzeit für Erkennung des SRC-High-Fehlers der Batteriespannung" VALUE 0x1CC1C8 Kw_Wu16 655350.0 Time_ms 0.00 655350.0 FORMAT "%8.1" /end CHARACTERISTIC
/begin CHARACTERISTIC BattCD_tiDebSRCHighOk_C "Entprellzeit für Heilung des SRC-High-Fehlers der Batteriespannung" VALUE 0x1CC1CA Kw_Wu16 655350.0 Time_ms 0.00 655350.0 FORMAT "%8.1" /end CHARACTERISTIC
/begin CHARACTERISTIC BattCD_tiDebSRCLowDef_C "Entprellzeit für Erkennung des SRC-Low-Fehlers der Batteriespannung" VALUE 0x1CC1CC Kw_Wu16 655350.0 Time_ms 0.00 655350.0 FORMAT "%8.1" /end CHARACTERISTIC
/begin CHARACTERISTIC BattCD_tiDebSRCLowOk_C "Entprellzeit für Heilung des SRC-Low-Fehlers der Batteriespannung" VALUE 0x1CC1CE Kw_Wu16 655350.0 Time_ms 0.00 655350.0 FORMAT "%8.1" /end CHARACTERISTIC
/begin CHARACTERISTIC BattCD_stSensIDWord_C "Kennung Batteriespannungserfassung" VALUE 0x1CC1D0 Kw_Wu16 65535.00 OneToOne 0.00 65535.00 FORMAT "%8.2" /end CHARACTERISTIC
/begin CHARACTERISTIC BattCD_uDfl_C "Vorgabewert Batteriespannung" VALUE 0x1CC1D2 Kw_Ws16 28603.18 Volt_Batt 0.00 28603.18 FORMAT "%8.2" EXTENDED_LIMITS -665674.1 665653.8 /end CHARACTERISTIC
/begin CHARACTERISTIC BattCD_vLim_C "Geschwindigkeitsgrenze zum Ausblenden von BattCD-SRC-High-Fehler" VALUE 0x1CC1D4 Kw_Ws16 250.0000 Vel 0.00 250.0000 FORMAT "%8.4" EXTENDED_LIMITS -327.6800 327.6700 /end CHARACTERISTIC
/begin CHARACTERISTIC Batt_facCor_CUR "Kennlinie für Batteriespannungskorrektur" CURVE 0x1CC190 Kl_Xs16_Ws16 1.600098 Fact 0.1999512 1.800049 FORMAT "%8.6" EXTENDED_LIMITS -4.000000 3.999878
 /begin AXIS_DESCR STD_AXIS BattCD_u Volt_Batt 4 0.00 20010.04 FORMAT "%8.2" EXTENDED_LIMITS -665674.1 665653.8 DEPOSIT ABSOLUTE /end AXIS_DESCR
/end CHARACTERISTIC
/begin CHARACTERISTIC BIP_tiSetPointCtrMI1_Vector "Konfigurationslabel für Bypass" VALUE 0x1C0A54 Kw_Wu8 255.0 OneToOne 0.00 255.0 FORMAT "%5.1" /end CHARACTERISTIC
/begin CHARACTERISTIC BIP_tiSetPointCtrMI1_Channel "Konfigurationslabel für Bypass" VALUE 0x1C0A55 Kw_Wu8 255.0 OneToOne 0.00 255.0 FORMAT "%5.1" /end CHARACTERISTIC
/begin CHARACTERISTIC BIP_tiSetPointCtrPiI1_Vector "Konfigurationslabel für Bypass" VALUE 0x1C0A56 Kw_Wu8 255.0 OneToOne 0.00 255.0 FORMAT "%5.1" /end CHARACTERISTIC
/begin CHARACTERISTIC BIP_tiSetPointCtrPiI1_Channel "Konfigurationslabel für Bypass" VALUE 0x1C0A57 Kw_Wu8 255.0 OneToOne 0.00 255.0 FORMAT "%5.1" /end CHARACTERISTIC
/begin CHARACTERISTIC BIP_tiSetPointCtrPoI2_Vector "Konfigurationslabel für Bypass" VALUE 0x1C0A58 Kw_Wu8 255.0 OneToOne 0.00 255.0 FORMAT "%5.1" /end CHARACTERISTIC
/begin CHARACTERISTIC BIP_tiSetPointCtrPoI2_Channel "Konfigurationslabel für Bypass" VALUE 0x1C0A59 Kw_Wu8 255.0 OneToOne 0.00 255.0 FORMAT "%5.1" /end CHARACTERISTIC
/begin CHARACTERISTIC BPSCD_uSRCMin_C "SRC-Min-Wert für Ladedruck." VALUE 0x1CC72C Kw_Ws16 5000.000 Volt 0.00 5000.000 FORMAT "%8.3" EXTENDED_LIMITS -160156.4 160151.5 /end CHARACTERISTIC
/begin CHARACTERISTIC BPSCD_uSRCMax_C "SRC-Max-Wert für Ladedruck." VALUE 0x1CC72E Kw_Ws16 5000.000 Volt 0.00 5000.000 FORMAT "%8.3" EXTENDED_LIMITS -160156.4 160151.5 /end CHARACTERISTIC
/begin CHARACTERISTIC BPSCD_pLin_CUR "Linearisierungskennlinie" CURVE 0x1CC730 Kl_Xs16_Ws16 5000.000 Pres_hPa 0.00 5000.000 FORMAT "%8.3" EXTENDED_LIMITS -32768.00 32767.00
 /begin AXIS_DESCR STD_AXIS BPSCD_uRawVal Volt 25 0.00 5000.000 FORMAT "%8.3" EXTENDED_LIMITS -160156.4 160151.5 DEPOSIT ABSOLUTE /end AXIS_DESCR
/end CHARACTERISTIC
/begin CHARACTERISTIC BPSCD_ctAvgMx_C "Anzahl der Berechnungszyklen für die Absolute APS-BPS Differenz" VALUE 0x1CC796 Kw_Wu16 249.0000 OneToOne 1.000000 250.0000 FORMAT "%8.4" EXTENDED_LIMITS 0.00 65535.00 /end CHARACTERISTIC
/begin CHARACTERISTIC BPSCD_DebSigDef_C "Defektentprellzeit fuer CAN Signal defekt" VALUE 0x1CC798 Kw_Wu16 655350.0 Time_ms 0.00 655350.0 FORMAT "%8.1" /end CHARACTERISTIC
/begin CHARACTERISTIC BPSCD_DebSigOK_C "Heilungsentprellzeit fuer CAN Signal defekt" VALUE 0x1CC79A Kw_Wu16 655350.0 Time_ms 0.00 655350.0 FORMAT "%8.1" /end CHARACTERISTIC
/begin CHARACTERISTIC BPSCD_DebSRCHighDef_C "Fehlerentprellzeit fuer SRC-High Fehler" VALUE 0x1CC79C Kw_Wu16 655350.0 Time_ms 0.00 655350.0 FORMAT "%8.1" /end CHARACTERISTIC
/begin CHARACTERISTIC BPSCD_DebSRCHighOK_C "Heilungsentprellzeit fuer SRC-High Fehler" VALUE 0x1CC79E Kw_Wu16 655350.0 Time_ms 0.00 655350.0 FORMAT "%8.1" /end CHARACTERISTIC
/begin CHARACTERISTIC BPSCD_DebSRCLowDef_C "Fehlerentprellzeit fuer SRC-Low Fehler" VALUE 0x1CC7A0 Kw_Wu16 655350.0 Time_ms 0.00 655350.0 FORMAT "%8.1" /end CHARACTERISTIC
/begin CHARACTERISTIC BPSCD_DebSRCLowOK_C "Heilungsentprellzeit fuer SRC-Low Fehler" VALUE 0x1CC7A2 Kw_Wu16 655350.0 Time_ms 0.00 655350.0 FORMAT "%8.1" /end CHARACTERISTIC
/begin CHARACTERISTIC BPSCD_nLim_C "Obere Grenze Motordrehzahl." VALUE 0x1CC7A4 Kw_Ws16 6000.000 EngN 0.00 6000.000 FORMAT "%8.3" EXTENDED_LIMITS -32768.00 32767.00 /end CHARACTERISTIC
/begin CHARACTERISTIC BPSCD_numSSp_C "Wahlschalter für Sensorversorgungsschaltermonitor für Ladedruckfühler" VALUE 0x1CC7A6 Kw_Wu8 2.000 OneToOne 1.000 3.000 FORMAT "%5.3" EXTENDED_LIMITS 0.00 255.0 /end CHARACTERISTIC
/begin CHARACTERISTIC BPSCD_pAdjMax_C "oberer Grenzwert für Ladedruckkorrektur mit dem Lade-Atmosphärendruckabgleichwert" VALUE 0x1CC7A8 Kw_Ws16 3000.000 Pres_hPa 0.00 3000.000 FORMAT "%8.3" EXTENDED_LIMITS -32768.00 32767.00 /end CHARACTERISTIC
/begin CHARACTERISTIC BPSCD_tiPT1_C "Verzugszeit. (für PT1 Filter )" VALUE 0x1CC7AC Kw_Wu32 4294.9673 TimeDelay_s 0.0000010000000 4294.9673 FORMAT "%9.4" /end CHARACTERISTIC
/begin CHARACTERISTIC BPSCD_pDiffLim_C "Grenzwert für absolute Differenz zwischen LD und AD" VALUE 0x1CC7B0 Kw_Ws16 3500.000 Pres_hPa 0.00 3500.000 FORMAT "%8.3" EXTENDED_LIMITS -32768.00 32767.00 /end CHARACTERISTIC
/begin CHARACTERISTIC BPSCD_tiLPFilt_C "Low-Pass-Filter Zeitkonstante für LDF-Erfassung" VALUE 0x1C0B40 Kw_Wu32 0.099997239 TimeDelay_s 0.0000020000000 0.099999239 FORMAT "%10.8" EXTENDED_LIMITS 0.0000010000000 4294.9673 /end CHARACTERISTIC
/begin CHARACTERISTIC BPSCD_dpRmpSlpUp_C "Rampensteigung bei Heilung/Vorgabewert für LDF" VALUE 0x1CC7B4 Kw_Wu32 65535999.9847 RmpPres_hPa 0.00 65535999.9847 FORMAT "%13.4" /end CHARACTERISTIC
/begin CHARACTERISTIC BPSCD_dpRmpSlpDwn_C "Rampensteigung bei Heilung/Vorgabewert für LDF" VALUE 0x1CC7B8 Kw_Wu32 65535999.9847 RmpPres_hPa 0.00 65535999.9847 FORMAT "%13.4" /end CHARACTERISTIC
/begin CHARACTERISTIC BPSCD_swtCorrOn_C "Schalter zur Aktivierung der Ladedruckkorrektur mit dem Lade-Atmosphärendruckabgleichwert" VALUE 0x1CC7BC Kw_Wu8 1.000 OneToOne 0.00 1.000 FORMAT "%5.3" EXTENDED_LIMITS 0.00 255.0 /end CHARACTERISTIC
/begin CHARACTERISTIC BPSCD_swtSigVal_C "Schalter ob Signal ueber CAN/ADC (0 = ADC, 1 = CAN)" VALUE 0x1CC7BD Kw_Wu8 1.000 OneToOne 0.00 1.000 FORMAT "%5.3" EXTENDED_LIMITS 0.00 255.0 /end CHARACTERISTIC
/begin CHARACTERISTIC BPSCD_tiAvgDlyRcy_C "Verzögerung des Berechnungsstarts der Absoluten APS-BPS Differenz nach recoveries" VALUE 0x1CC7BE Kw_Wu16 655350.0 Time_ms 0.00 655350.0 FORMAT "%8.1" /end CHARACTERISTIC
/begin CHARACTERISTIC BPSCD_tiAvgDly_C "Verzögerung des Berechnungsstarts der  Absoluten  APS-BPS Differenz" VALUE 0x1CC7C0 Kw_Wu16 655350.0 Time_ms 0.00 655350.0 FORMAT "%8.1" /end CHARACTERISTIC
/begin CHARACTERISTIC BPSCD_stSensIDWord_C "Geberkennwort LDF" VALUE 0x1CC7C2 Kw_Wu16 65535.00 OneToOne 0.00 65535.00 FORMAT "%8.2" /end CHARACTERISTIC
/begin CHARACTERISTIC BPSCD_pDfl_C "Ladedruck Vorgabewert" VALUE 0x1CC7C4 Kw_Ws16 65535.00 Pres_hPa -32768.00 32767.00 FORMAT "%8.2" /end CHARACTERISTIC
/begin CHARACTERISTIC BrkCD_DebBPTInvldDef_C "Defektzeit für Bremsdruck Status ungültig via CAN" VALUE 0x1CC7C8 Kw_Wu16 655350.0 Time_ms 0.00 655350.0 FORMAT "%8.1" /end CHARACTERISTIC
/begin CHARACTERISTIC BrkCD_DebBPTInvldOk_C "Heilzeit für Bremsdruck Status ungültig via CAN" VALUE 0x1CC7CA Kw_Wu16 655350.0 Time_ms 0.00 655350.0 FORMAT "%8.1" /end CHARACTERISTIC
/begin CHARACTERISTIC BrkCD_DebdynPlaDef_C "Zählergrenze für endgültig defekt bei dynamischer Bremsenplausibilität" VALUE 0x1CC7CC Kw_Wu16 65535.00 OneToOne 0.00 65535.00 FORMAT "%8.2" /end CHARACTERISTIC
/begin CHARACTERISTIC BrkCD_DebdynPlaOk_C "Zählerschwelle für endgültig ok (nicht verwendet)" VALUE 0x1CC7CE Kw_Wu16 65535.00 OneToOne 0.00 65535.00 FORMAT "%8.2" /end CHARACTERISTIC
/begin CHARACTERISTIC BrkCD_DebSRCHighDef_C "Fehlerentprellungszeit fuer SRC-High Bremskontakt" VALUE 0x1CC7D0 Kw_Wu16 655350.0 Time_ms 0.00 655350.0 FORMAT "%8.1" /end CHARACTERISTIC
/begin CHARACTERISTIC BrkCD_DebSRCHighOk_C "Heilungsentprellzeit fuer SRC-High Bremskontakt" VALUE 0x1CC7D2 Kw_Wu16 655350.0 Time_ms 0.00 655350.0 FORMAT "%8.1" /end CHARACTERISTIC
/begin CHARACTERISTIC BrkCD_DebSRCLowDef_C "Fehlerentprellungszeit fuer SRC-Low Bremskontakt" VALUE 0x1CC7D4 Kw_Wu16 655350.0 Time_ms 0.00 655350.0 FORMAT "%8.1" /end CHARACTERISTIC
/begin CHARACTERISTIC BrkCD_DebSRCLowOk_C "Heilungsentprellzeit fuer SRC-Low Bremskontakt" VALUE 0x1CC7D6 Kw_Wu16 655350.0 Time_ms 0.00 655350.0 FORMAT "%8.1" /end CHARACTERISTIC
/begin CHARACTERISTIC BrkCD_uMnSwtSRCMin_C "SRC Minimum (Bremskontakt)" VALUE 0x1CC7D8 Kw_Ws16 5200.391 Volt 0.00 5200.391 FORMAT "%8.3" EXTENDED_LIMITS -160156.4 160151.5 /end CHARACTERISTIC
/begin CHARACTERISTIC BrkCD_uMnSwtSRCMax_C "SRC Maximum (Bremskontakt)" VALUE 0x1CC7DA Kw_Ws16 5200.391 Volt 0.00 5200.391 FORMAT "%8.3" EXTENDED_LIMITS -160156.4 160151.5 /end CHARACTERISTIC
/begin CHARACTERISTIC BrkCD_uMnSwtLin_CUR "Linearisierungskennlinie des Bremskontaktes" CURVE 0x1CC7DC Kl_Xs16_Ws16 5200.391 Volt 0.00 5200.391 FORMAT "%8.3" EXTENDED_LIMITS -160156.4 160151.5
 /begin AXIS_DESCR STD_AXIS BrkCD_uMnSwtRawVal Volt 3 0.00 5200.391 FORMAT "%8.3" EXTENDED_LIMITS -160156.4 160151.5 DEPOSIT ABSOLUTE /end AXIS_DESCR
/end CHARACTERISTIC
/begin CHARACTERISTIC BrkCD_tiMnSwtDebNeg_C "Entprellzeit Bremskontakt - abfallende Flanke" VALUE 0x1CC7EA Kw_Wu16 655350.0 TimeDeb 0.00 655350.0 FORMAT "%8.1" /end CHARACTERISTIC
/begin CHARACTERISTIC BrkCD_tiMnSwtDebPos_C "Entprellzeit Bremskontakt - aufsteigende Flanke" VALUE 0x1CC7EC Kw_Wu16 655350.0 TimeDeb 0.00 655350.0 FORMAT "%8.1" /end CHARACTERISTIC
/begin CHARACTERISTIC BrkCD_numStepDef_C "Schrittweite des Zählers bei Defekterkennung" VALUE 0x1CC7EE Kw_Wu8 3.000 OneToOne 0.00 3.000 FORMAT "%5.3" EXTENDED_LIMITS 0.00 255.0 /end CHARACTERISTIC
/begin CHARACTERISTIC BrkCD_numStepOK_C "Schrittweise des Zählers bei der Heilungserkennung (nicht verwendet)" VALUE 0x1CC7EF Kw_Wu8 3.000 OneToOne 0.00 3.000 FORMAT "%5.3" EXTENDED_LIMITS 0.00 255.0 /end CHARACTERISTIC
/begin CHARACTERISTIC BrkCD_tiRedSwtDebNeg_C "Entprellzeit redundanter Bremskontakt - abfallende Flanke" VALUE 0x1CC7F0 Kw_Wu16 655350.0 TimeDeb 0.00 655350.0 FORMAT "%8.1" /end CHARACTERISTIC
/begin CHARACTERISTIC BrkCD_tiRedSwtDebPos_C "Entprellzeit redundanter Bremskontakt - aufsteigende Flanke" VALUE 0x1CC7F2 Kw_Wu16 655350.0 TimeDeb 0.00 655350.0 FORMAT "%8.1" /end CHARACTERISTIC
/begin CHARACTERISTIC BrkCD_dtRmpSlpUp_C "Aufwärts-Schritt für Rampe Bremskontakt" VALUE 0x1CC7F4 Kw_Wu32 320312805.400 RmpVolt 0.00 320312805.400 FORMAT "%13.3" /end CHARACTERISTIC
/begin CHARACTERISTIC BrkCD_dtRmpSlpDwn_C "Abwärts-Schritt für Rampe Bremskontakt" VALUE 0x1CC7F8 Kw_Wu32 320312805.400 RmpVolt 0.00 320312805.400 FORMAT "%13.3" /end CHARACTERISTIC
/begin CHARACTERISTIC BrkCD_stBrk8ErrMsk_C "Mask for CAN error in BRK8 frame" VALUE 0x1CC7FC Kw_Wu8 255.0 OneToOne 0.00 255.0 FORMAT "%5.1" /end CHARACTERISTIC
/begin CHARACTERISTIC BrkCD_stBrk_Invalid_C "Bremskontaktschalter Vorgabewert bei Sensordefekt" VALUE 0x1CC7FD Kw_Wu8 3.000 OneToOne 0.00 3.000 FORMAT "%5.3" EXTENDED_LIMITS 0.00 255.0 /end CHARACTERISTIC
/begin CHARACTERISTIC BrkCD_stDflVal_C "Redundanter Bremskontakt-Vorgabewert" VALUE 0x1C1FF0 Kw_Wu8 15.00 OneToOne 0.00 15.00 FORMAT "%5.2" EXTENDED_LIMITS 0.00 255.0 /end CHARACTERISTIC
/begin CHARACTERISTIC BrkCD_stMnSwtInvIn_C "Signal Bremskontakt invertiert" VALUE 0x1CC7FE Kw_Wu8 1.000 OneToOne 0.00 1.000 FORMAT "%5.3" EXTENDED_LIMITS 0.00 255.0 /end CHARACTERISTIC
/begin CHARACTERISTIC BrkCD_stRedSwtInvIn_C "Signal redundanter Bremskontakt invertiert" VALUE 0x1C1FF1 Kw_Wu8 1.000 OneToOne 0.00 1.000 FORMAT "%5.3" EXTENDED_LIMITS 0.00 255.0 /end CHARACTERISTIC
/begin CHARACTERISTIC BrkCD_swtRedSwtPresent_C "Schalter redundanter Bremskontakt vorhanden (1 = vorhanden, 0 = nicht vorhanden)" VALUE 0x1CC7FF Kw_Wu8 1.000 OneToOne 0.00 1.000 FORMAT "%5.3" EXTENDED_LIMITS 0.00 255.0 /end CHARACTERISTIC
/begin CHARACTERISTIC BrkCD_swtSigVal_C "Schalterwert, Signal von HW DIO/CAN (1=CAN, 0=DIO)" VALUE 0x1C1FF2 Kw_Wu8 4.000 OneToOne 0.00 4.000 FORMAT "%5.3" EXTENDED_LIMITS 0.00 255.0 /end CHARACTERISTIC
/begin CHARACTERISTIC BrkCD_tiBREdyn_C "Zeit für die ein unplausibles Signal anliegen muß, um den Ereigniszähler hochzuzählen" VALUE 0x1CC800 Kw_Wu32 1500.00000000 Time_ms 500.000000000 2000.00000000 FORMAT "%13.8" EXTENDED_LIMITS 0.00 42949672950.0 /end CHARACTERISTIC
/begin CHARACTERISTIC BrkCD_tiBREiO_C "Zeit für die plausible Bremssignale anliegen müssen um Fehler wieder zu heilen." VALUE 0x1CC804 Kw_Wu32 1500.00000000 Time_ms 500.000000000 2000.00000000 FORMAT "%13.8" EXTENDED_LIMITS 0.00 42949672950.0 /end CHARACTERISTIC
/begin CHARACTERISTIC BrkCD_stSensIDWord_C "Geberkennwort Bremskontakt" VALUE 0x1CC808 Kw_Wu16 65535.00 OneToOne 0.00 65535.00 FORMAT "%8.2" /end CHARACTERISTIC
/begin CHARACTERISTIC BrkCD_uDfl_C "Bremskontakt Spannungsvorgabewert bei Fehler" VALUE 0x1CC80A Kw_Ws16 5200.391 Volt 0.00 5200.391 FORMAT "%8.3" EXTENDED_LIMITS -160156.4 160151.5 /end CHARACTERISTIC
/begin CHARACTERISTIC BrkCD_uMnSwtA2DThres_C "Analogsignalschwelle zur Erkennung log. EIN" VALUE 0x1CC80C Kw_Ws16 5000.000 Volt 0.00 5000.000 FORMAT "%8.3" EXTENDED_LIMITS -160156.4 160151.5 /end CHARACTERISTIC
/begin CHARACTERISTIC BypEtk_dNsyncStimuli64_C "Bypass, nicht ändern. Anzahl der winkelsynchron übertragenen Acht-Byte-Größen von ASCET zur ECU." VALUE 0x1CC810 Kw_Wu8 255.0 OneToOne 0.00 255.0 FORMAT "%5.1" /end CHARACTERISTIC
/begin CHARACTERISTIC BypEtk_dNsyncStimuli32_C "Bypass, nicht ändern. Anzahl der winkelsynchron übertragenen Vier-Byte-Größen von ASCET zur ECU." VALUE 0x1CC811 Kw_Wu8 255.0 OneToOne 0.00 255.0 FORMAT "%5.1" /end CHARACTERISTIC
/begin CHARACTERISTIC BypEtk_dNsyncStimuli16_C "Bypass, nicht ändern. Anzahl der winkelsynchron übertragenen Zwei-Byte-Größen von ASCET zur ECU." VALUE 0x1CC812 Kw_Wu8 255.0 OneToOne 0.00 255.0 FORMAT "%5.1" /end CHARACTERISTIC
/begin CHARACTERISTIC BypEtk_dNsyncStimuli8_C "Bypass, nicht ändern. Anzahl der winkelsynchron übertragenen Ein-Byte-Größen von ASCET zur ECU." VALUE 0x1CC813 Kw_Wu8 255.0 OneToOne 0.00 255.0 FORMAT "%5.1" /end CHARACTERISTIC
/begin CHARACTERISTIC BypEtk_stAscet_C "Status ASCET ETK Bypass (0: deaktiviert; 1: ETK-Bypass starten, wenn Wert vorher 0; 2: sofort starten)" VALUE 0x1CC814 Kw_Wu8 2.000 OneToOne 0.00 2.000 FORMAT "%5.3" EXTENDED_LIMITS 0.00 255.0 /end CHARACTERISTIC
/begin CHARACTERISTIC BypEtk_dTsyncStimuli64_C "Bypass, nicht ändern. Anzahl der zeitsynchron übertragenen Acht-Byte-Größen von ASCET zur ECU." VALUE 0x1CC815 Kw_Wu8 255.0 OneToOne 0.00 255.0 FORMAT "%5.1" /end CHARACTERISTIC
/begin CHARACTERISTIC BypEtk_dTsyncStimuli32_C "Bypass, nicht ändern. Anzahl der zeitsynchron übertragenen Vier-Byte-Größen von ASCET zur ECU." VALUE 0x1CC816 Kw_Wu8 255.0 OneToOne 0.00 255.0 FORMAT "%5.1" /end CHARACTERISTIC
/begin CHARACTERISTIC BypEtk_dTsyncStimuli16_C "Bypass, nicht ändern. Anzahl der zeitsynchron übertragenen Zwei-Byte-Größen von ASCET zur ECU." VALUE 0x1CC817 Kw_Wu8 255.0 OneToOne 0.00 255.0 FORMAT "%5.1" /end CHARACTERISTIC
/begin CHARACTERISTIC BypEtk_dTsyncStimuli8_C "Bypass, nicht ändern. Anzahl der zeitsynchron übertragenen Ein-Byte-Größen von ASCET zur ECU." VALUE 0x1CC818 Kw_Wu8 255.0 OneToOne 0.00 255.0 FORMAT "%5.1" /end CHARACTERISTIC
/begin CHARACTERISTIC BypInt_adFunc_C "Feld von Funktionszeigern auf interne Bypass Funktionen" VAL_BLK 0x1CC81C Kwb_Wu32 4294967295.00 OneToOne 0.00 4294967295.00 FORMAT "%13.2" NUMBER 11 /end CHARACTERISTIC
/begin CHARACTERISTIC BypInt_stAscet_C "Status interner ASCET Bypass (0: deaktiviert; 1: internen Bypass starten, wenn Wert vorher 0; 2: sofort starten)" VALUE 0x1CC848 Kw_Wu8 2.000 OneToOne 0.00 2.000 FORMAT "%5.3" EXTENDED_LIMITS 0.00 255.0 /end CHARACTERISTIC
/begin CHARACTERISTIC CARB_Mode1PID1D_C "Sauserstoffsensor Position für Carb Mode $1 PID 1D" VALUE 0x1CC928 Kw_Wu8 255.0 OneToOne 0.00 255.0 FORMAT "%5.1" /end CHARACTERISTIC
/begin CHARACTERISTIC CARB_Mode1PID4FB_C "Lambda Konfiguration for Carb Mode $1 PID 4F (Byte 5-6)" VALUE 0x1CC92A Kw_Wu16 65535.00 OneToOne 0.00 65535.00 FORMAT "%8.2" /end CHARACTERISTIC
/begin CHARACTERISTIC CARB_Mode1PID4F_C "Lambda Konfiguration für Carb Mode $1 PID 4F (Byte 1-4)" VALUE 0x1CC92C Kw_Wu32 4294967295.00 OneToOne 0.00 4294967295.00 FORMAT "%13.2" /end CHARACTERISTIC
/begin CHARACTERISTIC Carb_Mode1PID_CA "Feld von unterstützen Carb Mode $1 PID's" VAL_BLK 0x1CC84C Kwb_Wu8 255.0 OneToOne 0.00 255.0 FORMAT "%5.1" NUMBER 40 /end CHARACTERISTIC
/begin CHARACTERISTIC Carb_Mode1Signal_CA "Feld der Signale von Carb Mode $1 welche mit den PID's verbunden sind" VAL_BLK 0x1CC874 Kwb_Wu16 1152.00000000 SigName 0.00 1152.00000000 FORMAT "%13.8" NUMBER 40 /end CHARACTERISTIC
/begin CHARACTERISTIC Carb_Mode2PID_CA "Feld von unterstützen Carb Mode $2 PID's" VAL_BLK 0x1CC8C4 Kwb_Wu8 254.0 OneToOne 1.000 255.0 FORMAT "%5.1" EXTENDED_LIMITS 0.00 255.0 NUMBER 25 /end CHARACTERISTIC
/begin CHARACTERISTIC Carb_Mode2Signal_CA "Feld der Signale von Carb Mode $2 welche mit den PID's verbunden sind" VAL_BLK 0x1CC8DE Kwb_Wu16 1152.00000000 SigName 0.00 1152.00000000 FORMAT "%13.8" NUMBER 25 /end CHARACTERISTIC
/begin CHARACTERISTIC Carb_Mode3SwtDia_C "Anzeigen der Fehler nur für Carb Mode 3(0) oder für Carb Mode 3 und 7 (1)" VALUE 0x1CC910 Kw_Wu8 255.0 OneToOne 0.00 255.0 FORMAT "%5.1" /end CHARACTERISTIC
/begin CHARACTERISTIC Carb_Mode4RefVal_C "Ist Carb_Mode4SigNum_C größer als dieser Referenzwert erfolgt kein Reset" VALUE 0x1CC914 Kw_Ws32 4294967295.00 OneToOne -2147483648.00 2147483647.00 FORMAT "%13.2" /end CHARACTERISTIC
/begin CHARACTERISTIC Carb_Mode4SigNum_C "Vergleiche Carb_Mode4SigNum_C mit dem Referenzwert Carb_Mode4RefVal_C" VALUE 0x1CC918 Kw_Wu16 65535.00 OneToOne 0.00 65535.00 FORMAT "%8.2" /end CHARACTERISTIC
/begin CHARACTERISTIC Carb_Mode9PID0_C "Support-Status des Infotype 0x00. Liefert alle ünterstützten Infotypes ( immer 0 für supported)" VALUE 0x1CC91A Kw_Wu8 255.0 OneToOne 0.00 255.0 FORMAT "%5.1" /end CHARACTERISTIC
/begin CHARACTERISTIC Carb_Mode9PID1_C "Support-Status des Infotype 0x01 (1 für supported, 0 für nicht supported)" VALUE 0x1CC91B Kw_Wu8 255.0 OneToOne 0.00 255.0 FORMAT "%5.1" /end CHARACTERISTIC
/begin CHARACTERISTIC Carb_Mode9PID2_C "Support-Status des Infotype 0x02 ""Vehicle Identification"" ( 2 für supported, 0 für nicht supported)" VALUE 0x1CC91C Kw_Wu8 255.0 OneToOne 0.00 255.0 FORMAT "%5.1" /end CHARACTERISTIC
/begin CHARACTERISTIC Carb_Mode9PID3_C "Support-Status des Infotype 0x03 ( 3 für supported, 0 für nicht supported)" VALUE 0x1CC91D Kw_Wu8 255.0 OneToOne 0.00 255.0 FORMAT "%5.1" /end CHARACTERISTIC
/begin CHARACTERISTIC Carb_Mode9PID4_C "Support-Status des Infotype 0x04 ""Calibration Identification"" ( 4 für supported, 0 für nicht supported)" VALUE 0x1CC91E Kw_Wu8 255.0 OneToOne 0.00 255.0 FORMAT "%5.1" /end CHARACTERISTIC
/begin CHARACTERISTIC Carb_Mode9PID5_C "Support-Status des Infotype 0x05 ( 5 für supported, 0 für nicht supported)" VALUE 0x1CC91F Kw_Wu8 255.0 OneToOne 0.00 255.0 FORMAT "%5.1" /end CHARACTERISTIC
/begin CHARACTERISTIC Carb_Mode9PID6_C "Support-Status des Infotype 0x06 ""Calibration Verification Number"" ( 6 für supported, 0 für nicht supported)" VALUE 0x1CC920 Kw_Wu8 6.000 OneToOne 0.00 6.000 FORMAT "%5.3" EXTENDED_LIMITS 0.00 255.0 /end CHARACTERISTIC
/begin CHARACTERISTIC Carb_Mode9PID7_C "Support-Status des Infotype 0x07 ( 7 für supported, 0 für nicht supported)" VALUE 0x1CC921 Kw_Wu8 255.0 OneToOne 0.00 255.0 FORMAT "%5.1" /end CHARACTERISTIC
/begin CHARACTERISTIC Carb_Mode9PID8_C "Support-Status des Infotype 0x08 ""IUMPR"" ( 8 für supported, 0 für nicht supported )" VALUE 0x1CC922 Kw_Wu8 255.0 OneToOne 0.00 255.0 FORMAT "%5.1" /end CHARACTERISTIC
/begin CHARACTERISTIC Carb_stOBDMedia_C "Schalter um OBD über Uart und/oder CAN auszuschalten" VALUE 0x1CC924 Kw_Wu8 3.000 OneToOne 0.00 3.000 FORMAT "%5.3" EXTENDED_LIMITS 0.00 255.0 /end CHARACTERISTIC
/begin CHARACTERISTIC CaSCD_ctAddTooth_C "Anzahl der tolerierbaren zusätzlichen Zähne im Nockenwellensignal" VALUE 0x1CC930 Kw_Wu8 255.0 OneToOne 0.00 255.0 FORMAT "%5.1" /end CHARACTERISTIC
/begin CHARACTERISTIC CaSCD_ctErrSegLen2Pos_C "Anzahl der tolerierbaren Fehler, Segmentlänge paßt nicht zur gefundenen Absolutposition des Nockenwellensignals" VALUE 0x1CC932 Kw_Wu8 255.0 OneToOne 0.00 255.0 FORMAT "%5.1" /end CHARACTERISTIC
/begin CHARACTERISTIC CaSCD_ctMissTooth_C "Anzahl der tolerierbaren fehlenden Zähne im Nockenwellensignal" VALUE 0x1CC934 Kw_Wu8 255.0 OneToOne 0.00 255.0 FORMAT "%5.1" /end CHARACTERISTIC
/begin CHARACTERISTIC CaSCD_dSegSeriesCor_C "Segmentfolge der Phasengebersegmente korrigiert" VAL_BLK 0x1CC9FC Kwb_Wu8 31.00 OneToOne 0.00 31.00 FORMAT "%5.2" EXTENDED_LIMITS 0.00 255.0 NUMBER 16 /end CHARACTERISTIC
/begin CHARACTERISTIC CaSCD_dSegSeries_C "Segmentfolge der Phasengebersegmente" VAL_BLK 0x1C0B44 Kwb_Wu8 31.00 OneToOne 0.00 31.00 FORMAT "%5.2" EXTENDED_LIMITS 0.00 255.0 NUMBER 16 /end CHARACTERISTIC
/begin CHARACTERISTIC CaSCD_dTrigMsk_C "Triggermaske für vorlaeufige Segmenterkennung" VALUE 0x1C0B54 Kw_Wu8 255.0 OneToOne 0.00 255.0 FORMAT "%5.1" /end CHARACTERISTIC
/begin CHARACTERISTIC CaSCD_dTrigRslt_C "Triggerergebnis der vorlaeufigen Segmenterkennung" VALUE 0x1C0B55 Kw_Wu8 255.0 OneToOne 0.00 255.0 FORMAT "%5.1" /end CHARACTERISTIC
/begin CHARACTERISTIC CaSCD_facPlausHigh_CUR "Obere Grenze der Plausibilitätsprüfung des Phasengebersignals" CURVE 0x1CC936 Kl_Xs16_Ws16 19.00000 Fact1 1.000000 20.00000 FORMAT "%8.5" EXTENDED_LIMITS -256.0000 255.9922
 /begin AXIS_DESCR STD_AXIS CaSCD_tiPeriodRev Period_ms 12 0.00 3276.700 FORMAT "%8.3" EXTENDED_LIMITS -3276.800 3276.700 DEPOSIT ABSOLUTE /end AXIS_DESCR
/end CHARACTERISTIC
/begin CHARACTERISTIC CaSCD_facPlausLow_CUR "Untere Grenze der Plausibilitätsprüfung des Phasengebersignals" CURVE 0x1CC968 Kl_Xs16_Ws16 1.000000 Fact1 0.00 1.000000 FORMAT "%8.6" EXTENDED_LIMITS -256.0000 255.9922
 /begin AXIS_DESCR STD_AXIS CaSCD_tiPeriodRevHold Period_ms 12 0.00 3276.700 FORMAT "%8.3" EXTENDED_LIMITS -3276.800 3276.700 DEPOSIT ABSOLUTE /end AXIS_DESCR
/end CHARACTERISTIC
/begin CHARACTERISTIC CaSCD_nEvalOfsStop_C "Drehzahlschwelle zur Deaktivierung der Verdrehwinkelberechung" VALUE 0x1CC9FA Kw_Wu16 6000.000 EngN 0.00 6000.000 FORMAT "%8.3" EXTENDED_LIMITS 0.00 65535.00 /end CHARACTERISTIC
/begin CHARACTERISTIC CaSCD_nMaxCor_C "max. Drehzahl bis Nockenwellensegmentanalyse erlaubt" VALUE 0x1CCA0C Kw_Ws16 5960.000 EngN 40.00000 6000.000 FORMAT "%8.3" EXTENDED_LIMITS -32768.00 32767.00 /end CHARACTERISTIC
/begin CHARACTERISTIC CaSCD_nMinCor_C "min. Drehzahl ab der Nockenwellensegmentanalyse erlaubt" VALUE 0x1CCA0E Kw_Ws16 5960.000 EngN 40.00000 6000.000 FORMAT "%8.3" EXTENDED_LIMITS -32768.00 32767.00 /end CHARACTERISTIC
/begin CHARACTERISTIC CaSCD_nMinSpeed_C "Kleinster Wert für Phasengeberraddrehzahl" VALUE 0x1C0B56 Kw_Ws16 5960.000 EngN 40.00000 6000.000 FORMAT "%8.3" EXTENDED_LIMITS -32768.00 32767.00 /end CHARACTERISTIC
/begin CHARACTERISTIC CaSCD_numIntStrtCor_C "Interrupttype für Startposition der Segmentlängenanalyse" VALUE 0x1CCA10 Kw_Wu8 15.00 OneToOne 0.00 15.00 FORMAT "%5.2" EXTENDED_LIMITS 0.00 255.0 /end CHARACTERISTIC
/begin CHARACTERISTIC CaSCD_numReSyncCor_C "Anzahl von Resynchronisationsversuchen zur Freigabe der Segmentanalyse" VALUE 0x1CCA11 Kw_Wu8 255.0 OneToOne 0.00 255.0 FORMAT "%5.1" /end CHARACTERISTIC
/begin CHARACTERISTIC CaSCD_numSegSeriesStrtCor_C "Startposition im Feld CaSCD_dSegSeries_C für die Segmentlängenanalyse" VALUE 0x1CCA12 Kw_Wu8 15.00 OneToOne 0.00 15.00 FORMAT "%5.2" EXTENDED_LIMITS 0.00 255.0 /end CHARACTERISTIC
/begin CHARACTERISTIC CaSCD_numTDCStrtCor_C "Zylinder für Startposition der Segmentlängenanalyse" VALUE 0x1CCA13 Kw_Wu8 3.000 OneToOne 1.000 4.000 FORMAT "%5.3" EXTENDED_LIMITS 0.00 255.0 /end CHARACTERISTIC
/begin CHARACTERISTIC CaSCD_phiHys1Cor_C "Triggerwinkel für Umschaltung auf CaSCD_dSegSeries_Cor_C und CaSCD_phiSegLen_C" VALUE 0x1CCA14 Kw_Ws16 360.0000 AngleCaS 0.00 360.0000 FORMAT "%8.4" EXTENDED_LIMITS -384.0000 383.9883 /end CHARACTERISTIC
/begin CHARACTERISTIC CaSCD_phiHys2Cor_C "Tiggerwinkel für Rückschaltung auf CaSCD_dSegSeries_C und CaSCD_phiSegLen_C" VALUE 0x1CCA16 Kw_Ws16 360.0000 AngleCaS 0.00 360.0000 FORMAT "%8.4" EXTENDED_LIMITS -384.0000 383.9883 /end CHARACTERISTIC
/begin CHARACTERISTIC CaSCD_phiPosTolc_C "Toleranzen der Absolutpositionen des Nockenwellensignals" VAL_BLK 0x1CC99A Kwb_Ws16 360.0000 AngleCaS 0.00 360.0000 FORMAT "%8.4" EXTENDED_LIMITS -384.0000 383.9883 NUMBER 16 /end CHARACTERISTIC
/begin CHARACTERISTIC CaSCD_phiSegLenCor_C "Länge der Phasensegmete korrigiert" VAL_BLK 0x1CCA18 Kwb_Ws16 360.0000 AngleCaS 0.00 360.0000 FORMAT "%8.4" EXTENDED_LIMITS -384.0000 383.9883 NUMBER 16 /end CHARACTERISTIC
/begin CHARACTERISTIC CaSCD_phiSegLenTolc_C "Toleranz für jede Segmentlänge" VAL_BLK 0x1C0B58 Kwb_Ws16 360.0000 AngleCaS 0.00 360.0000 FORMAT "%8.4" EXTENDED_LIMITS -384.0000 383.9883 NUMBER 16 /end CHARACTERISTIC
/begin CHARACTERISTIC CaSCD_phiSegLen_C "Länge der Phasensegmente" VAL_BLK 0x1C0B78 Kwb_Ws16 360.0000 AngleCaS 0.00 360.0000 FORMAT "%8.4" EXTENDED_LIMITS -384.0000 383.9883 NUMBER 16 /end CHARACTERISTIC
/begin CHARACTERISTIC CaSCD_phiSegOfs_C "Winkel zwischen physikalischer Nulllage und Beginn Referenztabelle" VALUE 0x1C0B98 Kw_Ws16 360.0000 AngleCaS 0.00 360.0000 FORMAT "%8.4" EXTENDED_LIMITS -384.0000 383.9883 /end CHARACTERISTIC
/begin CHARACTERISTIC CaSCD_phiSpeedCalcTolc_C "Toleranzwinkel für Segmenterkennung bei der Berechnung der Phasengeberdrehzahl" VALUE 0x1C0B9A Kw_Ws16 360.0000 AngleCaS 0.00 360.0000 FORMAT "%8.4" EXTENDED_LIMITS -384.0000 383.9883 /end CHARACTERISTIC
/begin CHARACTERISTIC CaSCD_phiSpeedSegLen_C "Winkel einer Segmentlänge zur Berechnung der Phasengeberraddrehzahl" VALUE 0x1C0B9C Kw_Ws16 360.0000 AngleCaS 0.00 360.0000 FORMAT "%8.4" EXTENDED_LIMITS -384.0000 383.9883 /end CHARACTERISTIC
/begin CHARACTERISTIC CaSCD_phiSpeedSegOfs_C "Winkel zwischen phys. Nullposition und dem Beginn der Segmente zur Phasenraddrehzahlberechnung" VALUE 0x1C0B9E Kw_Ws16 360.0000 AngleCaS 0.00 360.0000 FORMAT "%8.4" EXTENDED_LIMITS -384.0000 383.9883 /end CHARACTERISTIC
/begin CHARACTERISTIC CaSCD_phiTrig_C "Triggerwinkel für vorlaeufige Segmenterkennung" VALUE 0x1C0BA0 Kw_Ws16 360.0000 AngleCaS 0.00 360.0000 FORMAT "%8.4" EXTENDED_LIMITS -384.0000 383.9883 /end CHARACTERISTIC
/begin CHARACTERISTIC CaSCD_stCalc_C "Abschalten von unterschiedlichen Funktionen des Phasensystems" VALUE 0x1C0BA2 Kw_Wu8 255.0 OneToOne 0.00 255.0 FORMAT "%5.1" /end CHARACTERISTIC
/begin CHARACTERISTIC CaSCD_stEdgeTrig_C "Triggerbedingung für die Phasenflankenerfassung" VALUE 0x1C0BA3 Kw_Wu8 2.000 OneToOne 1.000 3.000 FORMAT "%5.3" EXTENDED_LIMITS 0.00 255.0 /end CHARACTERISTIC
/begin CHARACTERISTIC CaSCD_stPinState_C "Signalpegel zur Auswertung der Phasensegmente verwenden" VALUE 0x1C0BA4 Kw_Wu8 1.000 OneToOne 0.00 1.000 FORMAT "%5.3" EXTENDED_LIMITS 0.00 255.0 /end CHARACTERISTIC
/begin CHARACTERISTIC CaSCD_stTPO_C "True Power On Funktion des Phasengebersensors" VALUE 0x1C0BA5 Kw_Wu8 1.000 OneToOne 0.00 1.000 FORMAT "%5.3" EXTENDED_LIMITS 0.00 255.0 /end CHARACTERISTIC
/begin CHARACTERISTIC CaSCD_swtEnaSegCor_C "Schalter für Freigabe der Segmentlängenanalyse" VALUE 0x1CCA38 Kw_Wu8 1.000 OneToOne 0.00 1.000 FORMAT "%5.3" EXTENDED_LIMITS 0.00 255.0 /end CHARACTERISTIC
/begin CHARACTERISTIC CaSCD_swtSegLenPin2Pos_C "Variantenschalter zur Überprüfung der Segmentlänge und Pin Status zur Verifikation des Nockenwellensignals" VALUE 0x1CC9BA Kw_Wu8 1.000 OneToOne 0.00 1.000 FORMAT "%5.3" EXTENDED_LIMITS 0.00 255.0 /end CHARACTERISTIC
/begin CHARACTERISTIC CaSCD_tiPeriodRev1Max_C "Max. Zeit der vorletzten Periode einer Phasengeberradumdrehung" VALUE 0x1C0BA6 Kw_Ws16 3276.700 Period_ms 0.00 3276.700 FORMAT "%8.3" EXTENDED_LIMITS -3276.800 3276.700 /end CHARACTERISTIC
/begin CHARACTERISTIC CaSCD_tiPeriodRev2Max_C "Max. Zeit der letzten Periode einer Phasengeberradumdrehung" VALUE 0x1C0BA8 Kw_Ws16 3276.700 Period_ms 0.00 3276.700 FORMAT "%8.3" EXTENDED_LIMITS -3276.800 3276.700 /end CHARACTERISTIC
/begin CHARACTERISTIC CaSCD_tiTimOutOfs_C "Offset zur Berechnung des Timeout-Wertes der Plausibilitätsprüfung" VALUE 0x1C0BAA Kw_Ws16 3276.700 Period_ms 0.00 3276.700 FORMAT "%8.3" EXTENDED_LIMITS -3276.800 3276.700 /end CHARACTERISTIC
/begin CHARACTERISTIC CcpAcquisitionConfig "Bytefeld für Konfiguration Schnellstartmessung für CCP" VAL_BLK 0x1C0BAE Kwb_Wu8 255.0 default 0.00 255.0 FORMAT "%5.1" NUMBER 218 /end CHARACTERISTIC
/begin CHARACTERISTIC Clg_dtMinDynTst_C "Minimaler Anstieg der Wassertemperatur zur Verifizierung derPlausibilität der Wassertemperatur" VALUE 0x1CCA3A Kw_Ws16 6553.500 TempDiff_Kelv -3276.800 3276.700 FORMAT "%8.3" /end CHARACTERISTIC
/begin CHARACTERISTIC Clg_nMinEnaDynTst_C "Minimale Drehzahl zur Aktivierung des dynamischen Plausibilitätstests" VALUE 0x1CCA3C Kw_Ws16 65535.00 EngN -32768.00 32767.00 FORMAT "%8.2" /end CHARACTERISTIC
/begin CHARACTERISTIC Clg_qMinEnaDynTst_C "Minimale Einspritzmenge zur Aktivierung des dynamischen Plausibilitätstests" VALUE 0x1CCA3E Kw_Ws16 655.3500 InjMass -327.6800 327.6700 FORMAT "%8.4" /end CHARACTERISTIC
/begin CHARACTERISTIC Clg_tiInitTmr_C "Zeitspanne nach Motorstatrt bis die Wassertemperatur erfasst wird" VALUE 0x1CCA42 Kw_Ws16 655.3500 Time_s -327.6800 327.6700 FORMAT "%8.4" /end CHARACTERISTIC
/begin CHARACTERISTIC Clg_tiMaxDynTst_CUR "Kennlinie der maximal zulässigen Testzeit des dynamischen Plausibilitätstest" CURVE 0x1CCA44 Kl_Xs16_Ws16 167769.6 Time_DynTst -83886.08 83883.52 FORMAT "%8.2"
 /begin AXIS_DESCR STD_AXIS Clg_tClntStrtVal_mp Temp_Cels 10 -3549.940 3003.560 FORMAT "%8.3" DEPOSIT ABSOLUTE /end AXIS_DESCR
/end CHARACTERISTIC
/begin CHARACTERISTIC Clg_tMinClntDynTst_C "Minimale Wassertemperatur zur Verifizierung der Plausibilitäts der Wassertemperatur" VALUE 0x1CCA6E Kw_Ws16 6553.500 Temp_Cels -3549.940 3003.560 FORMAT "%8.3" /end CHARACTERISTIC
/begin CHARACTERISTIC CmbChb_nAvrgThrHi_C "Überwachungsbedingung: Maximal zulässige Motordrehzahl" VALUE 0x1CCA82 Kw_Ws16 6000.000 EngN 0.00 6000.000 FORMAT "%8.3" EXTENDED_LIMITS -32768.00 32767.00 /end CHARACTERISTIC
/begin CHARACTERISTIC CmbChb_nAvrgThrLo_C "Überwachungsbedingung: Minimal zulässige Motordrehzahl" VALUE 0x1CCA84 Kw_Ws16 6000.000 EngN 0.00 6000.000 FORMAT "%8.3" EXTENDED_LIMITS -32768.00 32767.00 /end CHARACTERISTIC
/begin CHARACTERISTIC CmbChb_qRawThrHi_C "maximale Menge fuer Ueberwachung" VALUE 0x1CCA86 Kw_Ws16 655.3500 InjMass -327.6800 327.6700 FORMAT "%8.4" /end CHARACTERISTIC
/begin CHARACTERISTIC CmbChb_qRawThrLo_C "minimale Menge fuer Ueberwachung" VALUE 0x1CCA88 Kw_Ws16 655.3500 InjMass -327.6800 327.6700 FORMAT "%8.4" /end CHARACTERISTIC
/begin CHARACTERISTIC CmbChb_tClntThrLo_C "Überwachungsbedingung: Minimal zulässige Motortemperatur" VALUE 0x1CCA8A Kw_Ws16 3003.700 Temp_Cels -0.1400000 3003.560 FORMAT "%8.3" EXTENDED_LIMITS -3549.940 3003.560 /end CHARACTERISTIC
/begin CHARACTERISTIC CmbChb_vThrHi_C "Überwachungsbedingung: Maximal zulässige Fahrzeuggeschwindigkeit" VALUE 0x1CCA8C Kw_Ws16 327.6700 Vel 0.00 327.6700 FORMAT "%8.4" EXTENDED_LIMITS -327.6800 327.6700 /end CHARACTERISTIC
/begin CHARACTERISTIC CmbChb_tiDebClutchChng_C "Überwachungsbedingung: Entprellzeit für das Kupplungssignal" VALUE 0x1CCA8E Kw_Wu16 655350.0 Time_ms 0.00 655350.0 FORMAT "%8.1" /end CHARACTERISTIC
/begin CHARACTERISTIC CmbChb_tiDlyStr_C "Überwachungsbedingung: Entprellzeit für den Motorzustand ""normal""" VALUE 0x1CCA90 Kw_Wu16 655350.0 Time_ms 0.00 655350.0 FORMAT "%8.1" /end CHARACTERISTIC
/begin CHARACTERISTIC CmbChb_ctEngRevPerBlk_C "Anzahl der Kurbelwellenumdrehungen pro Block" VALUE 0x1CCA92 Kw_Wu16 65535.00 OneToOne 0.00 65535.00 FORMAT "%8.2" /end CHARACTERISTIC
/begin CHARACTERISTIC CmbChb_ctSegTDC1_C "Offset für internen Segmentzähler in Aussetzererkennung" VALUE 0x1CCA94 Kw_Wu16 0.00 OneToOne 0.00 0.00 FORMAT "%8.2" EXTENDED_LIMITS 0.00 65535.00 /end CHARACTERISTIC
/begin CHARACTERISTIC CmbChb_numBlk_C "Anzahl der Blöcke in einem Testrahmen" VALUE 0x1CCA96 Kw_Wu16 65535.00 OneToOne 0.00 65535.00 FORMAT "%8.2" /end CHARACTERISTIC
/begin CHARACTERISTIC CmbChb_dnSegMin_C "Min. Drehzahlanstieg einer normalen Verbrennung in Prozent des durchschnittl. Drehzahlanstiegs: Empfindlichkeit der Erkennung" VALUE 0x1CCA98 Kw_Ws16 655.3500 Prc -327.6800 327.6700 FORMAT "%8.4" /end CHARACTERISTIC
/begin CHARACTERISTIC CmbChb_ctMisfireMax_C "Maximale Anzahl von Aussetzern pro Testrahmen, um den Zylinder als normal einzustufen" VALUE 0x1CCA9A Kw_Wu16 65535.00 OneToOne 0.00 65535.00 FORMAT "%8.2" /end CHARACTERISTIC
/begin CHARACTERISTIC CmbChb_phiCmbLim_CUR "Label für die Applikation der Brenngrenzen, keine Funktionalität" CURVE 0x1CCA70 Kl_Xs16_Ws16 1535.977 AngleCrS -768.0000 767.9766 FORMAT "%8.4"
 /begin AXIS_DESCR STD_AXIS Eng_nAvrg EngN 4 0.00 6000.000 FORMAT "%8.3" EXTENDED_LIMITS -32768.00 32767.00 DEPOSIT ABSOLUTE /end AXIS_DESCR
/end CHARACTERISTIC
/begin CHARACTERISTIC CmbChb_swtMonClutchVal_C "DS-Wert für SW-Schalter CmbChb_swtMonClutch, De/Aktivierung Überwachung Zündaussetzererkennung" VALUE 0x1CCA9C Kw_Wu8 3.000 OneToOne 0.00 3.000 FORMAT "%5.3" EXTENDED_LIMITS 0.00 255.0 /end CHARACTERISTIC
/begin CHARACTERISTIC CmbChb_swtMonClutchType_C "Typ SW-Schalter CmbChb_swtMonClutch (1: EEPROM, 2: DS-Wert CrCCD_swtMonClutchVal_C)" VALUE 0x1CCA9D Kw_Wu8 1.000 OneToOne 1.000 2.000 FORMAT "%5.3" EXTENDED_LIMITS 0.00 255.0 /end CHARACTERISTIC
/begin CHARACTERISTIC CmbChb_swtPoI2HCMisf_C " Schalter zur Aktivierung der massage  InjCrv_stPol2HCOff und die zusätzliche Freigabebedingung" VALUE 0x1CCA9E Kw_Wu8 1.000 OneToOne 0.00 1.000 FORMAT "%5.3" EXTENDED_LIMITS 0.00 255.0 /end CHARACTERISTIC
/begin CHARACTERISTIC CoDT_tiOvrRunDebNeg_C "Entprellung des Zustands ""Motor treibt an""" VALUE 0x1CCAEC Kw_Wu16 655350.0 TimeDeb 0.00 655350.0 FORMAT "%8.1" /end CHARACTERISTIC
/begin CHARACTERISTIC CoDT_tiOvrRunDebPos_C "Entprellung des Zustands ""Fahrzeug schiebt""" VALUE 0x1CCAEE Kw_Wu16 655350.0 TimeDeb 0.00 655350.0 FORMAT "%8.1" /end CHARACTERISTIC
/begin CHARACTERISTIC CoDT_dtrqLimDwnCurr_C "negative Steigung für einen Rampenschalter im Curr-Pfad" VALUE 0x1CCAA0 Kw_Wu32 6553599.99847 RmpTrq 0.00 6553599.99847 FORMAT "%13.5" /end CHARACTERISTIC
/begin CHARACTERISTIC CoDT_dtrqLimDwnLead_C "negative Steigung für einen Rampenschalter im Lead-Pfad" VALUE 0x1CCAA4 Kw_Wu32 6553599.99847 RmpTrq 0.00 6553599.99847 FORMAT "%13.5" /end CHARACTERISTIC
/begin CHARACTERISTIC CoDT_dtrqLimUpCurr_C "positive Steigung für einen Rampenschalter im Curr-Pfad" VALUE 0x1CCAA8 Kw_Wu32 6553599.99847 RmpTrq 0.00 6553599.99847 FORMAT "%13.5" /end CHARACTERISTIC
/begin CHARACTERISTIC CoDT_dtrqLimUpLead_C "positive Steigung für Rampenschalter im Lead-Pfad" VALUE 0x1CCAAC Kw_Wu32 6553599.99847 RmpTrq 0.00 6553599.99847 FORMAT "%13.5" /end CHARACTERISTIC
/begin CHARACTERISTIC CoDT_dtrqSlpLimErr_CUR "kennlinie für Steigungbeschränkungsstörung" CURVE 0x1CCAB0 Kl_Xs16_Ws16 4000.000 TrqPerSec -2000.000 2000.000 FORMAT "%8.3" EXTENDED_LIMITS -32768.00 32767.00
 /begin AXIS_DESCR STD_AXIS Eng_nAvrg EngN 5 40.00000 6000.000 FORMAT "%8.3" EXTENDED_LIMITS -32768.00 32767.00 DEPOSIT ABSOLUTE /end AXIS_DESCR
/end CHARACTERISTIC
/begin CHARACTERISTIC CoDT_dtrqSlpLimMin_C "Applikationsparameter für minimale Steigungsbegrenzungr" VALUE 0x1CCAC6 Kw_Ws16 32767.00 TrqPerSec 0.00 32767.00 FORMAT "%8.2" EXTENDED_LIMITS -32768.00 32767.00 /end CHARACTERISTIC
/begin CHARACTERISTIC CoDT_dtrqSlpLimSub_CUR "Kennlinie für Gradienten-Ersatzwert" CURVE 0x1CCAC8 Kl_Xs16_Ws16 4000.000 TrqPerSec -2000.000 2000.000 FORMAT "%8.3" EXTENDED_LIMITS -32768.00 32767.00
 /begin AXIS_DESCR STD_AXIS Eng_nAvrg EngN 5 40.00000 6000.000 FORMAT "%8.3" EXTENDED_LIMITS -32768.00 32767.00 DEPOSIT ABSOLUTE /end AXIS_DESCR
/end CHARACTERISTIC
/begin CHARACTERISTIC CoDT_swtCoTypeVal_C "Sollmoment im Schub über Fahrpedalstellung (0: conventional; 1: mastershift)" VALUE 0x1CCADE Kw_Wu8 1.000 OneToOne 0.00 1.000 FORMAT "%5.3" EXTENDED_LIMITS 0.00 255.0 /end CHARACTERISTIC
/begin CHARACTERISTIC CoDT_swtCoTypeType_C "CoDT_swtCoType 0: bed. Spez. ; 1: form E2PROM; 2: Applikation" VALUE 0x1CCADF Kw_Wu8 1.000 OneToOne 1.000 2.000 FORMAT "%5.3" EXTENDED_LIMITS 0.00 255.0 /end CHARACTERISTIC
/begin CHARACTERISTIC CoDT_swtCrCtlNoComp_C "Applikationsschalter für Kompensationsverhalten bei aktivem FGR (0 = Komp. aktiv, 1= Komp. nicht aktiv)" VALUE 0x1CCAF0 Kw_Wu8 1.000 OneToOne 0.00 1.000 FORMAT "%5.3" EXTENDED_LIMITS 0.00 255.0 /end CHARACTERISTIC
/begin CHARACTERISTIC CoDT_swtSlpLimEna_C "Schalter zur Aktivierung der Rampenfunktion" VALUE 0x1CCAE0 Kw_Wu8 1.000 OneToOne 0.00 1.000 FORMAT "%5.3" EXTENDED_LIMITS 0.00 255.0 /end CHARACTERISTIC
/begin CHARACTERISTIC CoDT_tiCompDwn_C "Zeit für Aufbau Nebenaggregatkompensation bei Wegfall Schub" VALUE 0x1CCAF2 Kw_Wu16 655350.0 Time_ms 0.00 655350.0 FORMAT "%8.1" /end CHARACTERISTIC
/begin CHARACTERISTIC CoDT_tiCompUp_C "Zeit für Abbau Nebenaggregatkompensation im Schub" VALUE 0x1CCAF4 Kw_Wu16 655350.0 Time_ms 0.00 655350.0 FORMAT "%8.1" /end CHARACTERISTIC
/begin CHARACTERISTIC CoDT_tiFltPT1_C "Parameter für Filterung des Momentenbands" VALUE 0x1CCAF8 Kw_Wu32 4294.9673 TimeDelay_s 0.0000010000000 4294.9673 FORMAT "%9.4" /end CHARACTERISTIC
/begin CHARACTERISTIC CoDT_tiGripDeb_C "Entprellzeit für die Kraftschlußerkennung im Triebstrang" VALUE 0x1CCAE8 Kw_Wu16 655350.0 Time_ms 0.00 655350.0 FORMAT "%8.1" /end CHARACTERISTIC
/begin CHARACTERISTIC CoDT_tiTrqRedMaxCurr_C "Zeitschwelle für ""langen"" Getriebeeingriff im Curr-Pfad" VALUE 0x1CCAE2 Kw_Wu16 655350.0 Time_ms 0.00 655350.0 FORMAT "%8.1" /end CHARACTERISTIC
/begin CHARACTERISTIC CoDT_tiTrqRedMaxLead_C "Zeitschwell für ""langen"" Getriebeeingriff im Lead-Pfad" VALUE 0x1CCAE4 Kw_Wu16 655350.0 Time_ms 0.00 655350.0 FORMAT "%8.1" /end CHARACTERISTIC
/begin CHARACTERISTIC CoDT_trqMinInit_C "Initialwert für minimales Vortriebsmoment" VALUE 0x1CCAFC Kw_Ws32 104856.000000 TrqPrpHigh -52428.8000000 52427.2000000 FORMAT "%13.7" EXTENDED_LIMITS -214748364.800 214748364.700 /end CHARACTERISTIC
/begin CHARACTERISTIC CoDT_vGrip_C "Geschwindigkeitsschwelle für Kraftschlußerkennung im Triebstrang" VALUE 0x1CCAEA Kw_Ws16 310.0000 Vel -10.00000 300.0000 FORMAT "%8.4" EXTENDED_LIMITS -327.6800 327.6700 /end CHARACTERISTIC
/begin CHARACTERISTIC CoEng_ExtWaitMsk_C "Bitmaske für externe Ereignisse for Schreiben des EEPROM" VALUE 0x1CCB34 Kw_Wu16 65535.00 OneToOne 0.00 65535.00 FORMAT "%8.2" /end CHARACTERISTIC
/begin CHARACTERISTIC CoEng_facCorValTot_C "Abgleichwert des Verbrauchs für Gesamteinspritzmenge[-]" VALUE 0x1CCB00 Kw_Ws16 1.000000 Fact1 0.5000000 1.500000 FORMAT "%8.6" EXTENDED_LIMITS -256.0000 255.9922 /end CHARACTERISTIC
/begin CHARACTERISTIC CoEng_facCorVal_C "Abgleichwert für die Verbrauchsberechnung [-]" VALUE 0x1CCB02 Kw_Ws16 1.000000 Fact1 0.5000000 1.500000 FORMAT "%8.6" EXTENDED_LIMITS -256.0000 255.9922 /end CHARACTERISTIC
/begin CHARACTERISTIC CoEng_facFlConsAllCorVal_C "Schwellenfaktor für maximal berücksichtigten Kraftstoffverbrauch" VALUE 0x1CCB36 Kw_Ws16 2.000000 Fact1000 0.00 2.000000 FORMAT "%8.6" EXTENDED_LIMITS -32.76800 32.76700 /end CHARACTERISTIC
/begin CHARACTERISTIC CoEng_nActrRelease_C "Mindestdrehzahl für Stellerfreigabe" VALUE 0x1CCB20 Kw_Ws16 32727.00 EngN 40.00000 32767.00 FORMAT "%8.2" EXTENDED_LIMITS -32768.00 32767.00 /end CHARACTERISTIC
/begin CHARACTERISTIC CoEng_nTVAClsd_C "Drehzahlschwelle für das Schließen der Drosselklappe im Nachlauf" VALUE 0x1CCBAC Kw_Ws16 6000.000 EngN 0.00 6000.000 FORMAT "%8.3" EXTENDED_LIMITS -32768.00 32767.00 /end CHARACTERISTIC
/begin CHARACTERISTIC CoEng_FBCfacActv_C "Mindestaktivierungsfaktor der Mengenausgleichsregelung im Schubkoordinator" VALUE 0x1CCBA0 Kw_Wu8 10.00 OneToOne 0.00 10.00 FORMAT "%5.2" EXTENDED_LIMITS 0.00 255.0 /end CHARACTERISTIC
/begin CHARACTERISTIC CoEng_ZFCfacActv_C "Mindestaktivierungsfaktor der Nullmengenkalibrierung im Schubkoordinator" VALUE 0x1CCBA1 Kw_Wu8 10.00 OneToOne 0.00 10.00 FORMAT "%5.2" EXTENDED_LIMITS 0.00 255.0 /end CHARACTERISTIC
/begin CHARACTERISTIC CoEng_ALSfacActv_C "Mindestaktivierungsfaktor der Adaption Lambdasonde im Schubkoordinator" VALUE 0x1CCBA2 Kw_Wu8 10.00 OneToOne 0.00 10.00 FORMAT "%5.2" EXTENDED_LIMITS 0.00 255.0 /end CHARACTERISTIC
/begin CHARACTERISTIC CoEng_TAAfacActv_C "Mindestaktivierungsfaktor der Inkrementwinkellernens im Schubkoordinator" VALUE 0x1CCBA3 Kw_Wu8 10.00 OneToOne 0.00 10.00 FORMAT "%5.2" EXTENDED_LIMITS 0.00 255.0 /end CHARACTERISTIC
/begin CHARACTERISTIC CoEng_tiPT1_C "Zeitkonstante für PT1 Element" VALUE 0x1CCB3C Kw_Wu32 4294.9673 TimeDelay_s 0.0000010000000 4294.9673 FORMAT "%9.4" /end CHARACTERISTIC
/begin CHARACTERISTIC CoEng_pTVAClsd_C "Ladedruckschwelle für das Schließen der Drosselklappe im Nachlauf" VALUE 0x1CCBAE Kw_Ws16 3500.000 Pres_hPa 0.00 3500.000 FORMAT "%8.3" EXTENDED_LIMITS -32768.00 32767.00 /end CHARACTERISTIC
/begin CHARACTERISTIC CoEng_qTVAClsd_C "Mengenschwelle für das Schließen der Drosselklappe im Nachlauf" VALUE 0x1CCBB0 Kw_Ws16 327.6700 InjMass 0.00 327.6700 FORMAT "%8.4" EXTENDED_LIMITS -327.6800 327.6700 /end CHARACTERISTIC
/begin CHARACTERISTIC CoEng_rhoFuel_C "Kraftstoffdichte [kg/m^3]" VALUE 0x1CCB06 Kw_Ws16 1500.000 RhoFuel 0.00 1500.000 FORMAT "%8.3" EXTENDED_LIMITS -3276.800 3276.700 /end CHARACTERISTIC
/begin CHARACTERISTIC CoEng_stCoopCapbl_C "Kooperationsattribute zu koordinierender Funktionen im Schubkoordinator (bitcodiert)" VALUE 0x1CCBA4 Kw_Wu8 15.00 OneToOne 0.00 15.00 FORMAT "%5.2" EXTENDED_LIMITS 0.00 255.0 /end CHARACTERISTIC
/begin CHARACTERISTIC CoEng_stIRevShutOff_C "Maske für irreversible Abschaltursachen" VALUE 0x1CCB44 Kw_Wu32 4294967295.00 OneToOne 0.00 4294967295.00 FORMAT "%13.2" /end CHARACTERISTIC
/begin CHARACTERISTIC CoEng_stRevShutOff_C "Maske für reversible Abschaltursachen" VALUE 0x1CCB48 Kw_Wu32 4294967295.00 OneToOne 0.00 4294967295.00 FORMAT "%13.2" /end CHARACTERISTIC
/begin CHARACTERISTIC CoEng_stShOffAirbFrnt_C "Abstellpfade für Airbag Frontalaufprall aktiv" VALUE 0x1CCB4C Kw_Wu32 4294967295.00 OneToOne 0.00 4294967295.00 FORMAT "%13.2" /end CHARACTERISTIC
/begin CHARACTERISTIC CoEng_stShOffAirbFuel_C "Abstellpfade für Airbag Crash-Intensität aktiv" VALUE 0x1CCB50 Kw_Wu32 4294967295.00 OneToOne 0.00 4294967295.00 FORMAT "%13.2" /end CHARACTERISTIC
/begin CHARACTERISTIC CoEng_stShOffAirbRear_C "Abstellpfade für Airbag Heckaufprall aktiv" VALUE 0x1CCB54 Kw_Wu32 4294967295.00 OneToOne 0.00 4294967295.00 FORMAT "%13.2" /end CHARACTERISTIC
/begin CHARACTERISTIC CoEng_stShOffAirbSide_C "Abstellpfade für Airbag Seitenaufprall aktiv" VALUE 0x1CCB58 Kw_Wu32 4294967295.00 OneToOne 0.00 4294967295.00 FORMAT "%13.2" /end CHARACTERISTIC
/begin CHARACTERISTIC CoEng_stShOffCompTst_C "Kundenspezifische reversible Abschaltanforderung" VALUE 0x1CCB5C Kw_Wu32 4294967295.00 OneToOne 0.00 4294967295.00 FORMAT "%13.2" /end CHARACTERISTIC
/begin CHARACTERISTIC CoEng_stShOffDblCtl_C "Abstellpfade für unzulässigen Hochdruck-Reglerbetrieb (nur 2-Reglerkonzept)" VALUE 0x1CCB60 Kw_Wu32 4294967295.00 OneToOne 0.00 4294967295.00 FORMAT "%13.2" /end CHARACTERISTIC
/begin CHARACTERISTIC CoEng_stShOffIlsPls_C "Abschaltpfad fuer die Interlockplausibilisierung" VALUE 0x1CCB64 Kw_Wu32 4294967295.00 OneToOne 0.00 4294967295.00 FORMAT "%13.2" /end CHARACTERISTIC
/begin CHARACTERISTIC CoEng_stShOffInjMon_C "Abstellpfade für mehrfache Injektorlastabfälle" VALUE 0x1CCB68 Kw_Wu32 4294967295.00 OneToOne 0.00 4294967295.00 FORMAT "%13.2" /end CHARACTERISTIC
/begin CHARACTERISTIC CoEng_stShOffIRevSys2_C "Abstellpfade für irreversible Systemfehler 2" VALUE 0x1CCB6C Kw_Wu32 4294967295.00 OneToOne 0.00 4294967295.00 FORMAT "%13.2" /end CHARACTERISTIC
/begin CHARACTERISTIC CoEng_stShOffIRevSys_C "Abstellpfade für irreversible Systemfehler" VALUE 0x1CCB70 Kw_Wu32 4294967295.00 OneToOne 0.00 4294967295.00 FORMAT "%13.2" /end CHARACTERISTIC
/begin CHARACTERISTIC CoEng_stShOffIRevVeh_C "Abstellpfade für irreversible Fahrzeugfehler" VALUE 0x1CCB74 Kw_Wu32 4294967295.00 OneToOne 0.00 4294967295.00 FORMAT "%13.2" /end CHARACTERISTIC
/begin CHARACTERISTIC CoEng_stShOffIrrCmb_C "Abstellpfade bei irregulärer Verbrennung" VALUE 0x1CCB78 Kw_Wu32 4294967295.00 OneToOne 0.00 4294967295.00 FORMAT "%13.2" /end CHARACTERISTIC
/begin CHARACTERISTIC CoEng_stShOffOvrSpd_C "Abstellpfade aufgrund Überdrehzahl" VALUE 0x1CCB7C Kw_Wu32 4294967295.00 OneToOne 0.00 4294967295.00 FORMAT "%13.2" /end CHARACTERISTIC
/begin CHARACTERISTIC CoEng_stShOffPresMin_C "Abstellpfade bei Mindestraildruck unteschritten" VALUE 0x1CCB80 Kw_Wu32 4294967295.00 OneToOne 0.00 4294967295.00 FORMAT "%13.2" /end CHARACTERISTIC
/begin CHARACTERISTIC CoEng_stShOffRevSys2_C "Abstellpfade für reversible Systemfehler 2" VALUE 0x1CCB84 Kw_Wu32 4294967295.00 OneToOne 0.00 4294967295.00 FORMAT "%13.2" /end CHARACTERISTIC
/begin CHARACTERISTIC CoEng_stShOffRevSys_C "Abstellpfade für reversible Systemfehler" VALUE 0x1CCB88 Kw_Wu32 4294967295.00 OneToOne 0.00 4294967295.00 FORMAT "%13.2" /end CHARACTERISTIC
/begin CHARACTERISTIC CoEng_stShOffRevVeh_C "Abstellpfade für reversible Fahrzeugfehler" VALUE 0x1CCB8C Kw_Wu32 4294967295.00 OneToOne 0.00 4294967295.00 FORMAT "%13.2" /end CHARACTERISTIC
/begin CHARACTERISTIC CoEng_stShOffRlOvrBar_C "Abstellpfade für Überrollbügel aktiv" VALUE 0x1CCB90 Kw_Wu32 4294967295.00 OneToOne 0.00 4294967295.00 FORMAT "%13.2" /end CHARACTERISTIC
/begin CHARACTERISTIC CoEng_stShOffSV_C "Abstellpfade aufgrund dauerbestromtem Magnetventil" VALUE 0x1CCB94 Kw_Wu32 4294967295.00 OneToOne 0.00 4294967295.00 FORMAT "%13.2" /end CHARACTERISTIC
/begin CHARACTERISTIC CoEng_stShOffTMFWRev_C "Reversible Abschaltanforderungen fuer das Zweimassenschwungrad" VALUE 0x1CCB98 Kw_Wu32 4294967295.00 OneToOne 0.00 4294967295.00 FORMAT "%13.2" /end CHARACTERISTIC
/begin CHARACTERISTIC CoEng_stShOffTSCCod_C "Abstellpfade für TSC Kodierung" VALUE 0x1CCB9C Kw_Wu32 4294967295.00 OneToOne 0.00 4294967295.00 FORMAT "%13.2" /end CHARACTERISTIC
/begin CHARACTERISTIC CoEng_swtFlConsAllCorActv_C "Schalter zur Aktivierung der Begrenzung" VALUE 0x1CCB38 Kw_Wu8 1.000 OneToOne 0.00 1.000 FORMAT "%5.3" EXTENDED_LIMITS 0.00 255.0 /end CHARACTERISTIC
/begin CHARACTERISTIC CoEng_swtFlConsDsplVal_C "Schalter zur Auswahl der Botschaft Gesamtverbrauch" VALUE 0x1CCB40 Kw_Wu8 1.000 OneToOne 0.00 1.000 FORMAT "%5.3" EXTENDED_LIMITS 0.00 255.0 /end CHARACTERISTIC
/begin CHARACTERISTIC CoEng_tiActrPrt_C "maximale Zeit für Stellerbestromung" VALUE 0x1CCB22 Kw_Wu16 655350.0 Time_ms 0.00 655350.0 FORMAT "%8.1" /end CHARACTERISTIC
/begin CHARACTERISTIC CoEng_tiAftRun_ImmCtl_C "Nachlaufzeit für Wegfahrsperre" VALUE 0x1CCB24 Kw_Wu16 655350.0 Time_ms 0.00 655350.0 FORMAT "%8.1" /end CHARACTERISTIC
/begin CHARACTERISTIC CoEng_tiEep_ImmCtl_C "Maximalzeit für Speichervorgang von WFS Daten" VALUE 0x1CCB26 Kw_Wu16 655350.0 Time_ms 0.00 655350.0 FORMAT "%8.1" /end CHARACTERISTIC
/begin CHARACTERISTIC CoEng_tiMinAftRun_C "minimale Nachlaufzeit" VALUE 0x1CCB28 Kw_Wu32 42949672950.0 Time_ms 0.00 42949672950.0 FORMAT "%13.1" /end CHARACTERISTIC
/begin CHARACTERISTIC CoEng_tiOvrRunCoordDebPos_C "Entprellzeit für den Übergang ""Kein Schub -> Schub"" im Schubkoordinator" VALUE 0x1CCBA6 Kw_Wu16 1000.000 Time_ms 0.00 1000.000 FORMAT "%8.3" EXTENDED_LIMITS 0.00 655350.0 /end CHARACTERISTIC
/begin CHARACTERISTIC CoEng_tiPwrStgDiaRdy_C "Verzoegerungszeit, um im Nachlauf abgeschaltete Steller zu diagnostizieren" VALUE 0x1CCB2C Kw_Wu16 655350.0 Time_ms 0.00 655350.0 FORMAT "%8.1" /end CHARACTERISTIC
/begin CHARACTERISTIC CoEng_tiSOPTstRdy_C "Verzögerungszeit, um redundanten Abschaltpfadtest durchzuführen" VALUE 0x1CCB2E Kw_Wu16 655350.0 Time_ms 0.00 655350.0 FORMAT "%8.1" /end CHARACTERISTIC
/begin CHARACTERISTIC CoEng_tiTVAClsd_C "Zeit für Schließen der Drosselklappe nach Motorstillstand" VALUE 0x1CCB30 Kw_Wu16 655350.0 Time_ms 0.00 655350.0 FORMAT "%8.1" /end CHARACTERISTIC
/begin CHARACTERISTIC CoEng_tiTVAOpn_C "Zeit für Wiederöffnen der Drosselklappe bei Motorstillstand" VALUE 0x1CCB32 Kw_Wu16 655350.0 Time_ms 0.00 655350.0 FORMAT "%8.1" /end CHARACTERISTIC
/begin CHARACTERISTIC CoEng_trqInrCurrFast_Vector "Konfiguration Label für Bypass Freischnitt" VALUE 0x1C0A5C Kw_Wu8 255.0 OneToOne 0.00 255.0 FORMAT "%5.1" /end CHARACTERISTIC
/begin CHARACTERISTIC CoEng_trqInrCurrFast_Channel "Konfiguration Label für Bypass Freischnitt" VALUE 0x1C0A5D Kw_Wu8 255.0 OneToOne 0.00 255.0 FORMAT "%5.1" /end CHARACTERISTIC
/begin CHARACTERISTIC CoEng_trqInrDesFast_Vector "Konfiguration Label für Bypass Freischnitt" VALUE 0x1C0A5E Kw_Wu8 255.0 OneToOne 0.00 255.0 FORMAT "%5.1" /end CHARACTERISTIC
/begin CHARACTERISTIC CoEng_trqInrDesFast_Channel "Konfiguration Label für Bypass Freischnitt" VALUE 0x1C0A5F Kw_Wu8 255.0 OneToOne 0.00 255.0 FORMAT "%5.1" /end CHARACTERISTIC
/begin CHARACTERISTIC CoEng_trqInrDesSlow_Vector "Bypass Label, nicht ändern!" VALUE 0x1C0A5A Kw_Wu8 255.0 OneToOne 0.00 255.0 FORMAT "%5.1" /end CHARACTERISTIC
/begin CHARACTERISTIC CoEng_trqInrDesSlow_Channel "Bypass Label, nicht ändern!" VALUE 0x1C0A5B Kw_Wu8 255.0 OneToOne 0.00 255.0 FORMAT "%5.1" /end CHARACTERISTIC
/begin CHARACTERISTIC CoEng_trqInrDrvSlow_Vector "Konfiguration Label für Bypass Freischnitt" VALUE 0x1C0A60 Kw_Wu8 255.0 OneToOne 0.00 255.0 FORMAT "%5.1" /end CHARACTERISTIC
/begin CHARACTERISTIC CoEng_trqInrDrvSlow_Channel "Konfiguration Label für Bypass Freischnitt" VALUE 0x1C0A61 Kw_Wu8 255.0 OneToOne 0.00 255.0 FORMAT "%5.1" /end CHARACTERISTIC
/begin CHARACTERISTIC CoEng_trqInrPCtl_mp_Vector "Konfiguration Label für Bypass Freischnitt" VALUE 0x1C0A62 Kw_Wu8 255.0 OneToOne 0.00 255.0 FORMAT "%5.1" /end CHARACTERISTIC
/begin CHARACTERISTIC CoEng_trqInrPCtl_mp_Channel "Konfiguration Label für Bypass Freischnitt" VALUE 0x1C0A63 Kw_Wu8 255.0 OneToOne 0.00 255.0 FORMAT "%5.1" /end CHARACTERISTIC
/begin CHARACTERISTIC CoEng_trqSlpLim_Vector "Bypass Label for CoEng_trqSlpLim (nicht verändern !)" VALUE 0x1C0A64 Kw_Wu8 255.0 OneToOne 0.00 255.0 FORMAT "%5.1" /end CHARACTERISTIC
/begin CHARACTERISTIC CoEng_trqSlpLim_Channel "Bypass Label für CoEng_trqSlpLim (nicht verändern !)" VALUE 0x1C0A65 Kw_Wu8 255.0 OneToOne 0.00 255.0 FORMAT "%5.1" /end CHARACTERISTIC
/begin CHARACTERISTIC CoEng_uLowBattPwrStg_C "Untere Grenze der Batteriespannung, an welcher spezielle Endstufendiagnosen abgeschaltet werden" VALUE 0x1CCBA8 Kw_Ws16 16008.03 Volt_Batt 0.00 16008.03 FORMAT "%8.2" EXTENDED_LIMITS -665674.1 665653.8 /end CHARACTERISTIC
/begin CHARACTERISTIC COTSCD_uSRCMin_C "Minimalwert für SRC WTK-Sensor" VALUE 0x1CCDBC Kw_Ws16 5200.391 Volt 0.00 5200.391 FORMAT "%8.3" EXTENDED_LIMITS -160156.4 160151.5 /end CHARACTERISTIC
/begin CHARACTERISTIC COTSCD_uSRCMax_C "Maximalwert für SRC WTK-Sensor" VALUE 0x1CCDBE Kw_Ws16 5200.391 Volt 0.00 5200.391 FORMAT "%8.3" EXTENDED_LIMITS -160156.4 160151.5 /end CHARACTERISTIC
/begin CHARACTERISTIC COTSCD_tLin_CUR "Linearisierungskennlinie für WTK-Sensor" CURVE 0x1CCDC0 Kl_Xs16_Ws16 250.0000 Temp_Cels -50.04000 199.9600 FORMAT "%8.4" EXTENDED_LIMITS -3549.940 3003.560
 /begin AXIS_DESCR STD_AXIS COTSCD_uRaw Volt 25 0.00 5200.391 FORMAT "%8.3" EXTENDED_LIMITS -160156.4 160151.5 DEPOSIT ABSOLUTE /end AXIS_DESCR
/end CHARACTERISTIC
/begin CHARACTERISTIC COTSCD_DebSRCHighDef_C "WTK Fehlerentprellzeit fuer SRC-High" VALUE 0x1CCE26 Kw_Wu16 655350.0 Time_ms 0.00 655350.0 FORMAT "%8.1" /end CHARACTERISTIC
/begin CHARACTERISTIC COTSCD_DebSRCHighOk_C "WTK Heilungsentprellzeit fuer SRC-High" VALUE 0x1CCE28 Kw_Wu16 655350.0 Time_ms 0.00 655350.0 FORMAT "%8.1" /end CHARACTERISTIC
/begin CHARACTERISTIC COTSCD_DebSRCLowDef_C "WTK Fehlerentprellzeit fuer SRC-Low" VALUE 0x1CCE2A Kw_Wu16 655350.0 Time_ms 0.00 655350.0 FORMAT "%8.1" /end CHARACTERISTIC
/begin CHARACTERISTIC COTSCD_DebSRCLowOk_C "WTK Heilungsentprellzeit fuer SRC-Low" VALUE 0x1CCE2C Kw_Wu16 655350.0 Time_ms 0.00 655350.0 FORMAT "%8.1" /end CHARACTERISTIC
/begin CHARACTERISTIC COTSCD_dtRmpSlpUp_C "Rampensteigung bei Heilung/Vorgabewert für WTK" VALUE 0x1CCE30 Kw_Wu32 6553599.99847 RmpTemp 0.00 6553599.99847 FORMAT "%13.5" /end CHARACTERISTIC
/begin CHARACTERISTIC COTSCD_dtRmpSlpDwn_C "Rampensteigung bei Heilung/Vorgabewert für WTK" VALUE 0x1CCE34 Kw_Wu32 6553599.99847 RmpTemp 0.00 6553599.99847 FORMAT "%13.5" /end CHARACTERISTIC
/begin CHARACTERISTIC COTSCD_stSensIDWord_C "Geberkennwort WTK-Sensor" VALUE 0x1CCE38 Kw_Wu16 65535.00 OneToOne 0.00 65535.00 FORMAT "%8.2" /end CHARACTERISTIC
/begin CHARACTERISTIC COTSCD_tDfl_C "Vorgabewert im Fehlerfall" VALUE 0x1CCE3A Kw_Ws16 250.0000 Temp_Cels -50.04000 199.9600 FORMAT "%8.4" EXTENDED_LIMITS -3549.940 3003.560 /end CHARACTERISTIC
/begin CHARACTERISTIC CoVeh_trqPrpDes_Vector "Bypass-Label für CoVeh_trqPrpDes (Nicht verstellen!)" VALUE 0x1C0A66 Kw_Wu8 255.0 OneToOne 0.00 255.0 FORMAT "%5.1" /end CHARACTERISTIC
/begin CHARACTERISTIC CoVeh_trqPrpDes_Channel "Bypass label, nicht editieren" VALUE 0x1C0A67 Kw_Wu8 255.0 OneToOne 0.00 255.0 FORMAT "%5.1" /end CHARACTERISTIC
/begin CHARACTERISTIC CoVeh_trqPrpLead_Vector "Bypass label, nicht editieren!" VALUE 0x1C0A68 Kw_Wu8 255.0 OneToOne 0.00 255.0 FORMAT "%5.1" /end CHARACTERISTIC
/begin CHARACTERISTIC CoVeh_trqPrpLead_Channel "Bypass label, nicht editieren!" VALUE 0x1C0A69 Kw_Wu8 255.0 OneToOne 0.00 255.0 FORMAT "%5.1" /end CHARACTERISTIC
/begin CHARACTERISTIC CrCCD_stKey_Vector "Konfiguration Label für Bypass Freischnitt" VALUE 0x1C0A6A Kw_Wu8 255.0 OneToOne 0.00 255.0 FORMAT "%5.1" /end CHARACTERISTIC
/begin CHARACTERISTIC CrCCD_stKey_Channel "Konfiguration Label für Bypass Freischnitt" VALUE 0x1C0A6B Kw_Wu8 255.0 OneToOne 0.00 255.0 FORMAT "%5.1" /end CHARACTERISTIC
/begin CHARACTERISTIC CrCtl_stBlocking_Vector "Konfigurationslabel für Bypass" VALUE 0x1C0A6C Kw_Wu8 255.0 OneToOne 0.00 255.0 FORMAT "%5.1" /end CHARACTERISTIC
/begin CHARACTERISTIC CrCtl_stBlocking_Channel "Konfigurationslabel für Bypass" VALUE 0x1C0A6D Kw_Wu8 255.0 OneToOne 0.00 255.0 FORMAT "%5.1" /end CHARACTERISTIC
/begin CHARACTERISTIC CrCtl_stKeyStateSig_Vector "Konfigurationslabel für Bypass" VALUE 0x1C0A6E Kw_Wu8 255.0 OneToOne 0.00 255.0 FORMAT "%5.1" /end CHARACTERISTIC
/begin CHARACTERISTIC CrCtl_stKeyStateSig_Channel "Konfigurationslabel für Bypass" VALUE 0x1C0A6F Kw_Wu8 255.0 OneToOne 0.00 255.0 FORMAT "%5.1" /end CHARACTERISTIC
/begin CHARACTERISTIC CrCtl_stOvrRun_Vector "Konfigurationslabel für Bypass Freischnitt" VALUE 0x1C0A70 Kw_Wu8 255.0 OneToOne 0.00 255.0 FORMAT "%5.1" /end CHARACTERISTIC
/begin CHARACTERISTIC CrCtl_stOvrRun_Channel "Konfigurationslabel für Bypass Freischnitt" VALUE 0x1C0A71 Kw_Wu8 255.0 OneToOne 0.00 255.0 FORMAT "%5.1" /end CHARACTERISTIC
/begin CHARACTERISTIC CrCtl_trqDes_Vector "Bypass label, nicht editieren!" VALUE 0x1C0A72 Kw_Wu8 255.0 OneToOne 0.00 255.0 FORMAT "%5.1" /end CHARACTERISTIC
/begin CHARACTERISTIC CrCtl_trqDes_Channel "Bypass label, nicht editieren!" VALUE 0x1C0A73 Kw_Wu8 255.0 OneToOne 0.00 255.0 FORMAT "%5.1" /end CHARACTERISTIC
/begin CHARACTERISTIC CrCtl_trqLead_Vector "Bypass label, nicht editieren!" VALUE 0x1C0A74 Kw_Wu8 255.0 OneToOne 0.00 255.0 FORMAT "%5.1" /end CHARACTERISTIC
/begin CHARACTERISTIC CrCtl_trqLead_Channel "Bypass label, nicht editieren!" VALUE 0x1C0A75 Kw_Wu8 255.0 OneToOne 0.00 255.0 FORMAT "%5.1" /end CHARACTERISTIC
/begin CHARACTERISTIC CrCtl_vSetPointTrgt_Vector "Konfigurationslabel für Bypass" VALUE 0x1C0A76 Kw_Wu8 255.0 OneToOne 0.00 255.0 FORMAT "%5.1" /end CHARACTERISTIC
/begin CHARACTERISTIC CrCtl_vSetPointTrgt_Channel "Konfigurationslabel für Bypass" VALUE 0x1C0A77 Kw_Wu8 255.0 OneToOne 0.00 255.0 FORMAT "%5.1" /end CHARACTERISTIC
/begin CHARACTERISTIC CtApCD_rHWE_mp_Vector "Konfigurationslabel für Bypass message" VALUE 0x1C0A78 Kw_Wu8 255.0 OneToOne 0.00 255.0 FORMAT "%5.1" /end CHARACTERISTIC
/begin CHARACTERISTIC CtApCD_rHWE_mp_Channel "Konfigurationslabel für Bypass message" VALUE 0x1C0A79 Kw_Wu8 255.0 OneToOne 0.00 255.0 FORMAT "%5.1" /end CHARACTERISTIC
/begin CHARACTERISTIC CTSCD_uSRCMinZoom_C "SRC-Min-Wassertemperatur bei Zoom-in" VALUE 0x1CD0D0 Kw_Ws16 5200.391 Volt 0.00 5200.391 FORMAT "%8.3" EXTENDED_LIMITS -160156.4 160151.5 /end CHARACTERISTIC
/begin CHARACTERISTIC CTSCD_uSRCMaxZoom_C "SRC-Max-Wassertemperatur bei Zoom-in" VALUE 0x1CD0D2 Kw_Ws16 5200.391 Volt 0.00 5200.391 FORMAT "%8.3" EXTENDED_LIMITS -160156.4 160151.5 /end CHARACTERISTIC
/begin CHARACTERISTIC CTSCD_tLinZoom_CUR "Linearisierungskennlinie für WTF-Sensor bei zoom-in" CURVE 0x1CD0D4 Kl_Xs16_Ws16 250.0000 Temp_Cels -50.14000 199.8600 FORMAT "%8.4" EXTENDED_LIMITS -3549.940 3003.560
 /begin AXIS_DESCR STD_AXIS CTSCD_uRawZoom Volt 25 0.00 5200.391 FORMAT "%8.3" EXTENDED_LIMITS -160156.4 160151.5 DEPOSIT ABSOLUTE /end AXIS_DESCR
/end CHARACTERISTIC
/begin CHARACTERISTIC CTSCD_uSRCMin_C "Minimalwert für SRC WTF-Sensor" VALUE 0x1CD13A Kw_Ws16 5200.391 Volt 0.00 5200.391 FORMAT "%8.3" EXTENDED_LIMITS -160156.4 160151.5 /end CHARACTERISTIC
/begin CHARACTERISTIC CTSCD_uSRCMax_C "Maximalwert für SRC WTF-Sensor" VALUE 0x1CD13C Kw_Ws16 5200.391 Volt 0.00 5200.391 FORMAT "%8.3" EXTENDED_LIMITS -160156.4 160151.5 /end CHARACTERISTIC
/begin CHARACTERISTIC CTSCD_tLin_CUR "Linearisierungskennlinie für WTF-Sensor" CURVE 0x1CD13E Kl_Xs16_Ws16 250.0000 Temp_Cels -50.14000 199.8600 FORMAT "%8.4" EXTENDED_LIMITS -3549.940 3003.560
 /begin AXIS_DESCR STD_AXIS CTSCD_uRaw Volt 25 0.00 5200.391 FORMAT "%8.3" EXTENDED_LIMITS -160156.4 160151.5 DEPOSIT ABSOLUTE /end AXIS_DESCR
/end CHARACTERISTIC
/begin CHARACTERISTIC CTSCD_DebCanDefDef_C "Fehlerentprellung  Wassertemperatursensor defekt über CAN" VALUE 0x1CD1A4 Kw_Wu16 655350.0 Time_ms 0.00 655350.0 FORMAT "%8.1" /end CHARACTERISTIC
/begin CHARACTERISTIC CTSCD_DebCanDefOk_C "Heilungsentprellung  Wassertemperatursensor defekt über CAN" VALUE 0x1CD1A6 Kw_Wu16 655350.0 Time_ms 0.00 655350.0 FORMAT "%8.1" /end CHARACTERISTIC
/begin CHARACTERISTIC CTSCD_DebCanInacDef_C "Fehlerentprellung  Wassertemperatursensor ungenau über CAN" VALUE 0x1CD1A8 Kw_Wu16 655350.0 Time_ms 0.00 655350.0 FORMAT "%8.1" /end CHARACTERISTIC
/begin CHARACTERISTIC CTSCD_DebCanInacOk_C "Heilungsentprellung  Wassertemperatursensor ungenau über CAN" VALUE 0x1CD1AA Kw_Wu16 655350.0 Time_ms 0.00 655350.0 FORMAT "%8.1" /end CHARACTERISTIC
/begin CHARACTERISTIC CTSCD_DebCanNotImplDef_C "Fehlerentprellung  Wassertemperatursensor nicht verbaut über CAN" VALUE 0x1CD1AC Kw_Wu16 655350.0 Time_ms 0.00 655350.0 FORMAT "%8.1" /end CHARACTERISTIC
/begin CHARACTERISTIC CTSCD_DebCanNotImplOk_C "Heilungsentprellung  Wassertemperatursensor nicht verbaut über CAN" VALUE 0x1CD1AE Kw_Wu16 655350.0 Time_ms 0.00 655350.0 FORMAT "%8.1" /end CHARACTERISTIC
/begin CHARACTERISTIC CTSCD_DebSRCHighDef_C "WTF Fehlerentprellzeit fuer SRC-High" VALUE 0x1CD1B0 Kw_Wu16 655350.0 Time_ms 0.00 655350.0 FORMAT "%8.1" /end CHARACTERISTIC
/begin CHARACTERISTIC CTSCD_DebSRCHighOk_C "WTF Heilungsentprellzeit fuer SRC-High" VALUE 0x1CD1B2 Kw_Wu16 655350.0 Time_ms 0.00 655350.0 FORMAT "%8.1" /end CHARACTERISTIC
/begin CHARACTERISTIC CTSCD_DebSRCLowDef_C "WTF Fehlerentprellzeit fuer SRC-Low" VALUE 0x1CD1B4 Kw_Wu16 655350.0 Time_ms 0.00 655350.0 FORMAT "%8.1" /end CHARACTERISTIC
/begin CHARACTERISTIC CTSCD_DebSRCLowOk_C "WTF Heilungsentprellzeit fuer SRC-Low" VALUE 0x1CD1B6 Kw_Wu16 655350.0 Time_ms 0.00 655350.0 FORMAT "%8.1" /end CHARACTERISTIC
/begin CHARACTERISTIC CTSCD_dtClntDelta_C "Offset für Ersatzwert Wassertemperatur über ADC" VALUE 0x1CD1E0 Kw_Ws16 25.00000 TempDiff_Kelv 0.00 25.00000 FORMAT "%8.5" EXTENDED_LIMITS -3276.800 3276.700 /end CHARACTERISTIC
/begin CHARACTERISTIC CTSCD_FTS4CTS_C "Verwendung eines anderen Sensorwertes für defekten Wassertemperatursensor" VALUE 0x1CD1E2 Kw_Wu8 1.000 OneToOne 0.00 1.000 FORMAT "%5.3" EXTENDED_LIMITS 0.00 255.0 /end CHARACTERISTIC
/begin CHARACTERISTIC CTSCD_dtRmpSlpUp_C "Rampensteigung bei Heilung/Vorgabewert für WTF" VALUE 0x1CD1B8 Kw_Wu32 6553599.99847 RmpTemp 0.00 6553599.99847 FORMAT "%13.5" /end CHARACTERISTIC
/begin CHARACTERISTIC CTSCD_dtRmpSlpDwn_C "Rampensteigung bei Heilung/Vorgabewert für WTF" VALUE 0x1CD1BC Kw_Wu32 6553599.99847 RmpTemp 0.00 6553599.99847 FORMAT "%13.5" /end CHARACTERISTIC
/begin CHARACTERISTIC CTSCD_stInvPullup_C "Hardware-Ausgang Invertierung Pullup-Widerstand" VALUE 0x1CD1C0 Kw_Wu8 1.000 OneToOne 0.00 1.000 FORMAT "%5.3" EXTENDED_LIMITS 0.00 255.0 /end CHARACTERISTIC
/begin CHARACTERISTIC CTSCD_swtLampMode_C "Softwareschalter für Wahl der Kühlmitteltemperatur" VALUE 0x1CD1C1 Kw_Wu8 1.000 OneToOne 0.00 1.000 FORMAT "%5.3" EXTENDED_LIMITS 0.00 255.0 /end CHARACTERISTIC
/begin CHARACTERISTIC CTSCD_swtPullupOn_C "Schalter Zoom-Funktion aktivieren" VALUE 0x1CD1C2 Kw_Wu8 1.000 OneToOne 0.00 1.000 FORMAT "%5.3" EXTENDED_LIMITS 0.00 255.0 /end CHARACTERISTIC
/begin CHARACTERISTIC CTSCD_swtSigVal_C "Signalquelle ADC/CAN (0: ADC, 1: CAN)" VALUE 0x1CD1C3 Kw_Wu8 1.000 OneToOne 0.00 1.000 FORMAT "%5.3" EXTENDED_LIMITS 0.00 255.0 /end CHARACTERISTIC
/begin CHARACTERISTIC CTSCD_swtTempDflVal_C "Schalter zur Verwendung von FTS oder OTS für defekten CTS" VALUE 0x1CD1C4 Kw_Wu8 1.000 OneToOne 0.00 1.000 FORMAT "%5.3" EXTENDED_LIMITS 0.00 255.0 /end CHARACTERISTIC
/begin CHARACTERISTIC CTSCD_swtTempDflType_C "Schaltertyp für CTSCD_swtTempDflVal_C" VALUE 0x1CD1C5 Kw_Wu8 2.000 OneToOne 0.00 2.000 FORMAT "%5.3" EXTENDED_LIMITS 0.00 255.0 /end CHARACTERISTIC
/begin CHARACTERISTIC CTSCD_tCTSCanPrtMax_C "obere Hysterreseschwelle der Anforderung der Kühlungszusatzmaßnahme" VALUE 0x1CD1C6 Kw_Ws16 200.0000 Temp_Cels -0.04000000 199.9600 FORMAT "%8.4" EXTENDED_LIMITS -3549.940 3003.560 /end CHARACTERISTIC
/begin CHARACTERISTIC CTSCD_tCTSCanPrtMin_C "untere Hysterreseschwelle der Anforderung der Kühlungszusatzmaßnahme" VALUE 0x1CD1C8 Kw_Ws16 200.0000 Temp_Cels -0.04000000 199.9600 FORMAT "%8.4" EXTENDED_LIMITS -3549.940 3003.560 /end CHARACTERISTIC
/begin CHARACTERISTIC CTSCD_tCTSPrtMax_C "Obergrenze für Anforderung Kühlwassertemperatur-Heißleuchte" VALUE 0x1CD1CA Kw_Ws16 100.0000 Temp_Cels -0.04000000 99.96000 FORMAT "%8.4" EXTENDED_LIMITS -3549.940 3003.560 /end CHARACTERISTIC
/begin CHARACTERISTIC CTSCD_tCTSPrtMin_C "Untergrenze für Anforderung Kühlwassertemperatur-Heißleuchte" VALUE 0x1CD1CC Kw_Ws16 100.0000 Temp_Cels -0.04000000 99.96000 FORMAT "%8.4" EXTENDED_LIMITS -3549.940 3003.560 /end CHARACTERISTIC
/begin CHARACTERISTIC CTSCD_tCTSWrnMax_C "Obergrenze für Anforderung Kühlwassertemperatur-Heißleuchtenvorwarnung" VALUE 0x1CD1CE Kw_Ws16 100.0000 Temp_Cels -0.04000000 99.96000 FORMAT "%8.4" EXTENDED_LIMITS -3549.940 3003.560 /end CHARACTERISTIC
/begin CHARACTERISTIC CTSCD_tCTSWrnMin_C "Untergrenze für Anforderung Kühlwassertemperatur-Heißleuchtenvorwarnung" VALUE 0x1CD1D0 Kw_Ws16 100.0000 Temp_Cels -0.04000000 99.96000 FORMAT "%8.4" EXTENDED_LIMITS -3549.940 3003.560 /end CHARACTERISTIC
/begin CHARACTERISTIC CTSCD_tCTSZoomOnMax_C "Zoom-Funktion obere Hystereseschwelle" VALUE 0x1CD1D2 Kw_Ws16 100.0000 Temp_Cels -0.04000000 99.96000 FORMAT "%8.4" EXTENDED_LIMITS -3549.940 3003.560 /end CHARACTERISTIC
/begin CHARACTERISTIC CTSCD_tCTSZoomOnMin_C "Zoom-Funktion untere Hystereseschwelle" VALUE 0x1CD1D4 Kw_Ws16 100.0000 Temp_Cels -0.04000000 99.96000 FORMAT "%8.4" EXTENDED_LIMITS -3549.940 3003.560 /end CHARACTERISTIC
/begin CHARACTERISTIC CTSCD_tiZoomOFF_C "Sensorschutz-Timer: Sensor inaktiv" VALUE 0x1CD1D6 Kw_Wu16 200000.0 Time_ms 0.00 200000.0 FORMAT "%8.1" EXTENDED_LIMITS 0.00 655350.0 /end CHARACTERISTIC
/begin CHARACTERISTIC CTSCD_tiZoomON_C "Sensorschutz-Timer: Sensor aktiv" VALUE 0x1CD1D8 Kw_Wu16 200000.0 Time_ms 0.00 200000.0 FORMAT "%8.1" EXTENDED_LIMITS 0.00 655350.0 /end CHARACTERISTIC
/begin CHARACTERISTIC CTSCD_stSensIDWord_C "Geberkennwort WTF-Sensor" VALUE 0x1CD1DA Kw_Wu16 65535.00 OneToOne 0.00 65535.00 FORMAT "%8.2" /end CHARACTERISTIC
/begin CHARACTERISTIC CTSCD_tDfl_C "Vorgabewert bei defektem WTF-Sensor" VALUE 0x1CD1DC Kw_Ws16 200.0000 Temp_Cels -50.14000 149.8600 FORMAT "%8.4" EXTENDED_LIMITS -3549.940 3003.560 /end CHARACTERISTIC
/begin CHARACTERISTIC CtTCtl_dcycThst_Vector "Konfigurationslabel für Bypass message" VALUE 0x1C0A7A Kw_Wu8 255.0 OneToOne 0.00 255.0 FORMAT "%5.1" /end CHARACTERISTIC
/begin CHARACTERISTIC CtTCtl_dcycThst_Channel "Konfigurationslabel für Bypass message" VALUE 0x1C0A7B Kw_Wu8 255.0 OneToOne 0.00 255.0 FORMAT "%5.1" /end CHARACTERISTIC
/begin CHARACTERISTIC DSM_CDCDfp_BPSCDPlaus_C "CARB spezifischer Fehlercode fuer Fehlerpfad Dfp_BPSCDPlaus" VAL_BLK 0x1CDC84 Kwb_Wu16 65535.00 OneToOne 0.00 65535.00 FORMAT "%8.2" NUMBER 4 /end CHARACTERISTIC
/begin CHARACTERISTIC DSM_CDKDfp_BPSCDPlaus_C "Kundenspezifischer Fehlercode fuer Fehlerpfad Dfp_BPSCDPlaus" VAL_BLK 0x1CE884 Kwb_Wu16 65535.00 OneToOne 0.00 65535.00 FORMAT "%8.2" NUMBER 4 /end CHARACTERISTIC
/begin CHARACTERISTIC DSM_ClaDfp_BPSCDPlaus_C "Fehlerklasse fuer Fehlerpfad Dfp_BPSCDPlaus" VALUE 0x1CF2E7 Kw_Wu8 20.00 OneToOne 0.00 20.00 FORMAT "%5.2" EXTENDED_LIMITS 0.00 255.0 /end CHARACTERISTIC
/begin CHARACTERISTIC DSM_EnvDfp_BPSCDPlaus_C "Fehlerpfad spezifische Umweltbedingungen fuer Fehlerpfad Dfp_BPSCDPlaus" VAL_BLK 0x1CF7DC Kwb_Wu16 1152.00000000 SigName 0.00 1152.00000000 FORMAT "%13.8" NUMBER 8 /end CHARACTERISTIC
/begin CHARACTERISTIC DSM_FMKDfp_BPSCDPlaus_C "Ausblendbedingungen fuer Fehlerpfad Dfp_BPSCDPlaus" VALUE 0x1CD967 Kw_Wu8 255.0 OneToOne 0.00 255.0 FORMAT "%5.1" /end CHARACTERISTIC
/begin CHARACTERISTIC DSM_TypDfp_BPSCDPlaus_C "Konvertierung der Fehlertypen auf der Diagnoseschnittstelle fuer Fehlerpfad Dfp_BPSCDPlaus" VAL_BLK 0x1D1FF2 Kwb_Wu8 255.0 OneToOne 0.00 255.0 FORMAT "%5.1" NUMBER 4 /end CHARACTERISTIC
/begin CHARACTERISTIC EGRCD_rOut_Vector "Konfigurationslabel für Bypass Freischnitt" VALUE 0x1C0A7C Kw_Wu8 255.0 OneToOne 0.00 255.0 FORMAT "%5.1" /end CHARACTERISTIC
/begin CHARACTERISTIC EGRCD_rOut_Channel "Konfigurationslabel für Bypass Freischnitt" VALUE 0x1C0A7D Kw_Wu8 255.0 OneToOne 0.00 255.0 FORMAT "%5.1" /end CHARACTERISTIC
/begin CHARACTERISTIC EGRVlv_rEGR_Vector "Bypass-Label für EGRVlv_rEGR" VALUE 0x1C0A7E Kw_Wu8 255.0 OneToOne 0.00 255.0 FORMAT "%5.1" /end CHARACTERISTIC
/begin CHARACTERISTIC EGRVlv_rEGR_Channel "Bypass-Label für EGRVlv_rEGR" VALUE 0x1C0A7F Kw_Wu8 255.0 OneToOne 0.00 255.0 FORMAT "%5.1" /end CHARACTERISTIC
/begin CHARACTERISTIC BasAdj_EGRnSetpoint_C "Leerlaufsolldrehzahl bei EGR Grundeinstellung  (Diagnose)" VALUE 0x1CC15E Kw_Ws16 65535.00 EngN -32768.00 32767.00 FORMAT "%8.2" /end CHARACTERISTIC
/begin CHARACTERISTIC BasAdj_EGRtime_C "Zeit nach der bei EGR-Grundeinstellung zwischen den beiden Tastverhältnissen umgeschalten wird  (Diagnose)" VALUE 0x1CC160 Kw_Wu16 655350.0 Time_ms 0.00 655350.0 FORMAT "%8.1" /end CHARACTERISTIC
/begin CHARACTERISTIC BasAdj_EGRBits_C "Maske für BasAdj_st bei EGR Grundeinstellung  (Diagnose)" VALUE 0x1CC162 Kw_Wu16 65535.00 OneToOne 0.00 65535.00 FORMAT "%8.2" READ_ONLY /end CHARACTERISTIC
/begin CHARACTERISTIC EGT_st_Vector "Bypass-Label, nicht editieren !" VALUE 0x1C0A80 Kw_Wu8 255.0 OneToOne 0.00 255.0 FORMAT "%5.1" /end CHARACTERISTIC
/begin CHARACTERISTIC EGT_st_Channel "Bypass-Label, nicht editieren !" VALUE 0x1C0A81 Kw_Wu8 255.0 OneToOne 0.00 255.0 FORMAT "%5.1" /end CHARACTERISTIC
/begin CHARACTERISTIC EngM_trqFrcMin_Vector "Konfiguration Label für Bypass Freischnitt" VALUE 0x1C0A84 Kw_Wu8 255.0 OneToOne 0.00 255.0 FORMAT "%5.1" /end CHARACTERISTIC
/begin CHARACTERISTIC EngM_trqFrcMin_Channel "Konfiguration Label für Bypass Freischnitt" VALUE 0x1C0A85 Kw_Wu8 255.0 OneToOne 0.00 255.0 FORMAT "%5.1" /end CHARACTERISTIC
/begin CHARACTERISTIC EngM_trqFrc_Vector "Bypass Label für EngM_trqFrc (nicht verändern !)" VALUE 0x1C0A86 Kw_Wu8 255.0 OneToOne 0.00 255.0 FORMAT "%5.1" /end CHARACTERISTIC
/begin CHARACTERISTIC EngM_trqFrc_Channel "Bypass Label for EngM_trqFrc (nicht verändern !)" VALUE 0x1C0A87 Kw_Wu8 255.0 OneToOne 0.00 255.0 FORMAT "%5.1" /end CHARACTERISTIC
/begin CHARACTERISTIC FanCtl_prcCAN_Vector "Konfigurationslabel für Bypass message" VALUE 0x1C0A8C Kw_Wu8 255.0 OneToOne 0.00 255.0 FORMAT "%5.1" /end CHARACTERISTIC
/begin CHARACTERISTIC FanCtl_prcCAN_Channel "Konfigurationslabel für Bypass message" VALUE 0x1C0A8D Kw_Wu8 255.0 OneToOne 0.00 255.0 FORMAT "%5.1" /end CHARACTERISTIC
/begin CHARACTERISTIC FBC_lrn_Vector "Bypass Label, nicht ändern!" VALUE 0x1C0A90 Kw_Wu8 255.0 OneToOne 0.00 255.0 FORMAT "%5.1" /end CHARACTERISTIC
/begin CHARACTERISTIC FBC_lrn_Channel "Bypass Label, nicht ändern!" VALUE 0x1C0A91 Kw_Wu8 255.0 OneToOne 0.00 255.0 FORMAT "%5.1" /end CHARACTERISTIC
/begin CHARACTERISTIC FBC_q_Vector "Bypass Label, nicht ändern!" VALUE 0x1C0A8E Kw_Wu8 255.0 OneToOne 0.00 255.0 FORMAT "%5.1" /end CHARACTERISTIC
/begin CHARACTERISTIC FBC_q_Channel "Bypass Label, nicht ändern!" VALUE 0x1C0A8F Kw_Wu8 255.0 OneToOne 0.00 255.0 FORMAT "%5.1" /end CHARACTERISTIC
/begin CHARACTERISTIC FlMng_qLimSmk_Vector "Konfigurationslabel für Bypass message" VALUE 0x1C0A92 Kw_Wu8 255.0 OneToOne 0.00 255.0 FORMAT "%5.1" /end CHARACTERISTIC
/begin CHARACTERISTIC FlMng_qLimSmk_Channel "Konfigurationslabel für Bypass message" VALUE 0x1C0A93 Kw_Wu8 255.0 OneToOne 0.00 255.0 FORMAT "%5.1" /end CHARACTERISTIC
/begin CHARACTERISTIC FMTC_etaCurr_Vector "Bypass Label, nicht ändern!" VALUE 0x1C0A94 Kw_Wu8 255.0 OneToOne 0.00 255.0 FORMAT "%5.1" /end CHARACTERISTIC
/begin CHARACTERISTIC FMTC_etaCurr_Channel "Bypass Label, nicht ändern!" VALUE 0x1C0A95 Kw_Wu8 255.0 OneToOne 0.00 255.0 FORMAT "%5.1" /end CHARACTERISTIC
/begin CHARACTERISTIC FrmMng_stSendEng6_B1_Vector "Konfigurationslabel für Bypass Freischnitt" VALUE 0x1C0A9A Kw_Wu8 255.0 OneToOne 0.00 255.0 FORMAT "%5.1" /end CHARACTERISTIC
/begin CHARACTERISTIC FrmMng_stSendEng6_B1_Channel "Konfigurationslabel für Bypass Freischnitt" VALUE 0x1C0A9B Kw_Wu8 255.0 OneToOne 0.00 255.0 FORMAT "%5.1" /end CHARACTERISTIC
/begin CHARACTERISTIC FrmMng_stSendEng6_B2_Vector "Konfigurationslabel für Bypass Freischnitt" VALUE 0x1C0A9C Kw_Wu8 255.0 OneToOne 0.00 255.0 FORMAT "%5.1" /end CHARACTERISTIC
/begin CHARACTERISTIC FrmMng_stSendEng6_B2_Channel "Konfigurationslabel für Bypass Freischnitt" VALUE 0x1C0A9D Kw_Wu8 255.0 OneToOne 0.00 255.0 FORMAT "%5.1" /end CHARACTERISTIC
/begin CHARACTERISTIC FrmMng_stSendEng6_B3_Vector "Konfigurationslabel für Bypass Freischnitt" VALUE 0x1C0A9E Kw_Wu8 255.0 OneToOne 0.00 255.0 FORMAT "%5.1" /end CHARACTERISTIC
/begin CHARACTERISTIC FrmMng_stSendEng6_B3_Channel "Konfigurationslabel für Bypass Freischnitt" VALUE 0x1C0A9F Kw_Wu8 255.0 OneToOne 0.00 255.0 FORMAT "%5.1" /end CHARACTERISTIC
/begin CHARACTERISTIC FrmMng_stSendEng6_B4_Vector "Konfigurationslabel für Bypass Freischnitt" VALUE 0x1C0AA0 Kw_Wu8 255.0 OneToOne 0.00 255.0 FORMAT "%5.1" /end CHARACTERISTIC
/begin CHARACTERISTIC FrmMng_stSendEng6_B4_Channel "Konfigurationslabel für Bypass Freischnitt" VALUE 0x1C0AA1 Kw_Wu8 255.0 OneToOne 0.00 255.0 FORMAT "%5.1" /end CHARACTERISTIC
/begin CHARACTERISTIC FrmMng_stSendEng6_B5_Vector "Konfigurationslabel für Bypass Freischnitt" VALUE 0x1C0AA2 Kw_Wu8 255.0 OneToOne 0.00 255.0 FORMAT "%5.1" /end CHARACTERISTIC
/begin CHARACTERISTIC FrmMng_stSendEng6_B5_Channel "Konfigurationslabel für Bypass Freischnitt" VALUE 0x1C0AA3 Kw_Wu8 255.0 OneToOne 0.00 255.0 FORMAT "%5.1" /end CHARACTERISTIC
/begin CHARACTERISTIC FrmMng_stSendEng6_B6_Vector "Konfigurationslabel für Bypass Freischnitt" VALUE 0x1C0AA4 Kw_Wu8 255.0 OneToOne 0.00 255.0 FORMAT "%5.1" /end CHARACTERISTIC
/begin CHARACTERISTIC FrmMng_stSendEng6_B6_Channel "Konfigurationslabel für Bypass Freischnitt" VALUE 0x1C0AA5 Kw_Wu8 255.0 OneToOne 0.00 255.0 FORMAT "%5.1" /end CHARACTERISTIC
/begin CHARACTERISTIC FrmMng_stSendEng6_B7_Vector "Konfigurationslabel für Bypass Freischnitt" VALUE 0x1C0AA6 Kw_Wu8 255.0 OneToOne 0.00 255.0 FORMAT "%5.1" /end CHARACTERISTIC
/begin CHARACTERISTIC FrmMng_stSendEng6_B7_Channel "Konfigurationslabel für Bypass Freischnitt" VALUE 0x1C0AA7 Kw_Wu8 255.0 OneToOne 0.00 255.0 FORMAT "%5.1" /end CHARACTERISTIC
/begin CHARACTERISTIC FrmMng_stSendEng6_B8_Vector "Konfigurationslabel für Bypass Freischnitt" VALUE 0x1C0AA8 Kw_Wu8 255.0 OneToOne 0.00 255.0 FORMAT "%5.1" /end CHARACTERISTIC
/begin CHARACTERISTIC FrmMng_stSendEng6_B8_Channel "Konfigurationslabel für Bypass Freischnitt" VALUE 0x1C0AA9 Kw_Wu8 255.0 OneToOne 0.00 255.0 FORMAT "%5.1" /end CHARACTERISTIC
/begin CHARACTERISTIC FrmMng_stSendEngTrq1_B1_Vector "Konfigurationslabel für Bypass Freischnitt" VALUE 0x1C0AAA Kw_Wu8 255.0 OneToOne 0.00 255.0 FORMAT "%5.1" /end CHARACTERISTIC
/begin CHARACTERISTIC FrmMng_stSendEngTrq1_B1_Channel "Konfigurationslabel für Bypass Freischnitt" VALUE 0x1C0AAB Kw_Wu8 255.0 OneToOne 0.00 255.0 FORMAT "%5.1" /end CHARACTERISTIC
/begin CHARACTERISTIC FrmMng_stSendEngTrq1_B2_Vector "Konfigurationslabel für Bypass Freischnitt" VALUE 0x1C0AAC Kw_Wu8 255.0 OneToOne 0.00 255.0 FORMAT "%5.1" /end CHARACTERISTIC
/begin CHARACTERISTIC FrmMng_stSendEngTrq1_B2_Channel "Konfigurationslabel für Bypass Freischnitt" VALUE 0x1C0AAD Kw_Wu8 255.0 OneToOne 0.00 255.0 FORMAT "%5.1" /end CHARACTERISTIC
/begin CHARACTERISTIC FrmMng_stSendEngTrq1_B3_Vector "Konfigurationslabel für Bypass Freischnitt" VALUE 0x1C0AAE Kw_Wu8 255.0 OneToOne 0.00 255.0 FORMAT "%5.1" /end CHARACTERISTIC
/begin CHARACTERISTIC FrmMng_stSendEngTrq1_B3_Channel "Konfigurationslabel für Bypass Freischnitt" VALUE 0x1C0AAF Kw_Wu8 255.0 OneToOne 0.00 255.0 FORMAT "%5.1" /end CHARACTERISTIC
/begin CHARACTERISTIC FrmMng_stSendEngTrq1_B4_Vector "Konfigurationslabel für Bypass Freischnitt" VALUE 0x1C0AB0 Kw_Wu8 255.0 OneToOne 0.00 255.0 FORMAT "%5.1" /end CHARACTERISTIC
/begin CHARACTERISTIC FrmMng_stSendEngTrq1_B4_Channel "Konfigurationslabel für Bypass Freischnitt" VALUE 0x1C0AB1 Kw_Wu8 255.0 OneToOne 0.00 255.0 FORMAT "%5.1" /end CHARACTERISTIC
/begin CHARACTERISTIC FrmMng_stSendEngTrq1_B5_Vector "Konfigurationslabel für Bypass Freischnitt" VALUE 0x1C0AB2 Kw_Wu8 255.0 OneToOne 0.00 255.0 FORMAT "%5.1" /end CHARACTERISTIC
/begin CHARACTERISTIC FrmMng_stSendEngTrq1_B5_Channel "Konfigurationslabel für Bypass Freischnitt" VALUE 0x1C0AB3 Kw_Wu8 255.0 OneToOne 0.00 255.0 FORMAT "%5.1" /end CHARACTERISTIC
/begin CHARACTERISTIC FrmMng_stSendEngTrq1_B6_Vector "Konfigurationslabel für Bypass Freischnitt" VALUE 0x1C0AB4 Kw_Wu8 255.0 OneToOne 0.00 255.0 FORMAT "%5.1" /end CHARACTERISTIC
/begin CHARACTERISTIC FrmMng_stSendEngTrq1_B6_Channel "Konfigurationslabel für Bypass Freischnitt" VALUE 0x1C0AB5 Kw_Wu8 255.0 OneToOne 0.00 255.0 FORMAT "%5.1" /end CHARACTERISTIC
/begin CHARACTERISTIC FrmMng_stSendEngTrq1_B7_Vector "Konfigurationslabel für Bypass Freischnitt" VALUE 0x1C0AB6 Kw_Wu8 255.0 OneToOne 0.00 255.0 FORMAT "%5.1" /end CHARACTERISTIC
/begin CHARACTERISTIC FrmMng_stSendEngTrq1_B7_Channel "Konfigurationslabel für Bypass Freischnitt" VALUE 0x1C0AB7 Kw_Wu8 255.0 OneToOne 0.00 255.0 FORMAT "%5.1" /end CHARACTERISTIC
/begin CHARACTERISTIC FrmMng_stSendEngTrq1_B8_Vector "Konfigurationslabel für Bypass Freischnitt" VALUE 0x1C0AB8 Kw_Wu8 255.0 OneToOne 0.00 255.0 FORMAT "%5.1" /end CHARACTERISTIC
/begin CHARACTERISTIC FrmMng_stSendEngTrq1_B8_Channel "Konfigurationslabel für Bypass Freischnitt" VALUE 0x1C0AB9 Kw_Wu8 255.0 OneToOne 0.00 255.0 FORMAT "%5.1" /end CHARACTERISTIC
/begin CHARACTERISTIC FrmMng_stSendEngTrq2_B1_Vector "Konfigurationslabel für Bypass Freischnitt" VALUE 0x1C0ABA Kw_Wu8 255.0 OneToOne 0.00 255.0 FORMAT "%5.1" /end CHARACTERISTIC
/begin CHARACTERISTIC FrmMng_stSendEngTrq2_B1_Channel "Konfigurationslabel für Bypass Freischnitt" VALUE 0x1C0ABB Kw_Wu8 255.0 OneToOne 0.00 255.0 FORMAT "%5.1" /end CHARACTERISTIC
/begin CHARACTERISTIC FrmMng_stSendEngTrq2_B2_Vector "Konfigurationslabel für Bypass Freischnitt" VALUE 0x1C0ABC Kw_Wu8 255.0 OneToOne 0.00 255.0 FORMAT "%5.1" /end CHARACTERISTIC
/begin CHARACTERISTIC FrmMng_stSendEngTrq2_B2_Channel "Konfigurationslabel für Bypass Freischnitt" VALUE 0x1C0ABD Kw_Wu8 255.0 OneToOne 0.00 255.0 FORMAT "%5.1" /end CHARACTERISTIC
/begin CHARACTERISTIC FrmMng_stSendEngTrq2_B3_Vector "Konfigurationslabel für Bypass Freischnitt" VALUE 0x1C0ABE Kw_Wu8 255.0 OneToOne 0.00 255.0 FORMAT "%5.1" /end CHARACTERISTIC
/begin CHARACTERISTIC FrmMng_stSendEngTrq2_B3_Channel "Konfigurationslabel für Bypass Freischnitt" VALUE 0x1C0ABF Kw_Wu8 255.0 OneToOne 0.00 255.0 FORMAT "%5.1" /end CHARACTERISTIC
/begin CHARACTERISTIC FrmMng_stSendEngTrq2_B4_Vector "Konfigurationslabel für Bypass Freischnitt" VALUE 0x1C0AC0 Kw_Wu8 255.0 OneToOne 0.00 255.0 FORMAT "%5.1" /end CHARACTERISTIC
/begin CHARACTERISTIC FrmMng_stSendEngTrq2_B4_Channel "Konfigurationslabel für Bypass message" VALUE 0x1C0AC1 Kw_Wu8 255.0 OneToOne 0.00 255.0 FORMAT "%5.1" /end CHARACTERISTIC
/begin CHARACTERISTIC FrmMng_stSendEngTrq2_B5_Vector "Konfigurationslabel für Bypass Freischnitt" VALUE 0x1C0AC2 Kw_Wu8 255.0 OneToOne 0.00 255.0 FORMAT "%5.1" /end CHARACTERISTIC
/begin CHARACTERISTIC FrmMng_stSendEngTrq2_B5_Channel "Konfigurationslabel für Bypass Freischnitt" VALUE 0x1C0AC3 Kw_Wu8 255.0 OneToOne 0.00 255.0 FORMAT "%5.1" /end CHARACTERISTIC
/begin CHARACTERISTIC FrmMng_stSendEngTrq2_B6_Vector "Konfigurationslabel für Bypass Freischnitt" VALUE 0x1C0AC4 Kw_Wu8 255.0 OneToOne 0.00 255.0 FORMAT "%5.1" /end CHARACTERISTIC
/begin CHARACTERISTIC FrmMng_stSendEngTrq2_B6_Channel "Konfigurationslabel für Bypass Freischnitt" VALUE 0x1C0AC5 Kw_Wu8 255.0 OneToOne 0.00 255.0 FORMAT "%5.1" /end CHARACTERISTIC
/begin CHARACTERISTIC FrmMng_stSendEngTrq2_B7_Vector "Konfigurationslabel für Bypass Freischnitt" VALUE 0x1C0AC6 Kw_Wu8 255.0 OneToOne 0.00 255.0 FORMAT "%5.1" /end CHARACTERISTIC
/begin CHARACTERISTIC FrmMng_stSendEngTrq2_B7_Channel "Konfigurationslabel für Bypass Freischnitt" VALUE 0x1C0AC7 Kw_Wu8 255.0 OneToOne 0.00 255.0 FORMAT "%5.1" /end CHARACTERISTIC
/begin CHARACTERISTIC FrmMng_stSendEngTrq2_B8_Vector "Konfigurationslabel für Bypass Freischnitt" VALUE 0x1C0AC8 Kw_Wu8 255.0 OneToOne 0.00 255.0 FORMAT "%5.1" /end CHARACTERISTIC
/begin CHARACTERISTIC FrmMng_stSendEngTrq2_B8_Channel "Konfigurationslabel für Bypass Freischnitt" VALUE 0x1C0AC9 Kw_Wu8 255.0 OneToOne 0.00 255.0 FORMAT "%5.1" /end CHARACTERISTIC
/begin CHARACTERISTIC FrmMng_stSendEngTrq3_B1_Vector "Konfigurationslabel für Bypass Freischnitt" VALUE 0x1C0ACA Kw_Wu8 255.0 OneToOne 0.00 255.0 FORMAT "%5.1" /end CHARACTERISTIC
/begin CHARACTERISTIC FrmMng_stSendEngTrq3_B1_Channel "Konfigurationslabel für Bypass Freischnitt" VALUE 0x1C0ACB Kw_Wu8 255.0 OneToOne 0.00 255.0 FORMAT "%5.1" /end CHARACTERISTIC
/begin CHARACTERISTIC FrmMng_stSendEngTrq3_B2_Vector "Konfigurationslabel für Bypass Freischnitt" VALUE 0x1C0ACC Kw_Wu8 255.0 OneToOne 0.00 255.0 FORMAT "%5.1" /end CHARACTERISTIC
/begin CHARACTERISTIC FrmMng_stSendEngTrq3_B2_Channel "Konfigurationslabel für Bypass Freischnitt" VALUE 0x1C0ACD Kw_Wu8 255.0 OneToOne 0.00 255.0 FORMAT "%5.1" /end CHARACTERISTIC
/begin CHARACTERISTIC FrmMng_stSendEngTrq3_B3_Vector "Konfigurationslabel für Bypass Freischnitt" VALUE 0x1C0ACE Kw_Wu8 255.0 OneToOne 0.00 255.0 FORMAT "%5.1" /end CHARACTERISTIC
/begin CHARACTERISTIC FrmMng_stSendEngTrq3_B3_Channel "Konfigurationslabel für Bypass Freischnitt" VALUE 0x1C0ACF Kw_Wu8 255.0 OneToOne 0.00 255.0 FORMAT "%5.1" /end CHARACTERISTIC
/begin CHARACTERISTIC FrmMng_stSendEngTrq3_B4_Vector "Konfigurationslabel für Bypass Freischnitt" VALUE 0x1C0AD0 Kw_Wu8 255.0 OneToOne 0.00 255.0 FORMAT "%5.1" /end CHARACTERISTIC
/begin CHARACTERISTIC FrmMng_stSendEngTrq3_B4_Channel "Konfigurationslabel für Bypass Freischnitt" VALUE 0x1C0AD1 Kw_Wu8 255.0 OneToOne 0.00 255.0 FORMAT "%5.1" /end CHARACTERISTIC
/begin CHARACTERISTIC FrmMng_stSendEngTrq3_B5_Vector "Konfigurationslabel für Bypass Freischnitt" VALUE 0x1C0AD2 Kw_Wu8 255.0 OneToOne 0.00 255.0 FORMAT "%5.1" /end CHARACTERISTIC
/begin CHARACTERISTIC FrmMng_stSendEngTrq3_B5_Channel "Konfigurationslabel für Bypass Freischnitt" VALUE 0x1C0AD3 Kw_Wu8 255.0 OneToOne 0.00 255.0 FORMAT "%5.1" /end CHARACTERISTIC
/begin CHARACTERISTIC FrmMng_stSendEngTrq3_B6_Vector "Konfigurationslabel für Bypass Freischnitt" VALUE 0x1C0AD4 Kw_Wu8 255.0 OneToOne 0.00 255.0 FORMAT "%5.1" /end CHARACTERISTIC
/begin CHARACTERISTIC FrmMng_stSendEngTrq3_B6_Channel "Konfigurationslabel für Bypass Freischnitt" VALUE 0x1C0AD5 Kw_Wu8 255.0 OneToOne 0.00 255.0 FORMAT "%5.1" /end CHARACTERISTIC
/begin CHARACTERISTIC FrmMng_stSendEngTrq3_B7_Vector "Konfigurationslabel für Bypass Freischnitt" VALUE 0x1C0AD6 Kw_Wu8 255.0 OneToOne 0.00 255.0 FORMAT "%5.1" /end CHARACTERISTIC
/begin CHARACTERISTIC FrmMng_stSendEngTrq3_B7_Channel "Konfigurationslabel für Bypass Freischnitt" VALUE 0x1C0AD7 Kw_Wu8 255.0 OneToOne 0.00 255.0 FORMAT "%5.1" /end CHARACTERISTIC
/begin CHARACTERISTIC FrmMng_stSendEngTrq3_B8_Vector "Konfigurationslabel für Bypass Freischnitt" VALUE 0x1C0AD8 Kw_Wu8 255.0 OneToOne 0.00 255.0 FORMAT "%5.1" /end CHARACTERISTIC
/begin CHARACTERISTIC FrmMng_stSendEngTrq3_B8_Channel "Konfigurationslabel für Bypass Freischnitt" VALUE 0x1C0AD9 Kw_Wu8 255.0 OneToOne 0.00 255.0 FORMAT "%5.1" /end CHARACTERISTIC
/begin CHARACTERISTIC Gearbx_trqInMax_Vector "Bypass Label, nicht ändern!" VALUE 0x1C0ADA Kw_Wu8 255.0 OneToOne 0.00 255.0 FORMAT "%5.1" /end CHARACTERISTIC
/begin CHARACTERISTIC Gearbx_trqInMax_Channel "Bypass Label, nicht ändern!" VALUE 0x1C0ADB Kw_Wu8 255.0 OneToOne 0.00 255.0 FORMAT "%5.1" /end CHARACTERISTIC
/begin CHARACTERISTIC IndSys_rVSAAdd_Vector "Bypass-Label für additiven Bypass von IndSys_rVSA (Nicht verstellen!)" VALUE 0x1C0ADC Kw_Wu8 255.0 OneToOne 0.00 255.0 FORMAT "%5.1" /end CHARACTERISTIC
/begin CHARACTERISTIC IndSys_rVSAAdd_Channel "Bypass-Label für additiven Bypass von IndSys_rVSA (Nicht verstellen!)" VALUE 0x1C0ADD Kw_Wu8 255.0 OneToOne 0.00 255.0 FORMAT "%5.1" /end CHARACTERISTIC
/begin CHARACTERISTIC IndSys_rVSA_Vector "Bypass-Label für IndSys_rVSA (Nicht verstellen!)" VALUE 0x1C0ADE Kw_Wu8 255.0 OneToOne 0.00 255.0 FORMAT "%5.1" /end CHARACTERISTIC
/begin CHARACTERISTIC IndSys_rVSA_Channel "Bypass-Label für IndSys_rVSA (Nicht verstellen!)" VALUE 0x1C0ADF Kw_Wu8 255.0 OneToOne 0.00 255.0 FORMAT "%5.1" /end CHARACTERISTIC
/begin CHARACTERISTIC InjCrv_phiMI1Des_Vector "Bypass-Label für InjCrv_phiMI1Des (Nicht verstellen!)" VALUE 0x1C0AE0 Kw_Wu8 255.0 OneToOne 0.00 255.0 FORMAT "%5.1" /end CHARACTERISTIC
/begin CHARACTERISTIC InjCrv_phiMI1Des_Channel "Bypass-Label für InjCrv_phiMI1Des (Nicht verstellen!)" VALUE 0x1C0AE1 Kw_Wu8 255.0 OneToOne 0.00 255.0 FORMAT "%5.1" /end CHARACTERISTIC
/begin CHARACTERISTIC InjCrv_phiPiI1Des_Vector "Bypass-Label für InjCrv_phiPiI1Des (Nicht verstellen!)" VALUE 0x1C0AE4 Kw_Wu8 255.0 OneToOne 0.00 255.0 FORMAT "%5.1" /end CHARACTERISTIC
/begin CHARACTERISTIC InjCrv_phiPiI1Des_Channel "Bypass-Label für InjCrv_phiPiI1Des (Nicht verstellen!)" VALUE 0x1C0AE5 Kw_Wu8 255.0 OneToOne 0.00 255.0 FORMAT "%5.1" /end CHARACTERISTIC
/begin CHARACTERISTIC InjCrv_phiPoI2Des_Vector "Konfigurationslabel für Bypass" VALUE 0x1C0AE8 Kw_Wu8 255.0 OneToOne 0.00 255.0 FORMAT "%5.1" /end CHARACTERISTIC
/begin CHARACTERISTIC InjCrv_phiPoI2Des_Channel "Konfigurationslabel für Bypass" VALUE 0x1C0AE9 Kw_Wu8 255.0 OneToOne 0.00 255.0 FORMAT "%5.1" /end CHARACTERISTIC
/begin CHARACTERISTIC InjCrv_qMI1Des_Vector "Bypass-Label für InjCrv_qMI1Des (Nicht verstellen!)" VALUE 0x1C0AE2 Kw_Wu8 255.0 OneToOne 0.00 255.0 FORMAT "%5.1" /end CHARACTERISTIC
/begin CHARACTERISTIC InjCrv_qMI1Des_Channel "Bypass-Label für InjCrv_qMI1Des (Nicht verstellen!)" VALUE 0x1C0AE3 Kw_Wu8 255.0 OneToOne 0.00 255.0 FORMAT "%5.1" /end CHARACTERISTIC
/begin CHARACTERISTIC InjCrv_qPiI1Des_Vector "Bypass-Label für InjCrv_qPiI1Des (Nicht verstellen!)" VALUE 0x1C0AE6 Kw_Wu8 255.0 OneToOne 0.00 255.0 FORMAT "%5.1" /end CHARACTERISTIC
/begin CHARACTERISTIC InjCrv_qPiI1Des_Channel "Bypass-Label für InjCrv_qPiI1Des (Nicht verstellen!)" VALUE 0x1C0AE7 Kw_Wu8 255.0 OneToOne 0.00 255.0 FORMAT "%5.1" /end CHARACTERISTIC
/begin CHARACTERISTIC InjCrv_qPoI2Des_Vector "Bypass-Label für InjCrv_qPoI2Des (Nicht verstellen!)" VALUE 0x1C0AEA Kw_Wu8 255.0 OneToOne 0.00 255.0 FORMAT "%5.1" /end CHARACTERISTIC
/begin CHARACTERISTIC InjCrv_qPoI2Des_Channel "Bypass-Label für InjCrv_qPoI2Des (Nicht verstellen!)" VALUE 0x1C0AEB Kw_Wu8 255.0 OneToOne 0.00 255.0 FORMAT "%5.1" /end CHARACTERISTIC
/begin CHARACTERISTIC InjCrv_qPoI2HCCylCor_Vector "Konfigurationslabel für Bypass-Freischnitt" VALUE 0x1C0AEC Kw_Wu8 255.0 OneToOne 0.00 255.0 FORMAT "%5.1" /end CHARACTERISTIC
/begin CHARACTERISTIC InjCrv_qPoI2HCCylCor_Channel "Konfigurationslabel für Bypass-Freischnitt" VALUE 0x1C0AED Kw_Wu8 255.0 OneToOne 0.00 255.0 FORMAT "%5.1" /end CHARACTERISTIC
/begin CHARACTERISTIC InjCrv_qPoI2HCFBCCor_Vector "Konfigurationslabel für Bypass-Freischnitt" VALUE 0x1C0AEE Kw_Wu8 255.0 OneToOne 0.00 255.0 FORMAT "%5.1" /end CHARACTERISTIC
/begin CHARACTERISTIC InjCrv_qPoI2HCFBCCor_Channel "Konfigurationslabel für Bypassfreischnitt" VALUE 0x1C0AEF Kw_Wu8 255.0 OneToOne 0.00 255.0 FORMAT "%5.1" /end CHARACTERISTIC
/begin CHARACTERISTIC InjCrv_qPoI2HCTrqCor_Vector "Konfigurationslabel für Bypass-Freischnitt" VALUE 0x1C0AF0 Kw_Wu8 255.0 OneToOne 0.00 255.0 FORMAT "%5.1" /end CHARACTERISTIC
/begin CHARACTERISTIC InjCrv_qPoI2HCTrqCor_Channel "Konfigurationslabel für Bypass-Freischnitt" VALUE 0x1C0AF1 Kw_Wu8 255.0 OneToOne 0.00 255.0 FORMAT "%5.1" /end CHARACTERISTIC
/begin CHARACTERISTIC InjCrv_stPoI2HCOff_Vector "Konfigurationslabel für Bypass Freischnitt" VALUE 0x1C0AF2 Kw_Wu8 255.0 OneToOne 0.00 255.0 FORMAT "%5.1" /end CHARACTERISTIC
/begin CHARACTERISTIC InjCrv_stPoI2HCOff_Channel "Konfigurationslabel für Bypass Freischnitt" VALUE 0x1C0AF3 Kw_Wu8 255.0 OneToOne 0.00 255.0 FORMAT "%5.1" /end CHARACTERISTIC
/begin CHARACTERISTIC InjUn_qMI1DesCorr_Vector "Konfigurationslabel für Bypass" VALUE 0x1C0AFA Kw_Wu8 255.0 OneToOne 0.00 255.0 FORMAT "%5.1" /end CHARACTERISTIC
/begin CHARACTERISTIC InjUn_qMI1DesCorr_Channel "Konfigurationslabel für Bypass" VALUE 0x1C0AFB Kw_Wu8 255.0 OneToOne 0.00 255.0 FORMAT "%5.1" /end CHARACTERISTIC
/begin CHARACTERISTIC InjUn_qPiI1DesCorr_Vector "Konfigurationslabel für Bypass" VALUE 0x1C0AFC Kw_Wu8 255.0 OneToOne 0.00 255.0 FORMAT "%5.1" /end CHARACTERISTIC
/begin CHARACTERISTIC InjUn_qPiI1DesCorr_Channel "Konfigurationslabel für Bypass" VALUE 0x1C0AFD Kw_Wu8 255.0 OneToOne 0.00 255.0 FORMAT "%5.1" /end CHARACTERISTIC
/begin CHARACTERISTIC InjUn_qPoI2DesCorr_Vector "Konfigurationslabel für Bypass" VALUE 0x1C0AFE Kw_Wu8 255.0 OneToOne 0.00 255.0 FORMAT "%5.1" /end CHARACTERISTIC
/begin CHARACTERISTIC InjUn_qPoI2DesCorr_Channel "Konfigurationslabel für Bypass" VALUE 0x1C0AFF Kw_Wu8 255.0 OneToOne 0.00 255.0 FORMAT "%5.1" /end CHARACTERISTIC
/begin CHARACTERISTIC InjVlv_phiMI1Dur_Vector "Konfigurationslabel für Bypass" VALUE 0x1C0B00 Kw_Wu8 255.0 OneToOne 0.00 255.0 FORMAT "%5.1" /end CHARACTERISTIC
/begin CHARACTERISTIC InjVlv_phiMI1Dur_Channel "Konfigurationslabel für Bypass" VALUE 0x1C0B01 Kw_Wu8 255.0 OneToOne 0.00 255.0 FORMAT "%5.1" /end CHARACTERISTIC
/begin CHARACTERISTIC InjVlv_phiPiI1Dur_Vector "Konfigurationslabel für Bypass" VALUE 0x1C0B02 Kw_Wu8 255.0 OneToOne 0.00 255.0 FORMAT "%5.1" /end CHARACTERISTIC
/begin CHARACTERISTIC InjVlv_phiPiI1Dur_Channel "Konfigurationslabel für Bypass" VALUE 0x1C0B03 Kw_Wu8 255.0 OneToOne 0.00 255.0 FORMAT "%5.1" /end CHARACTERISTIC
/begin CHARACTERISTIC InjVlv_phiPoI2Dur_Vector "Konfigurationslabel für Bypass" VALUE 0x1C0B04 Kw_Wu8 255.0 OneToOne 0.00 255.0 FORMAT "%5.1" /end CHARACTERISTIC
/begin CHARACTERISTIC InjVlv_phiPoI2Dur_Channel "Konfigurationslabel für Bypass" VALUE 0x1C0B05 Kw_Wu8 255.0 OneToOne 0.00 255.0 FORMAT "%5.1" /end CHARACTERISTIC
/begin CHARACTERISTIC LIGov_nSetpoint_Vector "Bypass label, nicht editieren" VALUE 0x1C0B06 Kw_Wu8 255.0 OneToOne 0.00 255.0 FORMAT "%5.1" /end CHARACTERISTIC
/begin CHARACTERISTIC LIGov_nSetpoint_Channel "Bypass Label, nicht editieren!" VALUE 0x1C0B07 Kw_Wu8 255.0 OneToOne 0.00 255.0 FORMAT "%5.1" /end CHARACTERISTIC
/begin CHARACTERISTIC LIGov_trq_Vector "Bypasslabel, nicht editieren!" VALUE 0x1C0B08 Kw_Wu8 255.0 OneToOne 0.00 255.0 FORMAT "%5.1" /end CHARACTERISTIC
/begin CHARACTERISTIC LIGov_trq_Channel "Bypasslabel, nicht editieren!" VALUE 0x1C0B09 Kw_Wu8 255.0 OneToOne 0.00 255.0 FORMAT "%5.1" /end CHARACTERISTIC
/begin CHARACTERISTIC BasAdj_PCRBiTnSetpoint_C "Leerlaufsolldrehzahl bei BiT-Grundeinstellung  (Diagnose)" VALUE 0x1CC164 Kw_Ws16 65535.00 EngN -32768.00 32767.00 FORMAT "%8.2" /end CHARACTERISTIC
/begin CHARACTERISTIC BasAdj_PCRBiTtime_C "Zeit nach der bei BiT-Grundeinstellung zwischen den beiden Tastverhältnissen umgeschalten wird  (Diagnose)" VALUE 0x1CC166 Kw_Wu16 655350.0 Time_ms 0.00 655350.0 FORMAT "%8.1" /end CHARACTERISTIC
/begin CHARACTERISTIC BasAdj_PCRBiTBits_C "Maske für BasAdj_st bei BiT-Grundeinstellung  (Diagnose)" VALUE 0x1CC168 Kw_Wu16 65535.00 OneToOne 0.00 65535.00 FORMAT "%8.2" READ_ONLY /end CHARACTERISTIC
/begin CHARACTERISTIC BasAdj_PCRnSetpoint_C "Leerlaufsolldrehzahl bei PCR-Grundeinstellung  (Diagnose)" VALUE 0x1CC16A Kw_Ws16 65535.00 EngN -32768.00 32767.00 FORMAT "%8.2" /end CHARACTERISTIC
/begin CHARACTERISTIC BasAdj_PCRtime_C "Zeit nach der bei PCR-Grundeinstellung zwischen den beiden Tastverhältnissen umgeschalten wird  (Diagnose)" VALUE 0x1CC16C Kw_Wu16 655350.0 Time_ms 0.00 655350.0 FORMAT "%8.1" /end CHARACTERISTIC
/begin CHARACTERISTIC BasAdj_PCRBits_C "Maske für BasAdj_st bei PCR-Grundeinstellung  (Diagnose)" VALUE 0x1CC16E Kw_Wu16 65535.00 OneToOne 0.00 65535.00 FORMAT "%8.2" READ_ONLY /end CHARACTERISTIC
/begin CHARACTERISTIC PCR_pBDes_Vector "Bypass-Label für PCR_pBDes (Nicht verstellen!)" VALUE 0x1C0B0E Kw_Wu8 255.0 OneToOne 0.00 255.0 FORMAT "%5.1" /end CHARACTERISTIC
/begin CHARACTERISTIC PCR_pBDes_Channel "Bypass-Label für PCR_pBDes (Nicht verstellen!)" VALUE 0x1C0B0F Kw_Wu8 255.0 OneToOne 0.00 255.0 FORMAT "%5.1" /end CHARACTERISTIC
/begin CHARACTERISTIC PCR_qCtl_Vector "Konfigurationslabel für Bypass message" VALUE 0x1C0B0A Kw_Wu8 255.0 OneToOne 0.00 255.0 FORMAT "%5.1" /end CHARACTERISTIC
/begin CHARACTERISTIC PCR_qCtl_Channel "Konfigurationslabel für Bypass message" VALUE 0x1C0B0B Kw_Wu8 255.0 OneToOne 0.00 255.0 FORMAT "%5.1" /end CHARACTERISTIC
/begin CHARACTERISTIC PCR_rBPACD_Vector "Bypass-Label für PCR_rBPACD (Nicht verstellen!)" VALUE 0x1C0B12 Kw_Wu8 255.0 OneToOne 0.00 255.0 FORMAT "%5.1" /end CHARACTERISTIC
/begin CHARACTERISTIC PCR_rBPACD_Channel "Bypass-Label für PCR_rBPACD (Nicht verstellen!)" VALUE 0x1C0B13 Kw_Wu8 255.0 OneToOne 0.00 255.0 FORMAT "%5.1" /end CHARACTERISTIC
/begin CHARACTERISTIC PCR_rBPCtl_Vector "Konfigurationslabel für Bypass message" VALUE 0x1C0B0C Kw_Wu8 255.0 OneToOne 0.00 255.0 FORMAT "%5.1" /end CHARACTERISTIC
/begin CHARACTERISTIC PCR_rBPCtl_Channel "Konfigurationslabel für Bypass message" VALUE 0x1C0B0D Kw_Wu8 255.0 OneToOne 0.00 255.0 FORMAT "%5.1" /end CHARACTERISTIC
/begin CHARACTERISTIC PCR_rBPGov_Vector "Konfigurationslabel für Bypass Freischnitt" VALUE 0x1C0B10 Kw_Wu8 255.0 OneToOne 0.00 255.0 FORMAT "%5.1" /end CHARACTERISTIC
/begin CHARACTERISTIC PCR_rBPGov_Channel "Konfigurationslabel für Bypass message" VALUE 0x1C0B11 Kw_Wu8 255.0 OneToOne 0.00 255.0 FORMAT "%5.1" /end CHARACTERISTIC
/begin CHARACTERISTIC PFlt_numRgn_mp_Vector "Konfigurationslabel für Bypass" VALUE 0x1C0B14 Kw_Wu8 255.0 OneToOne 0.00 255.0 FORMAT "%5.1" /end CHARACTERISTIC
/begin CHARACTERISTIC PFlt_numRgn_mp_Channel "Konfigurationslabel für Bypass" VALUE 0x1C0B15 Kw_Wu8 255.0 OneToOne 0.00 255.0 FORMAT "%5.1" /end CHARACTERISTIC
/begin CHARACTERISTIC PFlt_rSotSimPres_Vector "Konfigurationslabel für Bypass" VALUE 0x1C0B18 Kw_Wu8 255.0 OneToOne 0.00 255.0 FORMAT "%5.1" /end CHARACTERISTIC
/begin CHARACTERISTIC PFlt_rSotSimPres_Channel "Konfigurationslabel für Bypass" VALUE 0x1C0B19 Kw_Wu8 255.0 OneToOne 0.00 255.0 FORMAT "%5.1" /end CHARACTERISTIC
/begin CHARACTERISTIC PFlt_stEngPOp_Vector "Konfigurationslabel für Bypass" VALUE 0x1C0B16 Kw_Wu8 255.0 OneToOne 0.00 255.0 FORMAT "%5.1" /end CHARACTERISTIC
/begin CHARACTERISTIC PFlt_stEngPOp_Channel "Konfigurationslabel für Bypass" VALUE 0x1C0B17 Kw_Wu8 255.0 OneToOne 0.00 255.0 FORMAT "%5.1" /end CHARACTERISTIC
/begin CHARACTERISTIC PrpCtl_MaxSpdLimEEP_mp_Vector "Konfiguration Label für Bypass Freischnitt" VALUE 0x1C0B1E Kw_Wu8 255.0 OneToOne 0.00 255.0 FORMAT "%5.1" /end CHARACTERISTIC
/begin CHARACTERISTIC PrpCtl_MaxSpdLimEEP_mp_Channel "Konfiguration Label für Bypass Freischnitt" VALUE 0x1C0B1F Kw_Wu8 255.0 OneToOne 0.00 255.0 FORMAT "%5.1" /end CHARACTERISTIC
/begin CHARACTERISTIC PrpCtl_stSPTrack_mp_Vector "Konfiguration Label für Bypass Freischnitt" VALUE 0x1C0B20 Kw_Wu8 255.0 OneToOne 0.00 255.0 FORMAT "%5.1" /end CHARACTERISTIC
/begin CHARACTERISTIC PrpCtl_stSPTrack_mp_Channel "Konfiguration Label für Bypass Freischnitt" VALUE 0x1C0B21 Kw_Wu8 255.0 OneToOne 0.00 255.0 FORMAT "%5.1" /end CHARACTERISTIC
/begin CHARACTERISTIC PrpCtl_trqGovLim_mp_Vector "Konfiguration Label für Bypass Freischnitt" VALUE 0x1C0B22 Kw_Wu8 255.0 OneToOne 0.00 255.0 FORMAT "%5.1" /end CHARACTERISTIC
/begin CHARACTERISTIC PrpCtl_trqGovLim_mp_Channel "Konfiguration Label für Bypass Freischnitt" VALUE 0x1C0B23 Kw_Wu8 255.0 OneToOne 0.00 255.0 FORMAT "%5.1" /end CHARACTERISTIC
/begin CHARACTERISTIC PrpCtl_trqSpdLim_Vector "Konfiguration Label für Bypass Freischnitt" VALUE 0x1C0B24 Kw_Wu8 255.0 OneToOne 0.00 255.0 FORMAT "%5.1" /end CHARACTERISTIC
/begin CHARACTERISTIC PrpCtl_trqSpdLim_Channel "Konfiguration Label für Bypass Freischnitt" VALUE 0x1C0B25 Kw_Wu8 255.0 OneToOne 0.00 255.0 FORMAT "%5.1" /end CHARACTERISTIC
/begin CHARACTERISTIC PrpCtl_vCurrTrack_mp_Vector "Konfiguration Label für Bypass Freischnitt" VALUE 0x1C0B26 Kw_Wu8 255.0 OneToOne 0.00 255.0 FORMAT "%5.1" /end CHARACTERISTIC
/begin CHARACTERISTIC PrpCtl_vCurrTrack_mp_Channel "Konfiguration Label für Bypass Freischnitt" VALUE 0x1C0B27 Kw_Wu8 255.0 OneToOne 0.00 255.0 FORMAT "%5.1" /end CHARACTERISTIC
/begin CHARACTERISTIC PrpCtl_vMaxAWD_Vector "Konfiguration Label für Bypass Freischnitt" VALUE 0x1C0B28 Kw_Wu8 255.0 OneToOne 0.00 255.0 FORMAT "%5.1" /end CHARACTERISTIC
/begin CHARACTERISTIC PrpCtl_vMaxAWD_Channel "Konfiguration Label für Bypass Freischnitt" VALUE 0x1C0B29 Kw_Wu8 255.0 OneToOne 0.00 255.0 FORMAT "%5.1" /end CHARACTERISTIC
/begin CHARACTERISTIC PrpCtl_vMaxNiveau_Vector "Konfiguration Label für Bypass Freischnitt" VALUE 0x1C0B2A Kw_Wu8 255.0 OneToOne 0.00 255.0 FORMAT "%5.1" /end CHARACTERISTIC
/begin CHARACTERISTIC PrpCtl_vMaxNiveau_Channel "Konfiguration Label für Bypass Freischnitt" VALUE 0x1C0B2B Kw_Wu8 255.0 OneToOne 0.00 255.0 FORMAT "%5.1" /end CHARACTERISTIC
/begin CHARACTERISTIC Prp_rAPP_Vector "Konfigurationslabel für Bypass" VALUE 0x1C0B1A Kw_Wu8 255.0 OneToOne 0.00 255.0 FORMAT "%5.1" /end CHARACTERISTIC
/begin CHARACTERISTIC Prp_rAPP_Channel "Konfigurationslabel für Bypass" VALUE 0x1C0B1B Kw_Wu8 255.0 OneToOne 0.00 255.0 FORMAT "%5.1" /end CHARACTERISTIC
/begin CHARACTERISTIC Prp_rVirtAPP_Vector "Konfigurationslabel für Bypass" VALUE 0x1C0B1C Kw_Wu8 255.0 OneToOne 0.00 255.0 FORMAT "%5.1" /end CHARACTERISTIC
/begin CHARACTERISTIC Prp_rVirtAPP_Channel "Konfigurationslabel für Bypass" VALUE 0x1C0B1D Kw_Wu8 255.0 OneToOne 0.00 255.0 FORMAT "%5.1" /end CHARACTERISTIC
/begin CHARACTERISTIC BasAdj_PSPnSetpoint_C "Leerlaufsolldrehzahl bei PSP-Grundeinstellung  (Diagnose)" VALUE 0x1CC170 Kw_Ws16 65535.00 EngN -32768.00 32767.00 FORMAT "%8.2" /end CHARACTERISTIC
/begin CHARACTERISTIC BasAdj_PSPtime_C "Zeit nach der bei PSP-Grundeinstellung zwischen den beiden Tastverhältnissen umgeschalten wird  (Diagnose)" VALUE 0x1CC172 Kw_Wu16 655350.0 Time_ms 0.00 655350.0 FORMAT "%8.1" /end CHARACTERISTIC
/begin CHARACTERISTIC BasAdj_PSPBits_C "Maske für BasAdj_st bei PSP-Grundeinstellung  (Diagnose)" VALUE 0x1CC174 Kw_Wu16 65535.00 OneToOne 0.00 65535.00 FORMAT "%8.2" READ_ONLY /end CHARACTERISTIC
/begin CHARACTERISTIC Shtrp_T1AFSCDFlt_C "PT1 Zeitkonstante für die Filterung des Luftmassenwertes zur Bereitstellung für die Shtrp Diagnose" VALUE 0x1EFFF4 Kw_Wu32 2998.2788 TimeDelay_ms 1.0000001 2999.2788 FORMAT "%9.4" EXTENDED_LIMITS 0.0010000000 4294967.3 /end CHARACTERISTIC
/begin CHARACTERISTIC Shtrp_AFSCD_C "Array zur Applikation der zu durchzuführenden Short Trip Einzeltests für AFSCD" VAL_BLK 0x1EFFF8 Kwb_Wu8 255.0 OneToOne 0.00 255.0 FORMAT "%5.1" NUMBER 16 /end CHARACTERISTIC
/begin CHARACTERISTIC Shtrp_T1BPSCDFlt_C "PT1 Zeitkonstante für die Filterung des Ladedrucks zur Bereitstellung für die Shtrp Diagnose" VALUE 0x1F0008 Kw_Wu32 2998.2788 TimeDelay_ms 1.0000001 2999.2788 FORMAT "%9.4" EXTENDED_LIMITS 0.0010000000 4294967.3 /end CHARACTERISTIC
/begin CHARACTERISTIC Shtrp_CompComp_C "Array zur Applikation der zu durchzuführenden Short Trip Einzeltests für Comprehensive Components" VAL_BLK 0x1F000C Kwb_Wu8 255.0 OneToOne 0.00 255.0 FORMAT "%5.1" NUMBER 16 /end CHARACTERISTIC
/begin CHARACTERISTIC Shtrp_DfpAddPCD_CA "Array zur Applikation der zu prüfenden Fehlerpfade für AddPCD" VAL_BLK 0x1F001C Kwb_Wu16 384.000000000 DfpName 0.00 384.000000000 FORMAT "%13.9" NUMBER 10 /end CHARACTERISTIC
/begin CHARACTERISTIC Shtrp_DfpAFSCD_CA "Array zur Applikation der zu prüfenden Fehlerpfade für AFSCD" VAL_BLK 0x1F0030 Kwb_Wu16 384.000000000 DfpName 0.00 384.000000000 FORMAT "%13.9" NUMBER 10 /end CHARACTERISTIC
/begin CHARACTERISTIC Shtrp_DfpBIP_CA "Array zur Applikation der zu prüfenden Fehlerpfade für BIP" VAL_BLK 0x1F0044 Kwb_Wu16 384.000000000 DfpName 0.00 384.000000000 FORMAT "%13.9" NUMBER 10 /end CHARACTERISTIC
/begin CHARACTERISTIC Shtrp_DfpEGRBA_CA "Array zur Applikation der zu prüfenden Fehlerpfade für EGR Grundeinstellung" VAL_BLK 0x1F0058 Kwb_Wu16 384.000000000 DfpName 0.00 384.000000000 FORMAT "%13.9" NUMBER 10 /end CHARACTERISTIC
/begin CHARACTERISTIC Shtrp_DfpEGRCBV_CA "Array zur Applikation der zu prüfenden Fehlerpfade für EGRCBV" VAL_BLK 0x1F006C Kwb_Wu16 384.000000000 DfpName 0.00 384.000000000 FORMAT "%13.9" NUMBER 10 /end CHARACTERISTIC
/begin CHARACTERISTIC Shtrp_DfpEGRCD_CA "Array zur Applikation der zu prüfenden Fehlerpfade für EGRCD" VAL_BLK 0x1F0080 Kwb_Wu16 384.000000000 DfpName 0.00 384.000000000 FORMAT "%13.9" NUMBER 10 /end CHARACTERISTIC
/begin CHARACTERISTIC Shtrp_DfpEGRGovDev_CA "Array zur Applikation der zu prüfenden Fehlerpfade für EGRGovDev" VAL_BLK 0x1F0094 Kwb_Wu16 384.000000000 DfpName 0.00 384.000000000 FORMAT "%13.9" NUMBER 10 /end CHARACTERISTIC
/begin CHARACTERISTIC Shtrp_DfpFreeTstTog_CA "Fehlerpfade für den frei applizierbaren Shtrp Stellertest" VAL_BLK 0x1F00A8 Kwb_Wu16 384.000000000 DfpName 0.00 384.000000000 FORMAT "%13.9" NUMBER 35 /end CHARACTERISTIC
/begin CHARACTERISTIC Shtrp_DfpGlwCtl_CA "Array zur Applikation der zu prüfenden Fehlerpfade für GlwCtl" VAL_BLK 0x1F00EE Kwb_Wu16 384.000000000 DfpName 0.00 384.000000000 FORMAT "%13.9" NUMBER 10 /end CHARACTERISTIC
/begin CHARACTERISTIC Shtrp_DfpLSU_CA "Array zur Applikation der zu prüfenden Fehlerpfade für den Short Trip LSU Test" VAL_BLK 0x1F0102 Kwb_Wu16 384.000000000 DfpName 0.00 384.000000000 FORMAT "%13.9" NUMBER 10 /end CHARACTERISTIC
/begin CHARACTERISTIC Shtrp_DfpMisfire_CA "Array zur Applikation der zu prüfenden Fehlerpfade für Zündaussetzerkennung" VAL_BLK 0x1F0116 Kwb_Wu16 384.000000000 DfpName 0.00 384.000000000 FORMAT "%13.9" NUMBER 10 /end CHARACTERISTIC
/begin CHARACTERISTIC Shtrp_DfpPCRBA_CA "Array zur Applikation der zu prüfenden Fehlerpfade für PCR Grundeinstellung" VAL_BLK 0x1F012A Kwb_Wu16 384.000000000 DfpName 0.00 384.000000000 FORMAT "%13.9" NUMBER 10 /end CHARACTERISTIC
/begin CHARACTERISTIC Shtrp_DfpPSP_CA "Array zur Applikation der zu prüfenden Fehlerpfade für PSP" VAL_BLK 0x1F013E Kwb_Wu16 384.000000000 DfpName 0.00 384.000000000 FORMAT "%13.9" NUMBER 10 /end CHARACTERISTIC
/begin CHARACTERISTIC Shtrp_DfpT3Gov_CA "Array zur Applikation der zu prüfenden Fehlerpfade für T3GovDev" VAL_BLK 0x1F0152 Kwb_Wu16 384.000000000 DfpName 0.00 384.000000000 FORMAT "%13.9" NUMBER 10 /end CHARACTERISTIC
/begin CHARACTERISTIC Shtrp_DfpVSA_CA "Array zur Applikation der zu prüfenden Fehlerpfade für VSA" VAL_BLK 0x1F0166 Kwb_Wu16 384.000000000 DfpName 0.00 384.000000000 FORMAT "%13.9" NUMBER 10 /end CHARACTERISTIC
/begin CHARACTERISTIC Shtrp_EGRBA_C "Array zur Applikation der zu durchzuführenden Short Trip Einzeltests für EGR Grundeinstellung" VAL_BLK 0x1F017A Kwb_Wu8 255.0 OneToOne 0.00 255.0 FORMAT "%5.1" NUMBER 16 /end CHARACTERISTIC
/begin CHARACTERISTIC Shtrp_EGRBA_ctRepeat_C "Anzahl der zu wiederholenden Tests für EGR Grundeinstellung" VALUE 0x1F018A Kw_Wu8 15.00 OneToOne 0.00 15.00 FORMAT "%5.2" EXTENDED_LIMITS 0.00 255.0 /end CHARACTERISTIC
/begin CHARACTERISTIC Shtrp_EGRBA_mDeltaMinDfltTrm_C "Defaultwert für die Differenz zwischen 1. und 2. Testwert für die Shtrp-Diagnose" VALUE 0x1F018C Kw_Ws16 6553.500 AirMassPerCyl -3276.800 3276.700 FORMAT "%8.3" /end CHARACTERISTIC
/begin CHARACTERISTIC Shtrp_EGRBA_mDeltaMin_C "Minimale Änderung zum ersten angefahren Luftmassenwert bei Short Trip EGRBA Test" VALUE 0x1F018E Kw_Ws16 6553.500 AirMassPerCyl -3276.800 3276.700 FORMAT "%8.3" /end CHARACTERISTIC
/begin CHARACTERISTIC Shtrp_EGRBA_mMaxDfltTrm_C "Defaultwert für den erlaubten Maximalwert des Luftmassenwerts" VALUE 0x1F0190 Kw_Ws16 6553.500 AirMassPerCyl -3276.800 3276.700 FORMAT "%8.3" /end CHARACTERISTIC
/begin CHARACTERISTIC Shtrp_EGRBA_mMax_C "Obere Fehlerschwelle für ersten Luftmassenwert bei Short Trip EGRBA Test" VALUE 0x1F0192 Kw_Ws16 6553.500 AirMassPerCyl -3276.800 3276.700 FORMAT "%8.3" /end CHARACTERISTIC
/begin CHARACTERISTIC Shtrp_EGRBA_mMinDfltTrm_C "Defaultwert für den erlaubten Minimalwert des Luftmassenwerts" VALUE 0x1F0194 Kw_Ws16 6553.500 AirMassPerCyl -3276.800 3276.700 FORMAT "%8.3" /end CHARACTERISTIC
/begin CHARACTERISTIC Shtrp_EGRBA_mMin_C "Untere Fehlerschwelle für ersten Luftmassenwert bei Short Trip EGRBA Test" VALUE 0x1F0196 Kw_Ws16 6553.500 AirMassPerCyl -3276.800 3276.700 FORMAT "%8.3" /end CHARACTERISTIC
/begin CHARACTERISTIC Shtrp_EGRBA_mTrmMax_C "Maximalwert für Shtrp EGR Luftmassenwert - Trimmwert" VALUE 0x1F0198 Kw_Ws16 6553.500 AirMassPerCyl -3276.800 3276.700 FORMAT "%8.3" /end CHARACTERISTIC
/begin CHARACTERISTIC Shtrp_EGRBA_mTrmMin_C "Minimalwert für Shtrp EGR Luftmassenwert - Trimmwert" VALUE 0x1F019A Kw_Ws16 6553.500 AirMassPerCyl -3276.800 3276.700 FORMAT "%8.3" /end CHARACTERISTIC
/begin CHARACTERISTIC Shtrp_EGRBA_tiDelay_C "Einschwingzeit bei Short Trip EGRBA Test" VALUE 0x1F019C Kw_Wu16 655350.0 Time_ms 0.00 655350.0 FORMAT "%8.1" /end CHARACTERISTIC
/begin CHARACTERISTIC Shtrp_EGRBA_tiDfltTrm_C "Defaultwert für die Zeit zwischen dem Ansteuern des Aktuators und dem Durchführen der Diagnose" VALUE 0x1F019E Kw_Wu16 655350.0 Time_ms 0.00 655350.0 FORMAT "%8.1" /end CHARACTERISTIC
/begin CHARACTERISTIC Shtrp_EGRBA_tiTrmMax_C "Maximalwert für Shtrp EGR Ansteuerzeit - Trimmwert" VALUE 0x1F01A0 Kw_Wu16 655350.0 Time_ms 0.00 655350.0 FORMAT "%8.1" /end CHARACTERISTIC
/begin CHARACTERISTIC Shtrp_EGRBA_tiTrmMin_C "Miniimalwert für Shtrp EGR Ansteuerzeit - Trimmwert" VALUE 0x1F01A2 Kw_Wu16 655350.0 Time_ms 0.00 655350.0 FORMAT "%8.1" /end CHARACTERISTIC
/begin CHARACTERISTIC Shtrp_EGRCD_C "Array zur Applikation der zu durchzuführenden Short Trip Einzeltests für EGRCD" VAL_BLK 0x1F01A4 Kwb_Wu8 255.0 OneToOne 0.00 255.0 FORMAT "%5.1" NUMBER 16 /end CHARACTERISTIC
/begin CHARACTERISTIC Shtrp_EGRGovDev_C "Array zur Applikation der zu durchzuführenden Short Trip Einzeltests für EGRGovDev" VAL_BLK 0x1F01B4 Kwb_Wu8 255.0 OneToOne 0.00 255.0 FORMAT "%5.1" NUMBER 16 /end CHARACTERISTIC
/begin CHARACTERISTIC Shtrp_EGR_C "Array zur Applikation der zu durchzuführenden Short Trip Einzeltests für EGR" VAL_BLK 0x1F01C4 Kwb_Wu8 255.0 OneToOne 0.00 255.0 FORMAT "%5.1" NUMBER 16 /end CHARACTERISTIC
/begin CHARACTERISTIC Shtrp_FreeTstTogPos_C "Frei applizierbare Shtrp Stellertests" VAL_BLK 0x1F01D4 Kwb_Ws16 655.3500 DtyCyc -327.6800 327.6700 FORMAT "%8.4" NUMBER 35 /end CHARACTERISTIC
/begin CHARACTERISTIC Shtrp_FuelSys_C "Array zur Applikation der zu durchzuführenden Short Trip Einzeltests für FuelSys" VAL_BLK 0x1F021A Kwb_Wu8 255.0 OneToOne 0.00 255.0 FORMAT "%5.1" NUMBER 16 /end CHARACTERISTIC
/begin CHARACTERISTIC Shtrp_LSUmode_C "Array zur Applikation der Reihenfolge der Moden für den Short Trip LSU Test" VAL_BLK 0x1F022A Kwb_Wu16 65535.00 OneToOne 0.00 65535.00 FORMAT "%8.2" NUMBER 6 /end CHARACTERISTIC
/begin CHARACTERISTIC Shtrp_LSU_C "Array zur Applikation der durchzuführenden Short Trip Einzeltests für LSU" VAL_BLK 0x1F0236 Kwb_Wu8 255.0 OneToOne 0.00 255.0 FORMAT "%5.1" NUMBER 16 /end CHARACTERISTIC
/begin CHARACTERISTIC Shtrp_Misfire_C "Array zur Applikation der zu durchzuführenden Short Trip Einzeltests für Zündaussetzerkennung" VAL_BLK 0x1F0246 Kwb_Wu8 255.0 OneToOne 0.00 255.0 FORMAT "%5.1" NUMBER 16 /end CHARACTERISTIC
/begin CHARACTERISTIC Shtrp_nAddPCD_C "Drehzahlanforderung für Short Trip AddPCD Test" VALUE 0x1F0256 Kw_Ws16 65535.00 EngN -32768.00 32767.00 FORMAT "%8.2" /end CHARACTERISTIC
/begin CHARACTERISTIC Shtrp_nAFSCD_C "Array zur Applikation der zu anfahrenden Drehzahlen bei Short Trip AFSCD Test" VAL_BLK 0x1F0258 Kwb_Wu16 65535.00 EngN 0.00 65535.00 FORMAT "%8.2" NUMBER 12 /end CHARACTERISTIC
/begin CHARACTERISTIC Shtrp_nBIP_C "Drehzahlanforderung für Short Trip BIP Test" VALUE 0x1F0270 Kw_Ws16 65535.00 EngN -32768.00 32767.00 FORMAT "%8.2" /end CHARACTERISTIC
/begin CHARACTERISTIC Shtrp_nEGRBA_C "Drehzahlanforderung für Short Trip EGR Grundeinstellungstest" VALUE 0x1F0272 Kw_Ws16 65535.00 EngN -32768.00 32767.00 FORMAT "%8.2" /end CHARACTERISTIC
/begin CHARACTERISTIC Shtrp_nEGRCBV_C "Drehzahlanforderung für Short Trip EGRCBV Test" VALUE 0x1F0274 Kw_Ws16 65535.00 EngN -32768.00 32767.00 FORMAT "%8.2" /end CHARACTERISTIC
/begin CHARACTERISTIC Shtrp_nEGRCD_C "Drehzahlanforderung für Short Trip EGRCD Test" VALUE 0x1F0276 Kw_Ws16 65535.00 EngN -32768.00 32767.00 FORMAT "%8.2" /end CHARACTERISTIC
/begin CHARACTERISTIC Shtrp_nEGRGovDev_C "Drehzahlanforderung für Short Trip EGRGovDevTest" VALUE 0x1F0278 Kw_Ws16 65535.00 EngN -32768.00 32767.00 FORMAT "%8.2" /end CHARACTERISTIC
/begin CHARACTERISTIC Shtrp_nFreeTstTog_C "Drehzahl für den frei applizierbaren Shtrp Stellertest" VALUE 0x1F027A Kw_Ws16 65535.00 EngN -32768.00 32767.00 FORMAT "%8.2" /end CHARACTERISTIC
/begin CHARACTERISTIC Shtrp_nGlwCtl_C "Drehzahlanforderung für Short Trip GlwCtl Test" VALUE 0x1F027C Kw_Ws16 65535.00 EngN -32768.00 32767.00 FORMAT "%8.2" /end CHARACTERISTIC
/begin CHARACTERISTIC Shtrp_nLSUHigh_C "Array für die Drehzahlanforderungen des Short Trip LSU Tests" VAL_BLK 0x1F027E Kwb_Wu16 65535.00 EngN 0.00 65535.00 FORMAT "%8.2" NUMBER 6 /end CHARACTERISTIC
/begin CHARACTERISTIC Shtrp_nLSUTol_C "Toleranz für die Erkennung der geforderten Drehzahl des Short Trip LSU Tests" VALUE 0x1F028A Kw_Ws16 65535.00 EngN -32768.00 32767.00 FORMAT "%8.2" /end CHARACTERISTIC
/begin CHARACTERISTIC Shtrp_nMaxShtrp_C "Maximale Drehlzahl während aktiver Short Trip Diagnose" VALUE 0x1F028C Kw_Ws16 32767.00 EngN 0.00 32767.00 FORMAT "%8.2" EXTENDED_LIMITS -32768.00 32767.00 /end CHARACTERISTIC
/begin CHARACTERISTIC Shtrp_nMax_C "Maximum Drehzahl zur Aktivierung der Short Trip Diagnose" VALUE 0x1F028E Kw_Ws16 32767.00 EngN 0.00 32767.00 FORMAT "%8.2" EXTENDED_LIMITS -32768.00 32767.00 /end CHARACTERISTIC
/begin CHARACTERISTIC Shtrp_nMisfire_C "Drehzahlanforderung für Short Trip Zündaussetzerkennungs Test" VALUE 0x1F0290 Kw_Ws16 65535.00 EngN -32768.00 32767.00 FORMAT "%8.2" /end CHARACTERISTIC
/begin CHARACTERISTIC Shtrp_noRdy_C "Array zur Applikation der zu durchzuführenden Short Trip Einzeltests für komplette Short Trip Diagnose" VAL_BLK 0x1F0292 Kwb_Wu8 255.0 OneToOne 0.00 255.0 FORMAT "%5.1" NUMBER 16 /end CHARACTERISTIC
/begin CHARACTERISTIC Shtrp_nPCRBA_C "Drehzahlanforderung für Short Trip PCR Grundeinstellungstest" VALUE 0x1F02A2 Kw_Ws16 65535.00 EngN -32768.00 32767.00 FORMAT "%8.2" /end CHARACTERISTIC
/begin CHARACTERISTIC Shtrp_nPSP_C "Drehzahlanforderung für Short Trip PSP Test" VALUE 0x1F02A4 Kw_Ws16 65535.00 EngN -32768.00 32767.00 FORMAT "%8.2" /end CHARACTERISTIC
/begin CHARACTERISTIC Shtrp_nRmpSlpDwnLSU_C "Rampensteigung für verringernde Drehzahlwerte für Shtrp - LSU" VALUE 0x1F02A8 Kw_Wu32 9362278.57317 RmpEngN_LIGov 7.13893345424 9362285.71211 FORMAT "%13.5" EXTENDED_LIMITS 0.00 9362285.71211 /end CHARACTERISTIC
/begin CHARACTERISTIC Shtrp_nRmpSlpDwn_C "Rampensteigung für verringernde Drehzahlwerte für Shtrp" VALUE 0x1F02AC Kw_Wu32 9362278.57317 RmpEngN_LIGov 7.13893345424 9362285.71211 FORMAT "%13.5" EXTENDED_LIMITS 0.00 9362285.71211 /end CHARACTERISTIC
/begin CHARACTERISTIC Shtrp_nRmpSlpUpLSU_C "Rampensteigung für erhöhende Drehzahlwerte für Shtrp - LSU" VALUE 0x1F02B0 Kw_Wu32 9362278.57317 RmpEngN_LIGov 7.13893345424 9362285.71211 FORMAT "%13.5" EXTENDED_LIMITS 0.00 9362285.71211 /end CHARACTERISTIC
/begin CHARACTERISTIC Shtrp_nRmpSlpUp_C "Rampensteigung für erhöhende Drehzahlwerte für Shtrp" VALUE 0x1F02B4 Kw_Wu32 9362278.57317 RmpEngN_LIGov 7.13893345424 9362285.71211 FORMAT "%13.5" EXTENDED_LIMITS 0.00 9362285.71211 /end CHARACTERISTIC
/begin CHARACTERISTIC Shtrp_nT3GovDev_CA "Drehzahlvorgabe für T3 Testabschnitte" VAL_BLK 0x1F02B8 Kwb_Wu16 6000.000 EngN 0.00 6000.000 FORMAT "%8.3" EXTENDED_LIMITS 0.00 65535.00 NUMBER 4 /end CHARACTERISTIC
/begin CHARACTERISTIC Shtrp_nVSA_C " Drehzahlanforderung für Short Trip VSA Test" VALUE 0x1F02C0 Kw_Ws16 65535.00 EngN -32768.00 32767.00 FORMAT "%8.2" /end CHARACTERISTIC
/begin CHARACTERISTIC Shtrp_PCRBA_C "Drehzahlanforderung für Short Trip PCR Grundeinstellungstest" VAL_BLK 0x1F02C2 Kwb_Wu8 255.0 OneToOne 0.00 255.0 FORMAT "%5.1" NUMBER 16 /end CHARACTERISTIC
/begin CHARACTERISTIC Shtrp_PCRBA_ctRepeat_C "Anzahl der zu wiederholenden Tests für PCR Grundeinstellung" VALUE 0x1F02D2 Kw_Wu8 15.00 OneToOne 0.00 15.00 FORMAT "%5.2" EXTENDED_LIMITS 0.00 255.0 /end CHARACTERISTIC
/begin CHARACTERISTIC Shtrp_PCRBA_pDeltaMax_C "Maximale Änderung zum ersten angefahren Ladedruckwert bei Short Trip PCRBA Test" VALUE 0x1F02D4 Kw_Ws16 65535.00 Pres_hPa -32768.00 32767.00 FORMAT "%8.2" /end CHARACTERISTIC
/begin CHARACTERISTIC Shtrp_PCRBA_pDeltaMin_C "Minimale Änderung zum ersten angefahren Ladedruckwert bei Short Trip PCRBA Test" VALUE 0x1F02D6 Kw_Ws16 65535.00 Pres_hPa -32768.00 32767.00 FORMAT "%8.2" /end CHARACTERISTIC
/begin CHARACTERISTIC Shtrp_PCRBA_pMaxDfltTrm_C "Default Trimmwert für maximale zulässige Differenz" VALUE 0x1F02D8 Kw_Ws16 65535.00 Pres_hPa -32768.00 32767.00 FORMAT "%8.2" /end CHARACTERISTIC
/begin CHARACTERISTIC Shtrp_PCRBA_pMinDfltTrm_C "Default Trimmwert für minimale zulässige Differenz" VALUE 0x1F02DA Kw_Ws16 65535.00 Pres_hPa -32768.00 32767.00 FORMAT "%8.2" /end CHARACTERISTIC
/begin CHARACTERISTIC Shtrp_PCRBA_pTrmMax_C "Maximalwert für Shtrp EGR Ladedruck - Trimmwert" VALUE 0x1F02DC Kw_Ws16 65535.00 Pres_hPa -32768.00 32767.00 FORMAT "%8.2" /end CHARACTERISTIC
/begin CHARACTERISTIC Shtrp_PCRBA_pTrmMin_C "Minimalwert für Shtrp EGR Ladedruck - Trimmwert" VALUE 0x1F02DE Kw_Ws16 65535.00 Pres_hPa -32768.00 32767.00 FORMAT "%8.2" /end CHARACTERISTIC
/begin CHARACTERISTIC Shtrp_PCRBA_tiDelay_C "Einschwingzeit bei Short Trip PCRBA Test" VALUE 0x1F02E0 Kw_Wu16 655350.0 Time_ms 0.00 655350.0 FORMAT "%8.1" /end CHARACTERISTIC
/begin CHARACTERISTIC Shtrp_PCRBA_tiDfltTrm_C "Defaultwert für die Zeit zwischen dem Ansteuern des Aktuators und dem Durchführen der Diagnose" VALUE 0x1F02E2 Kw_Wu16 655350.0 Time_ms 0.00 655350.0 FORMAT "%8.1" /end CHARACTERISTIC
/begin CHARACTERISTIC Shtrp_PCRBA_tiTrmMax_C "Maximalwert für Shtrp PCR Ansteuerzeit - Trimmwert" VALUE 0x1F02E4 Kw_Wu16 655350.0 Time_ms 0.00 655350.0 FORMAT "%8.1" /end CHARACTERISTIC
/begin CHARACTERISTIC Shtrp_PCRBA_tiTrmMin_C "Minimalwert für Shtrp PCR Ansteuerzeit - Trimmwert" VALUE 0x1F02E6 Kw_Wu16 655350.0 Time_ms 0.00 655350.0 FORMAT "%8.1" /end CHARACTERISTIC
/begin CHARACTERISTIC Shtrp_qMax_C "Maximale Einspritzmenge zur Aktivierung der Short Trip Diagnose" VALUE 0x1F02E8 Kw_Ws16 327.6700 InjMass 0.00 327.6700 FORMAT "%8.4" EXTENDED_LIMITS -327.6800 327.6700 /end CHARACTERISTIC
/begin CHARACTERISTIC Shtrp_rAccPedMinTresh_C "PWG-Schwelle fuer die Short Trip Diagnose" VALUE 0x1F02EA Kw_Ws16 100.0000 Prc 0.00 100.0000 FORMAT "%8.4" EXTENDED_LIMITS -327.6800 327.6700 /end CHARACTERISTIC
/begin CHARACTERISTIC Shtrp_rEGRBAActPos_CA "Applizierbares Tastverhältnis für den EGR-Steller bei Short Trip EGR Grundeinstellung" VAL_BLK 0x1F02EC Kwb_Ws16 655.3500 Prc -327.6800 327.6700 FORMAT "%8.4" NUMBER 3 /end CHARACTERISTIC
/begin CHARACTERISTIC Shtrp_RgnStgT3GovDev_CA "Schalterstellung für Regenerationsstufenschalter im Shorttrip T3 Test" VAL_BLK 0x1F02F2 Kwb_Wu8 2.000 OneToOne 0.00 2.000 FORMAT "%5.3" EXTENDED_LIMITS 0.00 255.0 NUMBER 4 /end CHARACTERISTIC
/begin CHARACTERISTIC Shtrp_rPCRBAActPos_CA "Applizierbares Tastverhältnis für den PCR-Steller bei Short Trip PCR Grundeinstellung" VAL_BLK 0x1F02F6 Kwb_Ws16 655.3500 Prc -327.6800 327.6700 FORMAT "%8.4" NUMBER 3 /end CHARACTERISTIC
/begin CHARACTERISTIC Shtrp_rTVA_CA "Applizierbares Tastverhältnis für den TVA-Steller bei Short Trip TVA Grundeinstellung" VAL_BLK 0x1F02FC Kwb_Ws16 655.3500 Prc -327.6800 327.6700 FORMAT "%8.4" NUMBER 3 /end CHARACTERISTIC
/begin CHARACTERISTIC Shtrp_stReleaseType_C "Array der Weiterschaltbedingungen für Lambdasonden Short Trip" VAL_BLK 0x1F0302 Kwb_Wu16 65535.00 OneToOne 0.00 65535.00 FORMAT "%8.2" NUMBER 6 /end CHARACTERISTIC
/begin CHARACTERISTIC Shtrp_swtFcmIgnore_C "Schalter zum Ignorieren der Fehlerspeichereinträge für die Aktivierung der Short Trip Diagnose" VALUE 0x1F030E Kw_Wu8 1.000 OneToOne 0.00 1.000 FORMAT "%5.3" EXTENDED_LIMITS 0.00 255.0 /end CHARACTERISTIC
/begin CHARACTERISTIC Shtrp_T3GovDevMode_CA "Bedingungen zum Weiterschalten zum nächsten T3 Testabschnitt" VAL_BLK 0x1F030F Kwb_Wu8 15.00 OneToOne 0.00 15.00 FORMAT "%5.2" EXTENDED_LIMITS 0.00 255.0 NUMBER 4 /end CHARACTERISTIC
/begin CHARACTERISTIC Shtrp_T3Gov_C "Array zur Applikation der zu durchzuführenden Short Trip Einzeltests für T3GovDev" VAL_BLK 0x1F0313 Kwb_Wu8 255.0 OneToOne 0.00 255.0 FORMAT "%5.1" NUMBER 16 /end CHARACTERISTIC
/begin CHARACTERISTIC Shtrp_T3RmpSlpDwnT3GovDev_C "Rampe zum verringern der Drehzahl im Shorttrip T3 Test" VALUE 0x1F0324 Kw_Wu32 10000.0000000 RmpEngN_LIGov 0.00 10000.0000000 FORMAT "%13.7" EXTENDED_LIMITS 0.00 9362285.71211 /end CHARACTERISTIC
/begin CHARACTERISTIC Shtrp_T3RmpSlpUpT3GovDev_C "Rampe für Erhöhung der Drehzahl im Shorttrip T3 Test" VALUE 0x1F0328 Kw_Wu32 10000.0000000 RmpEngN_LIGov 0.00 10000.0000000 FORMAT "%13.7" EXTENDED_LIMITS 0.00 9362285.71211 /end CHARACTERISTIC
/begin CHARACTERISTIC Shtrp_tClntGovDevRelease_C "Schwelle für Clnt Temperatur im Shorttrip" VALUE 0x1F032C Kw_Ws16 6553.500 Temp_Cels -3549.940 3003.560 FORMAT "%8.3" /end CHARACTERISTIC
/begin CHARACTERISTIC Shtrp_tiBetweenTogVal_C "Toggle-Zeit bei Short Trip - Stellertest" VAL_BLK 0x1F032E Kwb_Wu16 655350.0 Time_ms 0.00 655350.0 FORMAT "%8.1" NUMBER 35 /end CHARACTERISTIC
/begin CHARACTERISTIC Shtrp_tiEnd_C "Maximale Zeit der Short Trip Diagnose" VALUE 0x1F0374 Kw_Wu16 655.3500 Time_s 0.00 655.3500 FORMAT "%8.4" /end CHARACTERISTIC
/begin CHARACTERISTIC Shtrp_tiEngSpdReached_C "Zeit zum Erreichen der Drehzahl bei der Short Trip Diagnose" VALUE 0x1F0376 Kw_Wu16 655.3500 Time_s 0.00 655.3500 FORMAT "%8.4" /end CHARACTERISTIC
/begin CHARACTERISTIC Shtrp_tiLSU_C "Array der Abarbeitungszeiten der einzelnen Teile des Short Trip LSU Tests" VAL_BLK 0x1F0378 Kwb_Wu16 655.3500 Time_s 0.00 655.3500 FORMAT "%8.4" NUMBER 6 /end CHARACTERISTIC
/begin CHARACTERISTIC Shtrp_tiRoutDemMax_C "Zeit in der der Tester eine neue Anforderung senden muß, um nicht ins Timeout zu gelangen" VALUE 0x1F0384 Kw_Wu16 655350.0 Time_ms 0.00 655350.0 FORMAT "%8.1" /end CHARACTERISTIC
/begin CHARACTERISTIC Shtrp_tiT3GovDev_CA "Max Zeit für einzelne Abschnitte des Shorttrip T3 Tests" VAL_BLK 0x1F0386 Kwb_Wu16 655.0000 Time_s 0.00 655.0000 FORMAT "%8.4" EXTENDED_LIMITS 0.00 655.3500 NUMBER 4 /end CHARACTERISTIC
/begin CHARACTERISTIC Shtrp_tiTestAbort_C "Abbruchzeiten der einzelnen Short Trip Tests" VAL_BLK 0x1F038E Kwb_Wu16 655.3500 Time_s 0.00 655.3500 FORMAT "%8.4" NUMBER 16 /end CHARACTERISTIC
/begin CHARACTERISTIC Shtrp_tiTmrBRK_C "Timer für Bremse erkannt bei Short Trip Diagnose" VALUE 0x1F03AE Kw_Wu16 655.3500 Time_s 0.00 655.3500 FORMAT "%8.4" /end CHARACTERISTIC
/begin CHARACTERISTIC Shtrp_tiTmrPWG_C "Timer für PWG erkannt bei Short Trip Diagnose" VALUE 0x1F03B0 Kw_Wu16 655.3500 Time_s 0.00 655.3500 FORMAT "%8.4" /end CHARACTERISTIC
/begin CHARACTERISTIC Shtrp_TstTogDemand_C "Array für Short Trip Stellertests" VAL_BLK 0x1F03B2 Kwb_Wu8 255.000000000 SigTstName 0.00 255.000000000 FORMAT "%13.9" NUMBER 35 /end CHARACTERISTIC
/begin CHARACTERISTIC Shtrp_TstTogID_C "ID für die freiapplizierbaren Shtrp Stellertests" VAL_BLK 0x1F03D5 Kwb_Wu8 255.0 OneToOne 0.00 255.0 FORMAT "%5.1" NUMBER 35 /end CHARACTERISTIC
/begin CHARACTERISTIC Shtrp_TstTogVal1_C "1. Tastverhältnis für Short Trip Stellertests" VAL_BLK 0x1F03F8 Kwb_Ws16 655.3500 DtyCyc -327.6800 327.6700 FORMAT "%8.4" NUMBER 35 /end CHARACTERISTIC
/begin CHARACTERISTIC Shtrp_TstTogVal2_C "2. Tastverhältnis für Short Trip Stellertests" VAL_BLK 0x1F043E Kwb_Ws16 655.3500 DtyCyc -327.6800 327.6700 FORMAT "%8.4" NUMBER 35 /end CHARACTERISTIC
/begin CHARACTERISTIC Shtrp_tT3GovDevRelease_C "Schwelle für T3 Temperatur im Shorttrip T3 Test" VALUE 0x1F0484 Kw_Ws16 6553.500 Temp_Cels -3549.940 3003.560 FORMAT "%8.3" /end CHARACTERISTIC
/begin CHARACTERISTIC SvLp_dSootLoadWIV2_Vector "Konfigurationslabel für Bypass message" VALUE 0x1C0B2C Kw_Wu8 255.0 OneToOne 0.00 255.0 FORMAT "%5.1" /end CHARACTERISTIC
/begin CHARACTERISTIC SvLp_dSootLoadWIV2_Channel "Konfigurationslabel für Bypass message" VALUE 0x1C0B2D Kw_Wu8 255.0 OneToOne 0.00 255.0 FORMAT "%5.1" /end CHARACTERISTIC
/begin CHARACTERISTIC SvLp_dSootLoad_Vector "Konfigurationslabel für Bypass message" VALUE 0x1C0B2E Kw_Wu8 255.0 OneToOne 0.00 255.0 FORMAT "%5.1" /end CHARACTERISTIC
/begin CHARACTERISTIC SvLp_dSootLoad_Channel "Konfigurationslabel für Bypass message" VALUE 0x1C0B2F Kw_Wu8 255.0 OneToOne 0.00 255.0 FORMAT "%5.1" /end CHARACTERISTIC
/begin CHARACTERISTIC T50CD_stDebVal_Vector "Konfigurationslabel für Bypass Freischnitt" VALUE 0x1C0B30 Kw_Wu8 255.0 OneToOne 0.00 255.0 FORMAT "%5.1" /end CHARACTERISTIC
/begin CHARACTERISTIC T50CD_stDebVal_Channel "Konfigurationslabel für Bypass Freischnitt" VALUE 0x1C0B31 Kw_Wu8 255.0 OneToOne 0.00 255.0 FORMAT "%5.1" /end CHARACTERISTIC
/begin CHARACTERISTIC T50CD_stRxDebVal_Vector "Configuration Label for Bypass message" VALUE 0x1C0B32 Kw_Wu8 255.0 OneToOne 0.00 255.0 FORMAT "%5.1" /end CHARACTERISTIC
/begin CHARACTERISTIC T50CD_stRxDebVal_Channel "Konfigurationslabel für Bypass Freischnitt" VALUE 0x1C0B33 Kw_Wu8 255.0 OneToOne 0.00 255.0 FORMAT "%5.1" /end CHARACTERISTIC
/begin CHARACTERISTIC ThrVlv_rTVA_Vector "Bypass-Label für ThrVlv_rTVA" VALUE 0x1C0B34 Kw_Wu8 255.0 OneToOne 0.00 255.0 FORMAT "%5.1" /end CHARACTERISTIC
/begin CHARACTERISTIC ThrVlv_rTVA_Channel "Bypass-Label für ThrVlv_rTVA" VALUE 0x1C0B35 Kw_Wu8 255.0 OneToOne 0.00 255.0 FORMAT "%5.1" /end CHARACTERISTIC
/begin CHARACTERISTIC BasAdj_TVAnSetpoint_C "Leerlaufdrehzahl für TVA Grundeinstellung (Diagnose)" VALUE 0x1CC176 Kw_Ws16 65535.00 EngN -32768.00 32767.00 FORMAT "%8.2" /end CHARACTERISTIC
/begin CHARACTERISTIC BasAdj_TVAtime_C "toggle-Zeit für TVA Grundeinstellung (Diagnose)" VALUE 0x1CC178 Kw_Wu16 655350.0 Time_ms 0.00 655350.0 FORMAT "%8.1" /end CHARACTERISTIC
/begin CHARACTERISTIC BasAdj_TVABits_C "Bitmaske für TVA Grundeinstellung (Diagnose)" VALUE 0x1CC17A Kw_Wu16 65535.00 OneToOne 0.00 65535.00 FORMAT "%8.2" READ_ONLY /end CHARACTERISTIC
/begin CHARACTERISTIC UAddr_stCalibration_C "ECU Applikationszugriff (0 = unterbunden, 1 = erlaubt)" VALUE 0x1C14A6 Kw_Wu8 1.000 OneToOne 0.00 1.000 FORMAT "%5.3" EXTENDED_LIMITS 0.00 255.0 /end CHARACTERISTIC
/begin CHARACTERISTIC USAp_CodeTbl1_CA "Variantencode Umsetztabelle 1" VAL_BLK 0x1F31B0 Kwb_Wu32 4294967295.00 OneToOne 0.00 4294967295.00 FORMAT "%13.2" NUMBER 32 /end CHARACTERISTIC
/begin CHARACTERISTIC USAp_CodeTbl2_CA "Variantencode Umsetztabelle 2" VAL_BLK 0x1F3230 Kwb_Wu32 4294967295.00 OneToOne 0.00 4294967295.00 FORMAT "%13.2" NUMBER 32 /end CHARACTERISTIC
/begin CHARACTERISTIC USAp_dCodeTblInv_C "Identifier dieser Datensatzvariante (invertiert)" VALUE 0x1F32B0 Kw_Wu32 4294967295.00 OneToOne 0.00 4294967295.00 FORMAT "%13.2" /end CHARACTERISTIC
/begin CHARACTERISTIC USAp_dCodeTbl_C "Identifier dieser Datensatzvariante" VALUE 0x1F32B4 Kw_Wu32 4294967295.00 OneToOne 0.00 4294967295.00 FORMAT "%13.2" /end CHARACTERISTIC
/begin CHARACTERISTIC USAp_dDatasetType_C "Duch diesen Label wird der Datensatz für Master- oder Slave- oder Single-Steuergerät markiert." VALUE 0x1F32B8 Kw_Wu8 255.0 OneToOne 0.00 255.0 FORMAT "%5.1" /end CHARACTERISTIC
/begin CHARACTERISTIC VehDa_nCarbThres_C "Drehzahl Schwelle ab der VehDa_tiCarbEngOn zu zählen beginnt" VALUE 0x1F32C0 Kw_Ws16 65535.00 EngN -32768.00 32767.00 FORMAT "%8.2" /end CHARACTERISTIC
/begin CHARACTERISTIC BasAdj_VSA1nSetpoint_C "Leerlaufsolldrehzahl bei VSA 1-Grundeinstellung  (Diagnose)" VALUE 0x1CC17C Kw_Ws16 65535.00 EngN -32768.00 32767.00 FORMAT "%8.2" /end CHARACTERISTIC
/begin CHARACTERISTIC BasAdj_VSA1time_C "Zeit nach der bei VSA 1-Grundeinstellung zwischen den beiden Tastverhältnissen umgeschalten wird  (Diagnose)" VALUE 0x1CC17E Kw_Wu16 655350.0 Time_ms 0.00 655350.0 FORMAT "%8.1" /end CHARACTERISTIC
/begin CHARACTERISTIC BasAdj_VSA1Bits_C "Maske für BasAdj_st bei VSA 1-Grundeinstellung  (Diagnose)" VALUE 0x1CC180 Kw_Wu16 65535.00 OneToOne 0.00 65535.00 FORMAT "%8.2" READ_ONLY /end CHARACTERISTIC
/begin CHARACTERISTIC BasAdj_VSA2nSetpoint_C "Leerlaufsolldrehzahl bei VSA 2-Grundeinstellung  (Diagnose)" VALUE 0x1CC182 Kw_Ws16 65535.00 EngN -32768.00 32767.00 FORMAT "%8.2" /end CHARACTERISTIC
/begin CHARACTERISTIC BasAdj_VSA2time_C "Zeit nach der bei VSA 2 - Grundeinstellung zwischen den beiden Tastverhältnissen umgeschalten wird  (Diagnose)" VALUE 0x1CC184 Kw_Wu16 655350.0 Time_ms 0.00 655350.0 FORMAT "%8.1" /end CHARACTERISTIC
/begin CHARACTERISTIC BasAdj_VSA2Bits_C "Maske für BasAdj_st bei VSA 2-Grundeinstellung  (Diagnose)" VALUE 0x1CC186 Kw_Wu16 65535.00 OneToOne 0.00 65535.00 FORMAT "%8.2" READ_ONLY /end CHARACTERISTIC
/begin CHARACTERISTIC VSACD_rOut_Vector "Konfigurationslabel für Bypass Freischnitt" VALUE 0x1C0B36 Kw_Wu8 255.0 OneToOne 0.00 255.0 FORMAT "%5.1" /end CHARACTERISTIC
/begin CHARACTERISTIC VSACD_rOut_Channel "Konfigurationslabel für Bypass Freischnitt" VALUE 0x1C0B37 Kw_Wu8 255.0 OneToOne 0.00 255.0 FORMAT "%5.1" /end CHARACTERISTIC
/begin CHARACTERISTIC BasAdj_VSAMSnSetpoint_C "Leerlaufsolldrehzahl bei VSA M/S - Grundeinstellung  (Diagnose)" VALUE 0x1CC188 Kw_Ws16 65535.00 EngN -32768.00 32767.00 FORMAT "%8.2" /end CHARACTERISTIC
/begin CHARACTERISTIC BasAdj_VSAMStime_C "Zeit nach der bei VSA M/S - Grundeinstellung zwischen den beiden Tastverhältnissen umgeschalten wird  (Diagnose)" VALUE 0x1CC18A Kw_Wu16 655350.0 Time_ms 0.00 655350.0 FORMAT "%8.1" /end CHARACTERISTIC
/begin CHARACTERISTIC BasAdj_VSAMSBits_C "Maske für BasAdj_st bei VSA M/S -Grundeinstellung  (Diagnose)" VALUE 0x1CC18C Kw_Wu16 65535.00 OneToOne 0.00 65535.00 FORMAT "%8.2" READ_ONLY /end CHARACTERISTIC
/begin COMPU_METHOD AirGasConst "Umrechnungsformel für Gaskonstante Luft" RAT_FUNC "%6.3" "[Nm/kg/K]" COEFFS 0 10 0 0 0 1 /end COMPU_METHOD
/begin COMPU_METHOD AirMassPerCyl "Luftmasse pro Zylinder" RAT_FUNC "%6.3" "[mg/Hub Luft]" COEFFS 0 10 0 0 0 1 /end COMPU_METHOD
/begin COMPU_METHOD AngleCaS "Winkel Nockenwelle" RAT_FUNC "%6.4" "[deg CaS]" COEFFS 0 85.3333333333334 0 0 0 1 /end COMPU_METHOD
/begin COMPU_METHOD AngleCrS "Winkel Kurbelwelle" RAT_FUNC "%6.4" "[deg CrS]" COEFFS 0 42.6666666666667 0 0 0 1 /end COMPU_METHOD
/begin COMPU_METHOD DfpName "Verbale Umrechnung für Fehlerpfadnamen" TAB_VERB "%6.3" "[-]" COMPU_TAB_REF DfpName /end COMPU_METHOD
/begin COMPU_VTAB DfpName "Verbale Umrechnung für Fehlerpfadnamen" TAB_VERB 385 0 "Dfp_unused" 1 "Dfp_ACCCD" 2 "Dfp_ACCCDBrkErr" 3 "Dfp_ACCCDBrkNPL" 4 "Dfp_ACCCDSensErr" 5 "Dfp_ACCCDWrongCoded" 6 "Dfp_ACCD" 7 "Dfp_ACCD_PAC" 8 "Dfp_ACCD_pCAN" 9 "Dfp_ACCD_trqCAN" 10 "Dfp_ACCIRevPanErr" 11 "Dfp_ACCIRevShOff" 12 "Dfp_ACCnotPlaus" 13 "Dfp_ADCMon" 14 "Dfp_AFSCD_PlOffsDrft" 15 "Dfp_AFSCD_PlSetyDrft" 16 "Dfp_AFSCD_SRCAirm" 17 "Dfp_AFVCD_Actr" 18 "Dfp_AOHtCDHt1" 19 "Dfp_AOHtCDHt2" 20 "Dfp_AOHtCDHt3" 21 "Dfp_APP1" 22 "Dfp_APP2" 23 "Dfp_APPCD_KickDown" 24 "Dfp_APPCD_PWGDrft" 25 "Dfp_APPSync" 26 "Dfp_APP_Npl" 27 "Dfp_APSCD" 28 "Dfp_AccPedPlausBrk" 29 "Dfp_AirCtl_GovDevMax" 30 "Dfp_AirCtl_GovDevMin" 31 "Dfp_AirCtl_GovDevRgnMax" 32 "Dfp_AirCtl_GovDevRgnMin" 33 "Dfp_AirbCDCrash" 34 "Dfp_AirbCDCrashCrCtl" 35 "Dfp_AirbCDCrashPSP" 36 "Dfp_AltCDExc" 37 "Dfp_AltCD_Load" 38 "Dfp_AltPwrCan" 39 "Dfp_BIP01" 40 "Dfp_BIP02" 41 "Dfp_BIP03" 42 "Dfp_BIP04" 43 "Dfp_BIP05" 44 "Dfp_BIP06" 45 "Dfp_BIP07" 46 "Dfp_BIP08" 47 "Dfp_BIP09" 48 "Dfp_BIP10" 49 "Dfp_BIP11" 50 "Dfp_BIP12" 51 "Dfp_BIP_Con" 52 "Dfp_BPACD_Max" 53 "Dfp_BPACD_Max2" 54 "Dfp_BPACD_Min" 55 "Dfp_BPACD_Min2" 56 "Dfp_BPACD_SigNpl" 57 "Dfp_BPACD_SigNpl2" 58 "Dfp_BPASCD" 59 "Dfp_BPSCD" 60 "Dfp_BPSCDPlaus" 61 "Dfp_BattCD" 62 "Dfp_BrkCD" 63 "Dfp_BrkCDBPTInvld" 64 "Dfp_BrkCDdynPl" 65 "Dfp_CANA" 66 "Dfp_CANB" 67 "Dfp_CANBus1" 68 "Dfp_CANBus2" 69 "Dfp_CANBus3" 70 "Dfp_CANC" 71 "Dfp_CANErrActA" 72 "Dfp_CANErrActB" 73 "Dfp_CANErrActC" 74 "Dfp_COTSCD" 75 "Dfp_CTSCD" 76 "Dfp_CTSCDCanInac" 77 "Dfp_CTSCDCanSig" 78 "Dfp_Clg_DynTst" 79 "Dfp_CmbChbMisfire1" 80 "Dfp_CmbChbMisfire2" 81 "Dfp_CmbChbMisfire3" 82 "Dfp_CmbChbMisfire4" 83 "Dfp_CmbChbMisfire5" 84 "Dfp_CmbChbMisfire6" 85 "Dfp_CmbChbMisfireMul" 86 "Dfp_CoVMDCSErr" 87 "Dfp_CoVMDCSh" 88 "Dfp_CoVMDCSp" 89 "Dfp_CoVMSumErr" 90 "Dfp_CoVMTCSErr" 91 "Dfp_CoVehLvl2" 92 "Dfp_ConvCD" 93 "Dfp_ConvCD_ConvErr" 94 "Dfp_ConvCD_EPB1" 95 "Dfp_CrCCDPanErrMSG" 96 "Dfp_CrCCDPanErrSMLS" 97 "Dfp_CrCCDPanMainSwtErr" 98 "Dfp_CrCtlDsplErrPat" 99 "Dfp_CrCtlDsplNotPlaus" 100 "Dfp_CrCtlPECDErr" 101 "Dfp_CrCtlPLmpDef" 102 "Dfp_CrCtlPShutOff" 103 "Dfp_CrCtlPTlrDef" 104 "Dfp_CrCtlVDsplNotPlaus" 105 "Dfp_CtApCD" 106 "Dfp_CtTCD" 107 "Dfp_CtT_Mon" 108 "Dfp_DifftrqLimErrPat" 109 "Dfp_EATSCD" 110 "Dfp_EATSCDCanInac" 111 "Dfp_EATSCDCanSig" 112 "Dfp_EEPCDVarMng" 113 "Dfp_EGPpCDTPreTrbn" 114 "Dfp_EGRCD_CBV" 115 "Dfp_EGRCD_Max" 116 "Dfp_EGRCD_Min" 117 "Dfp_EGRCD_Sig" 118 "Dfp_EGRCD_SigNpl" 119 "Dfp_EGRSCD" 120 "Dfp_EGRSCD_JamVlv" 121 "Dfp_EGRSCD_LgTimeDrft" 122 "Dfp_EGRSCD_ShTimeDrft" 123 "Dfp_EGRVlvGvnrDvt" 124 "Dfp_EGRVlv_JamVlv" 125 "Dfp_EMCCD_MLS1" 126 "Dfp_EngMBackUp" 127 "Dfp_EngMCaS1" 128 "Dfp_EngMCaSDrv" 129 "Dfp_EngMCrS1" 130 "Dfp_EngMOfsCaSCrS" 131 "Dfp_EngMonIrrCmb" 132 "Dfp_EngPrt" 133 "Dfp_ErLpCDMILReqON" 134 "Dfp_FMAErrMod" 135 "Dfp_FMTC_NonMonotonMap" 136 "Dfp_FQTSCD" 137 "Dfp_FQlSCD" 138 "Dfp_FTSCD" 139 "Dfp_FTSCDNpl" 140 "Dfp_FanCD_Fan1Ctlr1" 141 "Dfp_FanCD_Fan1Ctlr2" 142 "Dfp_FanCD_Fan2Ctlr1" 143 "Dfp_FanCD_Fan2Ctlr2" 144 "Dfp_FanCD_FanCtlr1" 145 "Dfp_FanCD_FanCtlr2" 146 "Dfp_FanCD_OutFanCtlr1" 147 "Dfp_FanCD_OutFanCtlr2" 148 "Dfp_FlClgCD" 149 "Dfp_FlPpCD" 150 "Dfp_FlSCDT1" 151 "Dfp_FrmMngAAGNpl" 152 "Dfp_FrmMngAAGTO" 153 "Dfp_FrmMngAC1Npl" 154 "Dfp_FrmMngAC1TO" 155 "Dfp_FrmMngACCNpl" 156 "Dfp_FrmMngACCTO" 157 "Dfp_FrmMngAIRBGNpl" 158 "Dfp_FrmMngAIRBGTO" 159 "Dfp_FrmMngAWD1Npl" 160 "Dfp_FrmMngAWD1TO" 161 "Dfp_FrmMngBEM1Npl" 162 "Dfp_FrmMngBEM1TO" 163 "Dfp_FrmMngBRK1Npl" 164 "Dfp_FrmMngBRK1TO" 165 "Dfp_FrmMngBRK2Npl" 166 "Dfp_FrmMngBRK2TO" 167 "Dfp_FrmMngBRK8Npl" 168 "Dfp_FrmMngBRK8TO" 169 "Dfp_FrmMngBSG3TO" 170 "Dfp_FrmMngCANVerErr" 171 "Dfp_FrmMngCCSel" 172 "Dfp_FrmMngCCTLNpl" 173 "Dfp_FrmMngCCTLTO" 174 "Dfp_FrmMngCHRGR1Npl" 175 "Dfp_FrmMngCHRGR1TO" 176 "Dfp_FrmMngCHRGR2Npl" 177 "Dfp_FrmMngCHRGR2TO" 178 "Dfp_FrmMngChrgr1A" 179 "Dfp_FrmMngChrgr1C" 180 "Dfp_FrmMngChrgr1N" 181 "Dfp_FrmMngChrgr1T" 182 "Dfp_FrmMngChrgr1V" 183 "Dfp_FrmMngChrgr2A" 184 "Dfp_FrmMngChrgr2C" 185 "Dfp_FrmMngChrgr2N" 186 "Dfp_FrmMngChrgr2T" 187 "Dfp_FrmMngChrgr2V" 188 "Dfp_FrmMngDIA1Npl" 189 "Dfp_FrmMngDIA1TO" 190 "Dfp_FrmMngDSP1Npl" 191 "Dfp_FrmMngDSP1TO" 192 "Dfp_FrmMngDSP2Npl" 193 "Dfp_FrmMngDSP2TO" 194 "Dfp_FrmMngDSP3Npl" 195 "Dfp_FrmMngDSP3TO" 196 "Dfp_FrmMngEPB1Npl" 197 "Dfp_FrmMngEPB1TO" 198 "Dfp_FrmMngESCUNpl" 199 "Dfp_FrmMngESCUTO" 200 "Dfp_FrmMngErrValDFM" 201 "Dfp_FrmMngGW1Npl" 202 "Dfp_FrmMngGW1TO" 203 "Dfp_FrmMngILMNpl" 204 "Dfp_FrmMngILMTO" 205 "Dfp_FrmMngLICHT1TO" 206 "Dfp_FrmMngLICHT2TO" 207 "Dfp_FrmMngNIV1WrngCod" 208 "Dfp_FrmMngNIVEAU1Npl" 209 "Dfp_FrmMngNIVEAU1TO" 210 "Dfp_FrmMngSA1Npl" 211 "Dfp_FrmMngSA1TO" 212 "Dfp_FrmMngSTIGNNpl" 213 "Dfp_FrmMngStIgnTO" 214 "Dfp_FrmMngTOSNpl" 215 "Dfp_FrmMngTOSTO" 216 "Dfp_FrmMngTSC1Npl" 217 "Dfp_FrmMngTSC1TO" 218 "Dfp_FrmMngTSC2Npl" 219 "Dfp_FrmMngTSC2TO" 220 "Dfp_FrmMngTSC3Npl" 221 "Dfp_FrmMngTSC3TO" 222 "Dfp_FrmMngTSC6Npl" 223 "Dfp_FrmMngTSC6TO" 224 "Dfp_FrmMngTrbnSpdErr" 225 "Dfp_FrmMngWIPERTO" 226 "Dfp_GbSSCD" 227 "Dfp_GbSSCD_HW" 228 "Dfp_GearbxCVTnMax" 229 "Dfp_GearbxClthPlaus" 230 "Dfp_GearbxINCCup" 231 "Dfp_GearbxNMinMon" 232 "Dfp_GearbxTSC" 233 "Dfp_GearbxTransConv" 234 "Dfp_GearbxTypeMTErr" 235 "Dfp_GlwCDDIAG" 236 "Dfp_GlwCDErr1" 237 "Dfp_GlwCDErr2" 238 "Dfp_GlwCDEvalCod" 239 "Dfp_GlwCDGSK2" 240 "Dfp_GlwCDGSK3" 241 "Dfp_GlwCDLmp" 242 "Dfp_GlwCDPLUG0" 243 "Dfp_GlwCDPLUG1" 244 "Dfp_GlwCDPLUG2" 245 "Dfp_GlwCDPLUG3" 246 "Dfp_GlwCDPLUG4" 247 "Dfp_GlwCDPLUG5" 248 "Dfp_GlwCD_LampCan" 249 "Dfp_GlwCDsfd" 250 "Dfp_HDSCD" 251 "Dfp_HWEMonCom" 252 "Dfp_HWEMonEEPROM" 253 "Dfp_HWEMonRcyLocked" 254 "Dfp_HWEMonRcySuppressed" 255 "Dfp_HWEMonRcyVisible" 256 "Dfp_HWEMonUMaxSupply" 257 "Dfp_HWEMonUMinSupply" 258 "Dfp_IATSCD" 259 "Dfp_IFCD" 260 "Dfp_ImmCtl" 261 "Dfp_IndSysMonIntMnf" 262 "Dfp_InjCrvT3DiaMax" 263 "Dfp_InjCrvT3DiaMin" 264 "Dfp_InjVlvBnk1A" 265 "Dfp_InjVlvBnk2A" 266 "Dfp_InjVlvCyl10A" 267 "Dfp_InjVlvCyl11A" 268 "Dfp_InjVlvCyl12A" 269 "Dfp_InjVlvCyl1A" 270 "Dfp_InjVlvCyl2A" 271 "Dfp_InjVlvCyl3A" 272 "Dfp_InjVlvCyl4A" 273 "Dfp_InjVlvCyl5A" 274 "Dfp_InjVlvCyl6A" 275 "Dfp_InjVlvCyl7A" 276 "Dfp_InjVlvCyl8A" 277 "Dfp_InjVlvCyl9A" 278 "Dfp_LASCD" 279 "Dfp_LSUCDCircNernst0" 280 "Dfp_LSUCDCircPumpCur0" 281 "Dfp_LSUCDCircVirtGnd0" 282 "Dfp_LSUCDHeater0" 283 "Dfp_LSUCDHtCoup0" 284 "Dfp_LSUCDO20" 285 "Dfp_LSUCDO2Clb0" 286 "Dfp_LSUCDRiClb0" 287 "Dfp_LSUCDSPI0" 288 "Dfp_LSUCDSPIBattLow0" 289 "Dfp_LSUCDWireIP0" 290 "Dfp_LSUCtlRiExc0" 291 "Dfp_LSUMonDyn0" 292 "Dfp_LSUMonFullLd0" 293 "Dfp_LSUMonOvrRun0" 294 "Dfp_LSUMonPartLd0" 295 "Dfp_MIL" 296 "Dfp_MRlyCD" 297 "Dfp_Montr" 298 "Dfp_OTSCD" 299 "Dfp_OTSCDCanInac" 300 "Dfp_OTSCDCanSig" 301 "Dfp_OTSCD_DynTst" 302 "Dfp_OvRMon" 303 "Dfp_OvRMonCrCtlP" 304 "Dfp_OvRMonSigA" 305 "Dfp_OxiCCDTPre" 306 "Dfp_OxiCCDTPre1" 307 "Dfp_PCR_BalGovDev" 308 "Dfp_PCR_GovDev" 309 "Dfp_PFltAPSens" 310 "Dfp_PFltCDHtg" 311 "Dfp_PFltCDHtg1" 312 "Dfp_PFltCDPDiff" 313 "Dfp_PFltCDTempPre" 314 "Dfp_PFltCDTempPre1" 315 "Dfp_PFltCDTempPst" 316 "Dfp_PFltChar" 317 "Dfp_PFltEngPrt" 318 "Dfp_PFltPresDynPlaus" 319 "Dfp_PFltPresHsChng" 320 "Dfp_PFltPresSens" 321 "Dfp_PFltPresSensFrz" 322 "Dfp_PFltPresSensHsLn" 323 "Dfp_PFltPresSensSot" 324 "Dfp_PFltRgnLckPerm" 325 "Dfp_PFltRgnLckPermTstr" 326 "Dfp_PFltRgnPerm" 327 "Dfp_PFltSotSimPresPerm" 328 "Dfp_PFltTempDwnStrm" 329 "Dfp_PFltTempDwnStrmMax" 330 "Dfp_PFltTempDwnStrmMin" 331 "Dfp_PFltTempPreOxiC" 332 "Dfp_PFltTempPrePFlt" 333 "Dfp_PFltTempPreTrbn" 334 "Dfp_PFltTempPst" 335 "Dfp_PFltTempPstPFlt" 336 "Dfp_PFltTempSens" 337 "Dfp_PFltTempSens2" 338 "Dfp_PFltTempUpStrm" 339 "Dfp_PFltTempUpStrmMax" 340 "Dfp_PFltTempUpStrmMin" 341 "Dfp_PSPCD_Actr" 342 "Dfp_PrpCtlvLimErrPat" 343 "Dfp_SOPTst" 344 "Dfp_SSpMon1" 345 "Dfp_SSpMon2" 346 "Dfp_SSpMon3" 347 "Dfp_Shtrp_EGRBA" 348 "Dfp_Shtrp_PCRBA" 349 "Dfp_SrvPmpStSAEcu" 350 "Dfp_StSysCtlShCirBatt" 351 "Dfp_StrtCDOffRly" 352 "Dfp_StrtCDOnRly" 353 "Dfp_StrtCtlIlsNotPlaus" 354 "Dfp_StrtCtlT50ROneRly1" 355 "Dfp_StrtCtlT50ROneRly2" 356 "Dfp_StrtCtlT50RZero" 357 "Dfp_SysLamp" 358 "Dfp_T15CD" 359 "Dfp_T50CD" 360 "Dfp_TPUMon" 361 "Dfp_TVACD_Max" 362 "Dfp_TVACD_Min" 363 "Dfp_TVACD_Sig" 364 "Dfp_TVACD_SigNpl" 365 "Dfp_TVACD_stLineDef" 366 "Dfp_TVASCD" 367 "Dfp_TVASCD_Drft" 368 "Dfp_ThrVlvGvnrDvt" 369 "Dfp_ThrVlvJamVlv" 370 "Dfp_UAcc_CodeBitErr" 371 "Dfp_USAp_DataVariant" 372 "Dfp_USAp_FuncCodeRead" 373 "Dfp_VSACD_Max" 374 "Dfp_VSACD_Min" 375 "Dfp_VSACD_SigNpl" 376 "Dfp_VSSCD" 377 "Dfp_VSSCD1" 378 "Dfp_VSSCD2" 379 "Dfp_VSSCD4" 380 "Dfp_VSSCDBrkLowVltg" 381 "Dfp_VSSCDCAN" 382 "Dfp_VSSCDNpl" 383 "Dfp_WDALCD" 384 "Dfp_WdCom" /end COMPU_VTAB
/begin COMPU_METHOD DtyCyc "Tastverhaeltnis" RAT_FUNC "%6.4" "[%]" COEFFS 0 100 0 0 0 1 /end COMPU_METHOD
/begin COMPU_METHOD EngN "Motordrehzahl" RAT_FUNC "%6.2" "[rpm]" COEFFS 0 1 0 0 0 1 /end COMPU_METHOD
/begin COMPU_METHOD Fact "Faktor mit Auflösung 1 / 8192, hauptsächlich für einen Faktorenbereich 0...1 verwendet" RAT_FUNC "%6.5" "[-]" COEFFS 0 8192 0 0 0 1 /end COMPU_METHOD
/begin COMPU_METHOD Fact1 "Faktor mit Auflösung 0,01 (100 mal höherer Bereich als Fact)" RAT_FUNC "%6.4" "[-]" COEFFS 0 128 0 0 0 1 /end COMPU_METHOD
/begin COMPU_METHOD Fact1000 "Faktor mit einer Auflösung von 0.001" RAT_FUNC "%6.5" "-" COEFFS 0 1000 0 0 0 1 /end COMPU_METHOD
/begin COMPU_METHOD InjMass "Einspritzmenge" RAT_FUNC "%6.4" "[mg/hub]" COEFFS 0 100 0 0 0 1 /end COMPU_METHOD
/begin COMPU_METHOD OneToOne "eins zu eins (physikalischer Wert ist gleich dem internen Wert)" RAT_FUNC "%6.2" "[-]" COEFFS 0 1 0 0 0 1 /end COMPU_METHOD
/begin COMPU_METHOD Period_ms "Periodendauer in ms" RAT_FUNC "%6.3" "[ms]" COEFFS 0 10 0 0 0 1 /end COMPU_METHOD
/begin COMPU_METHOD Prc "Prozent, gleiche interne Auflösung wie Fact, aber Darstellung in Prozent (0...100%)" RAT_FUNC "%6.4" "[%]" COEFFS 0 100 0 0 0 1 /end COMPU_METHOD
/begin COMPU_METHOD Pres_hPa "Druck (angezeigt in [hPa])" RAT_FUNC "%6.2" "[hPa]" COEFFS 0 1 0 0 0 1 /end COMPU_METHOD
/begin COMPU_METHOD RhoFuel "Kraftstoffdichte" RAT_FUNC "%6.3" "[kg/m^3]" COEFFS 0 10 0 0 0 1 /end COMPU_METHOD
/begin COMPU_METHOD RmpEngN_LIGov "Motordrehzahlgradient für Leerlaufreglerrampe" RAT_FUNC "%6.4" "[rpm/s]" COEFFS 0 458.752 0 0 0 1 /end COMPU_METHOD
/begin COMPU_METHOD RmpPres_hPa "Rampengradient für Druck angezeigt in [hPa/s]" RAT_FUNC "%6.4" "[hPa/s]" COEFFS 0 65.536 0 0 0 1 /end COMPU_METHOD
/begin COMPU_METHOD RmpTemp "Rampengradient für Temperatur" RAT_FUNC "%6.4" "[deg C/s]" COEFFS 0 655.36 0 0 0 1 /end COMPU_METHOD
/begin COMPU_METHOD RmpTrq "Rampengradient für Motormoment" RAT_FUNC "%6.4" "[Nm/s]" COEFFS 0 655.36 0 0 0 1 /end COMPU_METHOD
/begin COMPU_METHOD RmpVolt "ADC Spannungsrampengradient" RAT_FUNC "%6.4" "[mV/s]" COEFFS 0 13.4086656 0 0 0 1 /end COMPU_METHOD
/begin COMPU_METHOD RmpVoltBatt "Rampengradient für Batteriespannung" RAT_FUNC "%6.3" "[mV/s]" COEFFS 0 3.22602867866423 0 0 0 1 /end COMPU_METHOD
/begin COMPU_METHOD SigName "Verbale Umrechnung für Signal Referenz Nummern" TAB_VERB "%6.3" "[-]" COMPU_TAB_REF SigName /end COMPU_METHOD
/begin COMPU_VTAB SigName "Verbale Umrechnung für Signal Referenz Nummern" TAB_VERB 575 0 "Sig_unused" 4 "CoEng_rTrq__Carb_r_DLen1" 5 "CTSCD_tClntLin__Carb_t_DLen1" 11 "BPSCD_pLin__Carb_p_DLen1" 12 "Eng_nAvrg__Carb_n_DLen2" 13 "VSSCD_vCarb1__Carb_v_DLen1" 15 "IATSCD_tAirLin__Carb_t_DLen1" 16 "AFSCD_dmAirRawPerTime__Carb_mAirTim_DLen2" 17 "TVACD_rOut__Carb_r_DLen1" 28 "Signals_PID0x1C__OneToOne_DLen1" 29 "CARB_Mode1PID1D__OneToOne_DLen1" 31 "VehDa_tiCarbEngOn__OneToOne_DLen2" 33 "DSMDur_ctDfctDur1__Carb_l_DLen2" 44 "EGRCD_rOut__Carb_r_DLen1" 45 "EGRVlv_rGvnrDvtRel__Carb_rNeg_DLen1" 48 "DSM_ctWUC__OneToOne_DLen1" 49 "DSM_lDist__Carb_l_DLen2" 51 "APSCD_pSensorVal__Carb_p_DLen1" 60 "EGPpCD_tPreTrbn__Carb_tHighM1_DLen2" 62 "PFlt_tPre__Carb_tHighM1_DLen2" 65 "DSM_stPID41__LowByte_DLen4" 66 "BattCD_u__Carb_uBatt_DLen2" 69 "CARB_rRelThrVlvPos_PID45__Carb_r_DLen1" 70 "EATSCD_tAir__Carb_t_DLen1" 73 "CARB_rAPPCD_PID49__Carb_r_DLen1" 74 "CARB_rAPPCD_PID4A__Carb_r_DLen1" 76 "AirCtl_rTVA__Carb_r_DLen1" 79 "CARB_Mode1PID4F__LowByte_DLen4" 112 "CARB_LSU_rLmbd0__Carb_lr_DLen2" 113 "LSUCD_uO2Raw__Carb_u_DLen2" 114 "CARB_Mode1PID4FB__LowByte_DLen2" 115 "PFlt_tPst__Carb_tHighM1_DLen2" 116 "PFlt_tOxiPre__Carb_tHighM1_DLen2" 117 "PFlt_tOxiPst__Carb_tHighM1_DLen2" 118 "OxiCCD_tPre__Carb_tHighM1_DLen2" 119 "TVASCD_rNrm__Carb_r_DLen1" 120 "EGRVlv_rDesVal__Carb_r_DLen1" 122 "CARB_rNrmInvTVASCD__Carb_r_DLen1" 197 "Eng_nAvrg__n_DLen1" 198 "APPCD_stSwitchSig__OneToOne_DLen1" 199 "APPCD_uRawAPP1__u_DLen1" 200 "APPCD_uRawAPP2__u_DLen1" 201 "APPCD_rAPP1UnFlt__r_DLen1" 202 "BPSCD_uRawVal__u_DLen1" 203 "BPSCD_pOutVal__p_DLen1" 204 "APSCD_pVal__p_DLen1" 205 "APSCD_uRaw__u_DLen1" 206 "IATSCD_tAirLin__t_DLen1" 207 "IATSCD_uRaw__u_DLen1" 208 "FTSCD_tFuel__t_DLen1" 209 "CTSCD_uRaw__u_DLen1" 210 "CTSCD_tClnt__t_DLen1" 211 "OTSCD_tEngOil__t_DLen1" 212 "VSSCD_v__v_DLen1" 213 "AFSCD_dmAirRawPerTime__mAirTim_DLen1" 214 "AFSCD_uRaw__u_DLen1" 215 "AFSCD_dmAirPerTime__mAirTim_DLen1" 216 "BrkCD_stMnSwtRawVal__OneToOne_DLen1" 217 "BrkCD_stRedSwtRawVal__OneToOne_DLen1" 218 "ConvCD_stRawVal__OneToOne_DLen1" 219 "T15CD_stRawVal__OneToOne_DLen1" 220 "BattCD_uRaw__uBatt_DLen1" 221 "IndSys_rVSA__dcyc_DLen1" 222 "InjCtl_qCurr__q_DLen1" 223 "InjCtl_qSetUnBal__q_DLen1" 224 "BPACD_rOut__dcyc_DLen1" 225 "EGRCD_rOut__dcyc_DLen1" 226 "ACCtl_stLogicOut__OneToOne_DLen1" 227 "AOHt_stHt1Out__OneToOne_DLen1" 228 "GlwCtl_stLmpOut__OneToOne_DLen1" 229 "GlwCtl_stActrOut__OneToOne_DLen1" 230 "InjVlv_nCyl1__nCmpTst_DLen1" 231 "InjVlv_nCyl2__nCmpTst_DLen1" 232 "InjVlv_nCyl3__nCmpTst_DLen1" 233 "InjVlv_nCyl4__nCmpTst_DLen1" 234 "InjVlv_nCyl5__nCmpTst_DLen1" 235 "InjVlv_nCyl6__nCmpTst_DLen1" 236 "InjVlv_qFBCCyl1__q_DLen1" 237 "InjVlv_qFBCCyl2__q_DLen1" 238 "InjVlv_qFBCCyl3__q_DLen1" 239 "InjVlv_qFBCCyl4__q_DLen1" 240 "InjVlv_qFBCCyl5__q_DLen1" 241 "InjVlv_qFBCCyl6__q_DLen1" 242 "CaSCD_nPeriod__n_DLen1" 243 "FBC_qDvtCyl[0]__qdiff_DLen1" 244 "FBC_qDvtCyl[1]__qdiff_DLen1" 245 "FBC_qDvtCyl[2]__qdiff_DLen1" 246 "FBC_qDvtCyl[3]__qdiff_DLen1" 247 "FBC_qDvtCyl[4]__qdiff_DLen1" 248 "FBC_qDvtCyl[5]__qdiff_DLen1" 249 "FBC_qDvtCyl[6]__qdiff_DLen1" 250 "FBC_qDvtCyl[7]__qdiff_DLen1" 251 "FBC_qDvtCyl[8]__qdiff_DLen1" 252 "FBC_qDvtCyl[9]__qdiff_DLen1" 253 "InjCrv_phiMI1Des__phiHResol_DLen1" 254 "InjVlv_phiMI1DurCorr__phi_DLen1" 255 "PSP_stLogicOut__OneToOne_DLen1" 256 "ACCD_stMnSwtRawVal__OneToOne_DLen1" 257 "AOHt_stHt2Out__OneToOne_DLen1" 258 "AFSCD_mAirPerCyl__mAirCyl_DLen1" 259 "AFSCD_dmAirNorm__mAirTim_DLen1" 260 "AirCtl_mGovDev__mAirCylGov_DLen1" 261 "AirCtl_rEGR__r_DLen1" 262 "PCR_rBPACD__r_DLen1" 263 "Dfp_LSUCDCircNernst0_Low__OneToOne_DLen1" 264 "GlwCD_stRawVal__OneToOne_DLen1" 265 "APPCD_rFlt__r_DLen1" 266 "HWEMon_numRecovery__OneToOne_DLen1" 281 "DSM_stSysLamp__OneToOne_DLen1" 282 "DSM_stMIL__OneToOne_DLen1" 283 "BattCD_u__uBatt_DLen1" 284 "LIGov_nSetpoint__n_DLen1" 285 "VSSCD_a__a_DLen1" 286 "Tst_Zyklflag_SB5__OneToOne_DLen1" 287 "IATSCD_tAir__t_DLen1" 288 "AccPed_stPlaAPPBrk__OneToOne_DLen1" 289 "AccPed_trqDes__trqhigh_DLen1" 290 "COTSCD_tClnt__t_DLen1" 291 "AccPed_trqInrDesSig__trq_DLen1" 292 "Gearbx_stGear__OneToOne_DLen1" 293 "LSU_rLmbd[0]__rLmbd_DLen1" 294 "LSU_rLmbd[1]__rLmbd_DLen1" 295 "Tst_Zyklflag_SB1__OneToOne_DLen1" 296 "Tst_Zyklflag_SB2__OneToOne_DLen1" 297 "Tst_Zyklflag_SB3__OneToOne_DLen1" 298 "Tst_Zyklflag_SB4__OneToOne_DLen1" 299 "Tst_Zyklflag_SB6__OneToOne_DLen1" 300 "AirCtl_mDesVal__mAirCyl_DLen1" 301 "Tst_Zyklflag_SB7__OneToOne_DLen1" 302 "CtTCtl_tClntDes__t_DLen1" 303 "PCR_pBDes__p_DLen1" 304 "BPSCD_pFltVal__p_DLen1" 305 "FrmMng_lOil_mp__lLvl_DLen1" 306 "FlMng_stMon_mp__OneToOne_DLen1" 307 "FrmMng_stChrgr1Err1__OneToOne_DLen1" 308 "FrmMng_stChrgr1Err2__OneToOne_DLen1" 309 "FrmMng_stChrgr2Err1__OneToOne_DLen1" 310 "FrmMng_stChrgr2Err2__OneToOne_DLen1" 311 "FMTC_qStrt__q_DLen1" 312 "CrCtl_trqDes__trqhigh_DLen1" 313 "CoVM_trqInc__trqhigh_DLen1" 314 "CoEng_trqInrLim__trq_DLen1" 315 "FMTC_trqInrLimSmk__trq_DLen1" 316 "EngPrt_trqLim__trq_DLen1" 317 "CoVM_trqDec__trqhigh_DLen1" 318 "FlMng_qLimSmk__q_DLen1" 319 "CrCtl_vSetPointTrgt__v_DLen1" 320 "AltCD_rAltLoad__r_DLen1" 321 "CoEng_trqInrSet__trq_DLen1" 322 "CoEng_dvolFlConsum__Cnsmp_DLen1" 323 "AirCtl_stMonitor__OneToOne_DLen1" 324 "ACCtl_stLowByte_mp__OneToOne_DLen1" 325 "EngM_stSync__OneToOne_DLen1" 326 "NetMng_stCAN__LowByte_DLen1" 327 "LSUCD_resRiClb__res_DLen1" 328 "LSUCD_uO2Clb__u_DLen1" 329 "FrmMng_stTSC__LowByte_DLen1" 330 "FrmMng_stDCS__LowByte_DLen1" 331 "LSUCD_stAdpt__OneToOne_DLen1" 332 "LSUCD_uRiRaw__u_DLen1" 333 "LSUCD_mAirAftOvrrun__mAir_DLen1" 334 "GlwCtl_tiPst_mp__tiGlw_DLen1" 335 "PCR_stPCR_mp__LowByte_DLen1" 336 "AOHt_stShutOff_mp__LowByte_DLen1" 337 "FrmMng_stTCS__LowByte_DLen1" 338 "FrmMng_trqTSC__trq_DLen1" 339 "FrmMng_trqDCS__trqhigh_DLen1" 340 "CrCCD_stKeySig__OneToOne_DLen1" 341 "CrCtl_stKeyStateSig__OneToOne_DLen1" 342 "PrpCtl_vCurrTrack_mp__v_DLen1" 343 "CtApCD_rHWE_mp__dcyc_DLen1" 344 "Gearbx_trqDec__trq_DLen1" 345 "CrCtl_stShutOffrev__LowByte_DLen1" 346 "AirCtl_stAirCtl_mp__OneToOne_DLen1" 347 "DSM_stRdyAB__LowByte_DLen1" 348 "DSM_stRdyAB__HighByte_DLen1" 349 "DSM_stRdyCD__LowByte_DLen1" 350 "DSM_stRdyCD__HighByte_DLen1" 351 "PrpBrk_trqDes__trqhigh_DLen1" 352 "DSM_ctOBDPath__OneToOne_DLen1" 353 "DSM_ctRdyActCyc_mp__OneToOne_DLen1" 354 "GlwCtl_stLogic__LowByte_DLen1" 355 "GlwCtl_tiPre__tiGlw_DLen1" 356 "FMTC_trqInr__trq_DLen1" 357 "ACCtl_stBitStructure__HighByte_DLen1" 358 "AOHt_stShutOff_mp__HighByte_DLen1" 359 "FrmMng_stTSC__HighByte_DLen1" 360 "FrmMng_stDCS__HighByte_DLen1" 361 "FrmMng_stTCS__HighByte_DLen1" 362 "CrCtl_stSwitchSig__OneToOne_DLen1" 363 "EGSys_tEGLSU__tExhaust_DLen1" 364 "AOHt_NumRly_mp__OneToOne_DLen1" 365 "DSM_ctFcmEntry__OneToOne_DLen1" 368 "GlwCtl_stLogic__HighByte_DLen1" 369 "Dfp_HWEMonUMinSupply_Low__OneToOne_DLen1" 370 "Dfp_HWEMonUMaxSupply_Low__OneToOne_DLen1" 371 "PCR_rBalGvnrDiff__r_DLen1" 372 "Dfp_SOPTst_Low__OneToOne_DLen1" 373 "UAcc_SWPartNum_cs__OneToOne_DLen1" 374 "UAcc_ECUIdentEep_cs__OneToOne_DLen1" 375 "Gearbx_stTSC_mp__OneToOne_DLen1" 376 "CoVM_stActDem__OneToOne_DLen1" 377 "CrCCD_stKey__OneToOne_DLen1" 378 "CrCtl_stShutOff__OneToOne_DLen1" 379 "FanCtl_dcycFan1__dcyc_DLen1" 380 "FanCtl_dcycFan2__dcyc_DLen1" 381 "ACCD_p__pAC_DLen1" 382 "EngPrt_trqPrtLim__trq_DLen1" 383 "ImmCtl_tiLockCount__OneToOne_DLen1" 384 "UAcc_Vin_cs__OneToOne_DLen1" 385 "UAcc_dBGWVin_cs__OneToOne_DLen1" 386 "UAcc_SigBlk80_cs__OneToOne_DLen1" 387 "UAcc_SigBlk82_cs__OneToOne_DLen1" 388 "FlSys_stFlPp__OneToOne_DLen1" 389 "AOHtCD_volFlConsum__Cnsmp_DLen1" 390 "UAcc_MWB26sum_checksum_cs__OneToOne_DLen1" 391 "BPSCD_pLin__p_DLen1" 392 "CoEng_rTrq__r_DLen1" 393 "EngM_stEngMntCtl_MLS1__OneToOne_DLen1" 394 "EngM_stEngMntCtl_MLS2__OneToOne_DLen1" 395 "EngM_stEngMntCtl_GTL1__OneToOne_DLen1" 396 "EngM_stEngMntCtl_GTL2__OneToOne_DLen1" 397 "FanCD_rFan1HWE_mp__dcyc_DLen1" 398 "FanCD_rFan2HWE_mp__dcyc_DLen1" 399 "ACCD_trqCompr__trq_DLen1" 400 "TVACD_rOut__dcyc_DLen1" 401 "PFltCD_tPre__tExhaust_DLen1" 402 "PFltCD_pDiff__p_DLen1" 403 "EGPpCD_tPreTrbn__tExhaust_DLen1" 404 "AC_pwrDes__pwr_DLen1" 405 "Alt_pwrDes__pwr_DLen1" 406 "SrvPmp_pwrDes__pwr_DLen1" 407 "SvLp_dOilLoad__NoUnit_DLen1" 408 "SvLp_dSootLoad__NoUnit_DLen1" 409 "Dfp_LSUCDCircPumpCur0_Low__OneToOne_DLen1" 410 "Dfp_LSUCDCircVirtGnd0_Low__OneToOne_DLen1" 411 "Dfp_LSUCDHtCoup0_Low__OneToOne_DLen1" 412 "Dfp_LSUCDO20_Low__OneToOne_DLen1" 413 "Dfp_LSUCDHeater0_Low__OneToOne_DLen1" 414 "Dfp_LSUCDO2Clb0_Low__OneToOne_DLen1" 415 "Dfp_LSUCDRiClb0_Low__OneToOne_DLen1" 416 "Dfp_LSUCDSPI0_Low__OneToOne_DLen1" 417 "Dfp_LSUCDWireIP0_Low__OneToOne_DLen1" 418 "Dfp_LSUCtlRiExc0_Low__OneToOne_DLen1" 419 "Dfp_LSUMonFullLd_Low__LowByte_DLen1" 420 "Dfp_LSUMonPartLd_Low__LowByte_DLen1" 421 "Dfp_HWEMonEEPROM_Low__OneToOne_DLen1" 422 "Dfp_HWEMonCom_Low__OneToOne_DLen1" 423 "Ad_NumTyp_FreeApplic1_CSTR__FreeApplic1_DLen1" 424 "Ad_NumTyp_FreeApplic2_CSTR__FreeApplic2_DLen1" 425 "Ad_NumTyp_FreeApplic3_CSTR__FreeApplic3_DLen1" 426 "Ad_NumTyp_FreeApplic4_CSTR__FreeApplic4_DLen1" 427 "AFSCD_dmAirPerTimeB2__mAirTim_DLen1" 428 "AFSCD_mAirPerCylB1__mAirCyl_DLen1" 429 "AFSCD_mAirPerCylB2__mAirCyl_DLen1" 431 "BPACD_rOut2__dcyc_DLen1" 432 "AFSCD_dmAirPerTimeB1__mAirTim_DLen1" 468 "FrmMng_stNumTOOvrFlowECU[0]__OneToOne_DLen1" 469 "FrmMng_stNumTOOvrFlowECU[1]__OneToOne_DLen1" 470 "FrmMng_stNumTOOvrFlowECU[2]__OneToOne_DLen1" 471 "FrmMng_stNumTOOvrFlowECU[3]__OneToOne_DLen1" 472 "FrmMng_stNumTOOvrFlowECU[4]__OneToOne_DLen1" 473 "FrmMng_stNumTOOvrFlowECU[5]__OneToOne_DLen1" 474 "FrmMng_stNumTOOvrFlowECU[6]__OneToOne_DLen1" 475 "FrmMng_stNumTOOvrFlowECU[7]__OneToOne_DLen1" 476 "FrmMng_stNumTOOvrFlowECU[8]__OneToOne_DLen1" 477 "FrmMng_stNumTOOvrFlowECU[9]__OneToOne_DLen1" 478 "FrmMng_stNumTOOvrFlowECU[10]__OneToOne_DLen1" 479 "FrmMng_stNumTOOvrFlowECU[11]__OneToOne_DLen1" 480 "FrmMng_stNumTOOvrFlowECU[12]__OneToOne_DLen1" 481 "FrmMng_stNumTOOvrFlowECU[13]__OneToOne_DLen1" 482 "FrmMng_stNumTOOvrFlowECU[14]__OneToOne_DLen1" 483 "FrmMng_stNumTOOvrFlowECU[15]__OneToOne_DLen1" 484 "FrmMng_stNumTOOvrFlowECU[16]__OneToOne_DLen1" 485 "FrmMng_stNumTOOvrFlowECU[17]__OneToOne_DLen1" 486 "FrmMng_stNumTOOvrFlowECU[18]__OneToOne_DLen1" 487 "FrmMng_stNumTOOvrFlowECU[19]__OneToOne_DLen1" 488 "FrmMng_stNumTOOvrFlowECU[20]__OneToOne_DLen1" 489 "FrmMng_stNumTOOvrFlowECU[21]__OneToOne_DLen1" 490 "FrmMng_stNumTOOvrFlowECU[22]__OneToOne_DLen1" 491 "FrmMng_stNumTOOvrFlowECU[23]__OneToOne_DLen1" 492 "FrmMng_stNumTOOvrFlowECU[24]__OneToOne_DLen1" 493 "FrmMng_stNumTOOvrFlowECU[25]__OneToOne_DLen1" 494 "FrmMng_stNumTOOvrFlowECU[26]__OneToOne_DLen1" 495 "FrmMng_stNumTOOvrFlowECU[27]__OneToOne_DLen1" 496 "FrmMng_stNumTOOvrFlowECU[28]__OneToOne_DLen1" 497 "FrmMng_stNumTOOvrFlowECU[29]__OneToOne_DLen1" 498 "FrmMng_stNumTOOvrFlowECU[30]__OneToOne_DLen1" 499 "FrmMng_stNumTOOvrFlowECU[31]__OneToOne_DLen1" 526 "EGRVlv_rEGR__r_DLen1" 527 "EGRSCD_rRelPos__dcyc_DLen1" 532 "BPSCD_pIntVal__p_DLen1" 533 "EGRVlv_rDesVal__dcyc_DLen1" 535 "BPASCD_rRelPos__rNeg_DLen1" 536 "FMA_qRaw_mp__qNeg_DLen1" 538 "FMA_facSwtOff__Fact_DLen1" 601 "T50CD_stRxDebVal__OneToOne_DLen1" 602 "CoEng_stEng__OneToOne_DLen1" 603 "StSysCtl_stStrtCncl__LowByte_DLen1" 604 "PrpCtl_stSPTrack_mp__OneToOne_DLen1" 605 "ACCCD_stACC__OneToOne_DLen1" 606 "InjCrv_qLmbdCtl__q_DLen1" 607 "EGSys_stHtgLSU__OneToOne_DLen1" 608 "LSUCD_dcycHtCor__dcyc_DLen1" 609 "EGSys_pExhGas__p_DLen1" 610 "EGSys_dmEG__mAirTim_DLen1" 611 "LSUCD_drO2Adpt__O2diff_DLen1" 612 "LSUCD_stCircModeNewLow__OneToOne_DLen1" 613 "LSU_stPlausChk__OneToOne_DLen1" 614 "LSU_stO2Err__LowByte_DLen1" 615 "PFlt_pPre__p_DLen1" 616 "PFlt_pDiff__pPFlt_DLen1" 617 "PFlt_tPre__tExhaust_DLen1" 623 "PFlt_pDiffOfsValAct_mp__pPFlt_DLen1" 624 "PFlt_qFl_mp__q_DLen1" 625 "PFlt_tiSnceRgn_mp__ti_DLen1" 626 "PFlt_lSnceRgn_mp__l_DLen1" 627 "PFlt_stCntRes__OneToOne_DLen1" 628 "PFlt_numEngPOp_mp__OneToOne_DLen1" 629 "FMA_qIC__qdiff_DLen1" 630 "FMA_stSwtOff__LowByte_DLen1" 631 "EEPCD_stErrSet__OneToOne_DLen1" 632 "EEPCD_stOptErrCodSet__OneToOne_DLen1" 633 "CtTCtl_dcycThst__dcyc_DLen1" 634 "CtTCtl_stCtl__OneToOne_DLen1" 635 "EATSCD_tAir__t_DLen1" 636 "HDSCD_prcAir__r_DLen1" 638 "LSUCD_uO2Raw__u_DLen1" 639 "LSUCD_rO2Adpt__r_DLen1" 640 "PFlt_pDiffOfsValOld_mp__pPFlt_DLen1" 643 "ConvCD_stIlsDebVal__OneToOne_DLen1" 644 "StSysCtl_stT50CDOn__OneToOne_DLen1" 645 "StSysCtl_stT50CDOff__OneToOne_DLen1" 646 "T50CD_stDebVal__OneToOne_DLen1" 653 "AirCtl_mMaxDev_mp__mAirCylGov_DLen1" 654 "AirCtl_mMinDev_mp__mAirCylGov_DLen1" 655 "AirCtl_stDebDef__OneToOne_DLen1" 656 "AFSCD_stPlSetyDrft_mp__LowByte_DLen1" 657 "AFSCD_rAirNorm__Fact_DLen1" 658 "NetMng_stCAN__HighByte_DLen1" 659 "NetMng_stCAN__Byte2_DLen1" 660 "NetMng_stCAN__Byte3_DLen1" 661 "PCR_stPCR_mp__HighByte_DLen1" 662 "CrCtl_stShutOffrev__HighByte_DLen1" 663 "CrCtl_stShutOffrev__Byte2_DLen1" 664 "CrCtl_stShutOffrev__Byte3_DLen1" 665 "LSU_stO2Err__HighByte_DLen1" 666 "FMA_stSwtOff__HighByte_DLen1" 667 "AFSCD_stPlSetyDrft_mp__HighByte_DLen1" 671 "CARB_TstNotUsedMaxU__LowByte_DLen2" 672 "CARB_TstNotUsedMinU__LowByte_DLen2" 673 "CARB_TstNotUsedMaxS__LowByte_DLen2" 674 "CARB_TstNotUsedMinS__LowByte_DLen2" 675 "CARB_TstNotUsedTrue__LowByte_DLen2" 676 "CARB_TstNotUsedFalse__LowByte_DLen2" 681 "CoEng_dvolFlConsAllTot__Cnsmp_DLen1" 682 "EGT_st__Byte3_DLen1" 683 "EGT_st__Byte2_DLen1" 684 "EGT_st__HighByte_DLen1" 685 "EGT_st__LowByte_DLen1" 687 "LSUCD_stO2Valid__LowByte_DLen1" 688 "AirCtl_stEGRClgBypVlv__LowByte_DLen1" 689 "FQlSCD_rFlQlLin__ratio_DLen1" 690 "GlwCD_stLampOut__LowByte_DLen1" 691 "GlwCD_stOutHWE_mp__LowByte_DLen1" 692 "GlwCD_rGSK__dcyc_DLen1" 693 "FlPpCD_stFlPp__LowByte_DLen1" 694 "AFVCD_stActrOut__LowByte_DLen1" 695 "FrmMng_prcFan__dcyc_DLen1" 696 "EGPpCD_tLinPreTrbn__tExhaust_DLen1" 697 "EngPrt_facPrtLimCorr__Fact_DLen1" 698 "EngPrt_tPreTrbn__t_DLen1" 699 "FrmMng_trqFrcCan__trq_DLen1" 700 "CoVeh_trqAcs__trq_DLen1" 701 "CoEng_trqMin__trq_DLen1" 702 "BPSCD_pAvgDiff__pDiff_DLen1" 703 "IndSys_pAdj__pDiff_DLen1" 704 "BPSCD_ctAvg__OneToOne_DLen1" 705 "CtT_stCondMon__LowByte_DLen1" 706 "CtT_tAir__t_DLen1" 707 "SvLp_dOilLoadWIV2__NoUnitII_DLen1" 708 "SvLp_dSootLoadWIV2__NoUnitII_DLen1" 709 "CARB_stRdyCurrABCD__LowByte_DLen1" 710 "CARB_stRdyCurrABCD__HighByte_DLen1" 711 "CARB_stRdyCurrABCD__Byte2_DLen1" 712 "CARB_stRdyCurrABCD__Byte3_DLen1" 713 "CtT_stCondMon__HighByte_DLen1" 714 "CoEng_ctUnpla__OneToOne_DLen1" 716 "SvLpCD_ltmpMin2__lLvl2_DLen1" 717 "FanCtl_prcAddReq__r_DLen1" 718 "Dfp_LSUMonOvrRun_Low__LowByte_DLen1" 719 "Dfp_LSUMonDyn_Low__LowByte_DLen1" 720 "APPCD_rRawAPP1__r_DLen1" 721 "APPCD_rRawAPP2__r_DLen1" 722 "APPCD_rKDThres__r_DLen1" 727 "Shtrp_ctRemain__OneToOne_DLen1" 728 "Shtrp_numCurrTst__OneToOne_DLen1" 729 "CrCtl_stShutOffrevSig__LowByte_DLen1" 730 "CrCtl_stShutOffirevSig__LowByte_DLen1" 731 "ACCCD_trqDes__trqhigh_DLen1" 732 "ACC_trqDes__trqhigh_DLen1" 733 "ACC_trqBrk__trqhigh_DLen1" 734 "ACCCD_stACC__OneToOne_DLen1__2" 735 "ACCCD_stBrkErr_mp__OneToOne_DLen1" 736 "ACCCD_stSensErr_mp__OneToOne_DLen1" 737 "ACC_stState__OneToOne_DLen1" 738 "ACCCD_aDes__a_DLen1" 739 "ACCCD_phiRoad__phi2_DLen1" 740 "ACC_rBrkDes__r_DLen1" 748 "TVASCD_rRelPos__dcyc_DLen1" 750 "ThrVlv_rDesVal__dcyc_DLen1" 751 "ThrVlv_stMon__LowByte_DLen1" 752 "ThrVlv_stMon__HighByte_DLen1" 753 "ThrVlv_rTVA__dcyc_DLen1" 755 "StSysCtl_stStrtCncl_mp__LowByte_DLen1" 756 "StSysCtl_stStrtCncl_mp__HighByte_DLen1" 757 "FrmMng_rChrgr1Actr__dcyc_DLen1" 758 "FrmMng_tChrgr1ASIC__tExhaust_DLen1" 759 "FrmMng_rChrgr2Actr__dcyc_DLen1" 760 "FrmMng_tChrgr2ASIC__tExhaust_DLen1" 761 "Shtrp_ActFreeTstTog__OneToOne_DLen1" 762 "PFlt_tSimPstPFlt_mp__tExhaust_DLen1" 763 "FrmMng_volFuelFil__volLiter_DLen1" 764 "CtT_tClntMod__t_DLen1" 765 "InjCrv_stT3Dia_mp__LowByte_DLen1" 766 "InjCrv_stT3Dia_mp__HighByte_DLen1" 767 "InjCrv_ctT3DiaMin_mp__OneToOne_DLen1" 768 "InjCrv_tT3DiaMin_mp__tExhaust_DLen1" 769 "EGRCD_stCBVOutHWE_mp__LowByte_DLen1" 770 "FlClgCD_stFlClg__LowByte_DLen1" 771 "DIUMPR_ctIgn_mp__ct_DLen1" 772 "DIUMPR_ctGenDenom_mp__ct_DLen1" 773 "TVASCD_rDrftOpn_mp__dcycNeghighres_DLen1" 774 "TVASCD_rDrftCls_mp__dcycNeghighres_DLen1" 775 "WDASCD_stWntrSwtVal__LowByte_DLen1" 776 "WDASCD_stWntrLogVal_mp__LowByte_DLen1" 777 "PFlt_stRlsPlausTemp__OneToOne_DLen1" 778 "PFlt_stRlsPlausTempPrePFlt__OneToOne_DLen1" 779 "PFlt_stRlsPlausTempPreOxiC__OneToOne_DLen1" 780 "PFlt_stRlsPlausTempPreTrbn__OneToOne_DLen1" 781 "PFlt_stRlsPlausTempPstPFlt__OneToOne_DLen1" 1000 "BIP_tiDvtFltMI1[1]__tius_DLen1" 1001 "BIP_tiDvtFltMI1[2]__tius_DLen1" 1002 "BIP_tiDvtFltMI1[3]__tius_DLen1" 1003 "BIP_tiDvtFltMI1[4]__tius_DLen1" 1004 "BIP_tiDvtFltMI1[5]__tius_DLen1" 1005 "BIP_tiDvtFltMI1[6]__tius_DLen1" 1006 "BIP_tiDvtFltMI1[7]__tius_DLen1" 1007 "BIP_tiDvtFltMI1[8]__tius_DLen1" 1008 "BIP_tiDvtFltMI1[9]__tius_DLen1" 1009 "BIP_tiDvtFltMI1[10]__tius_DLen1" 1010 "BIPCD_stBIPDetMI1[1]__OneToOne_DLen1" 1011 "BIPCD_stBIPDetMI1[2]__OneToOne_DLen1" 1012 "BIPCD_stBIPDetMI1[3]__OneToOne_DLen1" 1013 "BIPCD_stBIPDetMI1[4]__OneToOne_DLen1" 1014 "BIPCD_stBIPDetMI1[5]__OneToOne_DLen1" 1015 "BIPCD_stBIPDetMI1[6]__OneToOne_DLen1" 1016 "BIPCD_stBIPDetMI1[7]__OneToOne_DLen1" 1017 "BIPCD_stBIPDetMI1[8]__OneToOne_DLen1" 1018 "BIPCD_stBIPDetMI1[9]__OneToOne_DLen1" 1019 "BIPCD_stBIPDetMI1[10]__OneToOne_DLen1" 1020 "EngM_phiCaSOfsCorr__phi_DLen1" 1021 "InjVCD_stInjVlv_mp__OneToOne_DLen1" 1022 "AFSCD_rAirThrHiPlHi_mp__Fact_DLen1" 1023 "AFSCD_rAirThrLoPlLo_mp__Fact_DLen1" 1024 "InjCrv_qPoI2Des__q_DLen1" 1025 "InjCrv_phiPoI2Des__phiHResol_DLen1" 1026 "InjVlv_phiPoI2Dur__phi_DLen1" 1027 "InjVlv_phiPiI1DurCorr__phi_DLen1" 1028 "InjCrv_qPiI1Des__q_DLen1" 1029 "InjCrv_phiPiI1Des__phiHResol_DLen1" 1030 "InjCrv_qPoI2LmbdOfs__q_DLen1" 1031 "PFlt_tiSumRgnMaxTmr__tisecond_DLen1" 1032 "PFlt_rAshLdLrn_mp__r_DLen1" 1033 "PFlt_rSotSimPres__r_DLen1" 1034 "PFlt_lSum_mp__l_DLen1" 1035 "PFlt_ctRgnLck__LowByte_DLen1" 1036 "PFlt_stCntRes__LowByte_DLen1" 1037 "PFlt_tiOp_mp__tiHour_DLen1" 1038 "IndSys_swtVacMonOn__OneToOne_DLen1" 1044 "BPASCD_rLinRelPos__r_DLen1" 1045 "VSACD_rOut__rNeg_DLen1" 1046 "BIPCD_stBIPDetPiI1[1]__OneToOne_DLen1" 1047 "BIPCD_stBIPDetPiI1[2]__OneToOne_DLen1" 1048 "BIPCD_stBIPDetPiI1[3]__OneToOne_DLen1" 1049 "BIPCD_stBIPDetPiI1[4]__OneToOne_DLen1" 1050 "BIPCD_stBIPDetPiI1[5]__OneToOne_DLen1" 1051 "BIPCD_stBIPDetPiI1[6]__OneToOne_DLen1" 1052 "BIPCD_stBIPDetPiI1[7]__OneToOne_DLen1" 1053 "BIPCD_stBIPDetPiI1[8]__OneToOne_DLen1" 1054 "BIPCD_stBIPDetPiI1[9]__OneToOne_DLen1" 1055 "BIPCD_stBIPDetPiI1[10]__OneToOne_DLen1" 1056 "BIPCD_stBIPDetPoI2[1]__OneToOne_DLen1" 1057 "BIPCD_stBIPDetPoI2[2]__OneToOne_DLen1" 1058 "BIPCD_stBIPDetPoI2[3]__OneToOne_DLen1" 1059 "BIPCD_stBIPDetPoI2[4]__OneToOne_DLen1" 1060 "BIPCD_stBIPDetPoI2[5]__OneToOne_DLen1" 1061 "BIPCD_stBIPDetPoI2[6]__OneToOne_DLen1" 1062 "BIPCD_stBIPDetPoI2[7]__OneToOne_DLen1" 1063 "BIPCD_stBIPDetPoI2[8]__OneToOne_DLen1" 1064 "BIPCD_stBIPDetPoI2[9]__OneToOne_DLen1" 1065 "BIPCD_stBIPDetPoI2[10]__OneToOne_DLen1" 1066 "BIP_tiDvtFltPiI1[1]__tius_DLen1" 1067 "BIP_tiDvtFltPiI1[2]__tius_DLen1" 1068 "BIP_tiDvtFltPiI1[3]__tius_DLen1" 1069 "BIP_tiDvtFltPiI1[4]__tius_DLen1" 1070 "BIP_tiDvtFltPiI1[5]__tius_DLen1" 1071 "BIP_tiDvtFltPiI1[6]__tius_DLen1" 1072 "BIP_tiDvtFltPiI1[7]__tius_DLen1" 1073 "BIP_tiDvtFltPiI1[8]__tius_DLen1" 1074 "BIP_tiDvtFltPiI1[9]__tius_DLen1" 1075 "BIP_tiDvtFltPiI1[10]__tius_DLen1" 1076 "BIP_tiDvtFltPoI2[1]__tius_DLen1" 1077 "BIP_tiDvtFltPoI2[2]__tius_DLen1" 1078 "BIP_tiDvtFltPoI2[3]__tius_DLen1" 1079 "BIP_tiDvtFltPoI2[4]__tius_DLen1" 1080 "BIP_tiDvtFltPoI2[5]__tius_DLen1" 1081 "BIP_tiDvtFltPoI2[6]__tius_DLen1" 1082 "BIP_tiDvtFltPoI2[7]__tius_DLen1" 1083 "BIP_tiDvtFltPoI2[8]__tius_DLen1" 1084 "BIP_tiDvtFltPoI2[9]__tius_DLen1" 1085 "BIP_tiDvtFltPoI2[10]__tius_DLen1" 1086 "PFlt_tFlt__tExhaust_DLen1" 1087 "PFlt_mAshTrmTot__mAsh_DLen1" 1089 "PFlt_rSotRatFlt_mp__r_DLen1" 1091 "PFlt_stCntRes__OneToOne_DLen1__2" 1092 "AddPCD_numStrkRem_mp__stroke_DLen1" 1093 "AddPmp_volAddTotDia_mp__vol_DLen1" 1094 "AddPmp_volAddDia_mp__volHigh_DLen1" 1095 "AddPmp_rAdd_mp__MLperL_DLen1" 1096 "EGRSCD_rOfsLrnLst__dcycNeg_DLen1" 1097 "EGRSCD_stAdapt__LowByte_DLen1" 1098 "BPASCD_rOfs__dcycNeg_DLen1" 1099 "BPASCD_stOfs__LowByte_DLen1" 1100 "FlSCD_volTotal__volLiter_DLen1" 1101 "UAcc_sigEnvDat[0]__LowByte_DLen1" 1102 "UAcc_sigEnvDat[1]__LowByte_DLen1" 1103 "UAcc_sigEnvDat[2]__LowByte_DLen1" 1104 "UAcc_sigEnvDat[3]__LowByte_DLen1" 1105 "UAcc_sigEnvDat[4]__LowByte_DLen1" 1106 "UAcc_sigEnvDat[5]__LowByte_DLen1" 1107 "UAcc_sigEnvDat[6]__LowByte_DLen1" 1108 "PFlt_tPst__tExhaust_DLen1" 1109 "GlwCD_rGSK__r_DLen1" 1110 "AddPCD_uTnkLvlRawVal__u_DLen1" 1111 "InjCrv_stPoI2LmbdT3Ctl__LowByte_DLen1" 1112 "PFlt_tSimPreTrbn_mp__tExhaust_DLen1" 1113 "PFlt_tSimPrePFlt_mp__tExhaust_DLen1" 1114 "DIUMPR_rMBGrp[0]__rDIUMPR_DLen1" 1115 "DIUMPR_rMBGrp[1]__rDIUMPR_DLen1" 1116 "DIUMPR_rMBGrp[2]__rDIUMPR_DLen1" 1117 "DIUMPR_rMBGrp[3]__rDIUMPR_DLen1" 1118 "DIUMPR_rMBGrp[4]__rDIUMPR_DLen1" 1119 "DIUMPR_rMBGrp[5]__rDIUMPR_DLen1" 1120 "DIUMPR_rMBGrp[6]__rDIUMPR_DLen1" 1121 "DIUMPR_rMBGrp[7]__rDIUMPR_DLen1" 1122 "DIUMPR_rMBGrp[8]__rDIUMPR_DLen1" 1123 "DIUMPR_rMBGrp[9]__rDIUMPR_DLen1" 1124 "DIUMPR_rMBGrp[10]__rDIUMPR_DLen1" 1125 "DIUMPR_rMBGrp[11]__rDIUMPR_DLen1" 1126 "DIUMPR_rMBGrp[12]__rDIUMPR_DLen1" 1127 "DIUMPR_rMBGrp[13]__rDIUMPR_DLen1" 1128 "DIUMPR_rMBGrp[14]__rDIUMPR_DLen1" 1129 "PFlt_dvol__dvol_DLen1" 1130 "PFlt_pDiffMinSty_mp__pPFlt_DLen1" 1131 "PFltCD_tPst__tExhaust_DLen1" 1132 "InjCrv_stPoI2LmbdT3Ctl__LowByte_DLen1__2" 1133 "InjCrv_tT3DiaPreNomFlt_mp__tExhaust_DLen1" 1134 "EGRSCD_rTmpOfs__dcycNeghighres_DLen1" 1147 "PFlt_rSotSimMax__r_DLen1" 1148 "EGSys_tOxiCatBrik[0]__tExhaust_DLen1" 1149 "EGSys_tOxiCatBrik[1]__tExhaust_DLen1" 1150 "PFlt_rSotSimTemp__r_DLen1" 1151 "PFlt_facArrhThm_mp__facArrh_DLen1" 1152 "PFlt_mSotSimTemp__mSot_DLen1" /end COMPU_VTAB
/begin COMPU_METHOD SigTstName "Verbale Umrechnung für Stellertest Referenz Nummern" TAB_VERB "%6.3" "[-]" COMPU_TAB_REF SigTstName /end COMPU_METHOD
/begin COMPU_VTAB SigTstName "Verbale Umrechnung für Stellertest Referenz Nummern" TAB_VERB 37 0 "SigTst_AC" 1 "SigTst_AFV" 2 "SigTst_AOHtCDHt1" 3 "SigTst_AOHtCDHt2" 4 "SigTst_AltRLYExc" 5 "SigTst_BPA" 6 "SigTst_BPA2" 7 "SigTst_CtAp" 8 "SigTst_CtT" 9 "SigTst_EGR" 10 "SigTst_EGRClgBypVlv" 11 "SigTst_ENGMENG" 12 "SigTst_ENGMENG1" 13 "SigTst_ENGMENG2" 14 "SigTst_ENGMGEAR" 15 "SigTst_ENGMGEAR1" 16 "SigTst_ENGMGEAR2" 17 "SigTst_EngM" 18 "SigTst_Fan1" 19 "SigTst_Fan2" 20 "SigTst_FlClgCD" 21 "SigTst_FlPpCD" 22 "SigTst_GLWLAMP" 23 "SigTst_GLWRLY" 24 "SigTst_GLWRLYGSK3" 25 "SigTst_LSUCDHt0" 26 "SigTst_MILLAMP" 27 "SigTst_PFltLmp" 28 "SigTst_PFltRLYHtg" 29 "SigTst_PSP" 30 "SigTst_SYSLAMP" 31 "SigTst_StrtCDRLYOffRly" 32 "SigTst_StrtCDRLYOnRly" 33 "SigTst_TVA" 34 "SigTst_VSA" 35 "SigTst_WDAL" 255 "SigTst_unused" /end COMPU_VTAB
/begin COMPU_METHOD TempDiff_Kelv "Offsettemperatur dargestellt in [K]" RAT_FUNC "%6.3" "[ deg C ]" COEFFS 0 10 0 0 0 1 /end COMPU_METHOD
/begin COMPU_METHOD Temp_Cels "Temperatur dargestellt in °C (gleiche interne Darstellung wie Temp_Kelv)" RAT_FUNC "%6.1" "[deg C]" COEFFS 0 10 2731.4 0 0 1 /end COMPU_METHOD
/begin COMPU_METHOD TimeDeb "Entprellzeit in Millisekunden für Libraryfunktion Debounce" RAT_FUNC "%6.1" "[ms]" COEFFS 0 0.1 0 0 0 1 /end COMPU_METHOD
/begin COMPU_METHOD TimeDelay_ms "Zeitkonstante T1 fuer die Bibliotheksfunktionen PT1, DT1, etc.,  in ms angegeben" RAT_FUNC "%9.0" "[ms]" COEFFS 0 0 1 0 2.3283064365387e-07 0 /end COMPU_METHOD
/begin COMPU_METHOD TimeDelay_s "Zeitkonstante T1 (in s) für PT1, DT1, etc." RAT_FUNC "%9.3" "[s]" COEFFS 0 0 1 0 0.00023283064365387 0 /end COMPU_METHOD
/begin COMPU_METHOD Time_DynTst "Zeitumrechung für dynamischen test mit geringerer Auflösung, damit es für KL Ausgang passt" RAT_FUNC "%6.2" "[s]" COEFFS 0 0.390625 0 0 0 1 /end COMPU_METHOD
/begin COMPU_METHOD Time_ms "Zeit in ms für Fehlerentprellung (DSM) und SW-Timer" RAT_FUNC "%6.1" "[ms]" COEFFS 0 0.1 0 0 0 1 /end COMPU_METHOD
/begin COMPU_METHOD Time_s "Zeit in s für Fehlerentprellung (DSM) und SW-Timer" RAT_FUNC "%6.4" "[s]" COEFFS 0 100 0 0 0 1 /end COMPU_METHOD
/begin COMPU_METHOD TrqPerSec "Motormomentengradient" RAT_FUNC "%6.2" "[Nm/s]" COEFFS 0 1 0 0 0 1 /end COMPU_METHOD
/begin COMPU_METHOD TrqPrpHigh "vortriebsmoment" RAT_FUNC "%6.3" "[Nm]" COEFFS 0 10 0 0 0 1 /end COMPU_METHOD
/begin COMPU_METHOD Vel "Fahrzeuggeschwindigkeit, gleiche interne Auflösung wie Vel_SI" RAT_FUNC "%6.4" "[km/h]" COEFFS 0 100 0 0 0 1 /end COMPU_METHOD
/begin COMPU_METHOD Volt "Spannung in V (von ADC)" RAT_FUNC "%6.2" "[mV]" COEFFS 0 0.2046 0 0 0 1 /end COMPU_METHOD
/begin COMPU_METHOD Volt_Batt "Batteriespannung" RAT_FUNC "%6.1" "[mV]" COEFFS 0 0.0492252911173131 0 0 0 1 /end COMPU_METHOD
/begin COMPU_METHOD default "" RAT_FUNC "%6.2" "" COEFFS 0 1 0 0 0 1 /end COMPU_METHOD
/begin RECORD_LAYOUT Kf_Xs16_Ys16_Ws16 NO_AXIS_PTS_X 1 SWORD NO_AXIS_PTS_Y 2 SWORD AXIS_PTS_X 3 SWORD INDEX_INCR DIRECT AXIS_PTS_Y 4 SWORD INDEX_INCR DIRECT FNC_VALUES 5 SWORD COLUMN_DIR DIRECT /end RECORD_LAYOUT
/begin RECORD_LAYOUT Kl_Xs16_Ws16 NO_AXIS_PTS_X 1 SWORD AXIS_PTS_X 2 SWORD INDEX_INCR DIRECT FNC_VALUES 3 SWORD COLUMN_DIR DIRECT /end RECORD_LAYOUT
/begin RECORD_LAYOUT Kwb_Ws16 FNC_VALUES 1 SWORD COLUMN_DIR DIRECT /end RECORD_LAYOUT
/begin RECORD_LAYOUT Kwb_Wu16 FNC_VALUES 1 UWORD COLUMN_DIR DIRECT /end RECORD_LAYOUT
/begin RECORD_LAYOUT Kwb_Wu32 FNC_VALUES 1 ULONG COLUMN_DIR DIRECT /end RECORD_LAYOUT
/begin RECORD_LAYOUT Kwb_Wu8 FNC_VALUES 1 UBYTE COLUMN_DIR DIRECT /end RECORD_LAYOUT
/begin RECORD_LAYOUT Kw_Ws16 FNC_VALUES 1 SWORD COLUMN_DIR DIRECT /end RECORD_LAYOUT
/begin RECORD_LAYOUT Kw_Ws32 FNC_VALUES 1 SLONG COLUMN_DIR DIRECT /end RECORD_LAYOUT
/begin RECORD_LAYOUT Kw_Wu16 FNC_VALUES 1 UWORD COLUMN_DIR DIRECT /end RECORD_LAYOUT
/begin RECORD_LAYOUT Kw_Wu32 FNC_VALUES 1 ULONG COLUMN_DIR DIRECT /end RECORD_LAYOUT
/begin RECORD_LAYOUT Kw_Wu8 FNC_VALUES 1 UBYTE COLUMN_DIR DIRECT /end RECORD_LAYOUT
/begin FUNCTION BPSCD_Co "Komponententreiber des Ladedruckfühlers"
 /begin DEF_CHARACTERISTIC BPSCD_DebSRCHighDef_C BPSCD_DebSRCHighOK_C BPSCD_DebSRCLowDef_C BPSCD_DebSRCLowOK_C BPSCD_DebSigDef_C BPSCD_DebSigOK_C BPSCD_ctAvgMx_C BPSCD_dpRmpSlpDwn_C BPSCD_dpRmpSlpUp_C BPSCD_nLim_C BPSCD_numSSp_C BPSCD_pAdjMax_C BPSCD_pDfl_C BPSCD_pDiffLim_C BPSCD_pLin_CUR BPSCD_stSensIDWord_C BPSCD_swtCorrOn_C BPSCD_swtSigVal_C BPSCD_tiAvgDlyRcy_C BPSCD_tiAvgDly_C BPSCD_tiLPFilt_C BPSCD_tiPT1_C BPSCD_uSRCMax_C BPSCD_uSRCMin_C DSM_CDCDfp_BPSCDPlaus_C DSM_CDKDfp_BPSCDPlaus_C DSM_ClaDfp_BPSCDPlaus_C DSM_EnvDfp_BPSCDPlaus_C DSM_FMKDfp_BPSCDPlaus_C DSM_TypDfp_BPSCDPlaus_C /end DEF_CHARACTERISTIC
/end FUNCTION
/begin FUNCTION BasAdj "Grundeinstellungstest bei externer Diagnoseanforderung" /begin SUB_FUNCTION BasAdj_TogVal /end SUB_FUNCTION /end FUNCTION
/begin FUNCTION BasAdj_TogVal "wechselnder Signalwert der Grundeinstellung"
 /begin DEF_CHARACTERISTIC BasAdj_AFVCDBits_C BasAdj_AFVCDnSetpoint_C BasAdj_AFVCDtime_C BasAdj_EGRBits_C BasAdj_EGRnSetpoint_C BasAdj_EGRtime_C BasAdj_K2SigBlkVal0_MAP BasAdj_K2SigBlkVal1_MAP BasAdj_K2SigBlkVal2_MAP BasAdj_PCRBiTBits_C BasAdj_PCRBiTnSetpoint_C BasAdj_PCRBiTtime_C BasAdj_PCRBits_C BasAdj_PCRnSetpoint_C BasAdj_PCRtime_C BasAdj_PSPBits_C BasAdj_PSPnSetpoint_C BasAdj_PSPtime_C BasAdj_TVABits_C BasAdj_TVAnSetpoint_C BasAdj_TVAtime_C BasAdj_VSA1Bits_C BasAdj_VSA1nSetpoint_C BasAdj_VSA1time_C BasAdj_VSA2Bits_C BasAdj_VSA2nSetpoint_C BasAdj_VSA2time_C BasAdj_VSAMSBits_C BasAdj_VSAMSnSetpoint_C BasAdj_VSAMStime_C BasAdj_nHighEngSpeed_C BasAdj_nMaxShortTrip_C BasAdj_nMax_C BasAdj_nRmpSlpDwn_C BasAdj_nRmpSlpUp_C BasAdj_qMax_C BasAdj_rAccPedMinTresh_C BasAdj_rAirCtlEGR_C BasAdj_rAirCtlTVA_C BasAdj_rPCRBiT_C BasAdj_rPCR_C BasAdj_rTVA_C BasAdj_stAFVCD_C BasAdj_stCmp2TstNum_C BasAdj_stCmpTstNum_C BasAdj_stKickDownlrnNum_C BasAdj_stPSP_C BasAdj_swtCondSave_C BasAdj_swtFcmIgnore_C BasAdj_tiEnd_C BasAdj_tiRoutDemMax_C BasAdj_tiTmrBRK_C BasAdj_tiTmrPWG_C Shtrp_AFSCD_C Shtrp_CompComp_C Shtrp_DfpAFSCD_CA Shtrp_DfpAddPCD_CA Shtrp_DfpBIP_CA Shtrp_DfpEGRBA_CA Shtrp_DfpEGRCBV_CA Shtrp_DfpEGRCD_CA Shtrp_DfpEGRGovDev_CA Shtrp_DfpFreeTstTog_CA Shtrp_DfpGlwCtl_CA Shtrp_DfpLSU_CA Shtrp_DfpMisfire_CA Shtrp_DfpPCRBA_CA Shtrp_DfpPSP_CA Shtrp_DfpT3Gov_CA Shtrp_DfpVSA_CA Shtrp_EGRBA_C Shtrp_EGRBA_ctRepeat_C Shtrp_EGRBA_mDeltaMinDfltTrm_C Shtrp_EGRBA_mDeltaMin_C Shtrp_EGRBA_mMaxDfltTrm_C Shtrp_EGRBA_mMax_C Shtrp_EGRBA_mMinDfltTrm_C Shtrp_EGRBA_mMin_C Shtrp_EGRBA_mTrmMax_C Shtrp_EGRBA_mTrmMin_C Shtrp_EGRBA_tiDelay_C Shtrp_EGRBA_tiDfltTrm_C Shtrp_EGRBA_tiTrmMax_C Shtrp_EGRBA_tiTrmMin_C Shtrp_EGRCD_C Shtrp_EGRGovDev_C Shtrp_EGR_C Shtrp_FreeTstTogPos_C Shtrp_FuelSys_C Shtrp_LSU_C Shtrp_LSUmode_C Shtrp_Misfire_C Shtrp_PCRBA_C Shtrp_PCRBA_ctRepeat_C Shtrp_PCRBA_pDeltaMax_C Shtrp_PCRBA_pDeltaMin_C Shtrp_PCRBA_pMaxDfltTrm_C Shtrp_PCRBA_pMinDfltTrm_C Shtrp_PCRBA_pTrmMax_C Shtrp_PCRBA_pTrmMin_C Shtrp_PCRBA_tiDelay_C Shtrp_PCRBA_tiDfltTrm_C Shtrp_PCRBA_tiTrmMax_C Shtrp_PCRBA_tiTrmMin_C Shtrp_RgnStgT3GovDev_CA Shtrp_T1AFSCDFlt_C Shtrp_T1BPSCDFlt_C Shtrp_T3GovDevMode_CA Shtrp_T3Gov_C Shtrp_T3RmpSlpDwnT3GovDev_C Shtrp_T3RmpSlpUpT3GovDev_C Shtrp_TstTogDemand_C Shtrp_TstTogID_C Shtrp_TstTogVal1_C Shtrp_TstTogVal2_C Shtrp_nAFSCD_C Shtrp_nAddPCD_C Shtrp_nBIP_C Shtrp_nEGRBA_C Shtrp_nEGRCBV_C Shtrp_nEGRCD_C Shtrp_nEGRGovDev_C Shtrp_nFreeTstTog_C Shtrp_nGlwCtl_C Shtrp_nLSUHigh_C Shtrp_nLSUTol_C Shtrp_nMaxShtrp_C Shtrp_nMax_C Shtrp_nMisfire_C Shtrp_nPCRBA_C Shtrp_nPSP_C Shtrp_nRmpSlpDwnLSU_C Shtrp_nRmpSlpDwn_C Shtrp_nRmpSlpUpLSU_C Shtrp_nRmpSlpUp_C Shtrp_nT3GovDev_CA Shtrp_nVSA_C Shtrp_noRdy_C Shtrp_qMax_C Shtrp_rAccPedMinTresh_C Shtrp_rEGRBAActPos_CA Shtrp_rPCRBAActPos_CA Shtrp_rTVA_CA Shtrp_stReleaseType_C Shtrp_swtFcmIgnore_C Shtrp_tClntGovDevRelease_C Shtrp_tT3GovDevRelease_C Shtrp_tiBetweenTogVal_C Shtrp_tiEnd_C Shtrp_tiEngSpdReached_C Shtrp_tiLSU_C Shtrp_tiRoutDemMax_C Shtrp_tiT3GovDev_CA Shtrp_tiTestAbort_C Shtrp_tiTmrBRK_C Shtrp_tiTmrPWG_C /end DEF_CHARACTERISTIC
/end FUNCTION
/begin FUNCTION Batt "Batterie" /begin SUB_FUNCTION BattCD /end SUB_FUNCTION /end FUNCTION
/begin FUNCTION BattCD "Komponententreiber Batteriespannung"
 /begin DEF_CHARACTERISTIC BattCD_duRmpSlpDwn_C BattCD_duRmpSlpUp_C BattCD_stSensIDWord_C BattCD_tiDebSRCHighDef_C BattCD_tiDebSRCHighOk_C BattCD_tiDebSRCLowDef_C BattCD_tiDebSRCLowOk_C BattCD_uDfl_C BattCD_uLin_CUR BattCD_uSRCMax_C BattCD_uSRCMin_C BattCD_vLim_C /end DEF_CHARACTERISTIC
/end FUNCTION
/begin FUNCTION Batt_CorFac_Proc "Berechnung des Korrekturfaktors für die Batteriespannung für PWM Endstufen" /begin DEF_CHARACTERISTIC Batt_facCor_CUR /end DEF_CHARACTERISTIC /end FUNCTION
/begin FUNCTION Boost_Pressure "Ladedruckregelung (LDR)" /begin SUB_FUNCTION BPACD_Co PCR /end SUB_FUNCTION /end FUNCTION
/begin FUNCTION BrkCD_Co "Komponententreiber zur Erfassung aller Bremssignale"
 /begin DEF_CHARACTERISTIC BrkCD_DebBPTInvldDef_C BrkCD_DebBPTInvldOk_C BrkCD_DebSRCHighDef_C BrkCD_DebSRCHighOk_C BrkCD_DebSRCLowDef_C BrkCD_DebSRCLowOk_C BrkCD_DebdynPlaDef_C BrkCD_DebdynPlaOk_C BrkCD_dtRmpSlpDwn_C BrkCD_dtRmpSlpUp_C BrkCD_numStepDef_C BrkCD_numStepOK_C BrkCD_stBrk8ErrMsk_C BrkCD_stBrk_Invalid_C BrkCD_stDflVal_C BrkCD_stMnSwtInvIn_C BrkCD_stRedSwtInvIn_C BrkCD_stSensIDWord_C BrkCD_swtRedSwtPresent_C BrkCD_swtSigVal_C BrkCD_tiBREdyn_C BrkCD_tiBREiO_C BrkCD_tiMnSwtDebNeg_C BrkCD_tiMnSwtDebPos_C BrkCD_tiRedSwtDebNeg_C BrkCD_tiRedSwtDebPos_C BrkCD_uDfl_C BrkCD_uMnSwtA2DThres_C BrkCD_uMnSwtLin_CUR BrkCD_uMnSwtSRCMax_C BrkCD_uMnSwtSRCMin_C /end DEF_CHARACTERISTIC
/end FUNCTION
/begin FUNCTION Bypass "Bypass-Labels"
 /begin DEF_CHARACTERISTIC ACCCD_stACC_Channel ACCCD_stACC_Vector ACCCD_stACCnew_Channel ACCCD_stACCnew_Vector ACCCD_stBrk_Channel ACCCD_stBrk_Vector ACC_stCrCtl_Channel ACC_stCrCtl_Vector ACC_stDrvBrk_Channel ACC_stDrvBrk_Vector ACC_stOvrRun_Channel ACC_stOvrRun_Vector ACC_trqDes_Channel ACC_trqDes_Vector ACC_trqLead_Channel ACC_trqLead_Vector AFSCD_dmAirPerTime_Channel AFSCD_dmAirPerTime_Vector AFSCD_mAirPerCylPlsCor_Channel AFSCD_mAirPerCylPlsCor_Vector AFSCD_mAirPerCyl_Channel AFSCD_mAirPerCyl_Vector ASDdc_trq_Channel ASDdc_trq_Vector ASDrf_trqInr_Channel ASDrf_trqInr_Vector AccPed_rChkdVal_Channel AccPed_rChkdVal_Vector AccPed_trqDes_Channel AccPed_trqDes_Vector AccPed_trqLead_Channel AccPed_trqLead_Vector AirCtl_mDesValAdd_Channel AirCtl_mDesValAdd_Vector AirCtl_mDesVal_Channel AirCtl_mDesVal_Vector AirCtl_rCtlVal_Channel AirCtl_rCtlVal_Vector AirCtl_rEGRAdd_Channel AirCtl_rEGRAdd_Vector AirCtl_rEGR_Channel AirCtl_rEGR_Vector AirCtl_rTVAAdd_Channel AirCtl_rTVAAdd_Vector AirCtl_rTVA_Channel AirCtl_rTVA_Vector AirCtl_stEGRClgBypVlv_Channel AirCtl_stEGRClgBypVlv_Vector Alt_pwrDes_Channel Alt_pwrDes_Vector BIP_tiSetPointCtrMI1_Channel BIP_tiSetPointCtrMI1_Vector BIP_tiSetPointCtrPiI1_Channel BIP_tiSetPointCtrPiI1_Vector BIP_tiSetPointCtrPoI2_Channel BIP_tiSetPointCtrPoI2_Vector BypEtk_dNsyncStimuli16_C BypEtk_dNsyncStimuli32_C BypEtk_dNsyncStimuli64_C BypEtk_dNsyncStimuli8_C BypEtk_dTsyncStimuli16_C BypEtk_dTsyncStimuli32_C BypEtk_dTsyncStimuli64_C BypEtk_dTsyncStimuli8_C BypEtk_stAscet_C BypInt_adFunc_C BypInt_stAscet_C CoEng_trqInrCurrFast_Channel CoEng_trqInrCurrFast_Vector CoEng_trqInrDesFast_Channel CoEng_trqInrDesFast_Vector CoEng_trqInrDesSlow_Channel CoEng_trqInrDesSlow_Vector CoEng_trqInrDrvSlow_Channel CoEng_trqInrDrvSlow_Vector CoEng_trqInrPCtl_mp_Channel CoEng_trqInrPCtl_mp_Vector CoEng_trqSlpLim_Channel CoEng_trqSlpLim_Vector CoVeh_trqPrpDes_Channel CoVeh_trqPrpDes_Vector CoVeh_trqPrpLead_Channel CoVeh_trqPrpLead_Vector CrCCD_stKey_Channel CrCCD_stKey_Vector CrCtl_stBlocking_Channel CrCtl_stBlocking_Vector CrCtl_stKeyStateSig_Channel CrCtl_stKeyStateSig_Vector CrCtl_stOvrRun_Channel CrCtl_stOvrRun_Vector CrCtl_trqDes_Channel CrCtl_trqDes_Vector CrCtl_trqLead_Channel CrCtl_trqLead_Vector CrCtl_vSetPointTrgt_Channel CrCtl_vSetPointTrgt_Vector CtApCD_rHWE_mp_Channel CtApCD_rHWE_mp_Vector CtTCtl_dcycThst_Channel CtTCtl_dcycThst_Vector EGRCD_rOut_Channel EGRCD_rOut_Vector EGRVlv_rEGR_Channel EGRVlv_rEGR_Vector EGT_st_Channel EGT_st_Vector EngM_trqFrcMin_Channel EngM_trqFrcMin_Vector EngM_trqFrc_Channel EngM_trqFrc_Vector FBC_lrn_Channel FBC_lrn_Vector FBC_q_Channel FBC_q_Vector FMTC_etaCurr_Channel FMTC_etaCurr_Vector FanCtl_prcCAN_Channel FanCtl_prcCAN_Vector FlMng_qLimSmk_Channel FlMng_qLimSmk_Vector FrmMng_stSendEng6_B1_Channel FrmMng_stSendEng6_B1_Vector FrmMng_stSendEng6_B2_Channel FrmMng_stSendEng6_B2_Vector FrmMng_stSendEng6_B3_Channel FrmMng_stSendEng6_B3_Vector FrmMng_stSendEng6_B4_Channel FrmMng_stSendEng6_B4_Vector FrmMng_stSendEng6_B5_Channel FrmMng_stSendEng6_B5_Vector FrmMng_stSendEng6_B6_Channel FrmMng_stSendEng6_B6_Vector FrmMng_stSendEng6_B7_Channel FrmMng_stSendEng6_B7_Vector FrmMng_stSendEng6_B8_Channel FrmMng_stSendEng6_B8_Vector FrmMng_stSendEngTrq1_B1_Channel FrmMng_stSendEngTrq1_B1_Vector FrmMng_stSendEngTrq1_B2_Channel FrmMng_stSendEngTrq1_B2_Vector FrmMng_stSendEngTrq1_B3_Channel FrmMng_stSendEngTrq1_B3_Vector FrmMng_stSendEngTrq1_B4_Channel FrmMng_stSendEngTrq1_B4_Vector FrmMng_stSendEngTrq1_B5_Channel FrmMng_stSendEngTrq1_B5_Vector FrmMng_stSendEngTrq1_B6_Channel FrmMng_stSendEngTrq1_B6_Vector FrmMng_stSendEngTrq1_B7_Channel FrmMng_stSendEngTrq1_B7_Vector FrmMng_stSendEngTrq1_B8_Channel FrmMng_stSendEngTrq1_B8_Vector FrmMng_stSendEngTrq2_B1_Channel FrmMng_stSendEngTrq2_B1_Vector FrmMng_stSendEngTrq2_B2_Channel FrmMng_stSendEngTrq2_B2_Vector FrmMng_stSendEngTrq2_B3_Channel FrmMng_stSendEngTrq2_B3_Vector FrmMng_stSendEngTrq2_B4_Channel FrmMng_stSendEngTrq2_B4_Vector FrmMng_stSendEngTrq2_B5_Channel FrmMng_stSendEngTrq2_B5_Vector FrmMng_stSendEngTrq2_B6_Channel FrmMng_stSendEngTrq2_B6_Vector FrmMng_stSendEngTrq2_B7_Channel FrmMng_stSendEngTrq2_B7_Vector FrmMng_stSendEngTrq2_B8_Channel FrmMng_stSendEngTrq2_B8_Vector FrmMng_stSendEngTrq3_B1_Channel FrmMng_stSendEngTrq3_B1_Vector FrmMng_stSendEngTrq3_B2_Channel FrmMng_stSendEngTrq3_B2_Vector FrmMng_stSendEngTrq3_B3_Channel FrmMng_stSendEngTrq3_B3_Vector FrmMng_stSendEngTrq3_B4_Channel FrmMng_stSendEngTrq3_B4_Vector FrmMng_stSendEngTrq3_B5_Channel FrmMng_stSendEngTrq3_B5_Vector FrmMng_stSendEngTrq3_B6_Channel FrmMng_stSendEngTrq3_B6_Vector FrmMng_stSendEngTrq3_B7_Channel FrmMng_stSendEngTrq3_B7_Vector FrmMng_stSendEngTrq3_B8_Channel FrmMng_stSendEngTrq3_B8_Vector Gearbx_trqInMax_Channel Gearbx_trqInMax_Vector IndSys_rVSAAdd_Channel IndSys_rVSAAdd_Vector IndSys_rVSA_Channel IndSys_rVSA_Vector InjCrv_phiMI1Des_Channel InjCrv_phiMI1Des_Vector InjCrv_phiPiI1Des_Channel InjCrv_phiPiI1Des_Vector InjCrv_phiPoI2Des_Channel InjCrv_phiPoI2Des_Vector InjCrv_qMI1Des_Channel InjCrv_qMI1Des_Vector InjCrv_qPiI1Des_Channel InjCrv_qPiI1Des_Vector InjCrv_qPoI2Des_Channel InjCrv_qPoI2Des_Vector InjCrv_qPoI2HCCylCor_Channel InjCrv_qPoI2HCCylCor_Vector InjCrv_qPoI2HCFBCCor_Channel InjCrv_qPoI2HCFBCCor_Vector InjCrv_qPoI2HCTrqCor_Channel InjCrv_qPoI2HCTrqCor_Vector InjCrv_stPoI2HCOff_Channel InjCrv_stPoI2HCOff_Vector InjUn_qMI1DesCorr_Channel InjUn_qMI1DesCorr_Vector InjUn_qPiI1DesCorr_Channel InjUn_qPiI1DesCorr_Vector InjUn_qPoI2DesCorr_Channel InjUn_qPoI2DesCorr_Vector InjVlv_phiMI1Dur_Channel InjVlv_phiMI1Dur_Vector InjVlv_phiPiI1Dur_Channel InjVlv_phiPiI1Dur_Vector InjVlv_phiPoI2Dur_Channel InjVlv_phiPoI2Dur_Vector LIGov_nSetpoint_Channel LIGov_nSetpoint_Vector LIGov_trq_Channel LIGov_trq_Vector PCR_pBDes_Channel PCR_pBDes_Vector PCR_qCtl_Channel PCR_qCtl_Vector PCR_rBPACD_Channel PCR_rBPACD_Vector PCR_rBPCtl_Channel PCR_rBPCtl_Vector PCR_rBPGov_Channel PCR_rBPGov_Vector PFlt_numRgn_mp_Channel PFlt_numRgn_mp_Vector PFlt_rSotSimPres_Channel PFlt_rSotSimPres_Vector PFlt_stEngPOp_Channel PFlt_stEngPOp_Vector PrpCtl_MaxSpdLimEEP_mp_Channel PrpCtl_MaxSpdLimEEP_mp_Vector PrpCtl_stSPTrack_mp_Channel PrpCtl_stSPTrack_mp_Vector PrpCtl_trqGovLim_mp_Channel PrpCtl_trqGovLim_mp_Vector PrpCtl_trqSpdLim_Channel PrpCtl_trqSpdLim_Vector PrpCtl_vCurrTrack_mp_Channel PrpCtl_vCurrTrack_mp_Vector PrpCtl_vMaxAWD_Channel PrpCtl_vMaxAWD_Vector PrpCtl_vMaxNiveau_Channel PrpCtl_vMaxNiveau_Vector Prp_rAPP_Channel Prp_rAPP_Vector Prp_rVirtAPP_Channel Prp_rVirtAPP_Vector SvLp_dSootLoadWIV2_Channel SvLp_dSootLoadWIV2_Vector SvLp_dSootLoad_Channel SvLp_dSootLoad_Vector T50CD_stDebVal_Channel T50CD_stDebVal_Vector T50CD_stRxDebVal_Channel T50CD_stRxDebVal_Vector ThrVlv_rTVA_Channel ThrVlv_rTVA_Vector VSACD_rOut_Channel VSACD_rOut_Vector /end DEF_CHARACTERISTIC
/end FUNCTION
/begin FUNCTION CCP_Config "CCP Konfiguration" /begin DEF_CHARACTERISTIC CcpAcquisitionConfig /end DEF_CHARACTERISTIC /end FUNCTION
/begin FUNCTION COTSCD_Co "Koordinator für den Komponentetreiber der Wassertemperatur am Kühleraustritt"
 /begin DEF_CHARACTERISTIC COTSCD_DebSRCHighDef_C COTSCD_DebSRCHighOk_C COTSCD_DebSRCLowDef_C COTSCD_DebSRCLowOk_C COTSCD_dtRmpSlpDwn_C COTSCD_dtRmpSlpUp_C COTSCD_stSensIDWord_C COTSCD_tDfl_C COTSCD_tLin_CUR COTSCD_uSRCMax_C COTSCD_uSRCMin_C /end DEF_CHARACTERISTIC
/end FUNCTION
/begin FUNCTION CTSCD_Co "Wassertemperaturfühler Komponententreiber"
 /begin DEF_CHARACTERISTIC CTSCD_DebCanDefDef_C CTSCD_DebCanDefOk_C CTSCD_DebCanInacDef_C CTSCD_DebCanInacOk_C CTSCD_DebCanNotImplDef_C CTSCD_DebCanNotImplOk_C CTSCD_DebSRCHighDef_C CTSCD_DebSRCHighOk_C CTSCD_DebSRCLowDef_C CTSCD_DebSRCLowOk_C CTSCD_FTS4CTS_C CTSCD_dtClntDelta_C CTSCD_dtRmpSlpDwn_C CTSCD_dtRmpSlpUp_C CTSCD_stInvPullup_C CTSCD_stSensIDWord_C CTSCD_swtLampMode_C CTSCD_swtPullupOn_C CTSCD_swtSigVal_C CTSCD_swtTempDflType_C CTSCD_swtTempDflVal_C CTSCD_tCTSCanPrtMax_C CTSCD_tCTSCanPrtMin_C CTSCD_tCTSPrtMax_C CTSCD_tCTSPrtMin_C CTSCD_tCTSWrnMax_C CTSCD_tCTSWrnMin_C CTSCD_tCTSZoomOnMax_C CTSCD_tCTSZoomOnMin_C CTSCD_tDfl_C CTSCD_tLinZoom_CUR CTSCD_tLin_CUR CTSCD_tiZoomOFF_C CTSCD_tiZoomON_C CTSCD_uSRCMaxZoom_C CTSCD_uSRCMax_C CTSCD_uSRCMinZoom_C CTSCD_uSRCMin_C /end DEF_CHARACTERISTIC
/end FUNCTION
/begin FUNCTION CaS "Nockenwelle" /begin SUB_FUNCTION CaSCD /end SUB_FUNCTION /end FUNCTION
/begin FUNCTION CaSCD "Komponententreiber Nockenwelle" /begin SUB_FUNCTION CaSCD_Co /end SUB_FUNCTION /end FUNCTION
/begin FUNCTION CaSCD_Co "Komponententreiber Nockenwelle" /begin DEF_CHARACTERISTIC CaSCD_nEvalOfsStop_C /end DEF_CHARACTERISTIC /end FUNCTION
/begin FUNCTION CaSCD_Pos "Nockenwellenposition"
 /begin DEF_CHARACTERISTIC CaSCD_ctAddTooth_C CaSCD_ctErrSegLen2Pos_C CaSCD_ctMissTooth_C CaSCD_dSegSeriesCor_C CaSCD_dSegSeries_C CaSCD_dTrigMsk_C CaSCD_dTrigRslt_C CaSCD_nMaxCor_C CaSCD_nMinCor_C CaSCD_numIntStrtCor_C CaSCD_numReSyncCor_C CaSCD_numSegSeriesStrtCor_C CaSCD_numTDCStrtCor_C CaSCD_phiHys1Cor_C CaSCD_phiHys2Cor_C CaSCD_phiPosTolc_C CaSCD_phiSegLenCor_C CaSCD_phiSegLenTolc_C CaSCD_phiSegLen_C CaSCD_phiSegOfs_C CaSCD_phiTrig_C CaSCD_stEdgeTrig_C CaSCD_stPinState_C CaSCD_stTPO_C CaSCD_swtEnaSegCor_C CaSCD_swtSegLenPin2Pos_C /end DEF_CHARACTERISTIC
/end FUNCTION
/begin FUNCTION CaSCD_Spd "Nockenwellendrehzahl"
 /begin DEF_CHARACTERISTIC CaSCD_facPlausHigh_CUR CaSCD_facPlausLow_CUR CaSCD_nMinSpeed_C CaSCD_phiSpeedCalcTolc_C CaSCD_phiSpeedSegLen_C CaSCD_phiSpeedSegOfs_C CaSCD_stCalc_C CaSCD_tiPeriodRev1Max_C CaSCD_tiPeriodRev2Max_C CaSCD_tiTimOutOfs_C /end DEF_CHARACTERISTIC
/end FUNCTION
/begin FUNCTION Calibration_Interface "Applikationsschnittstelle"
 /begin DEF_CHARACTERISTIC UAddr_stCalibration_C USAp_CodeTbl1_CA USAp_CodeTbl2_CA USAp_dCodeTblInv_C USAp_dCodeTbl_C USAp_dDatasetType_C /end DEF_CHARACTERISTIC
/end FUNCTION
/begin FUNCTION Carb_Co "CARB Einstellungskoordinator"
 /begin DEF_CHARACTERISTIC CARB_Mode1PID1D_C CARB_Mode1PID4FB_C CARB_Mode1PID4F_C Carb_Mode1PID_CA Carb_Mode1Signal_CA Carb_Mode2PID_CA Carb_Mode2Signal_CA Carb_Mode3SwtDia_C Carb_Mode4RefVal_C Carb_Mode4SigNum_C Carb_Mode9PID0_C Carb_Mode9PID1_C Carb_Mode9PID2_C Carb_Mode9PID3_C Carb_Mode9PID4_C Carb_Mode9PID5_C Carb_Mode9PID6_C Carb_Mode9PID7_C Carb_Mode9PID8_C Carb_stOBDMedia_C VehDa_nCarbThres_C /end DEF_CHARACTERISTIC
/end FUNCTION
/begin FUNCTION Clg_DynTst "dynamische Plausibilisierung der Wassertemperatur"
 /begin DEF_CHARACTERISTIC Clg_dtMinDynTst_C Clg_nMinEnaDynTst_C Clg_qMinEnaDynTst_C Clg_tMinClntDynTst_C Clg_tiInitTmr_C Clg_tiMaxDynTst_CUR /end DEF_CHARACTERISTIC
/end FUNCTION
/begin FUNCTION CmbChb_Misfire "Brennräume Fehlzündungserkennung"
 /begin DEF_CHARACTERISTIC CmbChb_ctEngRevPerBlk_C CmbChb_ctMisfireMax_C CmbChb_ctSegTDC1_C CmbChb_dnSegMin_C CmbChb_nAvrgThrHi_C CmbChb_nAvrgThrLo_C CmbChb_numBlk_C CmbChb_phiCmbLim_CUR CmbChb_qRawThrHi_C CmbChb_qRawThrLo_C CmbChb_swtMonClutchType_C CmbChb_swtMonClutchVal_C CmbChb_swtPoI2HCMisf_C CmbChb_tClntThrLo_C CmbChb_tiDebClutchChng_C CmbChb_tiDlyStr_C CmbChb_vThrHi_C /end DEF_CHARACTERISTIC
/end FUNCTION
/begin FUNCTION CoDT "Triebstrangkoordinator" /begin SUB_FUNCTION CoDT_CheckGrip CoDT_DrvTrnCord CoDT_PrpTrqRngCalc /end SUB_FUNCTION /end FUNCTION
/begin FUNCTION CoDT_CheckGrip "Erkennung Kraftschluß im Antriebsstrang" /begin DEF_CHARACTERISTIC CoDT_tiGripDeb_C CoDT_vGrip_C /end DEF_CHARACTERISTIC /end FUNCTION
/begin FUNCTION CoDT_DrvTrnCord "Antriebs-Koordination"
 /begin DEF_CHARACTERISTIC CoDT_dtrqLimDwnCurr_C CoDT_dtrqLimDwnLead_C CoDT_dtrqLimUpCurr_C CoDT_dtrqLimUpLead_C CoDT_dtrqSlpLimErr_CUR CoDT_dtrqSlpLimMin_C CoDT_dtrqSlpLimSub_CUR CoDT_swtCoTypeType_C CoDT_swtCoTypeVal_C CoDT_swtSlpLimEna_C CoDT_tiTrqRedMaxCurr_C CoDT_tiTrqRedMaxLead_C /end DEF_CHARACTERISTIC
/end FUNCTION
/begin FUNCTION CoDT_PrpTrqRngCalc "Bereitstellung Momentenintervall"
 /begin DEF_CHARACTERISTIC CoDT_swtCrCtlNoComp_C CoDT_tiCompDwn_C CoDT_tiCompUp_C CoDT_tiFltPT1_C CoDT_tiOvrRunDebNeg_C CoDT_tiOvrRunDebPos_C CoDT_trqMinInit_C /end DEF_CHARACTERISTIC
/end FUNCTION
/begin FUNCTION CoEng_ActrPrt "Steuerung Stellerschutz" /begin DEF_CHARACTERISTIC CoEng_nActrRelease_C CoEng_tiActrPrt_C /end DEF_CHARACTERISTIC /end FUNCTION
/begin FUNCTION CoEng_AftRunExtWait "Warten auf externe Ereignisse während Nachlauf" /begin DEF_CHARACTERISTIC CoEng_ExtWaitMsk_C /end DEF_CHARACTERISTIC /end FUNCTION
/begin FUNCTION CoEng_Afterrun "Nachlaufsteuerung"
 /begin DEF_CHARACTERISTIC CoEng_tiAftRun_ImmCtl_C CoEng_tiEep_ImmCtl_C CoEng_tiMinAftRun_C CoEng_tiPwrStgDiaRdy_C CoEng_tiSOPTstRdy_C CoEng_tiTVAClsd_C CoEng_tiTVAOpn_C /end DEF_CHARACTERISTIC
/end FUNCTION
/begin FUNCTION CoEng_FlConsum "Verbrauchsberechnung"
 /begin DEF_CHARACTERISTIC CoEng_facCorValTot_C CoEng_facCorVal_C CoEng_facFlConsAllCorVal_C CoEng_rhoFuel_C CoEng_swtFlConsAllCorActv_C CoEng_swtFlConsDsplVal_C CoEng_tiPT1_C /end DEF_CHARACTERISTIC
/end FUNCTION
/begin FUNCTION CoEng_Mon "Abschaltkoordinator"
 /begin DEF_CHARACTERISTIC CoEng_nTVAClsd_C CoEng_pTVAClsd_C CoEng_qTVAClsd_C CoEng_stIRevShutOff_C CoEng_stRevShutOff_C CoEng_stShOffAirbFrnt_C CoEng_stShOffAirbFuel_C CoEng_stShOffAirbRear_C CoEng_stShOffAirbSide_C CoEng_stShOffCompTst_C CoEng_stShOffDblCtl_C CoEng_stShOffIRevSys2_C CoEng_stShOffIRevSys_C CoEng_stShOffIRevVeh_C CoEng_stShOffIlsPls_C CoEng_stShOffInjMon_C CoEng_stShOffIrrCmb_C CoEng_stShOffOvrSpd_C CoEng_stShOffPresMin_C CoEng_stShOffRevSys2_C CoEng_stShOffRevSys_C CoEng_stShOffRevVeh_C CoEng_stShOffRlOvrBar_C CoEng_stShOffSV_C CoEng_stShOffTMFWRev_C CoEng_stShOffTSCCod_C /end DEF_CHARACTERISTIC
/end FUNCTION
/begin FUNCTION CoEng_OvrRunCoord "Schubkoordinator"
 /begin DEF_CHARACTERISTIC CoEng_ALSfacActv_C CoEng_FBCfacActv_C CoEng_TAAfacActv_C CoEng_ZFCfacActv_C CoEng_stCoopCapbl_C CoEng_tiOvrRunCoordDebPos_C /end DEF_CHARACTERISTIC
/end FUNCTION
/begin FUNCTION CoEng_PwrStgStateCalc "Endstufenkoordinator" /begin DEF_CHARACTERISTIC CoEng_uLowBattPwrStg_C /end DEF_CHARACTERISTIC /end FUNCTION
/end MODULE
/end PROJECT
