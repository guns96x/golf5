ASAP2_VERSION 1 3
/begin PROJECT X447 "EDC16U34"
/begin HEADER "" VERSION "VAA1" PROJECT_NO X447 /end HEADER
/begin MODULE DIM ""
/begin MOD_COMMON "" BYTE_ORDER MSB_FIRST ALIGNMENT_BYTE 1 ALIGNMENT_WORD 2 ALIGNMENT_LONG 4 ALIGNMENT_FLOAT32_IEEE 4 /end MOD_COMMON
/begin CHARACTERISTIC DSM_Class1Mil_C "Art der MIL Ansteuerung" VALUE 0x1CD73F Kw_Wu8 2.00000000000 Mil 0.00 2.00000000000 FORMAT "%13.11" /end CHARACTERISTIC
/begin CHARACTERISTIC DSM_Class1TFlc_C "Trigger Art für Fehlereintrags Bestätigungsentprellung (->Lampe an)" VALUE 0x1CD740 Kw_Wu8 5.00000000000 ClassTrigger 0.00 5.00000000000 FORMAT "%13.11" /end CHARACTERISTIC
/begin CHARACTERISTIC DSM_Class1Flc_C "Anzahl Triggerereignisse für Fehlereintrags Bestätigungsentprellung (->Lampe an)" VALUE 0x1CD741 Kw_Wu8 255.0 OneToOne 0.00 255.0 FORMAT "%5.1" /end CHARACTERISTIC
/begin CHARACTERISTIC DSM_Class1THlc_C "Trigger Art für Fehlerheilung (->Lampe aus)" VALUE 0x1CD742 Kw_Wu8 5.00000000000 ClassTrigger 0.00 5.00000000000 FORMAT "%13.11" /end CHARACTERISTIC
/begin CHARACTERISTIC DSM_Class1Hlc_C "Anzahl Triggerereignisse für Fehlerheilung (->Lampe aus)" VALUE 0x1CD743 Kw_Wu8 255.0 OneToOne 0.00 255.0 FORMAT "%5.1" /end CHARACTERISTIC
/begin CHARACTERISTIC DSM_Class1Scatt_C "Fehler ist lesbar für OBD Scan tool tester (SCATT) wenn Wert = 1" VALUE 0x1CD744 Kw_Wu8 1.00000000000 Scatt 0.00 1.00000000000 FORMAT "%13.11" /end CHARACTERISTIC
/begin CHARACTERISTIC DSM_Class1TDlcPen_C "Trigger Art für Löschentprellung von nicht bestätigten Fehlern (pending)" VALUE 0x1CD745 Kw_Wu8 3.00000000000 ClassTriggerTDlc 0.00 3.00000000000 FORMAT "%13.11" /end CHARACTERISTIC
/begin CHARACTERISTIC DSM_Class1DlcPen_C "Anzahl Triggerereignisse für die Löschung von nicht bestätigten Fehlern (pending)" VALUE 0x1CD746 Kw_Wu8 255.0 OneToOne 0.00 255.0 FORMAT "%5.1" /end CHARACTERISTIC
/begin CHARACTERISTIC DSM_Class1TDlc_C "Trigger Art für Löschentprellung" VALUE 0x1CD747 Kw_Wu8 3.00000000000 ClassTriggerTDlc 0.00 3.00000000000 FORMAT "%13.11" /end CHARACTERISTIC
/begin CHARACTERISTIC DSM_Class1DlcKd_C "Anzahl Triggerereignisse für die Löschung von Fehlereinträgen mit Status Kundendienst" VALUE 0x1CD748 Kw_Wu8 255.0 OneToOne 0.00 255.0 FORMAT "%5.1" /end CHARACTERISTIC
/begin CHARACTERISTIC DSM_Class1Dlc_C "Anzahl Triggerereignisse für die Löschung von Fehlereinträgen" VALUE 0x1CD749 Kw_Wu8 255.0 OneToOne 0.00 255.0 FORMAT "%5.1" /end CHARACTERISTIC
/begin CHARACTERISTIC DSM_Class1Prio_C "Priorität des Fehlereintrages für Verdrängung und freeze frame Zuordnung" VALUE 0x1CD74A Kw_Wu8 255.0 OneToOne 0.00 255.0 FORMAT "%5.1" /end CHARACTERISTIC
/begin CHARACTERISTIC DSM_Class1SysLamp_C "Art der Systemlampenansteuerung" VALUE 0x1CD74B Kw_Wu8 2.00000000000 SysLamp 0.00 2.00000000000 FORMAT "%13.11" /end CHARACTERISTIC
/begin CHARACTERISTIC DSM_Class1ResErf_C "Verhalten Fehlerflags bei Reset und abgebrochenem Nachlauf" VALUE 0x1CD74C Kw_Wu8 3.00000000000 ResErf 0.00 3.00000000000 FORMAT "%13.11" /end CHARACTERISTIC
/begin CHARACTERISTIC DSM_Class1Readiness_C "Zuordnung Entprellklasse zu Readiness Flags" VALUE 0x1CD74D Kw_Wu8 64.0000000000 Readiness 0.00 64.0000000000 FORMAT "%13.10" /end CHARACTERISTIC
/begin CHARACTERISTIC DSM_Class2Mil_C "Art der MIL Ansteuerung" VALUE 0x1CD74E Kw_Wu8 2.00000000000 Mil 0.00 2.00000000000 FORMAT "%13.11" /end CHARACTERISTIC
/begin CHARACTERISTIC DSM_Class2TFlc_C "Trigger Art für Fehlereintrags Bestätigungsentprellung (->Lampe an)" VALUE 0x1CD74F Kw_Wu8 5.00000000000 ClassTrigger 0.00 5.00000000000 FORMAT "%13.11" /end CHARACTERISTIC
/begin CHARACTERISTIC DSM_Class2Flc_C "Anzahl Triggerereignisse für Fehlereintrags Bestätigungsentprellung (->Lampe an)" VALUE 0x1CD750 Kw_Wu8 255.0 OneToOne 0.00 255.0 FORMAT "%5.1" /end CHARACTERISTIC
/begin CHARACTERISTIC DSM_Class2THlc_C "Trigger Art für Fehlerheilung (->Lampe aus)" VALUE 0x1CD751 Kw_Wu8 5.00000000000 ClassTrigger 0.00 5.00000000000 FORMAT "%13.11" /end CHARACTERISTIC
/begin CHARACTERISTIC DSM_Class2Hlc_C "Anzahl Triggerereignisse für Fehlerheilung (->Lampe aus)" VALUE 0x1CD752 Kw_Wu8 255.0 OneToOne 0.00 255.0 FORMAT "%5.1" /end CHARACTERISTIC
/begin CHARACTERISTIC DSM_Class2Scatt_C "Fehler ist lesbar für OBD Scan tool tester (SCATT) wenn Wert = 1" VALUE 0x1CD753 Kw_Wu8 1.00000000000 Scatt 0.00 1.00000000000 FORMAT "%13.11" /end CHARACTERISTIC
/begin CHARACTERISTIC DSM_Class2TDlcPen_C "Trigger Art für Löschentprellung von nicht bestätigten Fehlern (pending)" VALUE 0x1CD754 Kw_Wu8 3.00000000000 ClassTriggerTDlc 0.00 3.00000000000 FORMAT "%13.11" /end CHARACTERISTIC
/begin CHARACTERISTIC DSM_Class2DlcPen_C "Anzahl Triggerereignisse für die Löschung von nicht bestätigten Fehlern (pending)" VALUE 0x1CD755 Kw_Wu8 255.0 OneToOne 0.00 255.0 FORMAT "%5.1" /end CHARACTERISTIC
/begin CHARACTERISTIC DSM_Class2TDlc_C "Trigger Art für Löschentprellung" VALUE 0x1CD756 Kw_Wu8 3.00000000000 ClassTriggerTDlc 0.00 3.00000000000 FORMAT "%13.11" /end CHARACTERISTIC
/begin CHARACTERISTIC DSM_Class2DlcKd_C "Anzahl Triggerereignisse für die Löschung von Fehlereinträgen mit Status Kundendienst" VALUE 0x1CD757 Kw_Wu8 255.0 OneToOne 0.00 255.0 FORMAT "%5.1" /end CHARACTERISTIC
/begin CHARACTERISTIC DSM_Class2Dlc_C "Anzahl Triggerereignisse für die Löschung von Fehlereinträgen" VALUE 0x1CD758 Kw_Wu8 255.0 OneToOne 0.00 255.0 FORMAT "%5.1" /end CHARACTERISTIC
/begin CHARACTERISTIC DSM_Class2Prio_C "Priorität des Fehlereintrages für Verdrängung und freeze frame Zuordnung" VALUE 0x1CD759 Kw_Wu8 255.0 OneToOne 0.00 255.0 FORMAT "%5.1" /end CHARACTERISTIC
/begin CHARACTERISTIC DSM_Class2SysLamp_C "Art der Systemlampenansteuerung" VALUE 0x1CD75A Kw_Wu8 2.00000000000 SysLamp 0.00 2.00000000000 FORMAT "%13.11" /end CHARACTERISTIC
/begin CHARACTERISTIC DSM_Class2ResErf_C "Verhalten Fehlerflags bei Reset und abgebrochenem Nachlauf" VALUE 0x1CD75B Kw_Wu8 3.00000000000 ResErf 0.00 3.00000000000 FORMAT "%13.11" /end CHARACTERISTIC
/begin CHARACTERISTIC DSM_Class2Readiness_C "Zuordnung Entprellklasse zu Readiness Flags" VALUE 0x1CD75C Kw_Wu8 64.0000000000 Readiness 0.00 64.0000000000 FORMAT "%13.10" /end CHARACTERISTIC
/begin CHARACTERISTIC DSM_Class3Mil_C "Art der MIL Ansteuerung" VALUE 0x1CD75D Kw_Wu8 2.00000000000 Mil 0.00 2.00000000000 FORMAT "%13.11" /end CHARACTERISTIC
/begin CHARACTERISTIC DSM_Class3TFlc_C "Trigger Art für Fehlereintrags Bestätigungsentprellung (->Lampe an)" VALUE 0x1CD75E Kw_Wu8 5.00000000000 ClassTrigger 0.00 5.00000000000 FORMAT "%13.11" /end CHARACTERISTIC
/begin CHARACTERISTIC DSM_Class3Flc_C "Anzahl Triggerereignisse für Fehlereintrags Bestätigungsentprellung (->Lampe an)" VALUE 0x1CD75F Kw_Wu8 255.0 OneToOne 0.00 255.0 FORMAT "%5.1" /end CHARACTERISTIC
/begin CHARACTERISTIC DSM_Class3THlc_C "Trigger Art für Fehlerheilung (->Lampe aus)" VALUE 0x1CD760 Kw_Wu8 5.00000000000 ClassTrigger 0.00 5.00000000000 FORMAT "%13.11" /end CHARACTERISTIC
/begin CHARACTERISTIC DSM_Class3Hlc_C "Anzahl Triggerereignisse für Fehlerheilung (->Lampe aus)" VALUE 0x1CD761 Kw_Wu8 255.0 OneToOne 0.00 255.0 FORMAT "%5.1" /end CHARACTERISTIC
/begin CHARACTERISTIC DSM_Class3Scatt_C "Fehler ist lesbar für OBD Scan tool tester (SCATT) wenn Wert = 1" VALUE 0x1CD762 Kw_Wu8 1.00000000000 Scatt 0.00 1.00000000000 FORMAT "%13.11" /end CHARACTERISTIC
/begin CHARACTERISTIC DSM_Class3TDlcPen_C "Trigger Art für Löschentprellung von nicht bestätigten Fehlern (pending)" VALUE 0x1CD763 Kw_Wu8 3.00000000000 ClassTriggerTDlc 0.00 3.00000000000 FORMAT "%13.11" /end CHARACTERISTIC
/begin CHARACTERISTIC DSM_Class3DlcPen_C "Anzahl Triggerereignisse für die Löschung von nicht bestätigten Fehlern (pending)" VALUE 0x1CD764 Kw_Wu8 255.0 OneToOne 0.00 255.0 FORMAT "%5.1" /end CHARACTERISTIC
/begin CHARACTERISTIC DSM_Class3TDlc_C "Trigger Art für Löschentprellung" VALUE 0x1CD765 Kw_Wu8 3.00000000000 ClassTriggerTDlc 0.00 3.00000000000 FORMAT "%13.11" /end CHARACTERISTIC
/begin CHARACTERISTIC DSM_Class3DlcKd_C "Anzahl Triggerereignisse für die Löschung von Fehlereinträgen mit Status Kundendienst" VALUE 0x1CD766 Kw_Wu8 255.0 OneToOne 0.00 255.0 FORMAT "%5.1" /end CHARACTERISTIC
/begin CHARACTERISTIC DSM_Class3Dlc_C "Anzahl Triggerereignisse für die Löschung von Fehlereinträgen" VALUE 0x1CD767 Kw_Wu8 255.0 OneToOne 0.00 255.0 FORMAT "%5.1" /end CHARACTERISTIC
/begin CHARACTERISTIC DSM_Class3Prio_C "Priorität des Fehlereintrages für Verdrängung und freeze frame Zuordnung" VALUE 0x1CD768 Kw_Wu8 255.0 OneToOne 0.00 255.0 FORMAT "%5.1" /end CHARACTERISTIC
/begin CHARACTERISTIC DSM_Class3SysLamp_C "Art der Systemlampenansteuerung" VALUE 0x1CD769 Kw_Wu8 2.00000000000 SysLamp 0.00 2.00000000000 FORMAT "%13.11" /end CHARACTERISTIC
/begin CHARACTERISTIC DSM_Class3ResErf_C "Verhalten Fehlerflags bei Reset und abgebrochenem Nachlauf" VALUE 0x1CD76A Kw_Wu8 3.00000000000 ResErf 0.00 3.00000000000 FORMAT "%13.11" /end CHARACTERISTIC
/begin CHARACTERISTIC DSM_Class3Readiness_C "Zuordnung Entprellklasse zu Readiness Flags" VALUE 0x1CD76B Kw_Wu8 64.0000000000 Readiness 0.00 64.0000000000 FORMAT "%13.10" /end CHARACTERISTIC
/begin CHARACTERISTIC DSM_Class4Mil_C "Art der MIL Ansteuerung" VALUE 0x1CD76C Kw_Wu8 2.00000000000 Mil 0.00 2.00000000000 FORMAT "%13.11" /end CHARACTERISTIC
/begin CHARACTERISTIC DSM_Class4TFlc_C "Trigger Art für Fehlereintrags Bestätigungsentprellung (->Lampe an)" VALUE 0x1CD76D Kw_Wu8 5.00000000000 ClassTrigger 0.00 5.00000000000 FORMAT "%13.11" /end CHARACTERISTIC
/begin CHARACTERISTIC DSM_Class4Flc_C "Anzahl Triggerereignisse für Fehlereintrags Bestätigungsentprellung (->Lampe an)" VALUE 0x1CD76E Kw_Wu8 255.0 OneToOne 0.00 255.0 FORMAT "%5.1" /end CHARACTERISTIC
/begin CHARACTERISTIC DSM_Class4THlc_C "Trigger Art für Fehlerheilung (->Lampe aus)" VALUE 0x1CD76F Kw_Wu8 5.00000000000 ClassTrigger 0.00 5.00000000000 FORMAT "%13.11" /end CHARACTERISTIC
/begin CHARACTERISTIC DSM_Class4Hlc_C "Anzahl Triggerereignisse für Fehlerheilung (->Lampe aus)" VALUE 0x1CD770 Kw_Wu8 255.0 OneToOne 0.00 255.0 FORMAT "%5.1" /end CHARACTERISTIC
/begin CHARACTERISTIC DSM_Class4Scatt_C "Fehler ist lesbar für OBD Scan tool tester (SCATT) wenn Wert = 1" VALUE 0x1CD771 Kw_Wu8 1.00000000000 Scatt 0.00 1.00000000000 FORMAT "%13.11" /end CHARACTERISTIC
/begin CHARACTERISTIC DSM_Class4TDlcPen_C "Trigger Art für Löschentprellung von nicht bestätigten Fehlern (pending)" VALUE 0x1CD772 Kw_Wu8 3.00000000000 ClassTriggerTDlc 0.00 3.00000000000 FORMAT "%13.11" /end CHARACTERISTIC
/begin CHARACTERISTIC DSM_Class4DlcPen_C "Anzahl Triggerereignisse für die Löschung von nicht bestätigten Fehlern (pending)" VALUE 0x1CD773 Kw_Wu8 255.0 OneToOne 0.00 255.0 FORMAT "%5.1" /end CHARACTERISTIC
/begin CHARACTERISTIC DSM_Class4TDlc_C "Trigger Art für Löschentprellung" VALUE 0x1CD774 Kw_Wu8 3.00000000000 ClassTriggerTDlc 0.00 3.00000000000 FORMAT "%13.11" /end CHARACTERISTIC
/begin CHARACTERISTIC DSM_Class4DlcKd_C "Anzahl Triggerereignisse für die Löschung von Fehlereinträgen mit Status Kundendienst" VALUE 0x1CD775 Kw_Wu8 255.0 OneToOne 0.00 255.0 FORMAT "%5.1" /end CHARACTERISTIC
/begin CHARACTERISTIC DSM_Class4Dlc_C "Anzahl Triggerereignisse für die Löschung von Fehlereinträgen" VALUE 0x1CD776 Kw_Wu8 255.0 OneToOne 0.00 255.0 FORMAT "%5.1" /end CHARACTERISTIC
/begin CHARACTERISTIC DSM_Class4Prio_C "Priorität des Fehlereintrages für Verdrängung und freeze frame Zuordnung" VALUE 0x1CD777 Kw_Wu8 255.0 OneToOne 0.00 255.0 FORMAT "%5.1" /end CHARACTERISTIC
/begin CHARACTERISTIC DSM_Class4SysLamp_C "Art der Systemlampenansteuerung" VALUE 0x1CD778 Kw_Wu8 2.00000000000 SysLamp 0.00 2.00000000000 FORMAT "%13.11" /end CHARACTERISTIC
/begin CHARACTERISTIC DSM_Class4ResErf_C "Verhalten Fehlerflags bei Reset und abgebrochenem Nachlauf" VALUE 0x1CD779 Kw_Wu8 3.00000000000 ResErf 0.00 3.00000000000 FORMAT "%13.11" /end CHARACTERISTIC
/begin CHARACTERISTIC DSM_Class4Readiness_C "Zuordnung Entprellklasse zu Readiness Flags" VALUE 0x1CD77A Kw_Wu8 64.0000000000 Readiness 0.00 64.0000000000 FORMAT "%13.10" /end CHARACTERISTIC
/begin CHARACTERISTIC DSM_Class5Mil_C "Art der MIL Ansteuerung" VALUE 0x1CD77B Kw_Wu8 2.00000000000 Mil 0.00 2.00000000000 FORMAT "%13.11" /end CHARACTERISTIC
/begin CHARACTERISTIC DSM_Class5TFlc_C "Trigger Art für Fehlereintrags Bestätigungsentprellung (->Lampe an)" VALUE 0x1CD77C Kw_Wu8 5.00000000000 ClassTrigger 0.00 5.00000000000 FORMAT "%13.11" /end CHARACTERISTIC
/begin CHARACTERISTIC DSM_Class5Flc_C "Anzahl Triggerereignisse für Fehlereintrags Bestätigungsentprellung (->Lampe an)" VALUE 0x1CD77D Kw_Wu8 255.0 OneToOne 0.00 255.0 FORMAT "%5.1" /end CHARACTERISTIC
/begin CHARACTERISTIC DSM_Class5THlc_C "Trigger Art für Fehlerheilung (->Lampe aus)" VALUE 0x1CD77E Kw_Wu8 5.00000000000 ClassTrigger 0.00 5.00000000000 FORMAT "%13.11" /end CHARACTERISTIC
/begin CHARACTERISTIC DSM_Class5Hlc_C "Anzahl Triggerereignisse für Fehlerheilung (->Lampe aus)" VALUE 0x1CD77F Kw_Wu8 255.0 OneToOne 0.00 255.0 FORMAT "%5.1" /end CHARACTERISTIC
/begin CHARACTERISTIC DSM_Class5Scatt_C "Fehler ist lesbar für OBD Scan tool tester (SCATT) wenn Wert = 1" VALUE 0x1CD780 Kw_Wu8 1.00000000000 Scatt 0.00 1.00000000000 FORMAT "%13.11" /end CHARACTERISTIC
/begin CHARACTERISTIC DSM_Class5TDlcPen_C "Trigger Art für Löschentprellung von nicht bestätigten Fehlern (pending)" VALUE 0x1CD781 Kw_Wu8 3.00000000000 ClassTriggerTDlc 0.00 3.00000000000 FORMAT "%13.11" /end CHARACTERISTIC
/begin CHARACTERISTIC DSM_Class5DlcPen_C "Anzahl Triggerereignisse für die Löschung von nicht bestätigten Fehlern (pending)" VALUE 0x1CD782 Kw_Wu8 255.0 OneToOne 0.00 255.0 FORMAT "%5.1" /end CHARACTERISTIC
/begin CHARACTERISTIC DSM_Class5TDlc_C "Trigger Art für Löschentprellung" VALUE 0x1CD783 Kw_Wu8 3.00000000000 ClassTriggerTDlc 0.00 3.00000000000 FORMAT "%13.11" /end CHARACTERISTIC
/begin CHARACTERISTIC DSM_Class5DlcKd_C "Anzahl Triggerereignisse für die Löschung von Fehlereinträgen mit Status Kundendienst" VALUE 0x1CD784 Kw_Wu8 255.0 OneToOne 0.00 255.0 FORMAT "%5.1" /end CHARACTERISTIC
/begin CHARACTERISTIC DSM_Class5Dlc_C "Anzahl Triggerereignisse für die Löschung von Fehlereinträgen" VALUE 0x1CD785 Kw_Wu8 255.0 OneToOne 0.00 255.0 FORMAT "%5.1" /end CHARACTERISTIC
/begin CHARACTERISTIC DSM_Class5Prio_C "Priorität des Fehlereintrages für Verdrängung und freeze frame Zuordnung" VALUE 0x1CD786 Kw_Wu8 255.0 OneToOne 0.00 255.0 FORMAT "%5.1" /end CHARACTERISTIC
/begin CHARACTERISTIC DSM_Class5SysLamp_C "Art der Systemlampenansteuerung" VALUE 0x1CD787 Kw_Wu8 2.00000000000 SysLamp 0.00 2.00000000000 FORMAT "%13.11" /end CHARACTERISTIC
/begin CHARACTERISTIC DSM_Class5ResErf_C "Verhalten Fehlerflags bei Reset und abgebrochenem Nachlauf" VALUE 0x1CD788 Kw_Wu8 3.00000000000 ResErf 0.00 3.00000000000 FORMAT "%13.11" /end CHARACTERISTIC
/begin CHARACTERISTIC DSM_Class5Readiness_C "Zuordnung Entprellklasse zu Readiness Flags" VALUE 0x1CD789 Kw_Wu8 64.0000000000 Readiness 0.00 64.0000000000 FORMAT "%13.10" /end CHARACTERISTIC
/begin CHARACTERISTIC DSM_Class6Mil_C "Art der MIL Ansteuerung" VALUE 0x1CD78A Kw_Wu8 2.00000000000 Mil 0.00 2.00000000000 FORMAT "%13.11" /end CHARACTERISTIC
/begin CHARACTERISTIC DSM_Class6TFlc_C "Trigger Art für Fehlereintrags Bestätigungsentprellung (->Lampe an)" VALUE 0x1CD78B Kw_Wu8 5.00000000000 ClassTrigger 0.00 5.00000000000 FORMAT "%13.11" /end CHARACTERISTIC
/begin CHARACTERISTIC DSM_Class6Flc_C "Anzahl Triggerereignisse für Fehlereintrags Bestätigungsentprellung (->Lampe an)" VALUE 0x1CD78C Kw_Wu8 255.0 OneToOne 0.00 255.0 FORMAT "%5.1" /end CHARACTERISTIC
/begin CHARACTERISTIC DSM_Class6THlc_C "Trigger Art für Fehlerheilung (->Lampe aus)" VALUE 0x1CD78D Kw_Wu8 5.00000000000 ClassTrigger 0.00 5.00000000000 FORMAT "%13.11" /end CHARACTERISTIC
/begin CHARACTERISTIC DSM_Class6Hlc_C "Anzahl Triggerereignisse für Fehlerheilung (->Lampe aus)" VALUE 0x1CD78E Kw_Wu8 255.0 OneToOne 0.00 255.0 FORMAT "%5.1" /end CHARACTERISTIC
/begin CHARACTERISTIC DSM_Class6Scatt_C "Fehler ist lesbar für OBD Scan tool tester (SCATT) wenn Wert = 1" VALUE 0x1CD78F Kw_Wu8 1.00000000000 Scatt 0.00 1.00000000000 FORMAT "%13.11" /end CHARACTERISTIC
/begin CHARACTERISTIC DSM_Class6TDlcPen_C "Trigger Art für Löschentprellung von nicht bestätigten Fehlern (pending)" VALUE 0x1CD790 Kw_Wu8 3.00000000000 ClassTriggerTDlc 0.00 3.00000000000 FORMAT "%13.11" /end CHARACTERISTIC
/begin CHARACTERISTIC DSM_Class6DlcPen_C "Anzahl Triggerereignisse für die Löschung von nicht bestätigten Fehlern (pending)" VALUE 0x1CD791 Kw_Wu8 255.0 OneToOne 0.00 255.0 FORMAT "%5.1" /end CHARACTERISTIC
/begin CHARACTERISTIC DSM_Class6TDlc_C "Trigger Art für Löschentprellung" VALUE 0x1CD792 Kw_Wu8 3.00000000000 ClassTriggerTDlc 0.00 3.00000000000 FORMAT "%13.11" /end CHARACTERISTIC
/begin CHARACTERISTIC DSM_Class6DlcKd_C "Anzahl Triggerereignisse für die Löschung von Fehlereinträgen mit Status Kundendienst" VALUE 0x1CD793 Kw_Wu8 255.0 OneToOne 0.00 255.0 FORMAT "%5.1" /end CHARACTERISTIC
/begin CHARACTERISTIC DSM_Class6Dlc_C "Anzahl Triggerereignisse für die Löschung von Fehlereinträgen" VALUE 0x1CD794 Kw_Wu8 255.0 OneToOne 0.00 255.0 FORMAT "%5.1" /end CHARACTERISTIC
/begin CHARACTERISTIC DSM_Class6Prio_C "Priorität des Fehlereintrages für Verdrängung und freeze frame Zuordnung" VALUE 0x1CD795 Kw_Wu8 255.0 OneToOne 0.00 255.0 FORMAT "%5.1" /end CHARACTERISTIC
/begin CHARACTERISTIC DSM_Class6SysLamp_C "Art der Systemlampenansteuerung" VALUE 0x1CD796 Kw_Wu8 2.00000000000 SysLamp 0.00 2.00000000000 FORMAT "%13.11" /end CHARACTERISTIC
/begin CHARACTERISTIC DSM_Class6ResErf_C "Verhalten Fehlerflags bei Reset und abgebrochenem Nachlauf" VALUE 0x1CD797 Kw_Wu8 3.00000000000 ResErf 0.00 3.00000000000 FORMAT "%13.11" /end CHARACTERISTIC
/begin CHARACTERISTIC DSM_Class6Readiness_C "Zuordnung Entprellklasse zu Readiness Flags" VALUE 0x1CD798 Kw_Wu8 64.0000000000 Readiness 0.00 64.0000000000 FORMAT "%13.10" /end CHARACTERISTIC
/begin CHARACTERISTIC DSM_Class7Mil_C "Art der MIL Ansteuerung" VALUE 0x1CD799 Kw_Wu8 2.00000000000 Mil 0.00 2.00000000000 FORMAT "%13.11" /end CHARACTERISTIC
/begin CHARACTERISTIC DSM_Class7TFlc_C "Trigger Art für Fehlereintrags Bestätigungsentprellung (->Lampe an)" VALUE 0x1CD79A Kw_Wu8 5.00000000000 ClassTrigger 0.00 5.00000000000 FORMAT "%13.11" /end CHARACTERISTIC
/begin CHARACTERISTIC DSM_Class7Flc_C "Anzahl Triggerereignisse für Fehlereintrags Bestätigungsentprellung (->Lampe an)" VALUE 0x1CD79B Kw_Wu8 255.0 OneToOne 0.00 255.0 FORMAT "%5.1" /end CHARACTERISTIC
/begin CHARACTERISTIC DSM_Class7THlc_C "Trigger Art für Fehlerheilung (->Lampe aus)" VALUE 0x1CD79C Kw_Wu8 5.00000000000 ClassTrigger 0.00 5.00000000000 FORMAT "%13.11" /end CHARACTERISTIC
/begin CHARACTERISTIC DSM_Class7Hlc_C "Anzahl Triggerereignisse für Fehlerheilung (->Lampe aus)" VALUE 0x1CD79D Kw_Wu8 255.0 OneToOne 0.00 255.0 FORMAT "%5.1" /end CHARACTERISTIC
/begin CHARACTERISTIC DSM_Class7Scatt_C "Fehler ist lesbar für OBD Scan tool tester (SCATT) wenn Wert = 1" VALUE 0x1CD79E Kw_Wu8 1.00000000000 Scatt 0.00 1.00000000000 FORMAT "%13.11" /end CHARACTERISTIC
/begin CHARACTERISTIC DSM_Class7TDlcPen_C "Trigger Art für Löschentprellung von nicht bestätigten Fehlern (pending)" VALUE 0x1CD79F Kw_Wu8 3.00000000000 ClassTriggerTDlc 0.00 3.00000000000 FORMAT "%13.11" /end CHARACTERISTIC
/begin CHARACTERISTIC DSM_Class7DlcPen_C "Anzahl Triggerereignisse für die Löschung von nicht bestätigten Fehlern (pending)" VALUE 0x1CD7A0 Kw_Wu8 255.0 OneToOne 0.00 255.0 FORMAT "%5.1" /end CHARACTERISTIC
/begin CHARACTERISTIC DSM_Class7TDlc_C "Trigger Art für Löschentprellung" VALUE 0x1CD7A1 Kw_Wu8 3.00000000000 ClassTriggerTDlc 0.00 3.00000000000 FORMAT "%13.11" /end CHARACTERISTIC
/begin CHARACTERISTIC DSM_Class7DlcKd_C "Anzahl Triggerereignisse für die Löschung von Fehlereinträgen mit Status Kundendienst" VALUE 0x1CD7A2 Kw_Wu8 255.0 OneToOne 0.00 255.0 FORMAT "%5.1" /end CHARACTERISTIC
/begin CHARACTERISTIC DSM_Class7Dlc_C "Anzahl Triggerereignisse für die Löschung von Fehlereinträgen" VALUE 0x1CD7A3 Kw_Wu8 255.0 OneToOne 0.00 255.0 FORMAT "%5.1" /end CHARACTERISTIC
/begin CHARACTERISTIC DSM_Class7Prio_C "Priorität des Fehlereintrages für Verdrängung und freeze frame Zuordnung" VALUE 0x1CD7A4 Kw_Wu8 255.0 OneToOne 0.00 255.0 FORMAT "%5.1" /end CHARACTERISTIC
/begin CHARACTERISTIC DSM_Class7SysLamp_C "Art der Systemlampenansteuerung" VALUE 0x1CD7A5 Kw_Wu8 2.00000000000 SysLamp 0.00 2.00000000000 FORMAT "%13.11" /end CHARACTERISTIC
/begin CHARACTERISTIC DSM_Class7ResErf_C "Verhalten Fehlerflags bei Reset und abgebrochenem Nachlauf" VALUE 0x1CD7A6 Kw_Wu8 3.00000000000 ResErf 0.00 3.00000000000 FORMAT "%13.11" /end CHARACTERISTIC
/begin CHARACTERISTIC DSM_Class7Readiness_C "Zuordnung Entprellklasse zu Readiness Flags" VALUE 0x1CD7A7 Kw_Wu8 64.0000000000 Readiness 0.00 64.0000000000 FORMAT "%13.10" /end CHARACTERISTIC
/begin CHARACTERISTIC DSM_Class8Mil_C "Art der MIL Ansteuerung" VALUE 0x1CD7A8 Kw_Wu8 2.00000000000 Mil 0.00 2.00000000000 FORMAT "%13.11" /end CHARACTERISTIC
/begin CHARACTERISTIC DSM_Class8TFlc_C "Trigger Art für Fehlereintrags Bestätigungsentprellung (->Lampe an)" VALUE 0x1CD7A9 Kw_Wu8 5.00000000000 ClassTrigger 0.00 5.00000000000 FORMAT "%13.11" /end CHARACTERISTIC
/begin CHARACTERISTIC DSM_Class8Flc_C "Anzahl Triggerereignisse für Fehlereintrags Bestätigungsentprellung (->Lampe an)" VALUE 0x1CD7AA Kw_Wu8 255.0 OneToOne 0.00 255.0 FORMAT "%5.1" /end CHARACTERISTIC
/begin CHARACTERISTIC DSM_Class8THlc_C "Trigger Art für Fehlerheilung (->Lampe aus)" VALUE 0x1CD7AB Kw_Wu8 5.00000000000 ClassTrigger 0.00 5.00000000000 FORMAT "%13.11" /end CHARACTERISTIC
/begin CHARACTERISTIC DSM_Class8Hlc_C "Anzahl Triggerereignisse für Fehlerheilung (->Lampe aus)" VALUE 0x1CD7AC Kw_Wu8 255.0 OneToOne 0.00 255.0 FORMAT "%5.1" /end CHARACTERISTIC
/begin CHARACTERISTIC DSM_Class8Scatt_C "Fehler ist lesbar für OBD Scan tool tester (SCATT) wenn Wert = 1" VALUE 0x1CD7AD Kw_Wu8 1.00000000000 Scatt 0.00 1.00000000000 FORMAT "%13.11" /end CHARACTERISTIC
/begin CHARACTERISTIC DSM_Class8TDlcPen_C "Trigger Art für Löschentprellung von nicht bestätigten Fehlern (pending)" VALUE 0x1CD7AE Kw_Wu8 3.00000000000 ClassTriggerTDlc 0.00 3.00000000000 FORMAT "%13.11" /end CHARACTERISTIC
/begin CHARACTERISTIC DSM_Class8DlcPen_C "Anzahl Triggerereignisse für die Löschung von nicht bestätigten Fehlern (pending)" VALUE 0x1CD7AF Kw_Wu8 255.0 OneToOne 0.00 255.0 FORMAT "%5.1" /end CHARACTERISTIC
/begin CHARACTERISTIC DSM_Class8TDlc_C "Trigger Art für Löschentprellung" VALUE 0x1CD7B0 Kw_Wu8 3.00000000000 ClassTriggerTDlc 0.00 3.00000000000 FORMAT "%13.11" /end CHARACTERISTIC
/begin CHARACTERISTIC DSM_Class8DlcKd_C "Anzahl Triggerereignisse für die Löschung von Fehlereinträgen mit Status Kundendienst" VALUE 0x1CD7B1 Kw_Wu8 255.0 OneToOne 0.00 255.0 FORMAT "%5.1" /end CHARACTERISTIC
/begin CHARACTERISTIC DSM_Class8Dlc_C "Anzahl Triggerereignisse für die Löschung von Fehlereinträgen" VALUE 0x1CD7B2 Kw_Wu8 255.0 OneToOne 0.00 255.0 FORMAT "%5.1" /end CHARACTERISTIC
/begin CHARACTERISTIC DSM_Class8Prio_C "Priorität des Fehlereintrages für Verdrängung und freeze frame Zuordnung" VALUE 0x1CD7B3 Kw_Wu8 255.0 OneToOne 0.00 255.0 FORMAT "%5.1" /end CHARACTERISTIC
/begin CHARACTERISTIC DSM_Class8SysLamp_C "Art der Systemlampenansteuerung" VALUE 0x1CD7B4 Kw_Wu8 2.00000000000 SysLamp 0.00 2.00000000000 FORMAT "%13.11" /end CHARACTERISTIC
/begin CHARACTERISTIC DSM_Class8ResErf_C "Verhalten Fehlerflags bei Reset und abgebrochenem Nachlauf" VALUE 0x1CD7B5 Kw_Wu8 3.00000000000 ResErf 0.00 3.00000000000 FORMAT "%13.11" /end CHARACTERISTIC
/begin CHARACTERISTIC DSM_Class8Readiness_C "Zuordnung Entprellklasse zu Readiness Flags" VALUE 0x1CD7B6 Kw_Wu8 64.0000000000 Readiness 0.00 64.0000000000 FORMAT "%13.10" /end CHARACTERISTIC
/begin CHARACTERISTIC DSM_Class9Mil_C "Art der MIL Ansteuerung" VALUE 0x1CD7B7 Kw_Wu8 2.00000000000 Mil 0.00 2.00000000000 FORMAT "%13.11" /end CHARACTERISTIC
/begin CHARACTERISTIC DSM_Class9TFlc_C "Trigger Art für Fehlereintrags Bestätigungsentprellung (->Lampe an)" VALUE 0x1CD7B8 Kw_Wu8 5.00000000000 ClassTrigger 0.00 5.00000000000 FORMAT "%13.11" /end CHARACTERISTIC
/begin CHARACTERISTIC DSM_Class9Flc_C "Anzahl Triggerereignisse für Fehlereintrags Bestätigungsentprellung (->Lampe an)" VALUE 0x1CD7B9 Kw_Wu8 255.0 OneToOne 0.00 255.0 FORMAT "%5.1" /end CHARACTERISTIC
/begin CHARACTERISTIC DSM_Class9THlc_C "Trigger Art für Fehlerheilung (->Lampe aus)" VALUE 0x1CD7BA Kw_Wu8 5.00000000000 ClassTrigger 0.00 5.00000000000 FORMAT "%13.11" /end CHARACTERISTIC
/begin CHARACTERISTIC DSM_Class9Hlc_C "Anzahl Triggerereignisse für Fehlerheilung (->Lampe aus)" VALUE 0x1CD7BB Kw_Wu8 255.0 OneToOne 0.00 255.0 FORMAT "%5.1" /end CHARACTERISTIC
/begin CHARACTERISTIC DSM_Class9Scatt_C "Fehler ist lesbar für OBD Scan tool tester (SCATT) wenn Wert = 1" VALUE 0x1CD7BC Kw_Wu8 1.00000000000 Scatt 0.00 1.00000000000 FORMAT "%13.11" /end CHARACTERISTIC
/begin CHARACTERISTIC DSM_Class9TDlcPen_C "Trigger Art für Löschentprellung von nicht bestätigten Fehlern (pending)" VALUE 0x1CD7BD Kw_Wu8 3.00000000000 ClassTriggerTDlc 0.00 3.00000000000 FORMAT "%13.11" /end CHARACTERISTIC
/begin CHARACTERISTIC DSM_Class9DlcPen_C "Anzahl Triggerereignisse für die Löschung von nicht bestätigten Fehlern (pending)" VALUE 0x1CD7BE Kw_Wu8 255.0 OneToOne 0.00 255.0 FORMAT "%5.1" /end CHARACTERISTIC
/begin CHARACTERISTIC DSM_Class9TDlc_C "Trigger Art für Löschentprellung" VALUE 0x1CD7BF Kw_Wu8 3.00000000000 ClassTriggerTDlc 0.00 3.00000000000 FORMAT "%13.11" /end CHARACTERISTIC
/begin CHARACTERISTIC DSM_Class9DlcKd_C "Anzahl Triggerereignisse für die Löschung von Fehlereinträgen mit Status Kundendienst" VALUE 0x1CD7C0 Kw_Wu8 255.0 OneToOne 0.00 255.0 FORMAT "%5.1" /end CHARACTERISTIC
/begin CHARACTERISTIC DSM_Class9Dlc_C "Anzahl Triggerereignisse für die Löschung von Fehlereinträgen" VALUE 0x1CD7C1 Kw_Wu8 255.0 OneToOne 0.00 255.0 FORMAT "%5.1" /end CHARACTERISTIC
/begin CHARACTERISTIC DSM_Class9Prio_C "Priorität des Fehlereintrages für Verdrängung und freeze frame Zuordnung" VALUE 0x1CD7C2 Kw_Wu8 255.0 OneToOne 0.00 255.0 FORMAT "%5.1" /end CHARACTERISTIC
/begin CHARACTERISTIC DSM_Class9SysLamp_C "Art der Systemlampenansteuerung" VALUE 0x1CD7C3 Kw_Wu8 2.00000000000 SysLamp 0.00 2.00000000000 FORMAT "%13.11" /end CHARACTERISTIC
/begin CHARACTERISTIC DSM_Class9ResErf_C "Verhalten Fehlerflags bei Reset und abgebrochenem Nachlauf" VALUE 0x1CD7C4 Kw_Wu8 3.00000000000 ResErf 0.00 3.00000000000 FORMAT "%13.11" /end CHARACTERISTIC
/begin CHARACTERISTIC DSM_Class9Readiness_C "Zuordnung Entprellklasse zu Readiness Flags" VALUE 0x1CD7C5 Kw_Wu8 64.0000000000 Readiness 0.00 64.0000000000 FORMAT "%13.10" /end CHARACTERISTIC
/begin CHARACTERISTIC DSM_Class10Mil_C "Art der MIL Ansteuerung" VALUE 0x1CD7C6 Kw_Wu8 2.00000000000 Mil 0.00 2.00000000000 FORMAT "%13.11" /end CHARACTERISTIC
/begin CHARACTERISTIC DSM_Class10TFlc_C "Trigger Art für Fehlereintrags Bestätigungsentprellung (->Lampe an)" VALUE 0x1CD7C7 Kw_Wu8 5.00000000000 ClassTrigger 0.00 5.00000000000 FORMAT "%13.11" /end CHARACTERISTIC
/begin CHARACTERISTIC DSM_Class10Flc_C "Anzahl Triggerereignisse für Fehlereintrags Bestätigungsentprellung (->Lampe an)" VALUE 0x1CD7C8 Kw_Wu8 255.0 OneToOne 0.00 255.0 FORMAT "%5.1" /end CHARACTERISTIC
/begin CHARACTERISTIC DSM_Class10THlc_C "Trigger Art für Fehlerheilung (->Lampe aus)" VALUE 0x1CD7C9 Kw_Wu8 5.00000000000 ClassTrigger 0.00 5.00000000000 FORMAT "%13.11" /end CHARACTERISTIC
/begin CHARACTERISTIC DSM_Class10Hlc_C "Anzahl Triggerereignisse für Fehlerheilung (->Lampe aus)" VALUE 0x1CD7CA Kw_Wu8 255.0 OneToOne 0.00 255.0 FORMAT "%5.1" /end CHARACTERISTIC
/begin CHARACTERISTIC DSM_Class10Scatt_C "Fehler ist lesbar für OBD Scan tool tester (SCATT) wenn Wert = 1" VALUE 0x1CD7CB Kw_Wu8 1.00000000000 Scatt 0.00 1.00000000000 FORMAT "%13.11" /end CHARACTERISTIC
/begin CHARACTERISTIC DSM_Class10TDlcPen_C "Trigger Art für Löschentprellung von nicht bestätigten Fehlern (pending)" VALUE 0x1CD7CC Kw_Wu8 3.00000000000 ClassTriggerTDlc 0.00 3.00000000000 FORMAT "%13.11" /end CHARACTERISTIC
/begin CHARACTERISTIC DSM_Class10DlcPen_C "Anzahl Triggerereignisse für die Löschung von nicht bestätigten Fehlern (pending)" VALUE 0x1CD7CD Kw_Wu8 255.0 OneToOne 0.00 255.0 FORMAT "%5.1" /end CHARACTERISTIC
/begin CHARACTERISTIC DSM_Class10TDlc_C "Trigger Art für Löschentprellung" VALUE 0x1CD7CE Kw_Wu8 3.00000000000 ClassTriggerTDlc 0.00 3.00000000000 FORMAT "%13.11" /end CHARACTERISTIC
/begin CHARACTERISTIC DSM_Class10DlcKd_C "Anzahl Triggerereignisse für die Löschung von Fehlereinträgen mit Status Kundendienst" VALUE 0x1CD7CF Kw_Wu8 255.0 OneToOne 0.00 255.0 FORMAT "%5.1" /end CHARACTERISTIC
/begin CHARACTERISTIC DSM_Class10Dlc_C "Anzahl Triggerereignisse für die Löschung von Fehlereinträgen" VALUE 0x1CD7D0 Kw_Wu8 255.0 OneToOne 0.00 255.0 FORMAT "%5.1" /end CHARACTERISTIC
/begin CHARACTERISTIC DSM_Class10Prio_C "Priorität des Fehlereintrages für Verdrängung und freeze frame Zuordnung" VALUE 0x1CD7D1 Kw_Wu8 255.0 OneToOne 0.00 255.0 FORMAT "%5.1" /end CHARACTERISTIC
/begin CHARACTERISTIC DSM_Class10SysLamp_C "Art der Systemlampenansteuerung" VALUE 0x1CD7D2 Kw_Wu8 2.00000000000 SysLamp 0.00 2.00000000000 FORMAT "%13.11" /end CHARACTERISTIC
/begin CHARACTERISTIC DSM_Class10ResErf_C "Verhalten Fehlerflags bei Reset und abgebrochenem Nachlauf" VALUE 0x1CD7D3 Kw_Wu8 3.00000000000 ResErf 0.00 3.00000000000 FORMAT "%13.11" /end CHARACTERISTIC
/begin CHARACTERISTIC DSM_Class10Readiness_C "Zuordnung Entprellklasse zu Readiness Flags" VALUE 0x1CD7D4 Kw_Wu8 64.0000000000 Readiness 0.00 64.0000000000 FORMAT "%13.10" /end CHARACTERISTIC
/begin CHARACTERISTIC DSM_Class11Mil_C "Art der MIL Ansteuerung" VALUE 0x1CD7D5 Kw_Wu8 2.00000000000 Mil 0.00 2.00000000000 FORMAT "%13.11" /end CHARACTERISTIC
/begin CHARACTERISTIC DSM_Class11TFlc_C "Trigger Art für Fehlereintrags Bestätigungsentprellung (->Lampe an)" VALUE 0x1CD7D6 Kw_Wu8 5.00000000000 ClassTrigger 0.00 5.00000000000 FORMAT "%13.11" /end CHARACTERISTIC
/begin CHARACTERISTIC DSM_Class11Flc_C "Anzahl Triggerereignisse für Fehlereintrags Bestätigungsentprellung (->Lampe an)" VALUE 0x1CD7D7 Kw_Wu8 255.0 OneToOne 0.00 255.0 FORMAT "%5.1" /end CHARACTERISTIC
/begin CHARACTERISTIC DSM_Class11THlc_C "Trigger Art für Fehlerheilung (->Lampe aus)" VALUE 0x1CD7D8 Kw_Wu8 5.00000000000 ClassTrigger 0.00 5.00000000000 FORMAT "%13.11" /end CHARACTERISTIC
/begin CHARACTERISTIC DSM_Class11Hlc_C "Anzahl Triggerereignisse für Fehlerheilung (->Lampe aus)" VALUE 0x1CD7D9 Kw_Wu8 255.0 OneToOne 0.00 255.0 FORMAT "%5.1" /end CHARACTERISTIC
/begin CHARACTERISTIC DSM_Class11Scatt_C "Fehler ist lesbar für OBD Scan tool tester (SCATT) wenn Wert = 1" VALUE 0x1CD7DA Kw_Wu8 1.00000000000 Scatt 0.00 1.00000000000 FORMAT "%13.11" /end CHARACTERISTIC
/begin CHARACTERISTIC DSM_Class11TDlcPen_C "Trigger Art für Löschentprellung von nicht bestätigten Fehlern (pending)" VALUE 0x1CD7DB Kw_Wu8 3.00000000000 ClassTriggerTDlc 0.00 3.00000000000 FORMAT "%13.11" /end CHARACTERISTIC
/begin CHARACTERISTIC DSM_Class11DlcPen_C "Anzahl Triggerereignisse für die Löschung von nicht bestätigten Fehlern (pending)" VALUE 0x1CD7DC Kw_Wu8 255.0 OneToOne 0.00 255.0 FORMAT "%5.1" /end CHARACTERISTIC
/begin CHARACTERISTIC DSM_Class11TDlc_C "Trigger Art für Löschentprellung" VALUE 0x1CD7DD Kw_Wu8 3.00000000000 ClassTriggerTDlc 0.00 3.00000000000 FORMAT "%13.11" /end CHARACTERISTIC
/begin CHARACTERISTIC DSM_Class11DlcKd_C "Anzahl Triggerereignisse für die Löschung von Fehlereinträgen mit Status Kundendienst" VALUE 0x1CD7DE Kw_Wu8 255.0 OneToOne 0.00 255.0 FORMAT "%5.1" /end CHARACTERISTIC
/begin CHARACTERISTIC DSM_Class11Dlc_C "Anzahl Triggerereignisse für die Löschung von Fehlereinträgen" VALUE 0x1CD7DF Kw_Wu8 255.0 OneToOne 0.00 255.0 FORMAT "%5.1" /end CHARACTERISTIC
/begin CHARACTERISTIC DSM_Class11Prio_C "Priorität des Fehlereintrages für Verdrängung und freeze frame Zuordnung" VALUE 0x1CD7E0 Kw_Wu8 255.0 OneToOne 0.00 255.0 FORMAT "%5.1" /end CHARACTERISTIC
/begin CHARACTERISTIC DSM_Class11SysLamp_C "Art der Systemlampenansteuerung" VALUE 0x1CD7E1 Kw_Wu8 2.00000000000 SysLamp 0.00 2.00000000000 FORMAT "%13.11" /end CHARACTERISTIC
/begin CHARACTERISTIC DSM_Class11ResErf_C "Verhalten Fehlerflags bei Reset und abgebrochenem Nachlauf" VALUE 0x1CD7E2 Kw_Wu8 3.00000000000 ResErf 0.00 3.00000000000 FORMAT "%13.11" /end CHARACTERISTIC
/begin CHARACTERISTIC DSM_Class11Readiness_C "Zuordnung Entprellklasse zu Readiness Flags" VALUE 0x1CD7E3 Kw_Wu8 64.0000000000 Readiness 0.00 64.0000000000 FORMAT "%13.10" /end CHARACTERISTIC
/begin CHARACTERISTIC DSM_Class12Mil_C "Art der MIL Ansteuerung" VALUE 0x1CD7E4 Kw_Wu8 2.00000000000 Mil 0.00 2.00000000000 FORMAT "%13.11" /end CHARACTERISTIC
/begin CHARACTERISTIC DSM_Class12TFlc_C "Trigger Art für Fehlereintrags Bestätigungsentprellung (->Lampe an)" VALUE 0x1CD7E5 Kw_Wu8 5.00000000000 ClassTrigger 0.00 5.00000000000 FORMAT "%13.11" /end CHARACTERISTIC
/begin CHARACTERISTIC DSM_Class12Flc_C "Anzahl Triggerereignisse für Fehlereintrags Bestätigungsentprellung (->Lampe an)" VALUE 0x1CD7E6 Kw_Wu8 255.0 OneToOne 0.00 255.0 FORMAT "%5.1" /end CHARACTERISTIC
/begin CHARACTERISTIC DSM_Class12THlc_C "Trigger Art für Fehlerheilung (->Lampe aus)" VALUE 0x1CD7E7 Kw_Wu8 5.00000000000 ClassTrigger 0.00 5.00000000000 FORMAT "%13.11" /end CHARACTERISTIC
/begin CHARACTERISTIC DSM_Class12Hlc_C "Anzahl Triggerereignisse für Fehlerheilung (->Lampe aus)" VALUE 0x1CD7E8 Kw_Wu8 255.0 OneToOne 0.00 255.0 FORMAT "%5.1" /end CHARACTERISTIC
/begin CHARACTERISTIC DSM_Class12Scatt_C "Fehler ist lesbar für OBD Scan tool tester (SCATT) wenn Wert = 1" VALUE 0x1CD7E9 Kw_Wu8 1.00000000000 Scatt 0.00 1.00000000000 FORMAT "%13.11" /end CHARACTERISTIC
/begin CHARACTERISTIC DSM_Class12TDlcPen_C "Trigger Art für Löschentprellung von nicht bestätigten Fehlern (pending)" VALUE 0x1CD7EA Kw_Wu8 3.00000000000 ClassTriggerTDlc 0.00 3.00000000000 FORMAT "%13.11" /end CHARACTERISTIC
/begin CHARACTERISTIC DSM_Class12DlcPen_C "Anzahl Triggerereignisse für die Löschung von nicht bestätigten Fehlern (pending)" VALUE 0x1CD7EB Kw_Wu8 255.0 OneToOne 0.00 255.0 FORMAT "%5.1" /end CHARACTERISTIC
/begin CHARACTERISTIC DSM_Class12TDlc_C "Trigger Art für Löschentprellung" VALUE 0x1CD7EC Kw_Wu8 3.00000000000 ClassTriggerTDlc 0.00 3.00000000000 FORMAT "%13.11" /end CHARACTERISTIC
/begin CHARACTERISTIC DSM_Class12DlcKd_C "Anzahl Triggerereignisse für die Löschung von Fehlereinträgen mit Status Kundendienst" VALUE 0x1CD7ED Kw_Wu8 255.0 OneToOne 0.00 255.0 FORMAT "%5.1" /end CHARACTERISTIC
/begin CHARACTERISTIC DSM_Class12Dlc_C "Anzahl Triggerereignisse für die Löschung von Fehlereinträgen" VALUE 0x1CD7EE Kw_Wu8 255.0 OneToOne 0.00 255.0 FORMAT "%5.1" /end CHARACTERISTIC
/begin CHARACTERISTIC DSM_Class12Prio_C "Priorität des Fehlereintrages für Verdrängung und freeze frame Zuordnung" VALUE 0x1CD7EF Kw_Wu8 255.0 OneToOne 0.00 255.0 FORMAT "%5.1" /end CHARACTERISTIC
/begin CHARACTERISTIC DSM_Class12SysLamp_C "Art der Systemlampenansteuerung" VALUE 0x1CD7F0 Kw_Wu8 2.00000000000 SysLamp 0.00 2.00000000000 FORMAT "%13.11" /end CHARACTERISTIC
/begin CHARACTERISTIC DSM_Class12ResErf_C "Verhalten Fehlerflags bei Reset und abgebrochenem Nachlauf" VALUE 0x1CD7F1 Kw_Wu8 3.00000000000 ResErf 0.00 3.00000000000 FORMAT "%13.11" /end CHARACTERISTIC
/begin CHARACTERISTIC DSM_Class12Readiness_C "Zuordnung Entprellklasse zu Readiness Flags" VALUE 0x1CD7F2 Kw_Wu8 64.0000000000 Readiness 0.00 64.0000000000 FORMAT "%13.10" /end CHARACTERISTIC
/begin CHARACTERISTIC DSM_Class13Mil_C "Art der MIL Ansteuerung" VALUE 0x1CD7F3 Kw_Wu8 2.00000000000 Mil 0.00 2.00000000000 FORMAT "%13.11" /end CHARACTERISTIC
/begin CHARACTERISTIC DSM_Class13TFlc_C "Trigger Art für Fehlereintrags Bestätigungsentprellung (->Lampe an)" VALUE 0x1CD7F4 Kw_Wu8 5.00000000000 ClassTrigger 0.00 5.00000000000 FORMAT "%13.11" /end CHARACTERISTIC
/begin CHARACTERISTIC DSM_Class13Flc_C "Anzahl Triggerereignisse für Fehlereintrags Bestätigungsentprellung (->Lampe an)" VALUE 0x1CD7F5 Kw_Wu8 255.0 OneToOne 0.00 255.0 FORMAT "%5.1" /end CHARACTERISTIC
/begin CHARACTERISTIC DSM_Class13THlc_C "Trigger Art für Fehlerheilung (->Lampe aus)" VALUE 0x1CD7F6 Kw_Wu8 5.00000000000 ClassTrigger 0.00 5.00000000000 FORMAT "%13.11" /end CHARACTERISTIC
/begin CHARACTERISTIC DSM_Class13Hlc_C "Anzahl Triggerereignisse für Fehlerheilung (->Lampe aus)" VALUE 0x1CD7F7 Kw_Wu8 255.0 OneToOne 0.00 255.0 FORMAT "%5.1" /end CHARACTERISTIC
/begin CHARACTERISTIC DSM_Class13Scatt_C "Fehler ist lesbar für OBD Scan tool tester (SCATT) wenn Wert = 1" VALUE 0x1CD7F8 Kw_Wu8 1.00000000000 Scatt 0.00 1.00000000000 FORMAT "%13.11" /end CHARACTERISTIC
/begin CHARACTERISTIC DSM_Class13TDlcPen_C "Trigger Art für Löschentprellung von nicht bestätigten Fehlern (pending)" VALUE 0x1CD7F9 Kw_Wu8 3.00000000000 ClassTriggerTDlc 0.00 3.00000000000 FORMAT "%13.11" /end CHARACTERISTIC
/begin CHARACTERISTIC DSM_Class13DlcPen_C "Anzahl Triggerereignisse für die Löschung von nicht bestätigten Fehlern (pending)" VALUE 0x1CD7FA Kw_Wu8 255.0 OneToOne 0.00 255.0 FORMAT "%5.1" /end CHARACTERISTIC
/begin CHARACTERISTIC DSM_Class13TDlc_C "Trigger Art für Löschentprellung" VALUE 0x1CD7FB Kw_Wu8 3.00000000000 ClassTriggerTDlc 0.00 3.00000000000 FORMAT "%13.11" /end CHARACTERISTIC
/begin CHARACTERISTIC DSM_Class13DlcKd_C "Anzahl Triggerereignisse für die Löschung von Fehlereinträgen mit Status Kundendienst" VALUE 0x1CD7FC Kw_Wu8 255.0 OneToOne 0.00 255.0 FORMAT "%5.1" /end CHARACTERISTIC
/begin CHARACTERISTIC DSM_Class13Dlc_C "Anzahl Triggerereignisse für die Löschung von Fehlereinträgen" VALUE 0x1CD7FD Kw_Wu8 255.0 OneToOne 0.00 255.0 FORMAT "%5.1" /end CHARACTERISTIC
/begin CHARACTERISTIC DSM_Class13Prio_C "Priorität des Fehlereintrages für Verdrängung und freeze frame Zuordnung" VALUE 0x1CD7FE Kw_Wu8 255.0 OneToOne 0.00 255.0 FORMAT "%5.1" /end CHARACTERISTIC
/begin CHARACTERISTIC DSM_Class13SysLamp_C "Art der Systemlampenansteuerung" VALUE 0x1CD7FF Kw_Wu8 2.00000000000 SysLamp 0.00 2.00000000000 FORMAT "%13.11" /end CHARACTERISTIC
/begin CHARACTERISTIC DSM_Class13ResErf_C "Verhalten Fehlerflags bei Reset und abgebrochenem Nachlauf" VALUE 0x1CD800 Kw_Wu8 3.00000000000 ResErf 0.00 3.00000000000 FORMAT "%13.11" /end CHARACTERISTIC
/begin CHARACTERISTIC DSM_Class13Readiness_C "Zuordnung Entprellklasse zu Readiness Flags" VALUE 0x1CD801 Kw_Wu8 64.0000000000 Readiness 0.00 64.0000000000 FORMAT "%13.10" /end CHARACTERISTIC
/begin CHARACTERISTIC DSM_Class14Mil_C "Art der MIL Ansteuerung" VALUE 0x1CD802 Kw_Wu8 2.00000000000 Mil 0.00 2.00000000000 FORMAT "%13.11" /end CHARACTERISTIC
/begin CHARACTERISTIC DSM_Class14TFlc_C "Trigger Art für Fehlereintrags Bestätigungsentprellung (->Lampe an)" VALUE 0x1CD803 Kw_Wu8 5.00000000000 ClassTrigger 0.00 5.00000000000 FORMAT "%13.11" /end CHARACTERISTIC
/begin CHARACTERISTIC DSM_Class14Flc_C "Anzahl Triggerereignisse für Fehlereintrags Bestätigungsentprellung (->Lampe an)" VALUE 0x1CD804 Kw_Wu8 255.0 OneToOne 0.00 255.0 FORMAT "%5.1" /end CHARACTERISTIC
/begin CHARACTERISTIC DSM_Class14THlc_C "Trigger Art für Fehlerheilung (->Lampe aus)" VALUE 0x1CD805 Kw_Wu8 5.00000000000 ClassTrigger 0.00 5.00000000000 FORMAT "%13.11" /end CHARACTERISTIC
/begin CHARACTERISTIC DSM_Class14Hlc_C "Anzahl Triggerereignisse für Fehlerheilung (->Lampe aus)" VALUE 0x1CD806 Kw_Wu8 255.0 OneToOne 0.00 255.0 FORMAT "%5.1" /end CHARACTERISTIC
/begin CHARACTERISTIC DSM_Class14Scatt_C "Fehler ist lesbar für OBD Scan tool tester (SCATT) wenn Wert = 1" VALUE 0x1CD807 Kw_Wu8 1.00000000000 Scatt 0.00 1.00000000000 FORMAT "%13.11" /end CHARACTERISTIC
/begin CHARACTERISTIC DSM_Class14TDlcPen_C "Trigger Art für Löschentprellung von nicht bestätigten Fehlern (pending)" VALUE 0x1CD808 Kw_Wu8 3.00000000000 ClassTriggerTDlc 0.00 3.00000000000 FORMAT "%13.11" /end CHARACTERISTIC
/begin CHARACTERISTIC DSM_Class14DlcPen_C "Anzahl Triggerereignisse für die Löschung von nicht bestätigten Fehlern (pending)" VALUE 0x1CD809 Kw_Wu8 255.0 OneToOne 0.00 255.0 FORMAT "%5.1" /end CHARACTERISTIC
/begin CHARACTERISTIC DSM_Class14TDlc_C "Trigger Art für Löschentprellung" VALUE 0x1CD80A Kw_Wu8 3.00000000000 ClassTriggerTDlc 0.00 3.00000000000 FORMAT "%13.11" /end CHARACTERISTIC
/begin CHARACTERISTIC DSM_Class14DlcKd_C "Anzahl Triggerereignisse für die Löschung von Fehlereinträgen mit Status Kundendienst" VALUE 0x1CD80B Kw_Wu8 255.0 OneToOne 0.00 255.0 FORMAT "%5.1" /end CHARACTERISTIC
/begin CHARACTERISTIC DSM_Class14Dlc_C "Anzahl Triggerereignisse für die Löschung von Fehlereinträgen" VALUE 0x1CD80C Kw_Wu8 255.0 OneToOne 0.00 255.0 FORMAT "%5.1" /end CHARACTERISTIC
/begin CHARACTERISTIC DSM_Class14Prio_C "Priorität des Fehlereintrages für Verdrängung und freeze frame Zuordnung" VALUE 0x1CD80D Kw_Wu8 255.0 OneToOne 0.00 255.0 FORMAT "%5.1" /end CHARACTERISTIC
/begin CHARACTERISTIC DSM_Class14SysLamp_C "Art der Systemlampenansteuerung" VALUE 0x1CD80E Kw_Wu8 2.00000000000 SysLamp 0.00 2.00000000000 FORMAT "%13.11" /end CHARACTERISTIC
/begin CHARACTERISTIC DSM_Class14ResErf_C "Verhalten Fehlerflags bei Reset und abgebrochenem Nachlauf" VALUE 0x1CD80F Kw_Wu8 3.00000000000 ResErf 0.00 3.00000000000 FORMAT "%13.11" /end CHARACTERISTIC
/begin CHARACTERISTIC DSM_Class14Readiness_C "Zuordnung Entprellklasse zu Readiness Flags" VALUE 0x1CD810 Kw_Wu8 64.0000000000 Readiness 0.00 64.0000000000 FORMAT "%13.10" /end CHARACTERISTIC
/begin CHARACTERISTIC DSM_Class15Mil_C "Art der MIL Ansteuerung" VALUE 0x1CD811 Kw_Wu8 2.00000000000 Mil 0.00 2.00000000000 FORMAT "%13.11" /end CHARACTERISTIC
/begin CHARACTERISTIC DSM_Class15TFlc_C "Trigger Art für Fehlereintrags Bestätigungsentprellung (->Lampe an)" VALUE 0x1CD812 Kw_Wu8 5.00000000000 ClassTrigger 0.00 5.00000000000 FORMAT "%13.11" /end CHARACTERISTIC
/begin CHARACTERISTIC DSM_Class15Flc_C "Anzahl Triggerereignisse für Fehlereintrags Bestätigungsentprellung (->Lampe an)" VALUE 0x1CD813 Kw_Wu8 255.0 OneToOne 0.00 255.0 FORMAT "%5.1" /end CHARACTERISTIC
/begin CHARACTERISTIC DSM_Class15THlc_C "Trigger Art für Fehlerheilung (->Lampe aus)" VALUE 0x1CD814 Kw_Wu8 5.00000000000 ClassTrigger 0.00 5.00000000000 FORMAT "%13.11" /end CHARACTERISTIC
/begin CHARACTERISTIC DSM_Class15Hlc_C "Anzahl Triggerereignisse für Fehlerheilung (->Lampe aus)" VALUE 0x1CD815 Kw_Wu8 255.0 OneToOne 0.00 255.0 FORMAT "%5.1" /end CHARACTERISTIC
/begin CHARACTERISTIC DSM_Class15Scatt_C "Fehler ist lesbar für OBD Scan tool tester (SCATT) wenn Wert = 1" VALUE 0x1CD816 Kw_Wu8 1.00000000000 Scatt 0.00 1.00000000000 FORMAT "%13.11" /end CHARACTERISTIC
/begin CHARACTERISTIC DSM_Class15TDlcPen_C "Trigger Art für Löschentprellung von nicht bestätigten Fehlern (pending)" VALUE 0x1CD817 Kw_Wu8 3.00000000000 ClassTriggerTDlc 0.00 3.00000000000 FORMAT "%13.11" /end CHARACTERISTIC
/begin CHARACTERISTIC DSM_Class15DlcPen_C "Anzahl Triggerereignisse für die Löschung von nicht bestätigten Fehlern (pending)" VALUE 0x1CD818 Kw_Wu8 255.0 OneToOne 0.00 255.0 FORMAT "%5.1" /end CHARACTERISTIC
/begin CHARACTERISTIC DSM_Class15TDlc_C "Trigger Art für Löschentprellung" VALUE 0x1CD819 Kw_Wu8 3.00000000000 ClassTriggerTDlc 0.00 3.00000000000 FORMAT "%13.11" /end CHARACTERISTIC
/begin CHARACTERISTIC DSM_Class15DlcKd_C "Anzahl Triggerereignisse für die Löschung von Fehlereinträgen mit Status Kundendienst" VALUE 0x1CD81A Kw_Wu8 255.0 OneToOne 0.00 255.0 FORMAT "%5.1" /end CHARACTERISTIC
/begin CHARACTERISTIC DSM_Class15Dlc_C "Anzahl Triggerereignisse für die Löschung von Fehlereinträgen" VALUE 0x1CD81B Kw_Wu8 255.0 OneToOne 0.00 255.0 FORMAT "%5.1" /end CHARACTERISTIC
/begin CHARACTERISTIC DSM_Class15Prio_C "Priorität des Fehlereintrages für Verdrängung und freeze frame Zuordnung" VALUE 0x1CD81C Kw_Wu8 255.0 OneToOne 0.00 255.0 FORMAT "%5.1" /end CHARACTERISTIC
/begin CHARACTERISTIC DSM_Class15SysLamp_C "Art der Systemlampenansteuerung" VALUE 0x1CD81D Kw_Wu8 2.00000000000 SysLamp 0.00 2.00000000000 FORMAT "%13.11" /end CHARACTERISTIC
/begin CHARACTERISTIC DSM_Class15ResErf_C "Verhalten Fehlerflags bei Reset und abgebrochenem Nachlauf" VALUE 0x1CD81E Kw_Wu8 3.00000000000 ResErf 0.00 3.00000000000 FORMAT "%13.11" /end CHARACTERISTIC
/begin CHARACTERISTIC DSM_Class15Readiness_C "Zuordnung Entprellklasse zu Readiness Flags" VALUE 0x1CD81F Kw_Wu8 64.0000000000 Readiness 0.00 64.0000000000 FORMAT "%13.10" /end CHARACTERISTIC
/begin CHARACTERISTIC DSM_Class16Mil_C "Art der MIL Ansteuerung" VALUE 0x1CD820 Kw_Wu8 2.00000000000 Mil 0.00 2.00000000000 FORMAT "%13.11" /end CHARACTERISTIC
/begin CHARACTERISTIC DSM_Class16TFlc_C "Trigger Art für Fehlereintrags Bestätigungsentprellung (->Lampe an)" VALUE 0x1CD821 Kw_Wu8 5.00000000000 ClassTrigger 0.00 5.00000000000 FORMAT "%13.11" /end CHARACTERISTIC
/begin CHARACTERISTIC DSM_Class16Flc_C "Anzahl Triggerereignisse für Fehlereintrags Bestätigungsentprellung (->Lampe an)" VALUE 0x1CD822 Kw_Wu8 255.0 OneToOne 0.00 255.0 FORMAT "%5.1" /end CHARACTERISTIC
/begin CHARACTERISTIC DSM_Class16THlc_C "Trigger Art für Fehlerheilung (->Lampe aus)" VALUE 0x1CD823 Kw_Wu8 5.00000000000 ClassTrigger 0.00 5.00000000000 FORMAT "%13.11" /end CHARACTERISTIC
/begin CHARACTERISTIC DSM_Class16Hlc_C "Anzahl Triggerereignisse für Fehlerheilung (->Lampe aus)" VALUE 0x1CD824 Kw_Wu8 255.0 OneToOne 0.00 255.0 FORMAT "%5.1" /end CHARACTERISTIC
/begin CHARACTERISTIC DSM_Class16Scatt_C "Fehler ist lesbar für OBD Scan tool tester (SCATT) wenn Wert = 1" VALUE 0x1CD825 Kw_Wu8 1.00000000000 Scatt 0.00 1.00000000000 FORMAT "%13.11" /end CHARACTERISTIC
/begin CHARACTERISTIC DSM_Class16TDlcPen_C "Trigger Art für Löschentprellung von nicht bestätigten Fehlern (pending)" VALUE 0x1CD826 Kw_Wu8 3.00000000000 ClassTriggerTDlc 0.00 3.00000000000 FORMAT "%13.11" /end CHARACTERISTIC
/begin CHARACTERISTIC DSM_Class16DlcPen_C "Anzahl Triggerereignisse für die Löschung von nicht bestätigten Fehlern (pending)" VALUE 0x1CD827 Kw_Wu8 255.0 OneToOne 0.00 255.0 FORMAT "%5.1" /end CHARACTERISTIC
/begin CHARACTERISTIC DSM_Class16TDlc_C "Trigger Art für Löschentprellung" VALUE 0x1CD828 Kw_Wu8 3.00000000000 ClassTriggerTDlc 0.00 3.00000000000 FORMAT "%13.11" /end CHARACTERISTIC
/begin CHARACTERISTIC DSM_Class16DlcKd_C "Anzahl Triggerereignisse für die Löschung von Fehlereinträgen mit Status Kundendienst" VALUE 0x1CD829 Kw_Wu8 255.0 OneToOne 0.00 255.0 FORMAT "%5.1" /end CHARACTERISTIC
/begin CHARACTERISTIC DSM_Class16Dlc_C "Anzahl Triggerereignisse für die Löschung von Fehlereinträgen" VALUE 0x1CD82A Kw_Wu8 255.0 OneToOne 0.00 255.0 FORMAT "%5.1" /end CHARACTERISTIC
/begin CHARACTERISTIC DSM_Class16Prio_C "Priorität des Fehlereintrages für Verdrängung und freeze frame Zuordnung" VALUE 0x1CD82B Kw_Wu8 255.0 OneToOne 0.00 255.0 FORMAT "%5.1" /end CHARACTERISTIC
/begin CHARACTERISTIC DSM_Class16SysLamp_C "Art der Systemlampenansteuerung" VALUE 0x1CD82C Kw_Wu8 2.00000000000 SysLamp 0.00 2.00000000000 FORMAT "%13.11" /end CHARACTERISTIC
/begin CHARACTERISTIC DSM_Class16ResErf_C "Verhalten Fehlerflags bei Reset und abgebrochenem Nachlauf" VALUE 0x1CD82D Kw_Wu8 3.00000000000 ResErf 0.00 3.00000000000 FORMAT "%13.11" /end CHARACTERISTIC
/begin CHARACTERISTIC DSM_Class16Readiness_C "Zuordnung Entprellklasse zu Readiness Flags" VALUE 0x1CD82E Kw_Wu8 64.0000000000 Readiness 0.00 64.0000000000 FORMAT "%13.10" /end CHARACTERISTIC
/begin CHARACTERISTIC DSM_Class17Mil_C "Art der MIL Ansteuerung" VALUE 0x1CD82F Kw_Wu8 2.00000000000 Mil 0.00 2.00000000000 FORMAT "%13.11" /end CHARACTERISTIC
/begin CHARACTERISTIC DSM_Class17TFlc_C "Trigger Art für Fehlereintrags Bestätigungsentprellung (->Lampe an)" VALUE 0x1CD830 Kw_Wu8 5.00000000000 ClassTrigger 0.00 5.00000000000 FORMAT "%13.11" /end CHARACTERISTIC
/begin CHARACTERISTIC DSM_Class17Flc_C "Anzahl Triggerereignisse für Fehlereintrags Bestätigungsentprellung (->Lampe an)" VALUE 0x1CD831 Kw_Wu8 255.0 OneToOne 0.00 255.0 FORMAT "%5.1" /end CHARACTERISTIC
/begin CHARACTERISTIC DSM_Class17THlc_C "Trigger Art für Fehlerheilung (->Lampe aus)" VALUE 0x1CD832 Kw_Wu8 5.00000000000 ClassTrigger 0.00 5.00000000000 FORMAT "%13.11" /end CHARACTERISTIC
/begin CHARACTERISTIC DSM_Class17Hlc_C "Anzahl Triggerereignisse für Fehlerheilung (->Lampe aus)" VALUE 0x1CD833 Kw_Wu8 255.0 OneToOne 0.00 255.0 FORMAT "%5.1" /end CHARACTERISTIC
/begin CHARACTERISTIC DSM_Class17Scatt_C "Fehler ist lesbar für OBD Scan tool tester (SCATT) wenn Wert = 1" VALUE 0x1CD834 Kw_Wu8 1.00000000000 Scatt 0.00 1.00000000000 FORMAT "%13.11" /end CHARACTERISTIC
/begin CHARACTERISTIC DSM_Class17TDlcPen_C "Trigger Art für Löschentprellung von nicht bestätigten Fehlern (pending)" VALUE 0x1CD835 Kw_Wu8 3.00000000000 ClassTriggerTDlc 0.00 3.00000000000 FORMAT "%13.11" /end CHARACTERISTIC
/begin CHARACTERISTIC DSM_Class17DlcPen_C "Anzahl Triggerereignisse für die Löschung von nicht bestätigten Fehlern (pending)" VALUE 0x1CD836 Kw_Wu8 255.0 OneToOne 0.00 255.0 FORMAT "%5.1" /end CHARACTERISTIC
/begin CHARACTERISTIC DSM_Class17TDlc_C "Trigger Art für Löschentprellung" VALUE 0x1CD837 Kw_Wu8 3.00000000000 ClassTriggerTDlc 0.00 3.00000000000 FORMAT "%13.11" /end CHARACTERISTIC
/begin CHARACTERISTIC DSM_Class17DlcKd_C "Anzahl Triggerereignisse für die Löschung von Fehlereinträgen mit Status Kundendienst" VALUE 0x1CD838 Kw_Wu8 255.0 OneToOne 0.00 255.0 FORMAT "%5.1" /end CHARACTERISTIC
/begin CHARACTERISTIC DSM_Class17Dlc_C "Anzahl Triggerereignisse für die Löschung von Fehlereinträgen" VALUE 0x1CD839 Kw_Wu8 255.0 OneToOne 0.00 255.0 FORMAT "%5.1" /end CHARACTERISTIC
/begin CHARACTERISTIC DSM_Class17Prio_C "Priorität des Fehlereintrages für Verdrängung und freeze frame Zuordnung" VALUE 0x1CD83A Kw_Wu8 255.0 OneToOne 0.00 255.0 FORMAT "%5.1" /end CHARACTERISTIC
/begin CHARACTERISTIC DSM_Class17SysLamp_C "Art der Systemlampenansteuerung" VALUE 0x1CD83B Kw_Wu8 2.00000000000 SysLamp 0.00 2.00000000000 FORMAT "%13.11" /end CHARACTERISTIC
/begin CHARACTERISTIC DSM_Class17ResErf_C "Verhalten Fehlerflags bei Reset und abgebrochenem Nachlauf" VALUE 0x1CD83C Kw_Wu8 3.00000000000 ResErf 0.00 3.00000000000 FORMAT "%13.11" /end CHARACTERISTIC
/begin CHARACTERISTIC DSM_Class17Readiness_C "Zuordnung Entprellklasse zu Readiness Flags" VALUE 0x1CD83D Kw_Wu8 64.0000000000 Readiness 0.00 64.0000000000 FORMAT "%13.10" /end CHARACTERISTIC
/begin CHARACTERISTIC DSM_Class18Mil_C "Art der MIL Ansteuerung" VALUE 0x1CD83E Kw_Wu8 2.00000000000 Mil 0.00 2.00000000000 FORMAT "%13.11" /end CHARACTERISTIC
/begin CHARACTERISTIC DSM_Class18TFlc_C "Trigger Art für Fehlereintrags Bestätigungsentprellung (->Lampe an)" VALUE 0x1CD83F Kw_Wu8 5.00000000000 ClassTrigger 0.00 5.00000000000 FORMAT "%13.11" /end CHARACTERISTIC
/begin CHARACTERISTIC DSM_Class18Flc_C "Anzahl Triggerereignisse für Fehlereintrags Bestätigungsentprellung (->Lampe an)" VALUE 0x1CD840 Kw_Wu8 255.0 OneToOne 0.00 255.0 FORMAT "%5.1" /end CHARACTERISTIC
/begin CHARACTERISTIC DSM_Class18THlc_C "Trigger Art für Fehlerheilung (->Lampe aus)" VALUE 0x1CD841 Kw_Wu8 5.00000000000 ClassTrigger 0.00 5.00000000000 FORMAT "%13.11" /end CHARACTERISTIC
/begin CHARACTERISTIC DSM_Class18Hlc_C "Anzahl Triggerereignisse für Fehlerheilung (->Lampe aus)" VALUE 0x1CD842 Kw_Wu8 255.0 OneToOne 0.00 255.0 FORMAT "%5.1" /end CHARACTERISTIC
/begin CHARACTERISTIC DSM_Class18Scatt_C "Fehler ist lesbar für OBD Scan tool tester (SCATT) wenn Wert = 1" VALUE 0x1CD843 Kw_Wu8 1.00000000000 Scatt 0.00 1.00000000000 FORMAT "%13.11" /end CHARACTERISTIC
/begin CHARACTERISTIC DSM_Class18TDlcPen_C "Trigger Art für Löschentprellung von nicht bestätigten Fehlern (pending)" VALUE 0x1CD844 Kw_Wu8 3.00000000000 ClassTriggerTDlc 0.00 3.00000000000 FORMAT "%13.11" /end CHARACTERISTIC
/begin CHARACTERISTIC DSM_Class18DlcPen_C "Anzahl Triggerereignisse für die Löschung von nicht bestätigten Fehlern (pending)" VALUE 0x1CD845 Kw_Wu8 255.0 OneToOne 0.00 255.0 FORMAT "%5.1" /end CHARACTERISTIC
/begin CHARACTERISTIC DSM_Class18TDlc_C "Trigger Art für Löschentprellung" VALUE 0x1CD846 Kw_Wu8 3.00000000000 ClassTriggerTDlc 0.00 3.00000000000 FORMAT "%13.11" /end CHARACTERISTIC
/begin CHARACTERISTIC DSM_Class18DlcKd_C "Anzahl Triggerereignisse für die Löschung von Fehlereinträgen mit Status Kundendienst" VALUE 0x1CD847 Kw_Wu8 255.0 OneToOne 0.00 255.0 FORMAT "%5.1" /end CHARACTERISTIC
/begin CHARACTERISTIC DSM_Class18Dlc_C "Anzahl Triggerereignisse für die Löschung von Fehlereinträgen" VALUE 0x1CD848 Kw_Wu8 255.0 OneToOne 0.00 255.0 FORMAT "%5.1" /end CHARACTERISTIC
/begin CHARACTERISTIC DSM_Class18Prio_C "Priorität des Fehlereintrages für Verdrängung und freeze frame Zuordnung" VALUE 0x1CD849 Kw_Wu8 255.0 OneToOne 0.00 255.0 FORMAT "%5.1" /end CHARACTERISTIC
/begin CHARACTERISTIC DSM_Class18SysLamp_C "Art der Systemlampenansteuerung" VALUE 0x1CD84A Kw_Wu8 2.00000000000 SysLamp 0.00 2.00000000000 FORMAT "%13.11" /end CHARACTERISTIC
/begin CHARACTERISTIC DSM_Class18ResErf_C "Verhalten Fehlerflags bei Reset und abgebrochenem Nachlauf" VALUE 0x1CD84B Kw_Wu8 3.00000000000 ResErf 0.00 3.00000000000 FORMAT "%13.11" /end CHARACTERISTIC
/begin CHARACTERISTIC DSM_Class18Readiness_C "Zuordnung Entprellklasse zu Readiness Flags" VALUE 0x1CD84C Kw_Wu8 64.0000000000 Readiness 0.00 64.0000000000 FORMAT "%13.10" /end CHARACTERISTIC
/begin CHARACTERISTIC DSM_Class19Mil_C "Art der MIL Ansteuerung" VALUE 0x1CD84D Kw_Wu8 2.00000000000 Mil 0.00 2.00000000000 FORMAT "%13.11" /end CHARACTERISTIC
/begin CHARACTERISTIC DSM_Class19TFlc_C "Trigger Art für Fehlereintrags Bestätigungsentprellung (->Lampe an)" VALUE 0x1CD84E Kw_Wu8 5.00000000000 ClassTrigger 0.00 5.00000000000 FORMAT "%13.11" /end CHARACTERISTIC
/begin CHARACTERISTIC DSM_Class19Flc_C "Anzahl Triggerereignisse für Fehlereintrags Bestätigungsentprellung (->Lampe an)" VALUE 0x1CD84F Kw_Wu8 255.0 OneToOne 0.00 255.0 FORMAT "%5.1" /end CHARACTERISTIC
/begin CHARACTERISTIC DSM_Class19THlc_C "Trigger Art für Fehlerheilung (->Lampe aus)" VALUE 0x1CD850 Kw_Wu8 5.00000000000 ClassTrigger 0.00 5.00000000000 FORMAT "%13.11" /end CHARACTERISTIC
/begin CHARACTERISTIC DSM_Class19Hlc_C "Anzahl Triggerereignisse für Fehlerheilung (->Lampe aus)" VALUE 0x1CD851 Kw_Wu8 255.0 OneToOne 0.00 255.0 FORMAT "%5.1" /end CHARACTERISTIC
/begin CHARACTERISTIC DSM_Class19Scatt_C "Fehler ist lesbar für OBD Scan tool tester (SCATT) wenn Wert = 1" VALUE 0x1CD852 Kw_Wu8 1.00000000000 Scatt 0.00 1.00000000000 FORMAT "%13.11" /end CHARACTERISTIC
/begin CHARACTERISTIC DSM_Class19TDlcPen_C "Trigger Art für Löschentprellung von nicht bestätigten Fehlern (pending)" VALUE 0x1CD853 Kw_Wu8 3.00000000000 ClassTriggerTDlc 0.00 3.00000000000 FORMAT "%13.11" /end CHARACTERISTIC
/begin CHARACTERISTIC DSM_Class19DlcPen_C "Anzahl Triggerereignisse für die Löschung von nicht bestätigten Fehlern (pending)" VALUE 0x1CD854 Kw_Wu8 255.0 OneToOne 0.00 255.0 FORMAT "%5.1" /end CHARACTERISTIC
/begin CHARACTERISTIC DSM_Class19TDlc_C "Trigger Art für Löschentprellung" VALUE 0x1CD855 Kw_Wu8 3.00000000000 ClassTriggerTDlc 0.00 3.00000000000 FORMAT "%13.11" /end CHARACTERISTIC
/begin CHARACTERISTIC DSM_Class19DlcKd_C "Anzahl Triggerereignisse für die Löschung von Fehlereinträgen mit Status Kundendienst" VALUE 0x1CD856 Kw_Wu8 255.0 OneToOne 0.00 255.0 FORMAT "%5.1" /end CHARACTERISTIC
/begin CHARACTERISTIC DSM_Class19Dlc_C "Anzahl Triggerereignisse für die Löschung von Fehlereinträgen" VALUE 0x1CD857 Kw_Wu8 255.0 OneToOne 0.00 255.0 FORMAT "%5.1" /end CHARACTERISTIC
/begin CHARACTERISTIC DSM_Class19Prio_C "Priorität des Fehlereintrages für Verdrängung und freeze frame Zuordnung" VALUE 0x1CD858 Kw_Wu8 255.0 OneToOne 0.00 255.0 FORMAT "%5.1" /end CHARACTERISTIC
/begin CHARACTERISTIC DSM_Class19SysLamp_C "Art der Systemlampenansteuerung" VALUE 0x1CD859 Kw_Wu8 2.00000000000 SysLamp 0.00 2.00000000000 FORMAT "%13.11" /end CHARACTERISTIC
/begin CHARACTERISTIC DSM_Class19ResErf_C "Verhalten Fehlerflags bei Reset und abgebrochenem Nachlauf" VALUE 0x1CD85A Kw_Wu8 3.00000000000 ResErf 0.00 3.00000000000 FORMAT "%13.11" /end CHARACTERISTIC
/begin CHARACTERISTIC DSM_Class19Readiness_C "Zuordnung Entprellklasse zu Readiness Flags" VALUE 0x1CD85B Kw_Wu8 64.0000000000 Readiness 0.00 64.0000000000 FORMAT "%13.10" /end CHARACTERISTIC
/begin CHARACTERISTIC DSM_Class20Mil_C "Art der MIL Ansteuerung" VALUE 0x1CD85C Kw_Wu8 2.00000000000 Mil 0.00 2.00000000000 FORMAT "%13.11" /end CHARACTERISTIC
/begin CHARACTERISTIC DSM_Class20TFlc_C "Trigger Art für Fehlereintrags Bestätigungsentprellung (->Lampe an)" VALUE 0x1CD85D Kw_Wu8 5.00000000000 ClassTrigger 0.00 5.00000000000 FORMAT "%13.11" /end CHARACTERISTIC
/begin CHARACTERISTIC DSM_Class20Flc_C "Anzahl Triggerereignisse für Fehlereintrags Bestätigungsentprellung (->Lampe an)" VALUE 0x1CD85E Kw_Wu8 255.0 OneToOne 0.00 255.0 FORMAT "%5.1" /end CHARACTERISTIC
/begin CHARACTERISTIC DSM_Class20THlc_C "Trigger Art für Fehlerheilung (->Lampe aus)" VALUE 0x1CD85F Kw_Wu8 5.00000000000 ClassTrigger 0.00 5.00000000000 FORMAT "%13.11" /end CHARACTERISTIC
/begin CHARACTERISTIC DSM_Class20Hlc_C "Anzahl Triggerereignisse für Fehlerheilung (->Lampe aus)" VALUE 0x1CD860 Kw_Wu8 255.0 OneToOne 0.00 255.0 FORMAT "%5.1" /end CHARACTERISTIC
/begin CHARACTERISTIC DSM_Class20Scatt_C "Fehler ist lesbar für OBD Scan tool tester (SCATT) wenn Wert = 1" VALUE 0x1CD861 Kw_Wu8 1.00000000000 Scatt 0.00 1.00000000000 FORMAT "%13.11" /end CHARACTERISTIC
/begin CHARACTERISTIC DSM_Class20TDlcPen_C "Trigger Art für Löschentprellung von nicht bestätigten Fehlern (pending)" VALUE 0x1CD862 Kw_Wu8 3.00000000000 ClassTriggerTDlc 0.00 3.00000000000 FORMAT "%13.11" /end CHARACTERISTIC
/begin CHARACTERISTIC DSM_Class20DlcPen_C "Anzahl Triggerereignisse für die Löschung von nicht bestätigten Fehlern (pending)" VALUE 0x1CD863 Kw_Wu8 255.0 OneToOne 0.00 255.0 FORMAT "%5.1" /end CHARACTERISTIC
/begin CHARACTERISTIC DSM_Class20TDlc_C "Trigger Art für Löschentprellung" VALUE 0x1CD864 Kw_Wu8 3.00000000000 ClassTriggerTDlc 0.00 3.00000000000 FORMAT "%13.11" /end CHARACTERISTIC
/begin CHARACTERISTIC DSM_Class20DlcKd_C "Anzahl Triggerereignisse für die Löschung von Fehlereinträgen mit Status Kundendienst" VALUE 0x1CD865 Kw_Wu8 255.0 OneToOne 0.00 255.0 FORMAT "%5.1" /end CHARACTERISTIC
/begin CHARACTERISTIC DSM_Class20Dlc_C "Anzahl Triggerereignisse für die Löschung von Fehlereinträgen" VALUE 0x1CD866 Kw_Wu8 255.0 OneToOne 0.00 255.0 FORMAT "%5.1" /end CHARACTERISTIC
/begin CHARACTERISTIC DSM_Class20Prio_C "Priorität des Fehlereintrages für Verdrängung und freeze frame Zuordnung" VALUE 0x1CD867 Kw_Wu8 255.0 OneToOne 0.00 255.0 FORMAT "%5.1" /end CHARACTERISTIC
/begin CHARACTERISTIC DSM_Class20SysLamp_C "Art der Systemlampenansteuerung" VALUE 0x1CD868 Kw_Wu8 2.00000000000 SysLamp 0.00 2.00000000000 FORMAT "%13.11" /end CHARACTERISTIC
/begin CHARACTERISTIC DSM_Class20ResErf_C "Verhalten Fehlerflags bei Reset und abgebrochenem Nachlauf" VALUE 0x1CD869 Kw_Wu8 3.00000000000 ResErf 0.00 3.00000000000 FORMAT "%13.11" /end CHARACTERISTIC
/begin CHARACTERISTIC DSM_Class20Readiness_C "Zuordnung Entprellklasse zu Readiness Flags" VALUE 0x1CD86A Kw_Wu8 64.0000000000 Readiness 0.00 64.0000000000 FORMAT "%13.10" /end CHARACTERISTIC
/begin CHARACTERISTIC DSM_Class21Mil_C "Art der MIL Ansteuerung" VALUE 0x1CD86B Kw_Wu8 2.00000000000 Mil 0.00 2.00000000000 FORMAT "%13.11" /end CHARACTERISTIC
/begin CHARACTERISTIC DSM_Class21TFlc_C "Trigger Art für Fehlereintrags Bestätigungsentprellung (->Lampe an)" VALUE 0x1CD86C Kw_Wu8 5.00000000000 ClassTrigger 0.00 5.00000000000 FORMAT "%13.11" /end CHARACTERISTIC
/begin CHARACTERISTIC DSM_Class21Flc_C "Anzahl Triggerereignisse für Fehlereintrags Bestätigungsentprellung (->Lampe an)" VALUE 0x1CD86D Kw_Wu8 255.0 OneToOne 0.00 255.0 FORMAT "%5.1" /end CHARACTERISTIC
/begin CHARACTERISTIC DSM_Class21THlc_C "Trigger Art für Fehlerheilung (->Lampe aus)" VALUE 0x1CD86E Kw_Wu8 5.00000000000 ClassTrigger 0.00 5.00000000000 FORMAT "%13.11" /end CHARACTERISTIC
/begin CHARACTERISTIC DSM_Class21Hlc_C "Anzahl Triggerereignisse für Fehlerheilung (->Lampe aus)" VALUE 0x1CD86F Kw_Wu8 255.0 OneToOne 0.00 255.0 FORMAT "%5.1" /end CHARACTERISTIC
/begin CHARACTERISTIC DSM_Class21Scatt_C "Fehler ist lesbar für OBD Scan tool tester (SCATT) wenn Wert = 1" VALUE 0x1CD870 Kw_Wu8 1.00000000000 Scatt 0.00 1.00000000000 FORMAT "%13.11" /end CHARACTERISTIC
/begin CHARACTERISTIC DSM_Class21TDlcPen_C "Trigger Art für Löschentprellung von nicht bestätigten Fehlern (pending)" VALUE 0x1CD871 Kw_Wu8 3.00000000000 ClassTriggerTDlc 0.00 3.00000000000 FORMAT "%13.11" /end CHARACTERISTIC
/begin CHARACTERISTIC DSM_Class21DlcPen_C "Anzahl Triggerereignisse für die Löschung von nicht bestätigten Fehlern (pending)" VALUE 0x1CD872 Kw_Wu8 255.0 OneToOne 0.00 255.0 FORMAT "%5.1" /end CHARACTERISTIC
/begin CHARACTERISTIC DSM_Class21TDlc_C "Trigger Art für Löschentprellung" VALUE 0x1CD873 Kw_Wu8 3.00000000000 ClassTriggerTDlc 0.00 3.00000000000 FORMAT "%13.11" /end CHARACTERISTIC
/begin CHARACTERISTIC DSM_Class21DlcKd_C "Anzahl Triggerereignisse für die Löschung von Fehlereinträgen mit Status Kundendienst" VALUE 0x1CD874 Kw_Wu8 255.0 OneToOne 0.00 255.0 FORMAT "%5.1" /end CHARACTERISTIC
/begin CHARACTERISTIC DSM_Class21Dlc_C "Anzahl Triggerereignisse für die Löschung von Fehlereinträgen" VALUE 0x1CD875 Kw_Wu8 255.0 OneToOne 0.00 255.0 FORMAT "%5.1" /end CHARACTERISTIC
/begin CHARACTERISTIC DSM_Class21Prio_C "Priorität des Fehlereintrages für Verdrängung und freeze frame Zuordnung" VALUE 0x1CD876 Kw_Wu8 255.0 OneToOne 0.00 255.0 FORMAT "%5.1" /end CHARACTERISTIC
/begin CHARACTERISTIC DSM_Class21SysLamp_C "Art der Systemlampenansteuerung" VALUE 0x1CD877 Kw_Wu8 2.00000000000 SysLamp 0.00 2.00000000000 FORMAT "%13.11" /end CHARACTERISTIC
/begin CHARACTERISTIC DSM_Class21ResErf_C "Verhalten Fehlerflags bei Reset und abgebrochenem Nachlauf" VALUE 0x1CD878 Kw_Wu8 3.00000000000 ResErf 0.00 3.00000000000 FORMAT "%13.11" /end CHARACTERISTIC
/begin CHARACTERISTIC DSM_Class21Readiness_C "Zuordnung Entprellklasse zu Readiness Flags" VALUE 0x1CD879 Kw_Wu8 64.0000000000 Readiness 0.00 64.0000000000 FORMAT "%13.10" /end CHARACTERISTIC
/begin CHARACTERISTIC DSM_Class22Mil_C "Art der MIL Ansteuerung" VALUE 0x1CD87A Kw_Wu8 2.00000000000 Mil 0.00 2.00000000000 FORMAT "%13.11" /end CHARACTERISTIC
/begin CHARACTERISTIC DSM_Class22TFlc_C "Trigger Art für Fehlereintrags Bestätigungsentprellung (->Lampe an)" VALUE 0x1CD87B Kw_Wu8 5.00000000000 ClassTrigger 0.00 5.00000000000 FORMAT "%13.11" /end CHARACTERISTIC
/begin CHARACTERISTIC DSM_Class22Flc_C "Anzahl Triggerereignisse für Fehlereintrags Bestätigungsentprellung (->Lampe an)" VALUE 0x1CD87C Kw_Wu8 255.0 OneToOne 0.00 255.0 FORMAT "%5.1" /end CHARACTERISTIC
/begin CHARACTERISTIC DSM_Class22THlc_C "Trigger Art für Fehlerheilung (->Lampe aus)" VALUE 0x1CD87D Kw_Wu8 5.00000000000 ClassTrigger 0.00 5.00000000000 FORMAT "%13.11" /end CHARACTERISTIC
/begin CHARACTERISTIC DSM_Class22Hlc_C "Anzahl Triggerereignisse für Fehlerheilung (->Lampe aus)" VALUE 0x1CD87E Kw_Wu8 255.0 OneToOne 0.00 255.0 FORMAT "%5.1" /end CHARACTERISTIC
/begin CHARACTERISTIC DSM_Class22Scatt_C "Fehler ist lesbar für OBD Scan tool tester (SCATT) wenn Wert = 1" VALUE 0x1CD87F Kw_Wu8 1.00000000000 Scatt 0.00 1.00000000000 FORMAT "%13.11" /end CHARACTERISTIC
/begin CHARACTERISTIC DSM_Class22TDlcPen_C "Trigger Art für Löschentprellung von nicht bestätigten Fehlern (pending)" VALUE 0x1CD880 Kw_Wu8 3.00000000000 ClassTriggerTDlc 0.00 3.00000000000 FORMAT "%13.11" /end CHARACTERISTIC
/begin CHARACTERISTIC DSM_Class22DlcPen_C "Anzahl Triggerereignisse für die Löschung von nicht bestätigten Fehlern (pending)" VALUE 0x1CD881 Kw_Wu8 255.0 OneToOne 0.00 255.0 FORMAT "%5.1" /end CHARACTERISTIC
/begin CHARACTERISTIC DSM_Class22TDlc_C "Trigger Art für Löschentprellung" VALUE 0x1CD882 Kw_Wu8 3.00000000000 ClassTriggerTDlc 0.00 3.00000000000 FORMAT "%13.11" /end CHARACTERISTIC
/begin CHARACTERISTIC DSM_Class22DlcKd_C "Anzahl Triggerereignisse für die Löschung von Fehlereinträgen mit Status Kundendienst" VALUE 0x1CD883 Kw_Wu8 255.0 OneToOne 0.00 255.0 FORMAT "%5.1" /end CHARACTERISTIC
/begin CHARACTERISTIC DSM_Class22Dlc_C "Anzahl Triggerereignisse für die Löschung von Fehlereinträgen" VALUE 0x1CD884 Kw_Wu8 255.0 OneToOne 0.00 255.0 FORMAT "%5.1" /end CHARACTERISTIC
/begin CHARACTERISTIC DSM_Class22Prio_C "Priorität des Fehlereintrages für Verdrängung und freeze frame Zuordnung" VALUE 0x1CD885 Kw_Wu8 255.0 OneToOne 0.00 255.0 FORMAT "%5.1" /end CHARACTERISTIC
/begin CHARACTERISTIC DSM_Class22SysLamp_C "Art der Systemlampenansteuerung" VALUE 0x1CD886 Kw_Wu8 2.00000000000 SysLamp 0.00 2.00000000000 FORMAT "%13.11" /end CHARACTERISTIC
/begin CHARACTERISTIC DSM_Class22ResErf_C "Verhalten Fehlerflags bei Reset und abgebrochenem Nachlauf" VALUE 0x1CD887 Kw_Wu8 3.00000000000 ResErf 0.00 3.00000000000 FORMAT "%13.11" /end CHARACTERISTIC
/begin CHARACTERISTIC DSM_Class22Readiness_C "Zuordnung Entprellklasse zu Readiness Flags" VALUE 0x1CD888 Kw_Wu8 64.0000000000 Readiness 0.00 64.0000000000 FORMAT "%13.10" /end CHARACTERISTIC
/begin CHARACTERISTIC DSM_Class23Mil_C "Art der MIL Ansteuerung" VALUE 0x1CD889 Kw_Wu8 2.00000000000 Mil 0.00 2.00000000000 FORMAT "%13.11" /end CHARACTERISTIC
/begin CHARACTERISTIC DSM_Class23TFlc_C "Trigger Art für Fehlereintrags Bestätigungsentprellung (->Lampe an)" VALUE 0x1CD88A Kw_Wu8 5.00000000000 ClassTrigger 0.00 5.00000000000 FORMAT "%13.11" /end CHARACTERISTIC
/begin CHARACTERISTIC DSM_Class23Flc_C "Anzahl Triggerereignisse für Fehlereintrags Bestätigungsentprellung (->Lampe an)" VALUE 0x1CD88B Kw_Wu8 255.0 OneToOne 0.00 255.0 FORMAT "%5.1" /end CHARACTERISTIC
/begin CHARACTERISTIC DSM_Class23THlc_C "Trigger Art für Fehlerheilung (->Lampe aus)" VALUE 0x1CD88C Kw_Wu8 5.00000000000 ClassTrigger 0.00 5.00000000000 FORMAT "%13.11" /end CHARACTERISTIC
/begin CHARACTERISTIC DSM_Class23Hlc_C "Anzahl Triggerereignisse für Fehlerheilung (->Lampe aus)" VALUE 0x1CD88D Kw_Wu8 255.0 OneToOne 0.00 255.0 FORMAT "%5.1" /end CHARACTERISTIC
/begin CHARACTERISTIC DSM_Class23Scatt_C "Fehler ist lesbar für OBD Scan tool tester (SCATT) wenn Wert = 1" VALUE 0x1CD88E Kw_Wu8 1.00000000000 Scatt 0.00 1.00000000000 FORMAT "%13.11" /end CHARACTERISTIC
/begin CHARACTERISTIC DSM_Class23TDlcPen_C "Trigger Art für Löschentprellung von nicht bestätigten Fehlern (pending)" VALUE 0x1CD88F Kw_Wu8 3.00000000000 ClassTriggerTDlc 0.00 3.00000000000 FORMAT "%13.11" /end CHARACTERISTIC
/begin CHARACTERISTIC DSM_Class23DlcPen_C "Anzahl Triggerereignisse für die Löschung von nicht bestätigten Fehlern (pending)" VALUE 0x1CD890 Kw_Wu8 255.0 OneToOne 0.00 255.0 FORMAT "%5.1" /end CHARACTERISTIC
/begin CHARACTERISTIC DSM_Class23TDlc_C "Trigger Art für Löschentprellung" VALUE 0x1CD891 Kw_Wu8 3.00000000000 ClassTriggerTDlc 0.00 3.00000000000 FORMAT "%13.11" /end CHARACTERISTIC
/begin CHARACTERISTIC DSM_Class23DlcKd_C "Anzahl Triggerereignisse für die Löschung von Fehlereinträgen mit Status Kundendienst" VALUE 0x1CD892 Kw_Wu8 255.0 OneToOne 0.00 255.0 FORMAT "%5.1" /end CHARACTERISTIC
/begin CHARACTERISTIC DSM_Class23Dlc_C "Anzahl Triggerereignisse für die Löschung von Fehlereinträgen" VALUE 0x1CD893 Kw_Wu8 255.0 OneToOne 0.00 255.0 FORMAT "%5.1" /end CHARACTERISTIC
/begin CHARACTERISTIC DSM_Class23Prio_C "Priorität des Fehlereintrages für Verdrängung und freeze frame Zuordnung" VALUE 0x1CD894 Kw_Wu8 255.0 OneToOne 0.00 255.0 FORMAT "%5.1" /end CHARACTERISTIC
/begin CHARACTERISTIC DSM_Class23SysLamp_C "Art der Systemlampenansteuerung" VALUE 0x1CD895 Kw_Wu8 2.00000000000 SysLamp 0.00 2.00000000000 FORMAT "%13.11" /end CHARACTERISTIC
/begin CHARACTERISTIC DSM_Class23ResErf_C "Verhalten Fehlerflags bei Reset und abgebrochenem Nachlauf" VALUE 0x1CD896 Kw_Wu8 3.00000000000 ResErf 0.00 3.00000000000 FORMAT "%13.11" /end CHARACTERISTIC
/begin CHARACTERISTIC DSM_Class23Readiness_C "Zuordnung Entprellklasse zu Readiness Flags" VALUE 0x1CD897 Kw_Wu8 64.0000000000 Readiness 0.00 64.0000000000 FORMAT "%13.10" /end CHARACTERISTIC
/begin CHARACTERISTIC DSM_Class24Mil_C "Art der MIL Ansteuerung" VALUE 0x1CD898 Kw_Wu8 2.00000000000 Mil 0.00 2.00000000000 FORMAT "%13.11" /end CHARACTERISTIC
/begin CHARACTERISTIC DSM_Class24TFlc_C "Trigger Art für Fehlereintrags Bestätigungsentprellung (->Lampe an)" VALUE 0x1CD899 Kw_Wu8 5.00000000000 ClassTrigger 0.00 5.00000000000 FORMAT "%13.11" /end CHARACTERISTIC
/begin CHARACTERISTIC DSM_Class24Flc_C "Anzahl Triggerereignisse für Fehlereintrags Bestätigungsentprellung (->Lampe an)" VALUE 0x1CD89A Kw_Wu8 255.0 OneToOne 0.00 255.0 FORMAT "%5.1" /end CHARACTERISTIC
/begin CHARACTERISTIC DSM_Class24THlc_C "Trigger Art für Fehlerheilung (->Lampe aus)" VALUE 0x1CD89B Kw_Wu8 5.00000000000 ClassTrigger 0.00 5.00000000000 FORMAT "%13.11" /end CHARACTERISTIC
/begin CHARACTERISTIC DSM_Class24Hlc_C "Anzahl Triggerereignisse für Fehlerheilung (->Lampe aus)" VALUE 0x1CD89C Kw_Wu8 255.0 OneToOne 0.00 255.0 FORMAT "%5.1" /end CHARACTERISTIC
/begin CHARACTERISTIC DSM_Class24Scatt_C "Fehler ist lesbar für OBD Scan tool tester (SCATT) wenn Wert = 1" VALUE 0x1CD89D Kw_Wu8 1.00000000000 Scatt 0.00 1.00000000000 FORMAT "%13.11" /end CHARACTERISTIC
/begin CHARACTERISTIC DSM_Class24TDlcPen_C "Trigger Art für Löschentprellung von nicht bestätigten Fehlern (pending)" VALUE 0x1CD89E Kw_Wu8 3.00000000000 ClassTriggerTDlc 0.00 3.00000000000 FORMAT "%13.11" /end CHARACTERISTIC
/begin CHARACTERISTIC DSM_Class24DlcPen_C "Anzahl Triggerereignisse für die Löschung von nicht bestätigten Fehlern (pending)" VALUE 0x1CD89F Kw_Wu8 255.0 OneToOne 0.00 255.0 FORMAT "%5.1" /end CHARACTERISTIC
/begin CHARACTERISTIC DSM_Class24TDlc_C "Trigger Art für Löschentprellung" VALUE 0x1CD8A0 Kw_Wu8 3.00000000000 ClassTriggerTDlc 0.00 3.00000000000 FORMAT "%13.11" /end CHARACTERISTIC
/begin CHARACTERISTIC DSM_Class24DlcKd_C "Anzahl Triggerereignisse für die Löschung von Fehlereinträgen mit Status Kundendienst" VALUE 0x1CD8A1 Kw_Wu8 255.0 OneToOne 0.00 255.0 FORMAT "%5.1" /end CHARACTERISTIC
/begin CHARACTERISTIC DSM_Class24Dlc_C "Anzahl Triggerereignisse für die Löschung von Fehlereinträgen" VALUE 0x1CD8A2 Kw_Wu8 255.0 OneToOne 0.00 255.0 FORMAT "%5.1" /end CHARACTERISTIC
/begin CHARACTERISTIC DSM_Class24Prio_C "Priorität des Fehlereintrages für Verdrängung und freeze frame Zuordnung" VALUE 0x1CD8A3 Kw_Wu8 255.0 OneToOne 0.00 255.0 FORMAT "%5.1" /end CHARACTERISTIC
/begin CHARACTERISTIC DSM_Class24SysLamp_C "Art der Systemlampenansteuerung" VALUE 0x1CD8A4 Kw_Wu8 2.00000000000 SysLamp 0.00 2.00000000000 FORMAT "%13.11" /end CHARACTERISTIC
/begin CHARACTERISTIC DSM_Class24ResErf_C "Verhalten Fehlerflags bei Reset und abgebrochenem Nachlauf" VALUE 0x1CD8A5 Kw_Wu8 3.00000000000 ResErf 0.00 3.00000000000 FORMAT "%13.11" /end CHARACTERISTIC
/begin CHARACTERISTIC DSM_Class24Readiness_C "Zuordnung Entprellklasse zu Readiness Flags" VALUE 0x1CD8A6 Kw_Wu8 64.0000000000 Readiness 0.00 64.0000000000 FORMAT "%13.10" /end CHARACTERISTIC
/begin CHARACTERISTIC DSM_Class25Mil_C "Art der MIL Ansteuerung" VALUE 0x1CD8A7 Kw_Wu8 2.00000000000 Mil 0.00 2.00000000000 FORMAT "%13.11" /end CHARACTERISTIC
/begin CHARACTERISTIC DSM_Class25TFlc_C "Trigger Art für Fehlereintrags Bestätigungsentprellung (->Lampe an)" VALUE 0x1CD8A8 Kw_Wu8 5.00000000000 ClassTrigger 0.00 5.00000000000 FORMAT "%13.11" /end CHARACTERISTIC
/begin CHARACTERISTIC DSM_Class25Flc_C "Anzahl Triggerereignisse für Fehlereintrags Bestätigungsentprellung (->Lampe an)" VALUE 0x1CD8A9 Kw_Wu8 255.0 OneToOne 0.00 255.0 FORMAT "%5.1" /end CHARACTERISTIC
/begin CHARACTERISTIC DSM_Class25THlc_C "Trigger Art für Fehlerheilung (->Lampe aus)" VALUE 0x1CD8AA Kw_Wu8 5.00000000000 ClassTrigger 0.00 5.00000000000 FORMAT "%13.11" /end CHARACTERISTIC
/begin CHARACTERISTIC DSM_Class25Hlc_C "Anzahl Triggerereignisse für Fehlerheilung (->Lampe aus)" VALUE 0x1CD8AB Kw_Wu8 255.0 OneToOne 0.00 255.0 FORMAT "%5.1" /end CHARACTERISTIC
/begin CHARACTERISTIC DSM_Class25Scatt_C "Fehler ist lesbar für OBD Scan tool tester (SCATT) wenn Wert = 1" VALUE 0x1CD8AC Kw_Wu8 1.00000000000 Scatt 0.00 1.00000000000 FORMAT "%13.11" /end CHARACTERISTIC
/begin CHARACTERISTIC DSM_Class25TDlcPen_C "Trigger Art für Löschentprellung von nicht bestätigten Fehlern (pending)" VALUE 0x1CD8AD Kw_Wu8 3.00000000000 ClassTriggerTDlc 0.00 3.00000000000 FORMAT "%13.11" /end CHARACTERISTIC
/begin CHARACTERISTIC DSM_Class25DlcPen_C "Anzahl Triggerereignisse für die Löschung von nicht bestätigten Fehlern (pending)" VALUE 0x1CD8AE Kw_Wu8 255.0 OneToOne 0.00 255.0 FORMAT "%5.1" /end CHARACTERISTIC
/begin CHARACTERISTIC DSM_Class25TDlc_C "Trigger Art für Löschentprellung" VALUE 0x1CD8AF Kw_Wu8 3.00000000000 ClassTriggerTDlc 0.00 3.00000000000 FORMAT "%13.11" /end CHARACTERISTIC
/begin CHARACTERISTIC DSM_Class25DlcKd_C "Anzahl Triggerereignisse für die Löschung von Fehlereinträgen mit Status Kundendienst" VALUE 0x1CD8B0 Kw_Wu8 255.0 OneToOne 0.00 255.0 FORMAT "%5.1" /end CHARACTERISTIC
/begin CHARACTERISTIC DSM_Class25Dlc_C "Anzahl Triggerereignisse für die Löschung von Fehlereinträgen" VALUE 0x1CD8B1 Kw_Wu8 255.0 OneToOne 0.00 255.0 FORMAT "%5.1" /end CHARACTERISTIC
/begin CHARACTERISTIC DSM_Class25Prio_C "Priorität des Fehlereintrages für Verdrängung und freeze frame Zuordnung" VALUE 0x1CD8B2 Kw_Wu8 255.0 OneToOne 0.00 255.0 FORMAT "%5.1" /end CHARACTERISTIC
/begin CHARACTERISTIC DSM_Class25SysLamp_C "Art der Systemlampenansteuerung" VALUE 0x1CD8B3 Kw_Wu8 2.00000000000 SysLamp 0.00 2.00000000000 FORMAT "%13.11" /end CHARACTERISTIC
/begin CHARACTERISTIC DSM_Class25ResErf_C "Verhalten Fehlerflags bei Reset und abgebrochenem Nachlauf" VALUE 0x1CD8B4 Kw_Wu8 3.00000000000 ResErf 0.00 3.00000000000 FORMAT "%13.11" /end CHARACTERISTIC
/begin CHARACTERISTIC DSM_Class25Readiness_C "Zuordnung Entprellklasse zu Readiness Flags" VALUE 0x1CD8B5 Kw_Wu8 64.0000000000 Readiness 0.00 64.0000000000 FORMAT "%13.10" /end CHARACTERISTIC
/begin CHARACTERISTIC DSM_Class26Mil_C "Art der MIL Ansteuerung" VALUE 0x1CD8B6 Kw_Wu8 2.00000000000 Mil 0.00 2.00000000000 FORMAT "%13.11" /end CHARACTERISTIC
/begin CHARACTERISTIC DSM_Class26TFlc_C "Trigger Art für Fehlereintrags Bestätigungsentprellung (->Lampe an)" VALUE 0x1CD8B7 Kw_Wu8 5.00000000000 ClassTrigger 0.00 5.00000000000 FORMAT "%13.11" /end CHARACTERISTIC
/begin CHARACTERISTIC DSM_Class26Flc_C "Anzahl Triggerereignisse für Fehlereintrags Bestätigungsentprellung (->Lampe an)" VALUE 0x1CD8B8 Kw_Wu8 255.0 OneToOne 0.00 255.0 FORMAT "%5.1" /end CHARACTERISTIC
/begin CHARACTERISTIC DSM_Class26THlc_C "Trigger Art für Fehlerheilung (->Lampe aus)" VALUE 0x1CD8B9 Kw_Wu8 5.00000000000 ClassTrigger 0.00 5.00000000000 FORMAT "%13.11" /end CHARACTERISTIC
/begin CHARACTERISTIC DSM_Class26Hlc_C "Anzahl Triggerereignisse für Fehlerheilung (->Lampe aus)" VALUE 0x1CD8BA Kw_Wu8 255.0 OneToOne 0.00 255.0 FORMAT "%5.1" /end CHARACTERISTIC
/begin CHARACTERISTIC DSM_Class26Scatt_C "Fehler ist lesbar für OBD Scan tool tester (SCATT) wenn Wert = 1" VALUE 0x1CD8BB Kw_Wu8 1.00000000000 Scatt 0.00 1.00000000000 FORMAT "%13.11" /end CHARACTERISTIC
/begin CHARACTERISTIC DSM_Class26TDlcPen_C "Trigger Art für Löschentprellung von nicht bestätigten Fehlern (pending)" VALUE 0x1CD8BC Kw_Wu8 3.00000000000 ClassTriggerTDlc 0.00 3.00000000000 FORMAT "%13.11" /end CHARACTERISTIC
/begin CHARACTERISTIC DSM_Class26DlcPen_C "Anzahl Triggerereignisse für die Löschung von nicht bestätigten Fehlern (pending)" VALUE 0x1CD8BD Kw_Wu8 255.0 OneToOne 0.00 255.0 FORMAT "%5.1" /end CHARACTERISTIC
/begin CHARACTERISTIC DSM_Class26TDlc_C "Trigger Art für Löschentprellung" VALUE 0x1CD8BE Kw_Wu8 3.00000000000 ClassTriggerTDlc 0.00 3.00000000000 FORMAT "%13.11" /end CHARACTERISTIC
/begin CHARACTERISTIC DSM_Class26DlcKd_C "Anzahl Triggerereignisse für die Löschung von Fehlereinträgen mit Status Kundendienst" VALUE 0x1CD8BF Kw_Wu8 255.0 OneToOne 0.00 255.0 FORMAT "%5.1" /end CHARACTERISTIC
/begin CHARACTERISTIC DSM_Class26Dlc_C "Anzahl Triggerereignisse für die Löschung von Fehlereinträgen" VALUE 0x1CD8C0 Kw_Wu8 255.0 OneToOne 0.00 255.0 FORMAT "%5.1" /end CHARACTERISTIC
/begin CHARACTERISTIC DSM_Class26Prio_C "Priorität des Fehlereintrages für Verdrängung und freeze frame Zuordnung" VALUE 0x1CD8C1 Kw_Wu8 255.0 OneToOne 0.00 255.0 FORMAT "%5.1" /end CHARACTERISTIC
/begin CHARACTERISTIC DSM_Class26SysLamp_C "Art der Systemlampenansteuerung" VALUE 0x1CD8C2 Kw_Wu8 2.00000000000 SysLamp 0.00 2.00000000000 FORMAT "%13.11" /end CHARACTERISTIC
/begin CHARACTERISTIC DSM_Class26ResErf_C "Verhalten Fehlerflags bei Reset und abgebrochenem Nachlauf" VALUE 0x1CD8C3 Kw_Wu8 3.00000000000 ResErf 0.00 3.00000000000 FORMAT "%13.11" /end CHARACTERISTIC
/begin CHARACTERISTIC DSM_Class26Readiness_C "Zuordnung Entprellklasse zu Readiness Flags" VALUE 0x1CD8C4 Kw_Wu8 64.0000000000 Readiness 0.00 64.0000000000 FORMAT "%13.10" /end CHARACTERISTIC
/begin CHARACTERISTIC DSM_TypDfp_ACCCD_C "Konvertierung der Fehlertypen auf der Diagnoseschnittstelle fuer Fehlerpfad Dfp_ACCCD" VAL_BLK 0x1D1F06 Kwb_Wu8 255.0 OneToOne 0.00 255.0 FORMAT "%5.1" NUMBER 4 /end CHARACTERISTIC
/begin CHARACTERISTIC DSM_TypDfp_ACCCDBrkErr_C "Konvertierung der Fehlertypen auf der Diagnoseschnittstelle fuer Fehlerpfad Dfp_ACCCDBrkErr" VAL_BLK 0x1D1F0A Kwb_Wu8 255.0 OneToOne 0.00 255.0 FORMAT "%5.1" NUMBER 4 /end CHARACTERISTIC
/begin CHARACTERISTIC DSM_TypDfp_ACCCDBrkNPL_C "Konvertierung der Fehlertypen auf der Diagnoseschnittstelle fuer Fehlerpfad Dfp_ACCCDBrkNPL" VAL_BLK 0x1D1F0E Kwb_Wu8 255.0 OneToOne 0.00 255.0 FORMAT "%5.1" NUMBER 4 /end CHARACTERISTIC
/begin CHARACTERISTIC DSM_TypDfp_ACCCDSensErr_C "Konvertierung der Fehlertypen auf der Diagnoseschnittstelle fuer Fehlerpfad Dfp_ACCCDSensErr" VAL_BLK 0x1D1F12 Kwb_Wu8 255.0 OneToOne 0.00 255.0 FORMAT "%5.1" NUMBER 4 /end CHARACTERISTIC
/begin CHARACTERISTIC DSM_TypDfp_ACCCDWrongCoded_C "Konvertierung der Fehlertypen auf der Diagnoseschnittstelle fuer Fehlerpfad Dfp_ACCCDWrongCoded" VAL_BLK 0x1D1F16 Kwb_Wu8 255.0 OneToOne 0.00 255.0 FORMAT "%5.1" NUMBER 4 /end CHARACTERISTIC
/begin CHARACTERISTIC DSM_TypDfp_ACCD_C "Konvertierung der Fehlertypen auf der Diagnoseschnittstelle fuer Fehlerpfad Dfp_ACCD" VAL_BLK 0x1D1F1A Kwb_Wu8 255.0 OneToOne 0.00 255.0 FORMAT "%5.1" NUMBER 4 /end CHARACTERISTIC
/begin CHARACTERISTIC DSM_TypDfp_ACCD_PAC_C "Konvertierung der Fehlertypen auf der Diagnoseschnittstelle fuer Fehlerpfad Dfp_ACCD_PAC" VAL_BLK 0x1D1F1E Kwb_Wu8 255.0 OneToOne 0.00 255.0 FORMAT "%5.1" NUMBER 4 /end CHARACTERISTIC
/begin CHARACTERISTIC DSM_TypDfp_ACCD_pCAN_C "Konvertierung der Fehlertypen auf der Diagnoseschnittstelle fuer Fehlerpfad Dfp_ACCD_pCAN" VAL_BLK 0x1D1F22 Kwb_Wu8 255.0 OneToOne 0.00 255.0 FORMAT "%5.1" NUMBER 4 /end CHARACTERISTIC
/begin CHARACTERISTIC DSM_TypDfp_ACCD_trqCAN_C "Konvertierung der Fehlertypen auf der Diagnoseschnittstelle fuer Fehlerpfad Dfp_ACCD_trqCAN" VAL_BLK 0x1D1F26 Kwb_Wu8 255.0 OneToOne 0.00 255.0 FORMAT "%5.1" NUMBER 4 /end CHARACTERISTIC
/begin CHARACTERISTIC DSM_TypDfp_ACCIRevPanErr_C "Konvertierung der Fehlertypen auf der Diagnoseschnittstelle fuer Fehlerpfad Dfp_ACCIRevPanErr" VAL_BLK 0x1D1F2A Kwb_Wu8 255.0 OneToOne 0.00 255.0 FORMAT "%5.1" NUMBER 4 /end CHARACTERISTIC
/begin CHARACTERISTIC DSM_TypDfp_ACCIRevShOff_C "Konvertierung der Fehlertypen auf der Diagnoseschnittstelle fuer Fehlerpfad Dfp_ACCIRevShOff" VAL_BLK 0x1D1F2E Kwb_Wu8 255.0 OneToOne 0.00 255.0 FORMAT "%5.1" NUMBER 4 /end CHARACTERISTIC
/begin CHARACTERISTIC DSM_TypDfp_ACCnotPlaus_C "Konvertierung der Fehlertypen auf der Diagnoseschnittstelle fuer Fehlerpfad Dfp_ACCnotPlaus" VAL_BLK 0x1D1F32 Kwb_Wu8 255.0 OneToOne 0.00 255.0 FORMAT "%5.1" NUMBER 4 /end CHARACTERISTIC
/begin CHARACTERISTIC DSM_TypDfp_ADCMon_C "Konvertierung der Fehlertypen auf der Diagnoseschnittstelle fuer Fehlerpfad Dfp_ADCMon" VAL_BLK 0x1D1F36 Kwb_Wu8 255.0 OneToOne 0.00 255.0 FORMAT "%5.1" NUMBER 4 /end CHARACTERISTIC
/begin CHARACTERISTIC DSM_TypDfp_AFSCD_PlOffsDrft_C "Konvertierung der Fehlertypen auf der Diagnoseschnittstelle fuer Fehlerpfad Dfp_AFSCD_PlOffsDrft" VAL_BLK 0x1D1F3A Kwb_Wu8 255.0 OneToOne 0.00 255.0 FORMAT "%5.1" NUMBER 4 /end CHARACTERISTIC
/begin CHARACTERISTIC DSM_TypDfp_AFSCD_PlSetyDrft_C "Konvertierung der Fehlertypen auf der Diagnoseschnittstelle fuer Fehlerpfad Dfp_AFSCD_PlSetyDrft" VAL_BLK 0x1D1F3E Kwb_Wu8 255.0 OneToOne 0.00 255.0 FORMAT "%5.1" NUMBER 4 /end CHARACTERISTIC
/begin CHARACTERISTIC DSM_TypDfp_AFSCD_SRCAirm_C "Konvertierung der Fehlertypen auf der Diagnoseschnittstelle fuer Fehlerpfad Dfp_AFSCD_SRCAirm" VAL_BLK 0x1D1F42 Kwb_Wu8 255.0 OneToOne 0.00 255.0 FORMAT "%5.1" NUMBER 4 /end CHARACTERISTIC
/begin CHARACTERISTIC DSM_TypDfp_AFVCD_Actr_C "Konvertierung der Fehlertypen auf der Diagnoseschnittstelle fuer Fehlerpfad Dfp_AFVCD_Actr" VAL_BLK 0x1D1F46 Kwb_Wu8 255.0 OneToOne 0.00 255.0 FORMAT "%5.1" NUMBER 4 /end CHARACTERISTIC
/begin CHARACTERISTIC DSM_TypDfp_AOHtCDHt1_C "Konvertierung der Fehlertypen auf der Diagnoseschnittstelle fuer Fehlerpfad Dfp_AOHtCDHt1" VAL_BLK 0x1D1F4A Kwb_Wu8 255.0 OneToOne 0.00 255.0 FORMAT "%5.1" NUMBER 4 /end CHARACTERISTIC
/begin CHARACTERISTIC DSM_TypDfp_AOHtCDHt2_C "Konvertierung der Fehlertypen auf der Diagnoseschnittstelle fuer Fehlerpfad Dfp_AOHtCDHt2" VAL_BLK 0x1D1F4E Kwb_Wu8 255.0 OneToOne 0.00 255.0 FORMAT "%5.1" NUMBER 4 /end CHARACTERISTIC
/begin CHARACTERISTIC DSM_TypDfp_AOHtCDHt3_C "Konvertierung der Fehlertypen auf der Diagnoseschnittstelle fuer Fehlerpfad Dfp_AOHtCDHt3" VAL_BLK 0x1D1F52 Kwb_Wu8 255.0 OneToOne 0.00 255.0 FORMAT "%5.1" NUMBER 4 /end CHARACTERISTIC
/begin CHARACTERISTIC DSM_TypDfp_APP1_C "Konvertierung der Fehlertypen auf der Diagnoseschnittstelle fuer Fehlerpfad Dfp_APP1" VAL_BLK 0x1D1F56 Kwb_Wu8 255.0 OneToOne 0.00 255.0 FORMAT "%5.1" NUMBER 4 /end CHARACTERISTIC
/begin CHARACTERISTIC DSM_TypDfp_APP2_C "Konvertierung der Fehlertypen auf der Diagnoseschnittstelle fuer Fehlerpfad Dfp_APP2" VAL_BLK 0x1D1F5A Kwb_Wu8 255.0 OneToOne 0.00 255.0 FORMAT "%5.1" NUMBER 4 /end CHARACTERISTIC
/begin CHARACTERISTIC DSM_TypDfp_APPCD_KickDown_C "Konvertierung der Fehlertypen auf der Diagnoseschnittstelle fuer Fehlerpfad Dfp_APPCD_KickDown" VAL_BLK 0x1D1F5E Kwb_Wu8 255.0 OneToOne 0.00 255.0 FORMAT "%5.1" NUMBER 4 /end CHARACTERISTIC
/begin CHARACTERISTIC DSM_TypDfp_APPCD_PWGDrft_C "Konvertierung der Fehlertypen auf der Diagnoseschnittstelle fuer Fehlerpfad Dfp_APPCD_PWGDrft" VAL_BLK 0x1D1F62 Kwb_Wu8 255.0 OneToOne 0.00 255.0 FORMAT "%5.1" NUMBER 4 /end CHARACTERISTIC
/begin CHARACTERISTIC DSM_TypDfp_APPSync_C "Konvertierung der Fehlertypen auf der Diagnoseschnittstelle fuer Fehlerpfad Dfp_APPSync" VAL_BLK 0x1D1F66 Kwb_Wu8 255.0 OneToOne 0.00 255.0 FORMAT "%5.1" NUMBER 4 /end CHARACTERISTIC
/begin CHARACTERISTIC DSM_TypDfp_APP_Npl_C "Konvertierung der Fehlertypen auf der Diagnoseschnittstelle fuer Fehlerpfad Dfp_APP_Npl" VAL_BLK 0x1D1F6A Kwb_Wu8 255.0 OneToOne 0.00 255.0 FORMAT "%5.1" NUMBER 4 /end CHARACTERISTIC
/begin CHARACTERISTIC DSM_TypDfp_APSCD_C "Konvertierung der Fehlertypen auf der Diagnoseschnittstelle fuer Fehlerpfad Dfp_APSCD" VAL_BLK 0x1D1F6E Kwb_Wu8 255.0 OneToOne 0.00 255.0 FORMAT "%5.1" NUMBER 4 /end CHARACTERISTIC
/begin CHARACTERISTIC DSM_TypDfp_AccPedPlausBrk_C "Konvertierung der Fehlertypen auf der Diagnoseschnittstelle fuer Fehlerpfad Dfp_AccPedPlausBrk" VAL_BLK 0x1D1F72 Kwb_Wu8 255.0 OneToOne 0.00 255.0 FORMAT "%5.1" NUMBER 4 /end CHARACTERISTIC
/begin CHARACTERISTIC DSM_TypDfp_AirCtl_GovDevMax_C "Konvertierung der Fehlertypen auf der Diagnoseschnittstelle fuer Fehlerpfad Dfp_AirCtl_GovDevMax" VAL_BLK 0x1D1F76 Kwb_Wu8 255.0 OneToOne 0.00 255.0 FORMAT "%5.1" NUMBER 4 /end CHARACTERISTIC
/begin CHARACTERISTIC DSM_TypDfp_AirCtl_GovDevMin_C "Konvertierung der Fehlertypen auf der Diagnoseschnittstelle fuer Fehlerpfad Dfp_AirCtl_GovDevMin" VAL_BLK 0x1D1F7A Kwb_Wu8 255.0 OneToOne 0.00 255.0 FORMAT "%5.1" NUMBER 4 /end CHARACTERISTIC
/begin CHARACTERISTIC DSM_TypDfp_AirCtl_GovDevRgnMax_C "Konvertierung der Fehlertypen auf der Diagnoseschnittstelle fuer Fehlerpfad Dfp_AirCtl_GovDevRgnMax" VAL_BLK 0x1D1F7E Kwb_Wu8 255.0 OneToOne 0.00 255.0 FORMAT "%5.1" NUMBER 4 /end CHARACTERISTIC
/begin CHARACTERISTIC DSM_TypDfp_AirCtl_GovDevRgnMin_C "Konvertierung der Fehlertypen auf der Diagnoseschnittstelle fuer Fehlerpfad Dfp_AirCtl_GovDevRgnMin" VAL_BLK 0x1D1F82 Kwb_Wu8 255.0 OneToOne 0.00 255.0 FORMAT "%5.1" NUMBER 4 /end CHARACTERISTIC
/begin CHARACTERISTIC DSM_TypDfp_AirbCDCrash_C "Konvertierung der Fehlertypen auf der Diagnoseschnittstelle fuer Fehlerpfad Dfp_AirbCDCrash" VAL_BLK 0x1D1F86 Kwb_Wu8 255.0 OneToOne 0.00 255.0 FORMAT "%5.1" NUMBER 4 /end CHARACTERISTIC
/begin CHARACTERISTIC DSM_TypDfp_AirbCDCrashCrCtl_C "Konvertierung der Fehlertypen auf der Diagnoseschnittstelle fuer Fehlerpfad Dfp_AirbCDCrashCrCtl" VAL_BLK 0x1D1F8A Kwb_Wu8 255.0 OneToOne 0.00 255.0 FORMAT "%5.1" NUMBER 4 /end CHARACTERISTIC
/begin CHARACTERISTIC DSM_TypDfp_AirbCDCrashPSP_C "Konvertierung der Fehlertypen auf der Diagnoseschnittstelle fuer Fehlerpfad Dfp_AirbCDCrashPSP" VAL_BLK 0x1D1F8E Kwb_Wu8 255.0 OneToOne 0.00 255.0 FORMAT "%5.1" NUMBER 4 /end CHARACTERISTIC
/begin CHARACTERISTIC DSM_TypDfp_AltCDExc_C "Konvertierung der Fehlertypen auf der Diagnoseschnittstelle fuer Fehlerpfad Dfp_AltCDExc" VAL_BLK 0x1D1F92 Kwb_Wu8 255.0 OneToOne 0.00 255.0 FORMAT "%5.1" NUMBER 4 /end CHARACTERISTIC
/begin CHARACTERISTIC DSM_TypDfp_AltCD_Load_C "Konvertierung der Fehlertypen auf der Diagnoseschnittstelle fuer Fehlerpfad Dfp_AltCD_Load" VAL_BLK 0x1D1F96 Kwb_Wu8 255.0 OneToOne 0.00 255.0 FORMAT "%5.1" NUMBER 4 /end CHARACTERISTIC
/begin CHARACTERISTIC DSM_TypDfp_AltPwrCan_C "Konvertierung der Fehlertypen auf der Diagnoseschnittstelle fuer Fehlerpfad Dfp_AltPwrCan" VAL_BLK 0x1D1F9A Kwb_Wu8 255.0 OneToOne 0.00 255.0 FORMAT "%5.1" NUMBER 4 /end CHARACTERISTIC
/begin CHARACTERISTIC DSM_TypDfp_BIP01_C "Konvertierung der Fehlertypen auf der Diagnoseschnittstelle fuer Fehlerpfad Dfp_BIP01" VAL_BLK 0x1D1F9E Kwb_Wu8 255.0 OneToOne 0.00 255.0 FORMAT "%5.1" NUMBER 4 /end CHARACTERISTIC
/begin CHARACTERISTIC DSM_TypDfp_BIP02_C "Konvertierung der Fehlertypen auf der Diagnoseschnittstelle fuer Fehlerpfad Dfp_BIP02" VAL_BLK 0x1D1FA2 Kwb_Wu8 255.0 OneToOne 0.00 255.0 FORMAT "%5.1" NUMBER 4 /end CHARACTERISTIC
/begin CHARACTERISTIC DSM_TypDfp_BIP03_C "Konvertierung der Fehlertypen auf der Diagnoseschnittstelle fuer Fehlerpfad Dfp_BIP03" VAL_BLK 0x1D1FA6 Kwb_Wu8 255.0 OneToOne 0.00 255.0 FORMAT "%5.1" NUMBER 4 /end CHARACTERISTIC
/begin CHARACTERISTIC DSM_TypDfp_BIP04_C "Konvertierung der Fehlertypen auf der Diagnoseschnittstelle fuer Fehlerpfad Dfp_BIP04" VAL_BLK 0x1D1FAA Kwb_Wu8 255.0 OneToOne 0.00 255.0 FORMAT "%5.1" NUMBER 4 /end CHARACTERISTIC
/begin CHARACTERISTIC DSM_TypDfp_BIP05_C "Konvertierung der Fehlertypen auf der Diagnoseschnittstelle fuer Fehlerpfad Dfp_BIP05" VAL_BLK 0x1D1FAE Kwb_Wu8 255.0 OneToOne 0.00 255.0 FORMAT "%5.1" NUMBER 4 /end CHARACTERISTIC
/begin CHARACTERISTIC DSM_TypDfp_BIP06_C "Konvertierung der Fehlertypen auf der Diagnoseschnittstelle fuer Fehlerpfad Dfp_BIP06" VAL_BLK 0x1D1FB2 Kwb_Wu8 255.0 OneToOne 0.00 255.0 FORMAT "%5.1" NUMBER 4 /end CHARACTERISTIC
/begin CHARACTERISTIC DSM_TypDfp_BIP07_C "Konvertierung der Fehlertypen auf der Diagnoseschnittstelle fuer Fehlerpfad Dfp_BIP07" VAL_BLK 0x1D1FB6 Kwb_Wu8 255.0 OneToOne 0.00 255.0 FORMAT "%5.1" NUMBER 4 /end CHARACTERISTIC
/begin CHARACTERISTIC DSM_TypDfp_BIP08_C "Konvertierung der Fehlertypen auf der Diagnoseschnittstelle fuer Fehlerpfad Dfp_BIP08" VAL_BLK 0x1D1FBA Kwb_Wu8 255.0 OneToOne 0.00 255.0 FORMAT "%5.1" NUMBER 4 /end CHARACTERISTIC
/begin CHARACTERISTIC DSM_TypDfp_BIP09_C "Konvertierung der Fehlertypen auf der Diagnoseschnittstelle fuer Fehlerpfad Dfp_BIP09" VAL_BLK 0x1D1FBE Kwb_Wu8 255.0 OneToOne 0.00 255.0 FORMAT "%5.1" NUMBER 4 /end CHARACTERISTIC
/begin CHARACTERISTIC DSM_TypDfp_BIP10_C "Konvertierung der Fehlertypen auf der Diagnoseschnittstelle fuer Fehlerpfad Dfp_BIP10" VAL_BLK 0x1D1FC2 Kwb_Wu8 255.0 OneToOne 0.00 255.0 FORMAT "%5.1" NUMBER 4 /end CHARACTERISTIC
/begin CHARACTERISTIC DSM_TypDfp_BIP11_C "Konvertierung der Fehlertypen auf der Diagnoseschnittstelle fuer Fehlerpfad Dfp_BIP11" VAL_BLK 0x1D1FC6 Kwb_Wu8 255.0 OneToOne 0.00 255.0 FORMAT "%5.1" NUMBER 4 /end CHARACTERISTIC
/begin CHARACTERISTIC DSM_TypDfp_BIP12_C "Konvertierung der Fehlertypen auf der Diagnoseschnittstelle fuer Fehlerpfad Dfp_BIP12" VAL_BLK 0x1D1FCA Kwb_Wu8 255.0 OneToOne 0.00 255.0 FORMAT "%5.1" NUMBER 4 /end CHARACTERISTIC
/begin CHARACTERISTIC DSM_TypDfp_BIP_Con_C "Konvertierung der Fehlertypen auf der Diagnoseschnittstelle fuer Fehlerpfad Dfp_BIP_Con" VAL_BLK 0x1D1FCE Kwb_Wu8 255.0 OneToOne 0.00 255.0 FORMAT "%5.1" NUMBER 4 /end CHARACTERISTIC
/begin CHARACTERISTIC DSM_TypDfp_BPACD_Max_C "Konvertierung der Fehlertypen auf der Diagnoseschnittstelle fuer Fehlerpfad Dfp_BPACD_Max" VAL_BLK 0x1D1FD2 Kwb_Wu8 255.0 OneToOne 0.00 255.0 FORMAT "%5.1" NUMBER 4 /end CHARACTERISTIC
/begin CHARACTERISTIC DSM_TypDfp_BPACD_Max2_C "Konvertierung der Fehlertypen auf der Diagnoseschnittstelle fuer Fehlerpfad Dfp_BPACD_Max2" VAL_BLK 0x1D1FD6 Kwb_Wu8 255.0 OneToOne 0.00 255.0 FORMAT "%5.1" NUMBER 4 /end CHARACTERISTIC
/begin CHARACTERISTIC DSM_TypDfp_BPACD_Min_C "Konvertierung der Fehlertypen auf der Diagnoseschnittstelle fuer Fehlerpfad Dfp_BPACD_Min" VAL_BLK 0x1D1FDA Kwb_Wu8 255.0 OneToOne 0.00 255.0 FORMAT "%5.1" NUMBER 4 /end CHARACTERISTIC
/begin CHARACTERISTIC DSM_TypDfp_BPACD_Min2_C "Konvertierung der Fehlertypen auf der Diagnoseschnittstelle fuer Fehlerpfad Dfp_BPACD_Min2" VAL_BLK 0x1D1FDE Kwb_Wu8 255.0 OneToOne 0.00 255.0 FORMAT "%5.1" NUMBER 4 /end CHARACTERISTIC
/begin CHARACTERISTIC DSM_TypDfp_BPACD_SigNpl_C "Konvertierung der Fehlertypen auf der Diagnoseschnittstelle fuer Fehlerpfad Dfp_BPACD_SigNpl" VAL_BLK 0x1D1FE2 Kwb_Wu8 255.0 OneToOne 0.00 255.0 FORMAT "%5.1" NUMBER 4 /end CHARACTERISTIC
/begin CHARACTERISTIC DSM_TypDfp_BPACD_SigNpl2_C "Konvertierung der Fehlertypen auf der Diagnoseschnittstelle fuer Fehlerpfad Dfp_BPACD_SigNpl2" VAL_BLK 0x1D1FE6 Kwb_Wu8 255.0 OneToOne 0.00 255.0 FORMAT "%5.1" NUMBER 4 /end CHARACTERISTIC
/begin CHARACTERISTIC DSM_TypDfp_BPASCD_C "Konvertierung der Fehlertypen auf der Diagnoseschnittstelle fuer Fehlerpfad Dfp_BPASCD" VAL_BLK 0x1D1FEA Kwb_Wu8 255.0 OneToOne 0.00 255.0 FORMAT "%5.1" NUMBER 4 /end CHARACTERISTIC
/begin CHARACTERISTIC DSM_TypDfp_BPSCD_C "Konvertierung der Fehlertypen auf der Diagnoseschnittstelle fuer Fehlerpfad Dfp_BPSCD" VAL_BLK 0x1D1FEE Kwb_Wu8 255.0 OneToOne 0.00 255.0 FORMAT "%5.1" NUMBER 4 /end CHARACTERISTIC
/begin CHARACTERISTIC DSM_TypDfp_BattCD_C "Konvertierung der Fehlertypen auf der Diagnoseschnittstelle fuer Fehlerpfad Dfp_BattCD" VAL_BLK 0x1D1FF6 Kwb_Wu8 255.0 OneToOne 0.00 255.0 FORMAT "%5.1" NUMBER 4 /end CHARACTERISTIC
/begin CHARACTERISTIC DSM_TypDfp_BrkCD_C "Konvertierung der Fehlertypen auf der Diagnoseschnittstelle fuer Fehlerpfad Dfp_BrkCD" VAL_BLK 0x1D1FFA Kwb_Wu8 255.0 OneToOne 0.00 255.0 FORMAT "%5.1" NUMBER 4 /end CHARACTERISTIC
/begin CHARACTERISTIC DSM_TypDfp_BrkCDBPTInvld_C "Konvertierung der Fehlertypen auf der Diagnoseschnittstelle fuer Fehlerpfad Dfp_BrkCDBPTInvld" VAL_BLK 0x1D1FFE Kwb_Wu8 255.0 OneToOne 0.00 255.0 FORMAT "%5.1" NUMBER 4 /end CHARACTERISTIC
/begin CHARACTERISTIC DSM_TypDfp_BrkCDdynPl_C "Konvertierung der Fehlertypen auf der Diagnoseschnittstelle fuer Fehlerpfad Dfp_BrkCDdynPl" VAL_BLK 0x1D2002 Kwb_Wu8 255.0 OneToOne 0.00 255.0 FORMAT "%5.1" NUMBER 4 /end CHARACTERISTIC
/begin CHARACTERISTIC DSM_TypDfp_CANA_C "Konvertierung der Fehlertypen auf der Diagnoseschnittstelle fuer Fehlerpfad Dfp_CANA" VAL_BLK 0x1D2006 Kwb_Wu8 255.0 OneToOne 0.00 255.0 FORMAT "%5.1" NUMBER 4 /end CHARACTERISTIC
/begin CHARACTERISTIC DSM_TypDfp_CANB_C "Konvertierung der Fehlertypen auf der Diagnoseschnittstelle fuer Fehlerpfad Dfp_CANB" VAL_BLK 0x1D200A Kwb_Wu8 255.0 OneToOne 0.00 255.0 FORMAT "%5.1" NUMBER 4 /end CHARACTERISTIC
/begin CHARACTERISTIC DSM_TypDfp_CANBus1_C "Konvertierung der Fehlertypen auf der Diagnoseschnittstelle fuer Fehlerpfad Dfp_CANBus1" VAL_BLK 0x1D200E Kwb_Wu8 255.0 OneToOne 0.00 255.0 FORMAT "%5.1" NUMBER 4 /end CHARACTERISTIC
/begin CHARACTERISTIC DSM_TypDfp_CANBus2_C "Konvertierung der Fehlertypen auf der Diagnoseschnittstelle fuer Fehlerpfad Dfp_CANBus2" VAL_BLK 0x1D2012 Kwb_Wu8 255.0 OneToOne 0.00 255.0 FORMAT "%5.1" NUMBER 4 /end CHARACTERISTIC
/begin CHARACTERISTIC DSM_TypDfp_CANBus3_C "Konvertierung der Fehlertypen auf der Diagnoseschnittstelle fuer Fehlerpfad Dfp_CANBus3" VAL_BLK 0x1D2016 Kwb_Wu8 255.0 OneToOne 0.00 255.0 FORMAT "%5.1" NUMBER 4 /end CHARACTERISTIC
/begin CHARACTERISTIC DSM_TypDfp_CANC_C "Konvertierung der Fehlertypen auf der Diagnoseschnittstelle fuer Fehlerpfad Dfp_CANC" VAL_BLK 0x1D201A Kwb_Wu8 255.0 OneToOne 0.00 255.0 FORMAT "%5.1" NUMBER 4 /end CHARACTERISTIC
/begin CHARACTERISTIC DSM_TypDfp_CANErrActA_C "Konvertierung der Fehlertypen auf der Diagnoseschnittstelle fuer Fehlerpfad Dfp_CANErrActA" VAL_BLK 0x1D201E Kwb_Wu8 255.0 OneToOne 0.00 255.0 FORMAT "%5.1" NUMBER 4 /end CHARACTERISTIC
/begin CHARACTERISTIC DSM_TypDfp_CANErrActB_C "Konvertierung der Fehlertypen auf der Diagnoseschnittstelle fuer Fehlerpfad Dfp_CANErrActB" VAL_BLK 0x1D2022 Kwb_Wu8 255.0 OneToOne 0.00 255.0 FORMAT "%5.1" NUMBER 4 /end CHARACTERISTIC
/begin CHARACTERISTIC DSM_TypDfp_CANErrActC_C "Konvertierung der Fehlertypen auf der Diagnoseschnittstelle fuer Fehlerpfad Dfp_CANErrActC" VAL_BLK 0x1D2026 Kwb_Wu8 255.0 OneToOne 0.00 255.0 FORMAT "%5.1" NUMBER 4 /end CHARACTERISTIC
/begin CHARACTERISTIC DSM_TypDfp_COTSCD_C "Konvertierung der Fehlertypen auf der Diagnoseschnittstelle fuer Fehlerpfad Dfp_COTSCD" VAL_BLK 0x1D202A Kwb_Wu8 255.0 OneToOne 0.00 255.0 FORMAT "%5.1" NUMBER 4 /end CHARACTERISTIC
/begin CHARACTERISTIC DSM_TypDfp_CTSCD_C "Konvertierung der Fehlertypen auf der Diagnoseschnittstelle fuer Fehlerpfad Dfp_CTSCD" VAL_BLK 0x1D202E Kwb_Wu8 255.0 OneToOne 0.00 255.0 FORMAT "%5.1" NUMBER 4 /end CHARACTERISTIC
/begin CHARACTERISTIC DSM_TypDfp_CTSCDCanInac_C "Konvertierung der Fehlertypen auf der Diagnoseschnittstelle fuer Fehlerpfad Dfp_CTSCDCanInac" VAL_BLK 0x1D2032 Kwb_Wu8 255.0 OneToOne 0.00 255.0 FORMAT "%5.1" NUMBER 4 /end CHARACTERISTIC
/begin CHARACTERISTIC DSM_TypDfp_CTSCDCanSig_C "Konvertierung der Fehlertypen auf der Diagnoseschnittstelle fuer Fehlerpfad Dfp_CTSCDCanSig" VAL_BLK 0x1D2036 Kwb_Wu8 255.0 OneToOne 0.00 255.0 FORMAT "%5.1" NUMBER 4 /end CHARACTERISTIC
/begin CHARACTERISTIC DSM_TypDfp_Clg_DynTst_C "Konvertierung der Fehlertypen auf der Diagnoseschnittstelle fuer Fehlerpfad Dfp_Clg_DynTst" VAL_BLK 0x1D203A Kwb_Wu8 255.0 OneToOne 0.00 255.0 FORMAT "%5.1" NUMBER 4 /end CHARACTERISTIC
/begin CHARACTERISTIC DSM_TypDfp_CmbChbMisfire1_C "Konvertierung der Fehlertypen auf der Diagnoseschnittstelle fuer Fehlerpfad Dfp_CmbChbMisfire1" VAL_BLK 0x1D203E Kwb_Wu8 255.0 OneToOne 0.00 255.0 FORMAT "%5.1" NUMBER 4 /end CHARACTERISTIC
/begin CHARACTERISTIC DSM_TypDfp_CmbChbMisfire2_C "Konvertierung der Fehlertypen auf der Diagnoseschnittstelle fuer Fehlerpfad Dfp_CmbChbMisfire2" VAL_BLK 0x1D2042 Kwb_Wu8 255.0 OneToOne 0.00 255.0 FORMAT "%5.1" NUMBER 4 /end CHARACTERISTIC
/begin CHARACTERISTIC DSM_TypDfp_CmbChbMisfire3_C "Konvertierung der Fehlertypen auf der Diagnoseschnittstelle fuer Fehlerpfad Dfp_CmbChbMisfire3" VAL_BLK 0x1D2046 Kwb_Wu8 255.0 OneToOne 0.00 255.0 FORMAT "%5.1" NUMBER 4 /end CHARACTERISTIC
/begin CHARACTERISTIC DSM_TypDfp_CmbChbMisfire4_C "Konvertierung der Fehlertypen auf der Diagnoseschnittstelle fuer Fehlerpfad Dfp_CmbChbMisfire4" VAL_BLK 0x1D204A Kwb_Wu8 255.0 OneToOne 0.00 255.0 FORMAT "%5.1" NUMBER 4 /end CHARACTERISTIC
/begin CHARACTERISTIC DSM_TypDfp_CmbChbMisfire5_C "Konvertierung der Fehlertypen auf der Diagnoseschnittstelle fuer Fehlerpfad Dfp_CmbChbMisfire5" VAL_BLK 0x1D204E Kwb_Wu8 255.0 OneToOne 0.00 255.0 FORMAT "%5.1" NUMBER 4 /end CHARACTERISTIC
/begin CHARACTERISTIC DSM_TypDfp_CmbChbMisfire6_C "Konvertierung der Fehlertypen auf der Diagnoseschnittstelle fuer Fehlerpfad Dfp_CmbChbMisfire6" VAL_BLK 0x1D2052 Kwb_Wu8 255.0 OneToOne 0.00 255.0 FORMAT "%5.1" NUMBER 4 /end CHARACTERISTIC
/begin CHARACTERISTIC DSM_TypDfp_CmbChbMisfireMul_C "Konvertierung der Fehlertypen auf der Diagnoseschnittstelle fuer Fehlerpfad Dfp_CmbChbMisfireMul" VAL_BLK 0x1D2056 Kwb_Wu8 255.0 OneToOne 0.00 255.0 FORMAT "%5.1" NUMBER 4 /end CHARACTERISTIC
/begin CHARACTERISTIC DSM_TypDfp_CoVMDCSh_C "Konvertierung der Fehlertypen auf der Diagnoseschnittstelle fuer Fehlerpfad Dfp_CoVMDCSh" VAL_BLK 0x1D205E Kwb_Wu8 255.0 OneToOne 0.00 255.0 FORMAT "%5.1" NUMBER 4 /end CHARACTERISTIC
/begin CHARACTERISTIC DSM_TypDfp_CoVMDCSp_C "Konvertierung der Fehlertypen auf der Diagnoseschnittstelle fuer Fehlerpfad Dfp_CoVMDCSp" VAL_BLK 0x1D2062 Kwb_Wu8 255.0 OneToOne 0.00 255.0 FORMAT "%5.1" NUMBER 4 /end CHARACTERISTIC
/begin CHARACTERISTIC DSM_TypDfp_CoVehLvl2_C "Konvertierung der Fehlertypen auf der Diagnoseschnittstelle fuer Fehlerpfad Dfp_CoVehLvl2" VAL_BLK 0x1D206E Kwb_Wu8 255.0 OneToOne 0.00 255.0 FORMAT "%5.1" NUMBER 4 /end CHARACTERISTIC
/begin CHARACTERISTIC DSM_TypDfp_ConvCD_C "Konvertierung der Fehlertypen auf der Diagnoseschnittstelle fuer Fehlerpfad Dfp_ConvCD" VAL_BLK 0x1D2072 Kwb_Wu8 255.0 OneToOne 0.00 255.0 FORMAT "%5.1" NUMBER 4 /end CHARACTERISTIC
/begin CHARACTERISTIC DSM_TypDfp_ConvCD_ConvErr_C "Konvertierung der Fehlertypen auf der Diagnoseschnittstelle fuer Fehlerpfad Dfp_ConvCD_ConvErr" VAL_BLK 0x1D2076 Kwb_Wu8 255.0 OneToOne 0.00 255.0 FORMAT "%5.1" NUMBER 4 /end CHARACTERISTIC
/begin CHARACTERISTIC DSM_TypDfp_ConvCD_EPB1_C "Konvertierung der Fehlertypen auf der Diagnoseschnittstelle fuer Fehlerpfad Dfp_ConvCD_EPB1" VAL_BLK 0x1D207A Kwb_Wu8 255.0 OneToOne 0.00 255.0 FORMAT "%5.1" NUMBER 4 /end CHARACTERISTIC
/begin CHARACTERISTIC DSM_TypDfp_CrCCDPanErrMSG_C "Konvertierung der Fehlertypen auf der Diagnoseschnittstelle fuer Fehlerpfad Dfp_CrCCDPanErrMSG" VAL_BLK 0x1D207E Kwb_Wu8 255.0 OneToOne 0.00 255.0 FORMAT "%5.1" NUMBER 4 /end CHARACTERISTIC
/begin CHARACTERISTIC DSM_TypDfp_CrCCDPanErrSMLS_C "Konvertierung der Fehlertypen auf der Diagnoseschnittstelle fuer Fehlerpfad Dfp_CrCCDPanErrSMLS" VAL_BLK 0x1D2082 Kwb_Wu8 255.0 OneToOne 0.00 255.0 FORMAT "%5.1" NUMBER 4 /end CHARACTERISTIC
/begin CHARACTERISTIC DSM_TypDfp_CrCCDPanMainSwtErr_C "Konvertierung der Fehlertypen auf der Diagnoseschnittstelle fuer Fehlerpfad Dfp_CrCCDPanMainSwtErr" VAL_BLK 0x1D2086 Kwb_Wu8 255.0 OneToOne 0.00 255.0 FORMAT "%5.1" NUMBER 4 /end CHARACTERISTIC
/begin CHARACTERISTIC DSM_TypDfp_CrCtlDsplNotPlaus_C "Konvertierung der Fehlertypen auf der Diagnoseschnittstelle fuer Fehlerpfad Dfp_CrCtlDsplNotPlaus" VAL_BLK 0x1D208E Kwb_Wu8 255.0 OneToOne 0.00 255.0 FORMAT "%5.1" NUMBER 4 /end CHARACTERISTIC
/begin CHARACTERISTIC DSM_TypDfp_CrCtlPECDErr_C "Konvertierung der Fehlertypen auf der Diagnoseschnittstelle fuer Fehlerpfad Dfp_CrCtlPECDErr" VAL_BLK 0x1D2092 Kwb_Wu8 255.0 OneToOne 0.00 255.0 FORMAT "%5.1" NUMBER 4 /end CHARACTERISTIC
/begin CHARACTERISTIC DSM_TypDfp_CrCtlPLmpDef_C "Konvertierung der Fehlertypen auf der Diagnoseschnittstelle fuer Fehlerpfad Dfp_CrCtlPLmpDef" VAL_BLK 0x1D2096 Kwb_Wu8 255.0 OneToOne 0.00 255.0 FORMAT "%5.1" NUMBER 4 /end CHARACTERISTIC
/begin CHARACTERISTIC DSM_TypDfp_CrCtlPShutOff_C "Konvertierung der Fehlertypen auf der Diagnoseschnittstelle fuer Fehlerpfad Dfp_CrCtlPShutOff" VAL_BLK 0x1D209A Kwb_Wu8 255.0 OneToOne 0.00 255.0 FORMAT "%5.1" NUMBER 4 /end CHARACTERISTIC
/begin CHARACTERISTIC DSM_TypDfp_CrCtlPTlrDef_C "Konvertierung der Fehlertypen auf der Diagnoseschnittstelle fuer Fehlerpfad Dfp_CrCtlPTlrDef" VAL_BLK 0x1D209E Kwb_Wu8 255.0 OneToOne 0.00 255.0 FORMAT "%5.1" NUMBER 4 /end CHARACTERISTIC
/begin CHARACTERISTIC DSM_TypDfp_CtApCD_C "Konvertierung der Fehlertypen auf der Diagnoseschnittstelle fuer Fehlerpfad Dfp_CtApCD" VAL_BLK 0x1D20A6 Kwb_Wu8 255.0 OneToOne 0.00 255.0 FORMAT "%5.1" NUMBER 4 /end CHARACTERISTIC
/begin CHARACTERISTIC DSM_TypDfp_CtTCD_C "Konvertierung der Fehlertypen auf der Diagnoseschnittstelle fuer Fehlerpfad Dfp_CtTCD" VAL_BLK 0x1D20AA Kwb_Wu8 255.0 OneToOne 0.00 255.0 FORMAT "%5.1" NUMBER 4 /end CHARACTERISTIC
/begin CHARACTERISTIC DSM_TypDfp_CtT_Mon_C "Konvertierung der Fehlertypen auf der Diagnoseschnittstelle fuer Fehlerpfad Dfp_CtT_Mon" VAL_BLK 0x1D20AE Kwb_Wu8 255.0 OneToOne 0.00 255.0 FORMAT "%5.1" NUMBER 4 /end CHARACTERISTIC
/begin CHARACTERISTIC DSM_TypDfp_DifftrqLimErrPat_C "Konvertierung der Fehlertypen auf der Diagnoseschnittstelle fuer Fehlerpfad Dfp_DifftrqLimErrPat" VAL_BLK 0x1D20B2 Kwb_Wu8 255.0 OneToOne 0.00 255.0 FORMAT "%5.1" NUMBER 4 /end CHARACTERISTIC
/begin CHARACTERISTIC DSM_TypDfp_EATSCD_C "Konvertierung der Fehlertypen auf der Diagnoseschnittstelle fuer Fehlerpfad Dfp_EATSCD" VAL_BLK 0x1D20B6 Kwb_Wu8 255.0 OneToOne 0.00 255.0 FORMAT "%5.1" NUMBER 4 /end CHARACTERISTIC
/begin CHARACTERISTIC DSM_TypDfp_EATSCDCanInac_C "Konvertierung der Fehlertypen auf der Diagnoseschnittstelle fuer Fehlerpfad Dfp_EATSCDCanInac" VAL_BLK 0x1D20BA Kwb_Wu8 255.0 OneToOne 0.00 255.0 FORMAT "%5.1" NUMBER 4 /end CHARACTERISTIC
/begin CHARACTERISTIC DSM_TypDfp_EATSCDCanSig_C "Konvertierung der Fehlertypen auf der Diagnoseschnittstelle fuer Fehlerpfad Dfp_EATSCDCanSig" VAL_BLK 0x1D20BE Kwb_Wu8 255.0 OneToOne 0.00 255.0 FORMAT "%5.1" NUMBER 4 /end CHARACTERISTIC
/begin CHARACTERISTIC DSM_TypDfp_EEPCDVarMng_C "Konvertierung der Fehlertypen auf der Diagnoseschnittstelle fuer Fehlerpfad Dfp_EEPCDVarMng" VAL_BLK 0x1D20C2 Kwb_Wu8 255.0 OneToOne 0.00 255.0 FORMAT "%5.1" NUMBER 4 /end CHARACTERISTIC
/begin CHARACTERISTIC DSM_TypDfp_EGPpCDTPreTrbn_C "Konvertierung der Fehlertypen auf der Diagnoseschnittstelle fuer Fehlerpfad Dfp_EgPpCDTPreTrbn" VAL_BLK 0x1D20C6 Kwb_Wu8 255.0 OneToOne 0.00 255.0 FORMAT "%5.1" NUMBER 4 /end CHARACTERISTIC
/begin CHARACTERISTIC DSM_TypDfp_EGRCD_CBV_C "Konvertierung der Fehlertypen auf der Diagnoseschnittstelle fuer Fehlerpfad Dfp_EGRCD_CBV" VAL_BLK 0x1D20CA Kwb_Wu8 255.0 OneToOne 0.00 255.0 FORMAT "%5.1" NUMBER 4 /end CHARACTERISTIC
/begin CHARACTERISTIC DSM_TypDfp_EGRCD_Max_C "Konvertierung der Fehlertypen auf der Diagnoseschnittstelle fuer Fehlerpfad Dfp_EGRCD_Max" VAL_BLK 0x1D20CE Kwb_Wu8 255.0 OneToOne 0.00 255.0 FORMAT "%5.1" NUMBER 4 /end CHARACTERISTIC
/begin CHARACTERISTIC DSM_TypDfp_EGRCD_Min_C "Konvertierung der Fehlertypen auf der Diagnoseschnittstelle fuer Fehlerpfad Dfp_EGRCD_Min" VAL_BLK 0x1D20D2 Kwb_Wu8 255.0 OneToOne 0.00 255.0 FORMAT "%5.1" NUMBER 4 /end CHARACTERISTIC
/begin CHARACTERISTIC DSM_TypDfp_EGRCD_Sig_C "Konvertierung der Fehlertypen auf der Diagnoseschnittstelle fuer Fehlerpfad Dfp_EGRCD_Sig" VAL_BLK 0x1D20D6 Kwb_Wu8 255.0 OneToOne 0.00 255.0 FORMAT "%5.1" NUMBER 4 /end CHARACTERISTIC
/begin CHARACTERISTIC DSM_TypDfp_EGRCD_SigNpl_C "Konvertierung der Fehlertypen auf der Diagnoseschnittstelle fuer Fehlerpfad Dfp_EGRCD_SigNpl" VAL_BLK 0x1D20DA Kwb_Wu8 255.0 OneToOne 0.00 255.0 FORMAT "%5.1" NUMBER 4 /end CHARACTERISTIC
/begin CHARACTERISTIC DSM_TypDfp_EGRSCD_C "Konvertierung der Fehlertypen auf der Diagnoseschnittstelle fuer Fehlerpfad Dfp_EGRSCD" VAL_BLK 0x1D20DE Kwb_Wu8 255.0 OneToOne 0.00 255.0 FORMAT "%5.1" NUMBER 4 /end CHARACTERISTIC
/begin CHARACTERISTIC DSM_TypDfp_EGRSCD_JamVlv_C "Konvertierung der Fehlertypen auf der Diagnoseschnittstelle fuer Fehlerpfad Dfp_EGRSCD_JamVlv" VAL_BLK 0x1D20E2 Kwb_Wu8 255.0 OneToOne 0.00 255.0 FORMAT "%5.1" NUMBER 4 /end CHARACTERISTIC
/begin CHARACTERISTIC DSM_TypDfp_EGRSCD_LgTimeDrft_C "Konvertierung der Fehlertypen auf der Diagnoseschnittstelle fuer Fehlerpfad Dfp_EGRSCD_LgTimeDrft" VAL_BLK 0x1D20E6 Kwb_Wu8 255.0 OneToOne 0.00 255.0 FORMAT "%5.1" NUMBER 4 /end CHARACTERISTIC
/begin CHARACTERISTIC DSM_TypDfp_EGRSCD_ShTimeDrft_C "Konvertierung der Fehlertypen auf der Diagnoseschnittstelle fuer Fehlerpfad Dfp_EGRSCD_ShTimeDrft" VAL_BLK 0x1D20EA Kwb_Wu8 255.0 OneToOne 0.00 255.0 FORMAT "%5.1" NUMBER 4 /end CHARACTERISTIC
/begin CHARACTERISTIC DSM_TypDfp_EGRVlvGvnrDvt_C "Konvertierung der Fehlertypen auf der Diagnoseschnittstelle fuer Fehlerpfad Dfp_EGRVlvGvnrDvt" VAL_BLK 0x1D20EE Kwb_Wu8 255.0 OneToOne 0.00 255.0 FORMAT "%5.1" NUMBER 4 /end CHARACTERISTIC
/begin CHARACTERISTIC DSM_TypDfp_EGRVlv_JamVlv_C "Konvertierung der Fehlertypen auf der Diagnoseschnittstelle fuer Fehlerpfad Dfp_EGRVlv_JamVlv" VAL_BLK 0x1D20F2 Kwb_Wu8 255.0 OneToOne 0.00 255.0 FORMAT "%5.1" NUMBER 4 /end CHARACTERISTIC
/begin CHARACTERISTIC DSM_TypDfp_EMCCD_MLS1_C "Konvertierung der Fehlertypen auf der Diagnoseschnittstelle fuer Fehlerpfad Dfp_EMCCD_MLS1" VAL_BLK 0x1D20F6 Kwb_Wu8 255.0 OneToOne 0.00 255.0 FORMAT "%5.1" NUMBER 4 /end CHARACTERISTIC
/begin CHARACTERISTIC DSM_TypDfp_EngMBackUp_C "Konvertierung der Fehlertypen auf der Diagnoseschnittstelle fuer Fehlerpfad Dfp_EngMBackUp" VAL_BLK 0x1D20FA Kwb_Wu8 255.0 OneToOne 0.00 255.0 FORMAT "%5.1" NUMBER 4 /end CHARACTERISTIC
/begin CHARACTERISTIC DSM_TypDfp_EngMCaS1_C "Konvertierung der Fehlertypen auf der Diagnoseschnittstelle fuer Fehlerpfad Dfp_EngMCaS1" VAL_BLK 0x1D20FE Kwb_Wu8 255.0 OneToOne 0.00 255.0 FORMAT "%5.1" NUMBER 4 /end CHARACTERISTIC
/begin CHARACTERISTIC DSM_TypDfp_EngMCaSDrv_C "Konvertierung der Fehlertypen auf der Diagnoseschnittstelle fuer Fehlerpfad Dfp_EngMCaSDrv" VAL_BLK 0x1D2102 Kwb_Wu8 255.0 OneToOne 0.00 255.0 FORMAT "%5.1" NUMBER 4 /end CHARACTERISTIC
/begin CHARACTERISTIC DSM_TypDfp_EngMCrS1_C "Konvertierung der Fehlertypen auf der Diagnoseschnittstelle fuer Fehlerpfad Dfp_EngMCrS1" VAL_BLK 0x1D2106 Kwb_Wu8 255.0 OneToOne 0.00 255.0 FORMAT "%5.1" NUMBER 4 /end CHARACTERISTIC
/begin CHARACTERISTIC DSM_TypDfp_EngMOfsCaSCrS_C "Konvertierung der Fehlertypen auf der Diagnoseschnittstelle fuer Fehlerpfad Dfp_EngMOfsCaSCrS" VAL_BLK 0x1D210A Kwb_Wu8 255.0 OneToOne 0.00 255.0 FORMAT "%5.1" NUMBER 4 /end CHARACTERISTIC
/begin CHARACTERISTIC DSM_TypDfp_EngMonIrrCmb_C "Konvertierung der Fehlertypen auf der Diagnoseschnittstelle fuer Fehlerpfad Dfp_EngMonIrrCmb" VAL_BLK 0x1D210E Kwb_Wu8 255.0 OneToOne 0.00 255.0 FORMAT "%5.1" NUMBER 4 /end CHARACTERISTIC
/begin CHARACTERISTIC DSM_TypDfp_EngPrt_C "Konvertierung der Fehlertypen auf der Diagnoseschnittstelle fuer Fehlerpfad Dfp_EngPrt" VAL_BLK 0x1D2112 Kwb_Wu8 255.0 OneToOne 0.00 255.0 FORMAT "%5.1" NUMBER 4 /end CHARACTERISTIC
/begin CHARACTERISTIC DSM_TypDfp_ErLpCDMILReqON_C "Konvertierung der Fehlertypen auf der Diagnoseschnittstelle fuer Fehlerpfad Dfp_ErLpCDMILReqON" VAL_BLK 0x1D2116 Kwb_Wu8 255.0 OneToOne 0.00 255.0 FORMAT "%5.1" NUMBER 4 /end CHARACTERISTIC
/begin CHARACTERISTIC DSM_TypDfp_FMAErrMod_C "Konvertierung der Fehlertypen auf der Diagnoseschnittstelle fuer Fehlerpfad Dfp_FMAErrMod" VAL_BLK 0x1D211A Kwb_Wu8 255.0 OneToOne 0.00 255.0 FORMAT "%5.1" NUMBER 4 /end CHARACTERISTIC
/begin CHARACTERISTIC DSM_TypDfp_FMTC_NonMonotonMap_C "Konvertierung der Fehlertypen auf der Diagnoseschnittstelle fuer Fehlerpfad Dfp_FMTC_NonMonotonMap" VAL_BLK 0x1D211E Kwb_Wu8 255.0 OneToOne 0.00 255.0 FORMAT "%5.1" NUMBER 4 /end CHARACTERISTIC
/begin CHARACTERISTIC DSM_TypDfp_FQTSCD_C "Konvertierung der Fehlertypen auf der Diagnoseschnittstelle fuer Fehlerpfad Dfp_FQTSCD" VAL_BLK 0x1D2122 Kwb_Wu8 255.0 OneToOne 0.00 255.0 FORMAT "%5.1" NUMBER 4 /end CHARACTERISTIC
/begin CHARACTERISTIC DSM_TypDfp_FQlSCD_C "Konvertierung der Fehlertypen auf der Diagnoseschnittstelle fuer Fehlerpfad Dfp_FQlSCD" VAL_BLK 0x1D2126 Kwb_Wu8 255.0 OneToOne 0.00 255.0 FORMAT "%5.1" NUMBER 4 /end CHARACTERISTIC
/begin CHARACTERISTIC DSM_TypDfp_FTSCD_C "Konvertierung der Fehlertypen auf der Diagnoseschnittstelle fuer Fehlerpfad Dfp_FTSCD" VAL_BLK 0x1D212A Kwb_Wu8 255.0 OneToOne 0.00 255.0 FORMAT "%5.1" NUMBER 4 /end CHARACTERISTIC
/begin CHARACTERISTIC DSM_TypDfp_FTSCDNpl_C "Konvertierung der Fehlertypen auf der Diagnoseschnittstelle fuer Fehlerpfad Dfp_FTSCDNpl" VAL_BLK 0x1D212E Kwb_Wu8 255.0 OneToOne 0.00 255.0 FORMAT "%5.1" NUMBER 4 /end CHARACTERISTIC
/begin CHARACTERISTIC DSM_TypDfp_FanCD_Fan1Ctlr1_C "Konvertierung der Fehlertypen auf der Diagnoseschnittstelle fuer Fehlerpfad Dfp_FanCD_Fan1Ctlr1" VAL_BLK 0x1D2132 Kwb_Wu8 255.0 OneToOne 0.00 255.0 FORMAT "%5.1" NUMBER 4 /end CHARACTERISTIC
/begin CHARACTERISTIC DSM_TypDfp_FanCD_Fan1Ctlr2_C "Konvertierung der Fehlertypen auf der Diagnoseschnittstelle fuer Fehlerpfad Dfp_FanCD_Fan1Ctlr2" VAL_BLK 0x1D2136 Kwb_Wu8 255.0 OneToOne 0.00 255.0 FORMAT "%5.1" NUMBER 4 /end CHARACTERISTIC
/begin CHARACTERISTIC DSM_TypDfp_FanCD_Fan2Ctlr1_C "Konvertierung der Fehlertypen auf der Diagnoseschnittstelle fuer Fehlerpfad Dfp_FanCD_Fan2Ctlr1" VAL_BLK 0x1D213A Kwb_Wu8 255.0 OneToOne 0.00 255.0 FORMAT "%5.1" NUMBER 4 /end CHARACTERISTIC
/begin CHARACTERISTIC DSM_TypDfp_FanCD_Fan2Ctlr2_C "Konvertierung der Fehlertypen auf der Diagnoseschnittstelle fuer Fehlerpfad Dfp_FanCD_Fan2Ctlr2" VAL_BLK 0x1D213E Kwb_Wu8 255.0 OneToOne 0.00 255.0 FORMAT "%5.1" NUMBER 4 /end CHARACTERISTIC
/begin CHARACTERISTIC DSM_TypDfp_FanCD_FanCtlr1_C "Konvertierung der Fehlertypen auf der Diagnoseschnittstelle fuer Fehlerpfad Dfp_FanCD_FanCtlr1" VAL_BLK 0x1D2142 Kwb_Wu8 255.0 OneToOne 0.00 255.0 FORMAT "%5.1" NUMBER 4 /end CHARACTERISTIC
/begin CHARACTERISTIC DSM_TypDfp_FanCD_FanCtlr2_C "Konvertierung der Fehlertypen auf der Diagnoseschnittstelle fuer Fehlerpfad Dfp_FanCD_FanCtlr2" VAL_BLK 0x1D2146 Kwb_Wu8 255.0 OneToOne 0.00 255.0 FORMAT "%5.1" NUMBER 4 /end CHARACTERISTIC
/begin CHARACTERISTIC DSM_TypDfp_FanCD_OutFanCtlr1_C "Konvertierung der Fehlertypen auf der Diagnoseschnittstelle fuer Fehlerpfad Dfp_FanCD_OutFanCtlr1" VAL_BLK 0x1D214A Kwb_Wu8 255.0 OneToOne 0.00 255.0 FORMAT "%5.1" NUMBER 4 /end CHARACTERISTIC
/begin CHARACTERISTIC DSM_TypDfp_FanCD_OutFanCtlr2_C "Konvertierung der Fehlertypen auf der Diagnoseschnittstelle fuer Fehlerpfad Dfp_FanCD_OutFanCtlr2" VAL_BLK 0x1D214E Kwb_Wu8 255.0 OneToOne 0.00 255.0 FORMAT "%5.1" NUMBER 4 /end CHARACTERISTIC
/begin CHARACTERISTIC DSM_TypDfp_FlPpCD_C "Konvertierung der Fehlertypen auf der Diagnoseschnittstelle fuer Fehlerpfad Dfp_FlPpCD" VAL_BLK 0x1D2156 Kwb_Wu8 255.0 OneToOne 0.00 255.0 FORMAT "%5.1" NUMBER 4 /end CHARACTERISTIC
/begin CHARACTERISTIC DSM_TypDfp_FlSCDT1_C "Konvertierung der Fehlertypen auf der Diagnoseschnittstelle fuer Fehlerpfad Dfp_FlSCDT1" VAL_BLK 0x1D215A Kwb_Wu8 255.0 OneToOne 0.00 255.0 FORMAT "%5.1" NUMBER 4 /end CHARACTERISTIC
/begin CHARACTERISTIC DSM_TypDfp_FrmMngAAGNpl_C "Konvertierung der Fehlertypen auf der Diagnoseschnittstelle fuer Fehlerpfad Dfp_FrmMngAAGNpl" VAL_BLK 0x1D215E Kwb_Wu8 255.0 OneToOne 0.00 255.0 FORMAT "%5.1" NUMBER 4 /end CHARACTERISTIC
/begin CHARACTERISTIC DSM_TypDfp_FrmMngAAGTO_C "Konvertierung der Fehlertypen auf der Diagnoseschnittstelle fuer Fehlerpfad Dfp_FrmMngAAGTO" VAL_BLK 0x1D2162 Kwb_Wu8 255.0 OneToOne 0.00 255.0 FORMAT "%5.1" NUMBER 4 /end CHARACTERISTIC
/begin CHARACTERISTIC DSM_TypDfp_FrmMngAC1Npl_C "Konvertierung der Fehlertypen auf der Diagnoseschnittstelle fuer Fehlerpfad Dfp_FrmMngAC1Npl" VAL_BLK 0x1D2166 Kwb_Wu8 255.0 OneToOne 0.00 255.0 FORMAT "%5.1" NUMBER 4 /end CHARACTERISTIC
/begin CHARACTERISTIC DSM_TypDfp_FrmMngAC1TO_C "Konvertierung der Fehlertypen auf der Diagnoseschnittstelle fuer Fehlerpfad Dfp_FrmMngAC1TO" VAL_BLK 0x1D216A Kwb_Wu8 255.0 OneToOne 0.00 255.0 FORMAT "%5.1" NUMBER 4 /end CHARACTERISTIC
/begin CHARACTERISTIC DSM_TypDfp_FrmMngACCNpl_C "Konvertierung der Fehlertypen auf der Diagnoseschnittstelle fuer Fehlerpfad Dfp_FrmMngACCNpl" VAL_BLK 0x1D216E Kwb_Wu8 255.0 OneToOne 0.00 255.0 FORMAT "%5.1" NUMBER 4 /end CHARACTERISTIC
/begin CHARACTERISTIC DSM_TypDfp_FrmMngACCTO_C "Konvertierung der Fehlertypen auf der Diagnoseschnittstelle fuer Fehlerpfad Dfp_FrmMngACCTO" VAL_BLK 0x1D2172 Kwb_Wu8 255.0 OneToOne 0.00 255.0 FORMAT "%5.1" NUMBER 4 /end CHARACTERISTIC
/begin CHARACTERISTIC DSM_TypDfp_FrmMngAIRBGNpl_C "Konvertierung der Fehlertypen auf der Diagnoseschnittstelle fuer Fehlerpfad Dfp_FrmMngAIRBGNpl" VAL_BLK 0x1D2176 Kwb_Wu8 255.0 OneToOne 0.00 255.0 FORMAT "%5.1" NUMBER 4 /end CHARACTERISTIC
/begin CHARACTERISTIC DSM_TypDfp_FrmMngAIRBGTO_C "Konvertierung der Fehlertypen auf der Diagnoseschnittstelle fuer Fehlerpfad Dfp_FrmMngAIRBGTO" VAL_BLK 0x1D217A Kwb_Wu8 255.0 OneToOne 0.00 255.0 FORMAT "%5.1" NUMBER 4 /end CHARACTERISTIC
/begin CHARACTERISTIC DSM_TypDfp_FrmMngAWD1Npl_C "Konvertierung der Fehlertypen auf der Diagnoseschnittstelle fuer Fehlerpfad Dfp_FrmMngAWD1Npl" VAL_BLK 0x1D217E Kwb_Wu8 255.0 OneToOne 0.00 255.0 FORMAT "%5.1" NUMBER 4 /end CHARACTERISTIC
/begin CHARACTERISTIC DSM_TypDfp_FrmMngAWD1TO_C "Konvertierung der Fehlertypen auf der Diagnoseschnittstelle fuer Fehlerpfad Dfp_FrmMngAWD1TO" VAL_BLK 0x1D2182 Kwb_Wu8 255.0 OneToOne 0.00 255.0 FORMAT "%5.1" NUMBER 4 /end CHARACTERISTIC
/begin CHARACTERISTIC DSM_TypDfp_FrmMngBEM1Npl_C "Konvertierung der Fehlertypen auf der Diagnoseschnittstelle für Fehlerpfad Dfp_FrmMngBEM1Npl" VAL_BLK 0x1D2186 Kwb_Wu8 255.0 OneToOne 0.00 255.0 FORMAT "%5.1" NUMBER 4 /end CHARACTERISTIC
/begin CHARACTERISTIC DSM_TypDfp_FrmMngBEM1TO_C "Konvertierung der Fehlertypen auf der Diagnoseschnittstelle fuer Fehlerpfad Dfp_FrmMngBEM1TO" VAL_BLK 0x1D218A Kwb_Wu8 255.0 OneToOne 0.00 255.0 FORMAT "%5.1" NUMBER 4 /end CHARACTERISTIC
/begin CHARACTERISTIC DSM_TypDfp_FrmMngBRK1Npl_C "Konvertierung der Fehlertypen auf der Diagnoseschnittstelle fuer Fehlerpfad Dfp_FrmMngBRK1Npl" VAL_BLK 0x1D218E Kwb_Wu8 255.0 OneToOne 0.00 255.0 FORMAT "%5.1" NUMBER 4 /end CHARACTERISTIC
/begin CHARACTERISTIC DSM_TypDfp_FrmMngBRK1TO_C "Konvertierung der Fehlertypen auf der Diagnoseschnittstelle fuer Fehlerpfad Dfp_FrmMngBRK1TO" VAL_BLK 0x1D2192 Kwb_Wu8 255.0 OneToOne 0.00 255.0 FORMAT "%5.1" NUMBER 4 /end CHARACTERISTIC
/begin CHARACTERISTIC DSM_TypDfp_FrmMngBRK2Npl_C "Konvertierung der Fehlertypen auf der Diagnoseschnittstelle fuer Fehlerpfad Dfp_FrmMngBRK2Npl" VAL_BLK 0x1D2196 Kwb_Wu8 255.0 OneToOne 0.00 255.0 FORMAT "%5.1" NUMBER 4 /end CHARACTERISTIC
/begin CHARACTERISTIC DSM_TypDfp_FrmMngBRK2TO_C "Konvertierung der Fehlertypen auf der Diagnoseschnittstelle fuer Fehlerpfad Dfp_FrmMngBRK2TO" VAL_BLK 0x1D219A Kwb_Wu8 255.0 OneToOne 0.00 255.0 FORMAT "%5.1" NUMBER 4 /end CHARACTERISTIC
/begin CHARACTERISTIC DSM_TypDfp_FrmMngBRK8Npl_C "Konvertierung der Fehlertypen auf der Diagnoseschnittstelle fuer Fehlerpfad Dfp_FrmMngBRK8Npl" VAL_BLK 0x1D219E Kwb_Wu8 255.0 OneToOne 0.00 255.0 FORMAT "%5.1" NUMBER 4 /end CHARACTERISTIC
/begin CHARACTERISTIC DSM_TypDfp_FrmMngBRK8TO_C "Konvertierung der Fehlertypen auf der Diagnoseschnittstelle fuer Fehlerpfad Dfp_FrmMngBRK8TO" VAL_BLK 0x1D21A2 Kwb_Wu8 255.0 OneToOne 0.00 255.0 FORMAT "%5.1" NUMBER 4 /end CHARACTERISTIC
/begin CHARACTERISTIC DSM_TypDfp_FrmMngBSG3TO_C "Konvertierung der Fehlertypen auf der Diagnoseschnittstelle fuer Fehlerpfad Dfp_FrmMngBSG3TO" VAL_BLK 0x1D21A6 Kwb_Wu8 255.0 OneToOne 0.00 255.0 FORMAT "%5.1" NUMBER 4 /end CHARACTERISTIC
/begin CHARACTERISTIC DSM_TypDfp_FrmMngCANVerErr_C "Konvertierung der Fehlertypen auf der Diagnoseschnittstelle fuer Fehlerpfad Dfp_FrmMngCANVerErr" VAL_BLK 0x1D21AA Kwb_Wu8 255.0 OneToOne 0.00 255.0 FORMAT "%5.1" NUMBER 4 /end CHARACTERISTIC
/begin CHARACTERISTIC DSM_TypDfp_FrmMngCCSel_C "Konvertierung der Fehlertypen auf der Diagnoseschnittstelle fuer Fehlerpfad Dfp_FrmMngCCSel_C" VAL_BLK 0x1D21AE Kwb_Wu8 255.0 OneToOne 0.00 255.0 FORMAT "%5.1" NUMBER 4 /end CHARACTERISTIC
/begin CHARACTERISTIC DSM_TypDfp_FrmMngCCTLNpl_C "Konvertierung der Fehlertypen auf der Diagnoseschnittstelle fuer Fehlerpfad Dfp_FrmMngCCTLNpl" VAL_BLK 0x1D21B2 Kwb_Wu8 255.0 OneToOne 0.00 255.0 FORMAT "%5.1" NUMBER 4 /end CHARACTERISTIC
/begin CHARACTERISTIC DSM_TypDfp_FrmMngCCTLTO_C "Konvertierung der Fehlertypen auf der Diagnoseschnittstelle fuer Fehlerpfad Dfp_FrmMngCCTLTO" VAL_BLK 0x1D21B6 Kwb_Wu8 255.0 OneToOne 0.00 255.0 FORMAT "%5.1" NUMBER 4 /end CHARACTERISTIC
/begin CHARACTERISTIC DSM_TypDfp_FrmMngCHRGR1Npl_C "Konvertierung der Fehlertypen auf der Diagnoseschnittstelle fuer Fehlerpfad Dfp_FrmMngCHRGR1Npl" VAL_BLK 0x1D21BA Kwb_Wu8 255.0 OneToOne 0.00 255.0 FORMAT "%5.1" NUMBER 4 /end CHARACTERISTIC
/begin CHARACTERISTIC DSM_TypDfp_FrmMngCHRGR1TO_C "Konvertierung der Fehlertypen auf der Diagnoseschnittstelle fuer Fehlerpfad Dfp_FrmMngCHRGR1" VAL_BLK 0x1D21BE Kwb_Wu8 255.0 OneToOne 0.00 255.0 FORMAT "%5.1" NUMBER 4 /end CHARACTERISTIC
/begin CHARACTERISTIC DSM_TypDfp_FrmMngCHRGR2Npl_C "Konvertierung der Fehlertypen auf der Diagnoseschnittstelle fuer Fehlerpfad Dfp_FrmMngCHRGR2Npl" VAL_BLK 0x1D21C2 Kwb_Wu8 255.0 OneToOne 0.00 255.0 FORMAT "%5.1" NUMBER 4 /end CHARACTERISTIC
/begin CHARACTERISTIC DSM_TypDfp_FrmMngCHRGR2TO_C "Konvertierung der Fehlertypen auf der Diagnoseschnittstelle fuer Fehlerpfad Dfp_FrmMngCHRGR2" VAL_BLK 0x1D21C6 Kwb_Wu8 255.0 OneToOne 0.00 255.0 FORMAT "%5.1" NUMBER 4 /end CHARACTERISTIC
/begin CHARACTERISTIC DSM_TypDfp_FrmMngChrgr1A_C "Konvertierung der Fehlertypen auf der Diagnoseschnittstelle fuer Fehlerpfad Dfp_FrmMngChrgr1A" VAL_BLK 0x1D21CA Kwb_Wu8 255.0 OneToOne 0.00 255.0 FORMAT "%5.1" NUMBER 4 /end CHARACTERISTIC
/begin CHARACTERISTIC DSM_TypDfp_FrmMngChrgr1C_C "Konvertierung der Fehlertypen auf der Diagnoseschnittstelle fuer Fehlerpfad Dfp_FrmMngChrgr1C" VAL_BLK 0x1D21CE Kwb_Wu8 255.0 OneToOne 0.00 255.0 FORMAT "%5.1" NUMBER 4 /end CHARACTERISTIC
/begin CHARACTERISTIC DSM_TypDfp_FrmMngChrgr1N_C "Konvertierung der Fehlertypen auf der Diagnoseschnittstelle fuer Fehlerpfad Dfp_FrmMngChrgr1N" VAL_BLK 0x1D21D2 Kwb_Wu8 255.0 OneToOne 0.00 255.0 FORMAT "%5.1" NUMBER 4 /end CHARACTERISTIC
/begin CHARACTERISTIC DSM_TypDfp_FrmMngChrgr1T_C "Konvertierung der Fehlertypen auf der Diagnoseschnittstelle fuer Fehlerpfad Dfp_FrmMngChrgr1T" VAL_BLK 0x1D21D6 Kwb_Wu8 255.0 OneToOne 0.00 255.0 FORMAT "%5.1" NUMBER 4 /end CHARACTERISTIC
/begin CHARACTERISTIC DSM_TypDfp_FrmMngChrgr1V_C "Konvertierung der Fehlertypen auf der Diagnoseschnittstelle fuer Fehlerpfad Dfp_FrmMngChrgr1V" VAL_BLK 0x1D21DA Kwb_Wu8 255.0 OneToOne 0.00 255.0 FORMAT "%5.1" NUMBER 4 /end CHARACTERISTIC
/begin CHARACTERISTIC DSM_TypDfp_FrmMngChrgr2A_C "Konvertierung der Fehlertypen auf der Diagnoseschnittstelle fuer Fehlerpfad Dfp_FrmMngChrgr2A" VAL_BLK 0x1D21DE Kwb_Wu8 255.0 OneToOne 0.00 255.0 FORMAT "%5.1" NUMBER 4 /end CHARACTERISTIC
/begin CHARACTERISTIC DSM_TypDfp_FrmMngChrgr2C_C "Konvertierung der Fehlertypen auf der Diagnoseschnittstelle fuer Fehlerpfad Dfp_FrmMngChrgr2C" VAL_BLK 0x1D21E2 Kwb_Wu8 255.0 OneToOne 0.00 255.0 FORMAT "%5.1" NUMBER 4 /end CHARACTERISTIC
/begin CHARACTERISTIC DSM_TypDfp_FrmMngChrgr2N_C "Konvertierung der Fehlertypen auf der Diagnoseschnittstelle fuer Fehlerpfad Dfp_FrmMngChrgr2N" VAL_BLK 0x1D21E6 Kwb_Wu8 255.0 OneToOne 0.00 255.0 FORMAT "%5.1" NUMBER 4 /end CHARACTERISTIC
/begin CHARACTERISTIC DSM_TypDfp_FrmMngChrgr2T_C "Konvertierung der Fehlertypen auf der Diagnoseschnittstelle fuer Fehlerpfad Dfp_FrmMngChrgr2T" VAL_BLK 0x1D21EA Kwb_Wu8 255.0 OneToOne 0.00 255.0 FORMAT "%5.1" NUMBER 4 /end CHARACTERISTIC
/begin CHARACTERISTIC DSM_TypDfp_FrmMngChrgr2V_C "Konvertierung der Fehlertypen auf der Diagnoseschnittstelle fuer Fehlerpfad Dfp_FrmMngChrgr2V" VAL_BLK 0x1D21EE Kwb_Wu8 255.0 OneToOne 0.00 255.0 FORMAT "%5.1" NUMBER 4 /end CHARACTERISTIC
/begin CHARACTERISTIC DSM_TypDfp_FrmMngDIA1Npl_C "Konvertierung der Fehlertypen auf der Diagnoseschnittstelle fuer Fehlerpfad Dfp_FrmMngDIA1Npl" VAL_BLK 0x1D21F2 Kwb_Wu8 255.0 OneToOne 0.00 255.0 FORMAT "%5.1" NUMBER 4 /end CHARACTERISTIC
/begin CHARACTERISTIC DSM_TypDfp_FrmMngDIA1TO_C "Konvertierung der Fehlertypen auf der Diagnoseschnittstelle fuer Fehlerpfad Dfp_FrmMngDIA1TO" VAL_BLK 0x1D21F6 Kwb_Wu8 255.0 OneToOne 0.00 255.0 FORMAT "%5.1" NUMBER 4 /end CHARACTERISTIC
/begin CHARACTERISTIC DSM_TypDfp_FrmMngDSP1Npl_C "Konvertierung der Fehlertypen auf der Diagnoseschnittstelle fuer Fehlerpfad Dfp_FrmMngDSP1Npl" VAL_BLK 0x1D21FA Kwb_Wu8 255.0 OneToOne 0.00 255.0 FORMAT "%5.1" NUMBER 4 /end CHARACTERISTIC
/begin CHARACTERISTIC DSM_TypDfp_FrmMngDSP1TO_C "Konvertierung der Fehlertypen auf der Diagnoseschnittstelle fuer Fehlerpfad Dfp_FrmMngDSP1TO" VAL_BLK 0x1D21FE Kwb_Wu8 255.0 OneToOne 0.00 255.0 FORMAT "%5.1" NUMBER 4 /end CHARACTERISTIC
/begin CHARACTERISTIC DSM_TypDfp_FrmMngDSP2Npl_C "Konvertierung der Fehlertypen auf der Diagnoseschnittstelle fuer Fehlerpfad Dfp_FrmMngDSP2Npl" VAL_BLK 0x1D2202 Kwb_Wu8 255.0 OneToOne 0.00 255.0 FORMAT "%5.1" NUMBER 4 /end CHARACTERISTIC
/begin CHARACTERISTIC DSM_TypDfp_FrmMngDSP2TO_C "Konvertierung der Fehlertypen auf der Diagnoseschnittstelle fuer Fehlerpfad Dfp_FrmMngDSP2TO" VAL_BLK 0x1D2206 Kwb_Wu8 255.0 OneToOne 0.00 255.0 FORMAT "%5.1" NUMBER 4 /end CHARACTERISTIC
/begin CHARACTERISTIC DSM_TypDfp_FrmMngDSP3Npl_C "Konvertierung der Fehlertypen auf der Diagnoseschnittstelle fuer Fehlerpfad Dfp_FrmMngDSP3Npl" VAL_BLK 0x1D220A Kwb_Wu8 255.0 OneToOne 0.00 255.0 FORMAT "%5.1" NUMBER 4 /end CHARACTERISTIC
/begin CHARACTERISTIC DSM_TypDfp_FrmMngDSP3TO_C "Konvertierung der Fehlertypen auf der Diagnoseschnittstelle fuer Fehlerpfad Dfp_FrmMngDSP3TO" VAL_BLK 0x1D220E Kwb_Wu8 255.0 OneToOne 0.00 255.0 FORMAT "%5.1" NUMBER 4 /end CHARACTERISTIC
/begin CHARACTERISTIC DSM_TypDfp_FrmMngEPB1Npl_C "Konvertierung der Fehlertypen auf der Diagnoseschnittstelle fuer Fehlerpfad Dfp_FrmMngEPB1Npl" VAL_BLK 0x1D2212 Kwb_Wu8 255.0 OneToOne 0.00 255.0 FORMAT "%5.1" NUMBER 4 /end CHARACTERISTIC
/begin CHARACTERISTIC DSM_TypDfp_FrmMngEPB1TO_C "Konvertierung der Fehlertypen auf der Diagnoseschnittstelle fuer Fehlerpfad Dfp_FrmMngEPB1TO" VAL_BLK 0x1D2216 Kwb_Wu8 255.0 OneToOne 0.00 255.0 FORMAT "%5.1" NUMBER 4 /end CHARACTERISTIC
/begin CHARACTERISTIC DSM_TypDfp_FrmMngESCUNpl_C "Konvertierung der Fehlertypen auf der Diagnoseschnittstelle fuer Fehlerpfad Dfp_FrmMngESCUNpl" VAL_BLK 0x1D221A Kwb_Wu8 255.0 OneToOne 0.00 255.0 FORMAT "%5.1" NUMBER 4 /end CHARACTERISTIC
/begin CHARACTERISTIC DSM_TypDfp_FrmMngESCUTO_C "Konvertierung der Fehlertypen auf der Diagnoseschnittstelle fuer Fehlerpfad Dfp_FrmMngESCUTO" VAL_BLK 0x1D221E Kwb_Wu8 255.0 OneToOne 0.00 255.0 FORMAT "%5.1" NUMBER 4 /end CHARACTERISTIC
/begin CHARACTERISTIC DSM_TypDfp_FrmMngGW1Npl_C "Konvertierung der Fehlertypen auf der Diagnoseschnittstelle fuer Fehlerpfad Dfp_FrmMngGW1Npl" VAL_BLK 0x1D2226 Kwb_Wu8 255.0 OneToOne 0.00 255.0 FORMAT "%5.1" NUMBER 4 /end CHARACTERISTIC
/begin CHARACTERISTIC DSM_TypDfp_FrmMngGW1TO_C "Konvertierung der Fehlertypen auf der Diagnoseschnittstelle fuer Fehlerpfad Dfp_FrmMngGW1TO" VAL_BLK 0x1D222A Kwb_Wu8 255.0 OneToOne 0.00 255.0 FORMAT "%5.1" NUMBER 4 /end CHARACTERISTIC
/begin CHARACTERISTIC DSM_TypDfp_FrmMngILMNpl_C "Konvertierung der Fehlertypen auf der Diagnoseschnittstelle fuer Fehlerpfad Dfp_FrmMngILMNpl" VAL_BLK 0x1D222E Kwb_Wu8 255.0 OneToOne 0.00 255.0 FORMAT "%5.1" NUMBER 4 /end CHARACTERISTIC
/begin CHARACTERISTIC DSM_TypDfp_FrmMngILMTO_C "Konvertierung der Fehlertypen auf der Diagnoseschnittstelle fuer Fehlerpfad Dfp_FrmMngILMTO" VAL_BLK 0x1D2232 Kwb_Wu8 255.0 OneToOne 0.00 255.0 FORMAT "%5.1" NUMBER 4 /end CHARACTERISTIC
/begin CHARACTERISTIC DSM_TypDfp_FrmMngLICHT1TO_C "Konvertierung der Fehlertypen auf der Diagnoseschnittstelle fuer Fehlerpfad Dfp_FrmMngLICHT1TO" VAL_BLK 0x1D2236 Kwb_Wu8 255.0 OneToOne 0.00 255.0 FORMAT "%5.1" NUMBER 4 /end CHARACTERISTIC
/begin CHARACTERISTIC DSM_TypDfp_FrmMngLICHT2TO_C "Konvertierung der Fehlertypen auf der Diagnoseschnittstelle fuer Fehlerpfad Dfp_FrmMngLICHT2TO" VAL_BLK 0x1D223A Kwb_Wu8 255.0 OneToOne 0.00 255.0 FORMAT "%5.1" NUMBER 4 /end CHARACTERISTIC
/begin CHARACTERISTIC DSM_TypDfp_FrmMngNIV1WrngCod_C "Konvertierung der Fehlertypen auf der Diagnoseschnittstelle fuer Fehlerpfad Dfp_FrmMngNIV1WrngCod" VAL_BLK 0x1D223E Kwb_Wu8 255.0 OneToOne 0.00 255.0 FORMAT "%5.1" NUMBER 4 /end CHARACTERISTIC
/begin CHARACTERISTIC DSM_TypDfp_FrmMngNIVEAU1Npl_C "Konvertierung der Fehlertypen auf der Diagnoseschnittstelle fuer Fehlerpfad Dfp_FrmMngNIVEAU1Npl" VAL_BLK 0x1D2242 Kwb_Wu8 255.0 OneToOne 0.00 255.0 FORMAT "%5.1" NUMBER 4 /end CHARACTERISTIC
/begin CHARACTERISTIC DSM_TypDfp_FrmMngNIVEAU1TO_C "Konvertierung der Fehlertypen auf der Diagnoseschnittstelle fuer Fehlerpfad Dfp_FrmMngNIVEAU1TO" VAL_BLK 0x1D2246 Kwb_Wu8 255.0 OneToOne 0.00 255.0 FORMAT "%5.1" NUMBER 4 /end CHARACTERISTIC
/begin CHARACTERISTIC DSM_TypDfp_FrmMngSA1Npl_C "Konvertierung der Fehlertypen auf der Diagnoseschnittstelle fuer Fehlerpfad Dfp_FrmMngSA1Npl" VAL_BLK 0x1D224A Kwb_Wu8 255.0 OneToOne 0.00 255.0 FORMAT "%5.1" NUMBER 4 /end CHARACTERISTIC
/begin CHARACTERISTIC DSM_TypDfp_FrmMngSA1TO_C "Konvertierung der Fehlertypen auf der Diagnoseschnittstelle fuer Fehlerpfad Dfp_FrmMngSA1TO" VAL_BLK 0x1D224E Kwb_Wu8 255.0 OneToOne 0.00 255.0 FORMAT "%5.1" NUMBER 4 /end CHARACTERISTIC
/begin CHARACTERISTIC DSM_TypDfp_FrmMngSTIGNNpl_C "Konvertierung der Fehlertypen auf der Diagnoseschnittstelle fuer Fehlerpfad Dfp_FrmMngSTIGNNpl" VAL_BLK 0x1D2252 Kwb_Wu8 255.0 OneToOne 0.00 255.0 FORMAT "%5.1" NUMBER 4 /end CHARACTERISTIC
/begin CHARACTERISTIC DSM_TypDfp_FrmMngStIgnTO_C "Konvertierung der Fehlertypen auf der Diagnoseschnittstelle fuer Fehlerpfad Dfp_FrmMngStIgnTO" VAL_BLK 0x1D2256 Kwb_Wu8 255.0 OneToOne 0.00 255.0 FORMAT "%5.1" NUMBER 4 /end CHARACTERISTIC
/begin CHARACTERISTIC DSM_TypDfp_FrmMngTOSNpl_C "Konvertierung der Fehlertypen auf der Diagnoseschnittstelle fuer Fehlerpfad Dfp_FrmMngTOSNpl" VAL_BLK 0x1D225A Kwb_Wu8 255.0 OneToOne 0.00 255.0 FORMAT "%5.1" NUMBER 4 /end CHARACTERISTIC
/begin CHARACTERISTIC DSM_TypDfp_FrmMngTOSTO_C "Konvertierung der Fehlertypen auf der Diagnoseschnittstelle fuer Fehlerpfad Dfp_FrmMngTOSTO" VAL_BLK 0x1D225E Kwb_Wu8 255.0 OneToOne 0.00 255.0 FORMAT "%5.1" NUMBER 4 /end CHARACTERISTIC
/begin CHARACTERISTIC DSM_TypDfp_FrmMngTSC1Npl_C "Konvertierung der Fehlertypen auf der Diagnoseschnittstelle fuer Fehlerpfad Dfp_FrmMngTSC1Npl" VAL_BLK 0x1D2262 Kwb_Wu8 255.0 OneToOne 0.00 255.0 FORMAT "%5.1" NUMBER 4 /end CHARACTERISTIC
/begin CHARACTERISTIC DSM_TypDfp_FrmMngTSC1TO_C "Konvertierung der Fehlertypen auf der Diagnoseschnittstelle fuer Fehlerpfad Dfp_FrmMngTSC1TO" VAL_BLK 0x1D2266 Kwb_Wu8 255.0 OneToOne 0.00 255.0 FORMAT "%5.1" NUMBER 4 /end CHARACTERISTIC
/begin CHARACTERISTIC DSM_TypDfp_FrmMngTSC2Npl_C "Konvertierung der Fehlertypen auf der Diagnoseschnittstelle fuer Fehlerpfad Dfp_FrmMngTSC2Npl" VAL_BLK 0x1D226A Kwb_Wu8 255.0 OneToOne 0.00 255.0 FORMAT "%5.1" NUMBER 4 /end CHARACTERISTIC
/begin CHARACTERISTIC DSM_TypDfp_FrmMngTSC2TO_C "Konvertierung der Fehlertypen auf der Diagnoseschnittstelle fuer Fehlerpfad Dfp_FrmMngTSC2TO" VAL_BLK 0x1D226E Kwb_Wu8 255.0 OneToOne 0.00 255.0 FORMAT "%5.1" NUMBER 4 /end CHARACTERISTIC
/begin CHARACTERISTIC DSM_TypDfp_FrmMngTSC3Npl_C "Konvertierung der Fehlertypen auf der Diagnoseschnittstelle fuer Fehlerpfad Dfp_FrmMngTSC3Npl" VAL_BLK 0x1D2272 Kwb_Wu8 255.0 OneToOne 0.00 255.0 FORMAT "%5.1" NUMBER 4 /end CHARACTERISTIC
/begin CHARACTERISTIC DSM_TypDfp_FrmMngTSC3TO_C "Konvertierung der Fehlertypen auf der Diagnoseschnittstelle fuer Fehlerpfad Dfp_FrmMngTSC3TO" VAL_BLK 0x1D2276 Kwb_Wu8 255.0 OneToOne 0.00 255.0 FORMAT "%5.1" NUMBER 4 /end CHARACTERISTIC
/begin CHARACTERISTIC DSM_TypDfp_FrmMngTSC6Npl_C "Konvertierung der Fehlertypen auf der Diagnoseschnittstelle fuer Fehlerpfad Dfp_FrmMngTSC6Npl" VAL_BLK 0x1D227A Kwb_Wu8 255.0 OneToOne 0.00 255.0 FORMAT "%5.1" NUMBER 4 /end CHARACTERISTIC
/begin CHARACTERISTIC DSM_TypDfp_FrmMngTSC6TO_C "Konvertierung der Fehlertypen auf der Diagnoseschnittstelle fuer Fehlerpfad Dfp_FrmMngTSC6TO" VAL_BLK 0x1D227E Kwb_Wu8 255.0 OneToOne 0.00 255.0 FORMAT "%5.1" NUMBER 4 /end CHARACTERISTIC
/begin CHARACTERISTIC DSM_TypDfp_FrmMngTrbnSpdErr_C "Konvertierung der Fehlertypen auf der Diagnoseschnittstelle fuer Fehlerpfad Dfp_FrmMngTrbnSpdErr" VAL_BLK 0x1D2282 Kwb_Wu8 255.0 OneToOne 0.00 255.0 FORMAT "%5.1" NUMBER 4 /end CHARACTERISTIC
/begin CHARACTERISTIC DSM_TypDfp_FrmMngWIPERTO_C "Konvertierung der Fehlertypen auf der Diagnoseschnittstelle fuer Fehlerpfad Dfp_FrmMngWIPERTO" VAL_BLK 0x1D2286 Kwb_Wu8 255.0 OneToOne 0.00 255.0 FORMAT "%5.1" NUMBER 4 /end CHARACTERISTIC
/begin CHARACTERISTIC DSM_TypDfp_GbSSCD_C "Konvertierung der Fehlertypen auf der Diagnoseschnittstelle für Fehlerpfad Dfp_GbSSCD" VAL_BLK 0x1D228A Kwb_Wu8 255.0 OneToOne 0.00 255.0 FORMAT "%5.1" NUMBER 4 /end CHARACTERISTIC
/begin CHARACTERISTIC DSM_TypDfp_GbSSCD_HW_C "Konvertierung der Fehlertypen auf der Diagnoseschnittstelle fuer Fehlerpfad Dfp_GbSSCD_HW" VAL_BLK 0x1D228E Kwb_Wu8 255.0 OneToOne 0.00 255.0 FORMAT "%5.1" NUMBER 4 /end CHARACTERISTIC
/begin CHARACTERISTIC DSM_TypDfp_GearbxCVTnMax_C "Konvertierung der Fehlertypen auf der Diagnoseschnittstelle fuer Dfp_GearbxCVTnMax_mp" VAL_BLK 0x1D2292 Kwb_Wu8 255.0 OneToOne 0.00 255.0 FORMAT "%5.1" NUMBER 4 /end CHARACTERISTIC
/begin CHARACTERISTIC DSM_TypDfp_GearbxClthPlaus_C "Konvertierung der Fehlertypen auf der Diagnoseschnittstelle fuer Fehlerpfad Dfp_GearbxClthPlaus" VAL_BLK 0x1D2296 Kwb_Wu8 255.0 OneToOne 0.00 255.0 FORMAT "%5.1" NUMBER 4 /end CHARACTERISTIC
/begin CHARACTERISTIC DSM_TypDfp_GearbxINCCup_C "Konvertierung der Fehlertypen auf der Diagnoseschnittstelle fuer Fehlerpfad Dfp_GearbxINCCup" VAL_BLK 0x1D229A Kwb_Wu8 255.0 OneToOne 0.00 255.0 FORMAT "%5.1" NUMBER 4 /end CHARACTERISTIC
/begin CHARACTERISTIC DSM_TypDfp_GearbxNMinMon_C "Konvertierung der Fehlertypen auf der Diagnoseschnittstelle fuer Fehlerpfad Dfp_GearbxNMinMon" VAL_BLK 0x1D229E Kwb_Wu8 255.0 OneToOne 0.00 255.0 FORMAT "%5.1" NUMBER 4 /end CHARACTERISTIC
/begin CHARACTERISTIC DSM_TypDfp_GearbxTSC_C "Konvertierung der Fehlertypen auf der Diagnoseschnittstelle fuer Fehlerpfad Dfp_GearbxTSC" VAL_BLK 0x1D22A2 Kwb_Wu8 255.0 OneToOne 0.00 255.0 FORMAT "%5.1" NUMBER 4 /end CHARACTERISTIC
/begin CHARACTERISTIC DSM_TypDfp_GearbxTransConv_C "Konvertierung der Fehlertypen auf der Diagnoseschnittstelle fuer Fehlerpfad Dfp_GearbxTransConv" VAL_BLK 0x1D22A6 Kwb_Wu8 255.0 OneToOne 0.00 255.0 FORMAT "%5.1" NUMBER 4 /end CHARACTERISTIC
/begin CHARACTERISTIC DSM_TypDfp_GearbxTypeMTErr_C "Konvertierung der Fehlertypen auf der Diagnoseschnittstelle fuer Fehlerpfad Dfp_GearbxTypeMTErr" VAL_BLK 0x1D22AA Kwb_Wu8 255.0 OneToOne 0.00 255.0 FORMAT "%5.1" NUMBER 4 /end CHARACTERISTIC
/begin CHARACTERISTIC DSM_TypDfp_GlwCDDIAG_C "Konvertierung der Fehlertypen auf der Diagnoseschnittstelle fuer Fehlerpfad Dfp_GlwCDDIAG" VAL_BLK 0x1D22AE Kwb_Wu8 255.0 OneToOne 0.00 255.0 FORMAT "%5.1" NUMBER 4 /end CHARACTERISTIC
/begin CHARACTERISTIC DSM_TypDfp_GlwCDErr1_C "Konvertierung der Fehlertypen auf der Diagnoseschnittstelle fuer Fehlerpfad Dfp_GlwCDErr1" VAL_BLK 0x1D22B2 Kwb_Wu8 255.0 OneToOne 0.00 255.0 FORMAT "%5.1" NUMBER 4 /end CHARACTERISTIC
/begin CHARACTERISTIC DSM_TypDfp_GlwCDErr2_C "Konvertierung der Fehlertypen auf der Diagnoseschnittstelle fuer Fehlerpfad Dfp_GlwCDErr2" VAL_BLK 0x1D22B6 Kwb_Wu8 255.0 OneToOne 0.00 255.0 FORMAT "%5.1" NUMBER 4 /end CHARACTERISTIC
/begin CHARACTERISTIC DSM_TypDfp_GlwCDEvalCod_C "Konvertierung der Fehlertypen auf der Diagnoseschnittstelle fuer Fehlerpfad Dfp_GlwCDEvalCod" VAL_BLK 0x1D22BA Kwb_Wu8 255.0 OneToOne 0.00 255.0 FORMAT "%5.1" NUMBER 4 /end CHARACTERISTIC
/begin CHARACTERISTIC DSM_TypDfp_GlwCDGSK2_C "Konvertierung der Fehlertypen auf der Diagnoseschnittstelle fuer Fehlerpfad Dfp_GlwCDGSK2" VAL_BLK 0x1D22BE Kwb_Wu8 255.0 OneToOne 0.00 255.0 FORMAT "%5.1" NUMBER 4 /end CHARACTERISTIC
/begin CHARACTERISTIC DSM_TypDfp_GlwCDGSK3_C "Konvertierung der Fehlertypen auf der Diagnoseschnittstelle fuer Fehlerpfad Dfp_GlwCDGSK3" VAL_BLK 0x1D22C2 Kwb_Wu8 255.0 OneToOne 0.00 255.0 FORMAT "%5.1" NUMBER 4 /end CHARACTERISTIC
/begin CHARACTERISTIC DSM_TypDfp_GlwCDLmp_C "Konvertierung der Fehlertypen auf der Diagnoseschnittstelle fuer Fehlerpfad Dfp_GlwCDLmp" VAL_BLK 0x1D22C6 Kwb_Wu8 255.0 OneToOne 0.00 255.0 FORMAT "%5.1" NUMBER 4 /end CHARACTERISTIC
/begin CHARACTERISTIC DSM_TypDfp_GlwCDPLUG0_C "Konvertierung der Fehlertypen auf der Diagnoseschnittstelle fuer Fehlerpfad Dfp_GlwCDPLUG0" VAL_BLK 0x1D22CA Kwb_Wu8 255.0 OneToOne 0.00 255.0 FORMAT "%5.1" NUMBER 4 /end CHARACTERISTIC
/begin CHARACTERISTIC DSM_TypDfp_GlwCDPLUG1_C "Konvertierung der Fehlertypen auf der Diagnoseschnittstelle fuer Fehlerpfad Dfp_GlwCDPLUG1" VAL_BLK 0x1D22CE Kwb_Wu8 255.0 OneToOne 0.00 255.0 FORMAT "%5.1" NUMBER 4 /end CHARACTERISTIC
/begin CHARACTERISTIC DSM_TypDfp_GlwCDPLUG2_C "Konvertierung der Fehlertypen auf der Diagnoseschnittstelle fuer Fehlerpfad Dfp_GlwCDPLUG2" VAL_BLK 0x1D22D2 Kwb_Wu8 255.0 OneToOne 0.00 255.0 FORMAT "%5.1" NUMBER 4 /end CHARACTERISTIC
/begin CHARACTERISTIC DSM_TypDfp_GlwCDPLUG3_C "Konvertierung der Fehlertypen auf der Diagnoseschnittstelle fuer Fehlerpfad Dfp_GlwCDPLUG3" VAL_BLK 0x1D22D6 Kwb_Wu8 255.0 OneToOne 0.00 255.0 FORMAT "%5.1" NUMBER 4 /end CHARACTERISTIC
/begin CHARACTERISTIC DSM_TypDfp_GlwCDPLUG4_C "Konvertierung der Fehlertypen auf der Diagnoseschnittstelle fuer Fehlerpfad Dfp_GlwCDPLUG4" VAL_BLK 0x1D22DA Kwb_Wu8 255.0 OneToOne 0.00 255.0 FORMAT "%5.1" NUMBER 4 /end CHARACTERISTIC
/begin CHARACTERISTIC DSM_TypDfp_GlwCDPLUG5_C "Konvertierung der Fehlertypen auf der Diagnoseschnittstelle fuer Fehlerpfad Dfp_GlwCDPLUG5" VAL_BLK 0x1D22DE Kwb_Wu8 255.0 OneToOne 0.00 255.0 FORMAT "%5.1" NUMBER 4 /end CHARACTERISTIC
/begin CHARACTERISTIC DSM_TypDfp_GlwCD_LampCan_C "Konvertierung der Fehlertypen auf der Diagnoseschnittstelle fuer Fehlerpfad Dfp_GlwCD_LampCan" VAL_BLK 0x1D22E2 Kwb_Wu8 255.0 OneToOne 0.00 255.0 FORMAT "%5.1" NUMBER 4 /end CHARACTERISTIC
/begin CHARACTERISTIC DSM_TypDfp_GlwCDsfd_C "Konvertierung der Fehlertypen auf der Diagnoseschnittstelle fuer Fehlerpfad Dfp_GlwCDsfd" VAL_BLK 0x1D22E6 Kwb_Wu8 255.0 OneToOne 0.00 255.0 FORMAT "%5.1" NUMBER 4 /end CHARACTERISTIC
/begin CHARACTERISTIC DSM_TypDfp_HDSCD_C "Konvertierung der Fehlertypen auf der Diagnoseschnittstelle fuer Fehlerpfad Dfp_HDSCD" VAL_BLK 0x1D22EA Kwb_Wu8 255.0 OneToOne 0.00 255.0 FORMAT "%5.1" NUMBER 4 /end CHARACTERISTIC
/begin CHARACTERISTIC DSM_TypDfp_HWEMonCom_C "Konvertierung der Fehlertypen auf der Diagnoseschnittstelle fuer Fehlerpfad Dfp_HWEMonCom" VAL_BLK 0x1D22EE Kwb_Wu8 255.0 OneToOne 0.00 255.0 FORMAT "%5.1" NUMBER 4 /end CHARACTERISTIC
/begin CHARACTERISTIC DSM_TypDfp_HWEMonEEPROM_C "Konvertierung der Fehlertypen auf der Diagnoseschnittstelle fuer Fehlerpfad Dfp_HWEMonEEPROM" VAL_BLK 0x1D22F2 Kwb_Wu8 255.0 OneToOne 0.00 255.0 FORMAT "%5.1" NUMBER 4 /end CHARACTERISTIC
/begin CHARACTERISTIC DSM_TypDfp_HWEMonRcyLocked_C "Konvertierung der Fehlertypen auf der Diagnoseschnittstelle fuer Fehlerpfad Dfp_HWEMonRcyLocked" VAL_BLK 0x1D22F6 Kwb_Wu8 255.0 OneToOne 0.00 255.0 FORMAT "%5.1" NUMBER 4 /end CHARACTERISTIC
/begin CHARACTERISTIC DSM_TypDfp_HWEMonRcySuppressed_C "Konvertierung der Fehlertypen auf der Diagnoseschnittstelle fuer Fehlerpfad Dfp_HWEMonRcySuppressed" VAL_BLK 0x1D22FA Kwb_Wu8 255.0 OneToOne 0.00 255.0 FORMAT "%5.1" NUMBER 4 /end CHARACTERISTIC
/begin CHARACTERISTIC DSM_TypDfp_HWEMonRcyVisible_C "Konvertierung der Fehlertypen auf der Diagnoseschnittstelle fuer Fehlerpfad Dfp_HWEMonRcyVisible" VAL_BLK 0x1D22FE Kwb_Wu8 255.0 OneToOne 0.00 255.0 FORMAT "%5.1" NUMBER 4 /end CHARACTERISTIC
/begin CHARACTERISTIC DSM_TypDfp_HWEMonUMaxSupply_C "Konvertierung der Fehlertypen auf der Diagnoseschnittstelle fuer Fehlerpfad Dfp_HWEMonUMaxSupply" VAL_BLK 0x1D2302 Kwb_Wu8 255.0 OneToOne 0.00 255.0 FORMAT "%5.1" NUMBER 4 /end CHARACTERISTIC
/begin CHARACTERISTIC DSM_TypDfp_HWEMonUMinSupply_C "Konvertierung der Fehlertypen auf der Diagnoseschnittstelle fuer Fehlerpfad Dfp_HWEMonUMinSupply" VAL_BLK 0x1D2306 Kwb_Wu8 255.0 OneToOne 0.00 255.0 FORMAT "%5.1" NUMBER 4 /end CHARACTERISTIC
/begin CHARACTERISTIC DSM_TypDfp_IATSCD_C "Konvertierung der Fehlertypen auf der Diagnoseschnittstelle fuer Fehlerpfad Dfp_IATSCD" VAL_BLK 0x1D230A Kwb_Wu8 255.0 OneToOne 0.00 255.0 FORMAT "%5.1" NUMBER 4 /end CHARACTERISTIC
/begin CHARACTERISTIC DSM_TypDfp_IFCD_C "Konvertierung der Fehlertypen auf der Diagnoseschnittstelle fuer Fehlerpfad Dfp_IFCD" VAL_BLK 0x1D230E Kwb_Wu8 255.0 OneToOne 0.00 255.0 FORMAT "%5.1" NUMBER 4 /end CHARACTERISTIC
/begin CHARACTERISTIC DSM_TypDfp_ImmCtl_C "Konvertierung der Fehlertypen auf der Diagnoseschnittstelle fuer Fehlerpfad Dfp_ImmCtl" VAL_BLK 0x1D2312 Kwb_Wu8 255.0 OneToOne 0.00 255.0 FORMAT "%5.1" NUMBER 4 /end CHARACTERISTIC
/begin CHARACTERISTIC DSM_TypDfp_IndSysMonIntMnf_C "Konvertierung der Fehlertypen auf der Diagnoseschnittstelle fuer Fehlerpfad Dfp_IndSysMonIntMnf" VAL_BLK 0x1D2316 Kwb_Wu8 255.0 OneToOne 0.00 255.0 FORMAT "%5.1" NUMBER 4 /end CHARACTERISTIC
/begin CHARACTERISTIC DSM_TypDfp_InjVlvBnk1A_C "Konvertierung der Fehlertypen auf der Diagnoseschnittstelle fuer Fehlerpfad Dfp_InjVlvBnk1A" VAL_BLK 0x1D2322 Kwb_Wu8 255.0 OneToOne 0.00 255.0 FORMAT "%5.1" NUMBER 4 /end CHARACTERISTIC
/begin CHARACTERISTIC DSM_TypDfp_InjVlvBnk2A_C "Konvertierung der Fehlertypen auf der Diagnoseschnittstelle fuer Fehlerpfad Dfp_InjVlvBnk2A" VAL_BLK 0x1D2326 Kwb_Wu8 255.0 OneToOne 0.00 255.0 FORMAT "%5.1" NUMBER 4 /end CHARACTERISTIC
/begin CHARACTERISTIC DSM_TypDfp_InjVlvCyl10A_C "Konvertierung der Fehlertypen auf der Diagnoseschnittstelle fuer Fehlerpfad Dfp_InjVlvCyl10A" VAL_BLK 0x1D232A Kwb_Wu8 255.0 OneToOne 0.00 255.0 FORMAT "%5.1" NUMBER 4 /end CHARACTERISTIC
/begin CHARACTERISTIC DSM_TypDfp_InjVlvCyl11A_C "Konvertierung der Fehlertypen auf der Diagnoseschnittstelle fuer Fehlerpfad Dfp_InjVlvCyl11A" VAL_BLK 0x1D232E Kwb_Wu8 255.0 OneToOne 0.00 255.0 FORMAT "%5.1" NUMBER 4 /end CHARACTERISTIC
/begin CHARACTERISTIC DSM_TypDfp_InjVlvCyl12A_C "Konvertierung der Fehlertypen auf der Diagnoseschnittstelle fuer Fehlerpfad Dfp_InjVlvCyl12A" VAL_BLK 0x1D2332 Kwb_Wu8 255.0 OneToOne 0.00 255.0 FORMAT "%5.1" NUMBER 4 /end CHARACTERISTIC
/begin CHARACTERISTIC DSM_TypDfp_InjVlvCyl1A_C "Konvertierung der Fehlertypen auf der Diagnoseschnittstelle fuer Fehlerpfad Dfp_InjVlvCyl1A" VAL_BLK 0x1D2336 Kwb_Wu8 255.0 OneToOne 0.00 255.0 FORMAT "%5.1" NUMBER 4 /end CHARACTERISTIC
/begin CHARACTERISTIC DSM_TypDfp_InjVlvCyl2A_C "Konvertierung der Fehlertypen auf der Diagnoseschnittstelle fuer Fehlerpfad Dfp_InjVlvCyl2A" VAL_BLK 0x1D233A Kwb_Wu8 255.0 OneToOne 0.00 255.0 FORMAT "%5.1" NUMBER 4 /end CHARACTERISTIC
/begin CHARACTERISTIC DSM_TypDfp_InjVlvCyl3A_C "Konvertierung der Fehlertypen auf der Diagnoseschnittstelle fuer Fehlerpfad Dfp_InjVlvCyl3A" VAL_BLK 0x1D233E Kwb_Wu8 255.0 OneToOne 0.00 255.0 FORMAT "%5.1" NUMBER 4 /end CHARACTERISTIC
/begin CHARACTERISTIC DSM_TypDfp_InjVlvCyl4A_C "Konvertierung der Fehlertypen auf der Diagnoseschnittstelle fuer Fehlerpfad Dfp_InjVlvCyl4A" VAL_BLK 0x1D2342 Kwb_Wu8 255.0 OneToOne 0.00 255.0 FORMAT "%5.1" NUMBER 4 /end CHARACTERISTIC
/begin CHARACTERISTIC DSM_TypDfp_InjVlvCyl5A_C "Konvertierung der Fehlertypen auf der Diagnoseschnittstelle fuer Fehlerpfad Dfp_InjVlvCyl5A" VAL_BLK 0x1D2346 Kwb_Wu8 255.0 OneToOne 0.00 255.0 FORMAT "%5.1" NUMBER 4 /end CHARACTERISTIC
/begin CHARACTERISTIC DSM_TypDfp_InjVlvCyl6A_C "Konvertierung der Fehlertypen auf der Diagnoseschnittstelle fuer Fehlerpfad Dfp_InjVlvCyl6A" VAL_BLK 0x1D234A Kwb_Wu8 255.0 OneToOne 0.00 255.0 FORMAT "%5.1" NUMBER 4 /end CHARACTERISTIC
/begin CHARACTERISTIC DSM_TypDfp_InjVlvCyl7A_C "Konvertierung der Fehlertypen auf der Diagnoseschnittstelle fuer Fehlerpfad Dfp_InjVlvCyl7A" VAL_BLK 0x1D234E Kwb_Wu8 255.0 OneToOne 0.00 255.0 FORMAT "%5.1" NUMBER 4 /end CHARACTERISTIC
/begin CHARACTERISTIC DSM_TypDfp_InjVlvCyl8A_C "Konvertierung der Fehlertypen auf der Diagnoseschnittstelle fuer Fehlerpfad Dfp_InjVlvCyl8A" VAL_BLK 0x1D2352 Kwb_Wu8 255.0 OneToOne 0.00 255.0 FORMAT "%5.1" NUMBER 4 /end CHARACTERISTIC
/begin CHARACTERISTIC DSM_TypDfp_InjVlvCyl9A_C "Konvertierung der Fehlertypen auf der Diagnoseschnittstelle fuer Fehlerpfad Dfp_InjVlvCyl9A" VAL_BLK 0x1D2356 Kwb_Wu8 255.0 OneToOne 0.00 255.0 FORMAT "%5.1" NUMBER 4 /end CHARACTERISTIC
/begin CHARACTERISTIC DSM_TypDfp_LASCD_C "Konvertierung der Fehlertypen auf der Diagnoseschnittstelle fuer Fehlerpfad Dfp_LASCD" VAL_BLK 0x1D235A Kwb_Wu8 255.0 OneToOne 0.00 255.0 FORMAT "%5.1" NUMBER 4 /end CHARACTERISTIC
/begin CHARACTERISTIC DSM_TypDfp_LSUCDCircNernst0_C "Konvertierung der Fehlertypen auf der Diagnoseschnittstelle fuer Fehlerpfad Dfp_LSUCDCircNernst0" VAL_BLK 0x1D235E Kwb_Wu8 255.0 OneToOne 0.00 255.0 FORMAT "%5.1" NUMBER 4 /end CHARACTERISTIC
/begin CHARACTERISTIC DSM_TypDfp_LSUCDCircPumpCur0_C "Konvertierung der Fehlertypen auf der Diagnoseschnittstelle fuer Fehlerpfad Dfp_LSUCDCircPumpCur0" VAL_BLK 0x1D2362 Kwb_Wu8 255.0 OneToOne 0.00 255.0 FORMAT "%5.1" NUMBER 4 /end CHARACTERISTIC
/begin CHARACTERISTIC DSM_TypDfp_LSUCDCircVirtGnd0_C "Konvertierung der Fehlertypen auf der Diagnoseschnittstelle fuer Fehlerpfad Dfp_LSUCDCircVirtGnd0" VAL_BLK 0x1D2366 Kwb_Wu8 255.0 OneToOne 0.00 255.0 FORMAT "%5.1" NUMBER 4 /end CHARACTERISTIC
/begin CHARACTERISTIC DSM_TypDfp_LSUCDHeater0_C "Konvertierung der Fehlertypen auf der Diagnoseschnittstelle fuer Fehlerpfad Dfp_LSUCDHeater0" VAL_BLK 0x1D236A Kwb_Wu8 255.0 OneToOne 0.00 255.0 FORMAT "%5.1" NUMBER 4 /end CHARACTERISTIC
/begin CHARACTERISTIC DSM_TypDfp_LSUCDHtCoup0_C "Konvertierung der Fehlertypen auf der Diagnoseschnittstelle fuer Fehlerpfad Dfp_LSUCDHtCoup0" VAL_BLK 0x1D236E Kwb_Wu8 255.0 OneToOne 0.00 255.0 FORMAT "%5.1" NUMBER 4 /end CHARACTERISTIC
/begin CHARACTERISTIC DSM_TypDfp_LSUCDO20_C "Konvertierung der Fehlertypen auf der Diagnoseschnittstelle fuer Fehlerpfad Dfp_LSUCDO20" VAL_BLK 0x1D2372 Kwb_Wu8 255.0 OneToOne 0.00 255.0 FORMAT "%5.1" NUMBER 4 /end CHARACTERISTIC
/begin CHARACTERISTIC DSM_TypDfp_LSUCDO2Clb0_C "Konvertierung der Fehlertypen auf der Diagnoseschnittstelle fuer Fehlerpfad Dfp_LSUCDO2Clb0" VAL_BLK 0x1D2376 Kwb_Wu8 255.0 OneToOne 0.00 255.0 FORMAT "%5.1" NUMBER 4 /end CHARACTERISTIC
/begin CHARACTERISTIC DSM_TypDfp_LSUCDRiClb0_C "Konvertierung der Fehlertypen auf der Diagnoseschnittstelle fuer Fehlerpfad Dfp_LSUCDRiClb0" VAL_BLK 0x1D237A Kwb_Wu8 255.0 OneToOne 0.00 255.0 FORMAT "%5.1" NUMBER 4 /end CHARACTERISTIC
/begin CHARACTERISTIC DSM_TypDfp_LSUCDSPI0_C "Konvertierung der Fehlertypen auf der Diagnoseschnittstelle fuer Fehlerpfad Dfp_LSUCDSPI0" VAL_BLK 0x1D237E Kwb_Wu8 255.0 OneToOne 0.00 255.0 FORMAT "%5.1" NUMBER 4 /end CHARACTERISTIC
/begin CHARACTERISTIC DSM_TypDfp_LSUCDSPIBattLow0_C "Konvertierung der Fehlertypen auf der Diagnoseschnittstelle fuer Fehlerpfad Dfp_LSUCDSPIBattLow0" VAL_BLK 0x1D2382 Kwb_Wu8 255.0 OneToOne 0.00 255.0 FORMAT "%5.1" NUMBER 4 /end CHARACTERISTIC
/begin CHARACTERISTIC DSM_TypDfp_LSUCDWireIP0_C "Konvertierung der Fehlertypen auf der Diagnoseschnittstelle fuer Fehlerpfad Dfp_LSUCDWireIP0" VAL_BLK 0x1D2386 Kwb_Wu8 255.0 OneToOne 0.00 255.0 FORMAT "%5.1" NUMBER 4 /end CHARACTERISTIC
/begin CHARACTERISTIC DSM_TypDfp_LSUCtlRiExc0_C "Konvertierung der Fehlertypen auf der Diagnoseschnittstelle fuer Fehlerpfad Dfp_LSUCtlRiExc0" VAL_BLK 0x1D238A Kwb_Wu8 255.0 OneToOne 0.00 255.0 FORMAT "%5.1" NUMBER 4 /end CHARACTERISTIC
/begin CHARACTERISTIC DSM_TypDfp_LSUMonDyn0_C "Konvertierung der Fehlertypen auf der Diagnoseschnittstelle fuer Fehlerpfad Dfp_LSUMonDyn0" VAL_BLK 0x1D238E Kwb_Wu8 255.0 OneToOne 0.00 255.0 FORMAT "%5.1" NUMBER 4 /end CHARACTERISTIC
/begin CHARACTERISTIC DSM_TypDfp_LSUMonFullLd0_C "Konvertierung der Fehlertypen auf der Diagnoseschnittstelle fuer Fehlerpfad Dfp_LSUMonFullLd0" VAL_BLK 0x1D2392 Kwb_Wu8 255.0 OneToOne 0.00 255.0 FORMAT "%5.1" NUMBER 4 /end CHARACTERISTIC
/begin CHARACTERISTIC DSM_TypDfp_LSUMonOvrRun0_C "Konvertierung der Fehlertypen auf der Diagnoseschnittstelle fuer Fehlerpfad Dfp_LSUMonOvrRun0" VAL_BLK 0x1D2396 Kwb_Wu8 255.0 OneToOne 0.00 255.0 FORMAT "%5.1" NUMBER 4 /end CHARACTERISTIC
/begin CHARACTERISTIC DSM_TypDfp_LSUMonPartLd0_C "Konvertierung der Fehlertypen auf der Diagnoseschnittstelle fuer Fehlerpfad Dfp_LSUMonPartLd0" VAL_BLK 0x1D239A Kwb_Wu8 255.0 OneToOne 0.00 255.0 FORMAT "%5.1" NUMBER 4 /end CHARACTERISTIC
/begin CHARACTERISTIC DSM_TypDfp_MIL_C "Konvertierung der Fehlertypen auf der Diagnoseschnittstelle fuer Fehlerpfad Dfp_MIL" VAL_BLK 0x1D239E Kwb_Wu8 255.0 OneToOne 0.00 255.0 FORMAT "%5.1" NUMBER 4 /end CHARACTERISTIC
/begin CHARACTERISTIC DSM_TypDfp_MRlyCD_C "Konvertierung der Fehlertypen auf der Diagnoseschnittstelle fuer Fehlerpfad Dfp_MRlyCD" VAL_BLK 0x1D23A2 Kwb_Wu8 255.0 OneToOne 0.00 255.0 FORMAT "%5.1" NUMBER 4 /end CHARACTERISTIC
/begin CHARACTERISTIC DSM_TypDfp_Montr_C "Konvertierung der Fehlertypen auf der Diagnoseschnittstelle fuer Fehlerpfad Dfp_Montr" VAL_BLK 0x1D23A6 Kwb_Wu8 255.0 OneToOne 0.00 255.0 FORMAT "%5.1" NUMBER 4 /end CHARACTERISTIC
/begin CHARACTERISTIC DSM_TypDfp_OTSCD_C "Konvertierung der Fehlertypen auf der Diagnoseschnittstelle fuer Fehlerpfad Dfp_OTSCD" VAL_BLK 0x1D23AA Kwb_Wu8 255.0 OneToOne 0.00 255.0 FORMAT "%5.1" NUMBER 4 /end CHARACTERISTIC
/begin CHARACTERISTIC DSM_TypDfp_OTSCDCanInac_C "Konvertierung der Fehlertypen auf der Diagnoseschnittstelle fuer Fehlerpfad Dfp_OTSCDCanInac" VAL_BLK 0x1D23AE Kwb_Wu8 255.0 OneToOne 0.00 255.0 FORMAT "%5.1" NUMBER 4 /end CHARACTERISTIC
/begin CHARACTERISTIC DSM_TypDfp_OTSCDCanSig_C "Konvertierung der Fehlertypen auf der Diagnoseschnittstelle fuer Fehlerpfad Dfp_OTSCDCanSig" VAL_BLK 0x1D23B2 Kwb_Wu8 255.0 OneToOne 0.00 255.0 FORMAT "%5.1" NUMBER 4 /end CHARACTERISTIC
/begin CHARACTERISTIC DSM_TypDfp_OvRMon_C "Konvertierung der Fehlertypen auf der Diagnoseschnittstelle fuer Fehlerpfad Dfp_OvRMon" VAL_BLK 0x1D23BA Kwb_Wu8 255.0 OneToOne 0.00 255.0 FORMAT "%5.1" NUMBER 4 /end CHARACTERISTIC
/begin CHARACTERISTIC DSM_TypDfp_OvRMonCrCtlP_C "Konvertierung der Fehlertypen auf der Diagnoseschnittstelle fuer Fehlerpfad Dfp_OvRMonCrCtlP" VAL_BLK 0x1D23BE Kwb_Wu8 255.0 OneToOne 0.00 255.0 FORMAT "%5.1" NUMBER 4 /end CHARACTERISTIC
/begin CHARACTERISTIC DSM_TypDfp_OvRMonSigA_C "Konvertierung der Fehlertypen auf der Diagnoseschnittstelle fuer Fehlerpfad Dfp_OvRMonSigA" VAL_BLK 0x1D23C2 Kwb_Wu8 255.0 OneToOne 0.00 255.0 FORMAT "%5.1" NUMBER 4 /end CHARACTERISTIC
/begin CHARACTERISTIC DSM_TypDfp_OxiCCDTPre_C "Konvertierung der Fehlertypen auf der Diagnoseschnittstelle fuer Fehlerpfad Dfp_OxiCCDTPre" VAL_BLK 0x1D23C6 Kwb_Wu8 255.0 OneToOne 0.00 255.0 FORMAT "%5.1" NUMBER 4 /end CHARACTERISTIC
/begin CHARACTERISTIC DSM_TypDfp_OxiCCDTPre1_C "Konvertierung der Fehlertypen auf der Diagnoseschnittstelle fuer Fehlerpfad Dfp_OxiCCDTPre1" VAL_BLK 0x1D23CA Kwb_Wu8 255.0 OneToOne 0.00 255.0 FORMAT "%5.1" NUMBER 4 /end CHARACTERISTIC
/begin CHARACTERISTIC DSM_TypDfp_PCR_BalGovDev_C "Konvertierung der Fehlertypen auf der Diagnoseschnittstelle fuer Fehlerpfad Dfp_PCR_BalGovDev" VAL_BLK 0x1D23CE Kwb_Wu8 255.0 OneToOne 0.00 255.0 FORMAT "%5.1" NUMBER 4 /end CHARACTERISTIC
/begin CHARACTERISTIC DSM_TypDfp_PCR_GovDev_C "Konvertierung der Fehlertypen auf der Diagnoseschnittstelle fuer Fehlerpfad Dfp_PCR_GovDev" VAL_BLK 0x1D23D2 Kwb_Wu8 255.0 OneToOne 0.00 255.0 FORMAT "%5.1" NUMBER 4 /end CHARACTERISTIC
/begin CHARACTERISTIC DSM_TypDfp_PFltAPSens_C "Konvertierung der Fehlertypen auf der Diagnoseschnittstelle fuer Fehlerpfad Dfp_PFltAPSens" VAL_BLK 0x1D23D6 Kwb_Wu8 255.0 OneToOne 0.00 255.0 FORMAT "%5.1" NUMBER 4 /end CHARACTERISTIC
/begin CHARACTERISTIC DSM_TypDfp_PFltCDHtg_C "Konvertierung der Fehlertypen auf der Diagnoseschnittstelle fuer Fehlerpfad Dfp_PFltCDHtg" VAL_BLK 0x1D23DA Kwb_Wu8 255.0 OneToOne 0.00 255.0 FORMAT "%5.1" NUMBER 4 /end CHARACTERISTIC
/begin CHARACTERISTIC DSM_TypDfp_PFltCDHtg1_C "Konvertierung der Fehlertypen auf der Diagnoseschnittstelle fuer Fehlerpfad Dfp_PFltCDHtg1" VAL_BLK 0x1D23DE Kwb_Wu8 255.0 OneToOne 0.00 255.0 FORMAT "%5.1" NUMBER 4 /end CHARACTERISTIC
/begin CHARACTERISTIC DSM_TypDfp_PFltCDPDiff_C "Konvertierung der Fehlertypen auf der Diagnoseschnittstelle fuer Fehlerpfad Dfp_PFltCDPDiff" VAL_BLK 0x1D23E2 Kwb_Wu8 255.0 OneToOne 0.00 255.0 FORMAT "%5.1" NUMBER 4 /end CHARACTERISTIC
/begin CHARACTERISTIC DSM_TypDfp_PFltCDTempPre_C "Konvertierung der Fehlertypen auf der Diagnoseschnittstelle fuer Fehlerpfad Dfp_PFltCDTempPre" VAL_BLK 0x1D23E6 Kwb_Wu8 255.0 OneToOne 0.00 255.0 FORMAT "%5.1" NUMBER 4 /end CHARACTERISTIC
/begin CHARACTERISTIC DSM_TypDfp_PFltCDTempPre1_C "Konvertierung der Fehlertypen auf der Diagnoseschnittstelle fuer Fehlerpfad Dfp_PFltCDTempPre1" VAL_BLK 0x1D23EA Kwb_Wu8 255.0 OneToOne 0.00 255.0 FORMAT "%5.1" NUMBER 4 /end CHARACTERISTIC
/begin CHARACTERISTIC DSM_TypDfp_PFltCDTempPst_C "Konvertierung der Fehlertypen auf der Diagnoseschnittstelle fuer Fehlerpfad Dfp_PFltCDTempPst" VAL_BLK 0x1D23EE Kwb_Wu8 255.0 OneToOne 0.00 255.0 FORMAT "%5.1" NUMBER 4 /end CHARACTERISTIC
/begin CHARACTERISTIC DSM_TypDfp_PFltChar_C "Konvertierung der Fehlertypen auf der Diagnoseschnittstelle fuer Fehlerpfad Dfp_PFltChar" VAL_BLK 0x1D23F2 Kwb_Wu8 255.0 OneToOne 0.00 255.0 FORMAT "%5.1" NUMBER 4 /end CHARACTERISTIC
/begin CHARACTERISTIC DSM_TypDfp_PFltEngPrt_C "Konvertierung der Fehlertypen auf der Diagnoseschnittstelle fuer Fehlerpfad Dfp_PFltEngPrt" VAL_BLK 0x1D23F6 Kwb_Wu8 255.0 OneToOne 0.00 255.0 FORMAT "%5.1" NUMBER 4 /end CHARACTERISTIC
/begin CHARACTERISTIC DSM_TypDfp_PFltPresDynPlaus_C "Konvertierung der Fehlertypen auf der Diagnoseschnittstelle fuer Fehlerpfad Dfp_PFltPresDynPlaus" VAL_BLK 0x1D23FA Kwb_Wu8 255.0 OneToOne 0.00 255.0 FORMAT "%5.1" NUMBER 4 /end CHARACTERISTIC
/begin CHARACTERISTIC DSM_TypDfp_PFltPresHsChng_C "Konvertierung der Fehlertypen auf der Diagnoseschnittstelle fuer Fehlerpfad Dfp_PFltPresHsChng" VAL_BLK 0x1D23FE Kwb_Wu8 255.0 OneToOne 0.00 255.0 FORMAT "%5.1" NUMBER 4 /end CHARACTERISTIC
/begin CHARACTERISTIC DSM_TypDfp_PFltPresSens_C "Konvertierung der Fehlertypen auf der Diagnoseschnittstelle fuer Fehlerpfad Dfp_PFltPresSens" VAL_BLK 0x1D2402 Kwb_Wu8 255.0 OneToOne 0.00 255.0 FORMAT "%5.1" NUMBER 4 /end CHARACTERISTIC
/begin CHARACTERISTIC DSM_TypDfp_PFltPresSensFrz_C "Konvertierung der Fehlertypen auf der Diagnoseschnittstelle fuer Fehlerpfad Dfp_PFltPresSensFrz" VAL_BLK 0x1D2406 Kwb_Wu8 255.0 OneToOne 0.00 255.0 FORMAT "%5.1" NUMBER 4 /end CHARACTERISTIC
/begin CHARACTERISTIC DSM_TypDfp_PFltPresSensHsLn_C "Konvertierung der Fehlertypen auf der Diagnoseschnittstelle fuer Fehlerpfad Dfp_PFltPresSensHsLn" VAL_BLK 0x1D240A Kwb_Wu8 255.0 OneToOne 0.00 255.0 FORMAT "%5.1" NUMBER 4 /end CHARACTERISTIC
/begin CHARACTERISTIC DSM_TypDfp_PFltPresSensSot_C "Konvertierung der Fehlertypen auf der Diagnoseschnittstelle fuer Fehlerpfad Dfp_PFltPresSensSot" VAL_BLK 0x1D240E Kwb_Wu8 255.0 OneToOne 0.00 255.0 FORMAT "%5.1" NUMBER 4 /end CHARACTERISTIC
/begin CHARACTERISTIC DSM_TypDfp_PFltRgnLckPerm_C "Konvertierung der Fehlertypen auf der Diagnoseschnittstelle fuer Fehlerpfad Dfp_PFltRgnLckPerm" VAL_BLK 0x1D2412 Kwb_Wu8 255.0 OneToOne 0.00 255.0 FORMAT "%5.1" NUMBER 4 /end CHARACTERISTIC
/begin CHARACTERISTIC DSM_TypDfp_PFltRgnLckPermTstr_C "Konvertierung der Fehlertypen auf der Diagnoseschnittstelle fuer Fehlerpfad Dfp_PFltRgnLckPermTstr" VAL_BLK 0x1D2416 Kwb_Wu8 255.0 OneToOne 0.00 255.0 FORMAT "%5.1" NUMBER 4 /end CHARACTERISTIC
/begin CHARACTERISTIC DSM_TypDfp_PFltRgnPerm_C "Konvertierung der Fehlertypen auf der Diagnoseschnittstelle fuer Fehlerpfad Dfp_PFltRgnPerm" VAL_BLK 0x1D241A Kwb_Wu8 255.0 OneToOne 0.00 255.0 FORMAT "%5.1" NUMBER 4 /end CHARACTERISTIC
/begin CHARACTERISTIC DSM_TypDfp_PFltSotSimPresPerm_C "Konvertierung der Fehlertypen auf der Diagnoseschnittstelle fuer Fehlerpfad Dfp_PFltSotSimPresPerm" VAL_BLK 0x1D241E Kwb_Wu8 255.0 OneToOne 0.00 255.0 FORMAT "%5.1" NUMBER 4 /end CHARACTERISTIC
/begin CHARACTERISTIC DSM_TypDfp_PFltTempDwnStrm_C "Konvertierung der Fehlertypen auf der Diagnoseschnittstelle fuer Fehlerpfad Dfp_PFltTempDwnStrm" VAL_BLK 0x1D2422 Kwb_Wu8 255.0 OneToOne 0.00 255.0 FORMAT "%5.1" NUMBER 4 /end CHARACTERISTIC
/begin CHARACTERISTIC DSM_TypDfp_PFltTempDwnStrmMax_C "Konvertierung der Fehlertypen auf der Diagnoseschnittstelle fuer Fehlerpfad Dfp_PFltTempDwnStrmMax" VAL_BLK 0x1D2426 Kwb_Wu8 255.0 OneToOne 0.00 255.0 FORMAT "%5.1" NUMBER 4 /end CHARACTERISTIC
/begin CHARACTERISTIC DSM_TypDfp_PFltTempDwnStrmMin_C "Konvertierung der Fehlertypen auf der Diagnoseschnittstelle fuer Fehlerpfad Dfp_PFltTempDwnStrmMin" VAL_BLK 0x1D242A Kwb_Wu8 255.0 OneToOne 0.00 255.0 FORMAT "%5.1" NUMBER 4 /end CHARACTERISTIC
/begin CHARACTERISTIC DSM_TypDfp_PFltTempPreOxiC_C "Konvertierung der Fehlertypen auf der Diagnoseschnittstelle fuer Fehlerpfad Dfp_PFltTempPreOxiC" VAL_BLK 0x1D242E Kwb_Wu8 255.0 OneToOne 0.00 255.0 FORMAT "%5.1" NUMBER 4 /end CHARACTERISTIC
/begin CHARACTERISTIC DSM_TypDfp_PFltTempPrePFlt_C "Konvertierung der Fehlertypen auf der Diagnoseschnittstelle fuer Fehlerpfad Dfp_PFltTempPrePFlt" VAL_BLK 0x1D2432 Kwb_Wu8 255.0 OneToOne 0.00 255.0 FORMAT "%5.1" NUMBER 4 /end CHARACTERISTIC
/begin CHARACTERISTIC DSM_TypDfp_PFltTempPreTrbn_C "Konvertierung der Fehlertypen auf der Diagnoseschnittstelle fuer Fehlerpfad Dfp_PFltTempPreTrbn" VAL_BLK 0x1D2436 Kwb_Wu8 255.0 OneToOne 0.00 255.0 FORMAT "%5.1" NUMBER 4 /end CHARACTERISTIC
/begin CHARACTERISTIC DSM_TypDfp_PFltTempPstPFlt_C "Konvertierung der Fehlertypen auf der Diagnoseschnittstelle fuer Fehlerpfad Dfp_PFltTempPstPFlt" VAL_BLK 0x1D243E Kwb_Wu8 255.0 OneToOne 0.00 255.0 FORMAT "%5.1" NUMBER 4 /end CHARACTERISTIC
/begin CHARACTERISTIC DSM_TypDfp_PFltTempSens_C "Konvertierung der Fehlertypen auf der Diagnoseschnittstelle fuer Fehlerpfad Dfp_PFltTempSens" VAL_BLK 0x1D2442 Kwb_Wu8 255.0 OneToOne 0.00 255.0 FORMAT "%5.1" NUMBER 4 /end CHARACTERISTIC
/begin CHARACTERISTIC DSM_TypDfp_PFltTempSens2_C "Konvertierung der Fehlertypen auf der Diagnoseschnittstelle fuer Fehlerpfad Dfp_PFltTempSens2" VAL_BLK 0x1D2446 Kwb_Wu8 255.0 OneToOne 0.00 255.0 FORMAT "%5.1" NUMBER 4 /end CHARACTERISTIC
/begin CHARACTERISTIC DSM_TypDfp_PFltTempUpStrm_C "Konvertierung der Fehlertypen auf der Diagnoseschnittstelle fuer Fehlerpfad Dfp_PFltTempUpStrm" VAL_BLK 0x1D244A Kwb_Wu8 255.0 OneToOne 0.00 255.0 FORMAT "%5.1" NUMBER 4 /end CHARACTERISTIC
/begin CHARACTERISTIC DSM_TypDfp_PFltTempUpStrmMax_C "Konvertierung der Fehlertypen auf der Diagnoseschnittstelle fuer Fehlerpfad Dfp_PFltTempUpStrmMax" VAL_BLK 0x1D244E Kwb_Wu8 255.0 OneToOne 0.00 255.0 FORMAT "%5.1" NUMBER 4 /end CHARACTERISTIC
/begin CHARACTERISTIC DSM_TypDfp_PFltTempUpStrmMin_C "Konvertierung der Fehlertypen auf der Diagnoseschnittstelle fuer Fehlerpfad Dfp_PFltTempUpStrmMin" VAL_BLK 0x1D2452 Kwb_Wu8 255.0 OneToOne 0.00 255.0 FORMAT "%5.1" NUMBER 4 /end CHARACTERISTIC
/begin CHARACTERISTIC DSM_TypDfp_PSPCD_Actr_C "Konvertierung der Fehlertypen auf der Diagnoseschnittstelle fuer Fehlerpfad Dfp_PSPCD_Actr" VAL_BLK 0x1D2456 Kwb_Wu8 255.0 OneToOne 0.00 255.0 FORMAT "%5.1" NUMBER 4 /end CHARACTERISTIC
/begin CHARACTERISTIC DSM_TypDfp_PrpCtlvLimErrPat_C "Konvertierung der Fehlertypen auf der Diagnoseschnittstelle fuer Fehlerpfad Dfp_PrpCtlvLimErrPat" VAL_BLK 0x1D245A Kwb_Wu8 255.0 OneToOne 0.00 255.0 FORMAT "%5.1" NUMBER 4 /end CHARACTERISTIC
/begin CHARACTERISTIC DSM_TypDfp_SOPTst_C "Konvertierung der Fehlertypen auf der Diagnoseschnittstelle fuer Fehlerpfad Dfp_SOPTst" VAL_BLK 0x1D245E Kwb_Wu8 255.0 OneToOne 0.00 255.0 FORMAT "%5.1" NUMBER 4 /end CHARACTERISTIC
/begin CHARACTERISTIC DSM_TypDfp_SSpMon1_C "Konvertierung der Fehlertypen auf der Diagnoseschnittstelle fuer Fehlerpfad Dfp_SSpMon1" VAL_BLK 0x1D2462 Kwb_Wu8 255.0 OneToOne 0.00 255.0 FORMAT "%5.1" NUMBER 4 /end CHARACTERISTIC
/begin CHARACTERISTIC DSM_TypDfp_SSpMon2_C "Konvertierung der Fehlertypen auf der Diagnoseschnittstelle fuer Fehlerpfad Dfp_SSpMon2" VAL_BLK 0x1D2466 Kwb_Wu8 255.0 OneToOne 0.00 255.0 FORMAT "%5.1" NUMBER 4 /end CHARACTERISTIC
/begin CHARACTERISTIC DSM_TypDfp_SSpMon3_C "Konvertierung der Fehlertypen auf der Diagnoseschnittstelle fuer Fehlerpfad Dfp_SSpMon3" VAL_BLK 0x1D246A Kwb_Wu8 255.0 OneToOne 0.00 255.0 FORMAT "%5.1" NUMBER 4 /end CHARACTERISTIC
/begin CHARACTERISTIC DSM_TypDfp_Shtrp_EGRBA_C "Konvertierung der Fehlertypen auf der Diagnoseschnittstelle fuer Fehlerpfad Dfp_Shtrp_EGRBA" VAL_BLK 0x1D246E Kwb_Wu8 255.0 OneToOne 0.00 255.0 FORMAT "%5.1" NUMBER 4 /end CHARACTERISTIC
/begin CHARACTERISTIC DSM_TypDfp_Shtrp_PCRBA_C "Konvertierung der Fehlertypen auf der Diagnoseschnittstelle fuer Fehlerpfad Dfp_Shtrp_PCRBA" VAL_BLK 0x1D2472 Kwb_Wu8 255.0 OneToOne 0.00 255.0 FORMAT "%5.1" NUMBER 4 /end CHARACTERISTIC
/begin CHARACTERISTIC DSM_TypDfp_SrvPmpStSAEcu_C "Konvertierung der Fehlertypen auf der Diagnoseschnittstelle fuer Fehlerpfad Dfp_SrvPmpStSAEcu" VAL_BLK 0x1D2476 Kwb_Wu8 255.0 OneToOne 0.00 255.0 FORMAT "%5.1" NUMBER 4 /end CHARACTERISTIC
/begin CHARACTERISTIC DSM_TypDfp_StSysCtlShCirBatt_C "Konvertierung der Fehlertypen auf der Diagnoseschnittstelle fuer Fehlerpfad Dfp_StSysCtlShCirBatt" VAL_BLK 0x1D247A Kwb_Wu8 255.0 OneToOne 0.00 255.0 FORMAT "%5.1" NUMBER 4 /end CHARACTERISTIC
/begin CHARACTERISTIC DSM_TypDfp_StrtCDOffRly_C "Konvertierung der Fehlertypen auf der Diagnoseschnittstelle für Fehlerpfad Dfp_StrtCDOffRly" VAL_BLK 0x1D247E Kwb_Wu8 255.0 OneToOne 0.00 255.0 FORMAT "%5.1" NUMBER 4 /end CHARACTERISTIC
/begin CHARACTERISTIC DSM_TypDfp_StrtCDOnRly_C "Konvertierung der Fehlertypen auf der Diagnoseschnittstelle für Fehlerpfad Dfp_StrtCDOnRly" VAL_BLK 0x1D2482 Kwb_Wu8 255.0 OneToOne 0.00 255.0 FORMAT "%5.1" NUMBER 4 /end CHARACTERISTIC
/begin CHARACTERISTIC DSM_TypDfp_StrtCtlIlsNotPlaus_C "Konvertierung der Fehlertypen auf der Diagnoseschnittstelle für Fehlerpfad Dfp_StrtCtlIlsNotPlaus" VAL_BLK 0x1D2486 Kwb_Wu8 255.0 OneToOne 0.00 255.0 FORMAT "%5.1" NUMBER 4 /end CHARACTERISTIC
/begin CHARACTERISTIC DSM_TypDfp_StrtCtlT50ROneRly1_C "Konvertierung der Fehlertypen auf der Diagnoseschnittstelle fuer Fehlerpfad Dfp_StrtCtlT50ROneRly1" VAL_BLK 0x1D248A Kwb_Wu8 255.0 OneToOne 0.00 255.0 FORMAT "%5.1" NUMBER 4 /end CHARACTERISTIC
/begin CHARACTERISTIC DSM_TypDfp_StrtCtlT50ROneRly2_C "Konvertierung der Fehlertypen auf der Diagnoseschnittstelle fuer Fehlerpfad Dfp_StrtCtlT50ROneRly2" VAL_BLK 0x1D248E Kwb_Wu8 255.0 OneToOne 0.00 255.0 FORMAT "%5.1" NUMBER 4 /end CHARACTERISTIC
/begin CHARACTERISTIC DSM_TypDfp_StrtCtlT50RZero_C "Konvertierung der Fehlertypen auf der Diagnoseschnittstelle fuer Fehlerpfad Dfp_StrtCtlT50RZero" VAL_BLK 0x1D2492 Kwb_Wu8 255.0 OneToOne 0.00 255.0 FORMAT "%5.1" NUMBER 4 /end CHARACTERISTIC
/begin CHARACTERISTIC DSM_TypDfp_SysLamp_C "Konvertierung der Fehlertypen auf der Diagnoseschnittstelle fuer Fehlerpfad Dfp_SysLamp" VAL_BLK 0x1D2496 Kwb_Wu8 255.0 OneToOne 0.00 255.0 FORMAT "%5.1" NUMBER 4 /end CHARACTERISTIC
/begin CHARACTERISTIC DSM_TypDfp_T15CD_C "Konvertierung der Fehlertypen auf der Diagnoseschnittstelle fuer Fehlerpfad Dfp_T15CD" VAL_BLK 0x1D249A Kwb_Wu8 255.0 OneToOne 0.00 255.0 FORMAT "%5.1" NUMBER 4 /end CHARACTERISTIC
/begin CHARACTERISTIC DSM_TypDfp_T50CD_C "Konvertierung der Fehlertypen auf der Diagnoseschnittstelle fuer Fehlerpfad Dfp_T50CD" VAL_BLK 0x1D249E Kwb_Wu8 255.0 OneToOne 0.00 255.0 FORMAT "%5.1" NUMBER 4 /end CHARACTERISTIC
/begin CHARACTERISTIC DSM_TypDfp_TPUMon_C "Konvertierung der Fehlertypen auf der Diagnoseschnittstelle fuer Fehlerpfad Dfp_TPUMon" VAL_BLK 0x1D24A2 Kwb_Wu8 255.0 OneToOne 0.00 255.0 FORMAT "%5.1" NUMBER 4 /end CHARACTERISTIC
/begin CHARACTERISTIC DSM_TypDfp_TVACD_Max_C "Konvertierung der Fehlertypen auf der Diagnoseschnittstelle fuer Fehlerpfad Dfp_TVACD_Max" VAL_BLK 0x1D24A6 Kwb_Wu8 255.0 OneToOne 0.00 255.0 FORMAT "%5.1" NUMBER 4 /end CHARACTERISTIC
/begin CHARACTERISTIC DSM_TypDfp_TVACD_Min_C "Konvertierung der Fehlertypen auf der Diagnoseschnittstelle fuer Fehlerpfad Dfp_TVACD_Min" VAL_BLK 0x1D24AA Kwb_Wu8 255.0 OneToOne 0.00 255.0 FORMAT "%5.1" NUMBER 4 /end CHARACTERISTIC
/begin CHARACTERISTIC DSM_TypDfp_TVACD_Sig_C "Konvertierung der Fehlertypen auf der Diagnoseschnittstelle fuer Fehlerpfad Dfp_TVACD_Sig" VAL_BLK 0x1D24AE Kwb_Wu8 255.0 OneToOne 0.00 255.0 FORMAT "%5.1" NUMBER 4 /end CHARACTERISTIC
/begin CHARACTERISTIC DSM_TypDfp_TVACD_SigNpl_C "Konvertierung der Fehlertypen auf der Diagnoseschnittstelle fuer Fehlerpfad Dfp_TVACD_SigNpl" VAL_BLK 0x1D24B2 Kwb_Wu8 255.0 OneToOne 0.00 255.0 FORMAT "%5.1" NUMBER 4 /end CHARACTERISTIC
/begin CHARACTERISTIC DSM_TypDfp_TVACD_stLineDef_C "Konvertierung der Fehlertypen auf der Diagnoseschnittstelle fuer Fehlerpfad Dfp_TVACD_stLineDef" VAL_BLK 0x1D24B6 Kwb_Wu8 255.0 OneToOne 0.00 255.0 FORMAT "%5.1" NUMBER 4 /end CHARACTERISTIC
/begin CHARACTERISTIC DSM_TypDfp_TVASCD_C "Konvertierung der Fehlertypen auf der Diagnoseschnittstelle fuer Fehlerpfad Dfp_TVASCD" VAL_BLK 0x1D24BA Kwb_Wu8 255.0 OneToOne 0.00 255.0 FORMAT "%5.1" NUMBER 4 /end CHARACTERISTIC
/begin CHARACTERISTIC DSM_TypDfp_TVASCD_Drft_C "Konvertierung der Fehlertypen auf der Diagnoseschnittstelle fuer Fehlerpfad Dfp_TVASCD_Drft" VAL_BLK 0x1D24BE Kwb_Wu8 255.0 OneToOne 0.00 255.0 FORMAT "%5.1" NUMBER 4 /end CHARACTERISTIC
/begin CHARACTERISTIC DSM_TypDfp_ThrVlvGvnrDvt_C "Konvertierung der Fehlertypen auf der Diagnoseschnittstelle fuer Fehlerpfad Dfp_ThrVlvGvnrDvt" VAL_BLK 0x1D24C2 Kwb_Wu8 255.0 OneToOne 0.00 255.0 FORMAT "%5.1" NUMBER 4 /end CHARACTERISTIC
/begin CHARACTERISTIC DSM_TypDfp_ThrVlvJamVlv_C "Konvertierung der Fehlertypen auf der Diagnoseschnittstelle fuer Fehlerpfad Dfp_ThrVlvJamVlv" VAL_BLK 0x1D24C6 Kwb_Wu8 255.0 OneToOne 0.00 255.0 FORMAT "%5.1" NUMBER 4 /end CHARACTERISTIC
/begin CHARACTERISTIC DSM_TypDfp_UAcc_CodeBitErr_C "Konvertierung der Fehlertypen auf der Diagnoseschnittstelle fuer Fehlerpfad Dfp_UAcc_CodeBitErr" VAL_BLK 0x1D24CA Kwb_Wu8 255.0 OneToOne 0.00 255.0 FORMAT "%5.1" NUMBER 4 /end CHARACTERISTIC
/begin CHARACTERISTIC DSM_TypDfp_USAp_DataVariant_C "Konvertierung der Fehlertypen auf der Diagnoseschnittstelle fuer Fehlerpfad Dfp_USAp_DataVariant" VAL_BLK 0x1D24CE Kwb_Wu8 255.0 OneToOne 0.00 255.0 FORMAT "%5.1" NUMBER 4 /end CHARACTERISTIC
/begin CHARACTERISTIC DSM_TypDfp_USAp_FuncCodeRead_C "Konvertierung der Fehlertypen auf der Diagnoseschnittstelle fuer Fehlerpfad Dfp_USAp_FuncCodeRead" VAL_BLK 0x1D24D2 Kwb_Wu8 255.0 OneToOne 0.00 255.0 FORMAT "%5.1" NUMBER 4 /end CHARACTERISTIC
/begin CHARACTERISTIC DSM_TypDfp_VSACD_Max_C "Konvertierung der Fehlertypen auf der Diagnoseschnittstelle fuer Fehlerpfad Dfp_VSACD_Max" VAL_BLK 0x1D24D6 Kwb_Wu8 255.0 OneToOne 0.00 255.0 FORMAT "%5.1" NUMBER 4 /end CHARACTERISTIC
/begin CHARACTERISTIC DSM_TypDfp_VSACD_Min_C "Konvertierung der Fehlertypen auf der Diagnoseschnittstelle fuer Fehlerpfad Dfp_VSACD_Min" VAL_BLK 0x1D24DA Kwb_Wu8 255.0 OneToOne 0.00 255.0 FORMAT "%5.1" NUMBER 4 /end CHARACTERISTIC
/begin CHARACTERISTIC DSM_TypDfp_VSACD_SigNpl_C "Konvertierung der Fehlertypen auf der Diagnoseschnittstelle fuer Fehlerpfad Dfp_VSACD_SigNpl" VAL_BLK 0x1D24DE Kwb_Wu8 255.0 OneToOne 0.00 255.0 FORMAT "%5.1" NUMBER 4 /end CHARACTERISTIC
/begin CHARACTERISTIC DSM_TypDfp_VSSCD_C "Konvertierung der Fehlertypen auf der Diagnoseschnittstelle fuer Fehlerpfad Dfp_VSSCD" VAL_BLK 0x1D24E2 Kwb_Wu8 255.0 OneToOne 0.00 255.0 FORMAT "%5.1" NUMBER 4 /end CHARACTERISTIC
/begin CHARACTERISTIC DSM_TypDfp_VSSCD1_C "Konvertierung der Fehlertypen auf der Diagnoseschnittstelle fuer Fehlerpfad Dfp_VSSCD1" VAL_BLK 0x1D24E6 Kwb_Wu8 255.0 OneToOne 0.00 255.0 FORMAT "%5.1" NUMBER 4 /end CHARACTERISTIC
/begin CHARACTERISTIC DSM_TypDfp_VSSCD2_C "Konvertierung der Fehlertypen auf der Diagnoseschnittstelle fuer Fehlerpfad Dfp_VSSCD2" VAL_BLK 0x1D24EA Kwb_Wu8 255.0 OneToOne 0.00 255.0 FORMAT "%5.1" NUMBER 4 /end CHARACTERISTIC
/begin CHARACTERISTIC DSM_TypDfp_VSSCD4_C "Konvertierung der Fehlertypen auf der Diagnoseschnittstelle fuer Fehlerpfad Dfp_VSSCD4" VAL_BLK 0x1D24EE Kwb_Wu8 255.0 OneToOne 0.00 255.0 FORMAT "%5.1" NUMBER 4 /end CHARACTERISTIC
/begin CHARACTERISTIC DSM_TypDfp_VSSCDBrkLowVltg_C "Konvertierung der Fehlertypen auf der Diagnoseschnittstelle fuer Fehlerpfad Dfp_VSSCDBrkLowVltg" VAL_BLK 0x1D24F2 Kwb_Wu8 255.0 OneToOne 0.00 255.0 FORMAT "%5.1" NUMBER 4 /end CHARACTERISTIC
/begin CHARACTERISTIC DSM_TypDfp_VSSCDCAN_C "Konvertierung der Fehlertypen auf der Diagnoseschnittstelle fuer Fehlerpfad Dfp_VSSCDCAN" VAL_BLK 0x1D24F6 Kwb_Wu8 255.0 OneToOne 0.00 255.0 FORMAT "%5.1" NUMBER 4 /end CHARACTERISTIC
/begin CHARACTERISTIC DSM_TypDfp_VSSCDNpl_C "Konvertierung der Fehlertypen auf der Diagnoseschnittstelle fuer Fehlerpfad Dfp_VSSCDNpl" VAL_BLK 0x1D24FA Kwb_Wu8 255.0 OneToOne 0.00 255.0 FORMAT "%5.1" NUMBER 4 /end CHARACTERISTIC
/begin CHARACTERISTIC DSM_TypDfp_WdCom_C "Konvertierung der Fehlertypen auf der Diagnoseschnittstelle fuer Fehlerpfad Dfp_WdCom" VAL_BLK 0x1D2502 Kwb_Wu8 255.0 OneToOne 0.00 255.0 FORMAT "%5.1" NUMBER 4 /end CHARACTERISTIC
/begin COMPU_METHOD ClassTrigger "Verbale Umrechnung für DSM_Class%TFlc_C und DSM_Class%THlc_C" TAB_VERB "%6.3" "" COMPU_TAB_REF ClassTrigger /end COMPU_METHOD
/begin COMPU_VTAB ClassTrigger "Verbale Umrechnung für DSM_Class%TFlc_C und DSM_Class%THlc_C" TAB_VERB 6 0 "no handling" 1 "time quantum" 2 "driving cycle" 3 "warm up cycle" 4 "flc driving cycle" 5 "hlc driving cycle Similar Condition" /end COMPU_VTAB
/begin COMPU_METHOD ClassTriggerTDlc "Verbale Umrechnung für DSM_Class%TDlc_C und DSM_Class%TDlcPen_C" TAB_VERB "%6.3" "" COMPU_TAB_REF ClassTriggerTDlc /end COMPU_METHOD
/begin COMPU_VTAB ClassTriggerTDlc "Verbale Umrechnung für DSM_Class%TDlc_C und DSM_Class%TDlcPen_C" TAB_VERB 4 0 "no handling" 1 "each afterrun_1" 2 "driving cycle" 3 "warm up cycle" /end COMPU_VTAB
/begin COMPU_METHOD Mil "Verbale Umrechnung für DSM_Class%Mil_C" TAB_VERB "%6.3" "" COMPU_TAB_REF Mil /end COMPU_METHOD
/begin COMPU_VTAB Mil "Verbale Umrechnung für DSM_Class%Mil_C" TAB_VERB 3 0 "Mil OFF" 1 "Mil ON" 2 "Mil BLINK" /end COMPU_VTAB
/begin COMPU_METHOD OneToOne "eins zu eins (physikalischer Wert ist gleich dem internen Wert)" RAT_FUNC "%6.2" "[-]" COEFFS 0 1 0 0 0 1 /end COMPU_METHOD
/begin COMPU_METHOD Readiness "Verbale Umrechnung für DSM_Class%Readiness_C" TAB_VERB "%6.3" "" COMPU_TAB_REF Readiness /end COMPU_METHOD
/begin COMPU_VTAB Readiness "Verbale Umrechnung für DSM_Class%Readiness_C" TAB_VERB 8 0 "non" 1 "EGR system monitoring" 2 "catalyst monitoring" 4 "misfire monitoring" 8 "fuel system" 16 "comprehensive components" 32 "oxygen sensor" 64 "oxygen sensor heater" /end COMPU_VTAB
/begin COMPU_METHOD ResErf "Verbale Umrechnung für DSM_Class%ResErf_C" TAB_VERB "%6.3" "" COMPU_TAB_REF ResErf /end COMPU_METHOD
/begin COMPU_VTAB ResErf "Verbale Umrechnung für DSM_Class%ResErf_C" TAB_VERB 4 0 "no Reset" 1 "Reset on Init" 2 "Reset on Restart" 3 "Reset on Init or Restart" /end COMPU_VTAB
/begin COMPU_METHOD Scatt "Verbale Umrechnugn für DSM_Class%Scatt_C" TAB_VERB "%6.3" "" COMPU_TAB_REF Scatt /end COMPU_METHOD
/begin COMPU_VTAB Scatt "Verbale Umrechnugn für DSM_Class%Scatt_C" TAB_VERB 2 0 "not visible for OBD-Tester" 1 "visible for OBD-Tester" /end COMPU_VTAB
/begin COMPU_METHOD SysLamp "Verbale Umrechnung für DSM_Class%SysLamp_C" TAB_VERB "%6.3" "" COMPU_TAB_REF SysLamp /end COMPU_METHOD
/begin COMPU_VTAB SysLamp "Verbale Umrechnung für DSM_Class%SysLamp_C" TAB_VERB 3 0 "SysLamp OFF" 1 "SysLamp ON" 2 "SysLamp BLINK" /end COMPU_VTAB
/begin RECORD_LAYOUT Kwb_Wu8 FNC_VALUES 1 UBYTE COLUMN_DIR DIRECT /end RECORD_LAYOUT
/begin RECORD_LAYOUT Kw_Wu8 FNC_VALUES 1 UBYTE COLUMN_DIR DIRECT /end RECORD_LAYOUT
/begin FUNCTION DSM_Typ "Configuration parameters for Conversion of fault types for diagnostic Interface per fault path"
 /begin DEF_CHARACTERISTIC DSM_TypDfp_ACCCDBrkErr_C DSM_TypDfp_ACCCDBrkNPL_C DSM_TypDfp_ACCCDSensErr_C DSM_TypDfp_ACCCDWrongCoded_C DSM_TypDfp_ACCCD_C DSM_TypDfp_ACCD_C DSM_TypDfp_ACCD_PAC_C DSM_TypDfp_ACCD_pCAN_C DSM_TypDfp_ACCD_trqCAN_C DSM_TypDfp_ACCIRevPanErr_C DSM_TypDfp_ACCIRevShOff_C DSM_TypDfp_ACCnotPlaus_C DSM_TypDfp_ADCMon_C DSM_TypDfp_AFSCD_PlOffsDrft_C DSM_TypDfp_AFSCD_PlSetyDrft_C DSM_TypDfp_AFSCD_SRCAirm_C DSM_TypDfp_AFVCD_Actr_C DSM_TypDfp_AOHtCDHt1_C DSM_TypDfp_AOHtCDHt2_C DSM_TypDfp_AOHtCDHt3_C DSM_TypDfp_APP1_C DSM_TypDfp_APP2_C DSM_TypDfp_APPCD_KickDown_C DSM_TypDfp_APPCD_PWGDrft_C DSM_TypDfp_APPSync_C DSM_TypDfp_APP_Npl_C DSM_TypDfp_APSCD_C DSM_TypDfp_AccPedPlausBrk_C DSM_TypDfp_AirCtl_GovDevMax_C DSM_TypDfp_AirCtl_GovDevMin_C DSM_TypDfp_AirCtl_GovDevRgnMax_C DSM_TypDfp_AirCtl_GovDevRgnMin_C DSM_TypDfp_AirbCDCrashCrCtl_C DSM_TypDfp_AirbCDCrashPSP_C DSM_TypDfp_AirbCDCrash_C DSM_TypDfp_AltCDExc_C DSM_TypDfp_AltCD_Load_C DSM_TypDfp_AltPwrCan_C DSM_TypDfp_BIP01_C DSM_TypDfp_BIP02_C DSM_TypDfp_BIP03_C DSM_TypDfp_BIP04_C DSM_TypDfp_BIP05_C DSM_TypDfp_BIP06_C DSM_TypDfp_BIP07_C DSM_TypDfp_BIP08_C DSM_TypDfp_BIP09_C DSM_TypDfp_BIP10_C DSM_TypDfp_BIP11_C DSM_TypDfp_BIP12_C DSM_TypDfp_BIP_Con_C DSM_TypDfp_BPACD_Max2_C DSM_TypDfp_BPACD_Max_C DSM_TypDfp_BPACD_Min2_C DSM_TypDfp_BPACD_Min_C DSM_TypDfp_BPACD_SigNpl2_C DSM_TypDfp_BPACD_SigNpl_C DSM_TypDfp_BPASCD_C DSM_TypDfp_BPSCD_C DSM_TypDfp_BattCD_C DSM_TypDfp_BrkCDBPTInvld_C DSM_TypDfp_BrkCD_C DSM_TypDfp_BrkCDdynPl_C DSM_TypDfp_CANA_C DSM_TypDfp_CANB_C DSM_TypDfp_CANBus1_C DSM_TypDfp_CANBus2_C DSM_TypDfp_CANBus3_C DSM_TypDfp_CANC_C DSM_TypDfp_CANErrActA_C DSM_TypDfp_CANErrActB_C DSM_TypDfp_CANErrActC_C DSM_TypDfp_COTSCD_C DSM_TypDfp_CTSCDCanInac_C DSM_TypDfp_CTSCDCanSig_C DSM_TypDfp_CTSCD_C DSM_TypDfp_Clg_DynTst_C DSM_TypDfp_CmbChbMisfire1_C DSM_TypDfp_CmbChbMisfire2_C DSM_TypDfp_CmbChbMisfire3_C DSM_TypDfp_CmbChbMisfire4_C DSM_TypDfp_CmbChbMisfire5_C DSM_TypDfp_CmbChbMisfire6_C DSM_TypDfp_CmbChbMisfireMul_C DSM_TypDfp_CoVMDCSh_C DSM_TypDfp_CoVMDCSp_C DSM_TypDfp_CoVehLvl2_C DSM_TypDfp_ConvCD_C DSM_TypDfp_ConvCD_ConvErr_C DSM_TypDfp_ConvCD_EPB1_C DSM_TypDfp_CrCCDPanErrMSG_C DSM_TypDfp_CrCCDPanErrSMLS_C DSM_TypDfp_CrCCDPanMainSwtErr_C DSM_TypDfp_CrCtlDsplNotPlaus_C DSM_TypDfp_CrCtlPECDErr_C DSM_TypDfp_CrCtlPLmpDef_C DSM_TypDfp_CrCtlPShutOff_C DSM_TypDfp_CrCtlPTlrDef_C DSM_TypDfp_CtApCD_C DSM_TypDfp_CtTCD_C DSM_TypDfp_CtT_Mon_C DSM_TypDfp_DifftrqLimErrPat_C DSM_TypDfp_EATSCDCanInac_C DSM_TypDfp_EATSCDCanSig_C DSM_TypDfp_EATSCD_C DSM_TypDfp_EEPCDVarMng_C DSM_TypDfp_EGPpCDTPreTrbn_C DSM_TypDfp_EGRCD_CBV_C DSM_TypDfp_EGRCD_Max_C DSM_TypDfp_EGRCD_Min_C DSM_TypDfp_EGRCD_SigNpl_C DSM_TypDfp_EGRCD_Sig_C DSM_TypDfp_EGRSCD_C DSM_TypDfp_EGRSCD_JamVlv_C DSM_TypDfp_EGRSCD_LgTimeDrft_C DSM_TypDfp_EGRSCD_ShTimeDrft_C DSM_TypDfp_EGRVlvGvnrDvt_C DSM_TypDfp_EGRVlv_JamVlv_C DSM_TypDfp_EMCCD_MLS1_C DSM_TypDfp_EngMBackUp_C DSM_TypDfp_EngMCaS1_C DSM_TypDfp_EngMCaSDrv_C DSM_TypDfp_EngMCrS1_C DSM_TypDfp_EngMOfsCaSCrS_C DSM_TypDfp_EngMonIrrCmb_C DSM_TypDfp_EngPrt_C DSM_TypDfp_ErLpCDMILReqON_C DSM_TypDfp_FMAErrMod_C DSM_TypDfp_FMTC_NonMonotonMap_C DSM_TypDfp_FQTSCD_C DSM_TypDfp_FQlSCD_C DSM_TypDfp_FTSCDNpl_C DSM_TypDfp_FTSCD_C DSM_TypDfp_FanCD_Fan1Ctlr1_C DSM_TypDfp_FanCD_Fan1Ctlr2_C DSM_TypDfp_FanCD_Fan2Ctlr1_C DSM_TypDfp_FanCD_Fan2Ctlr2_C DSM_TypDfp_FanCD_FanCtlr1_C DSM_TypDfp_FanCD_FanCtlr2_C DSM_TypDfp_FanCD_OutFanCtlr1_C DSM_TypDfp_FanCD_OutFanCtlr2_C DSM_TypDfp_FlPpCD_C DSM_TypDfp_FlSCDT1_C DSM_TypDfp_FrmMngAAGNpl_C DSM_TypDfp_FrmMngAAGTO_C DSM_TypDfp_FrmMngAC1Npl_C DSM_TypDfp_FrmMngAC1TO_C DSM_TypDfp_FrmMngACCNpl_C DSM_TypDfp_FrmMngACCTO_C DSM_TypDfp_FrmMngAIRBGNpl_C DSM_TypDfp_FrmMngAIRBGTO_C DSM_TypDfp_FrmMngAWD1Npl_C DSM_TypDfp_FrmMngAWD1TO_C DSM_TypDfp_FrmMngBEM1Npl_C DSM_TypDfp_FrmMngBEM1TO_C DSM_TypDfp_FrmMngBRK1Npl_C DSM_TypDfp_FrmMngBRK1TO_C DSM_TypDfp_FrmMngBRK2Npl_C DSM_TypDfp_FrmMngBRK2TO_C DSM_TypDfp_FrmMngBRK8Npl_C DSM_TypDfp_FrmMngBRK8TO_C DSM_TypDfp_FrmMngBSG3TO_C DSM_TypDfp_FrmMngCANVerErr_C DSM_TypDfp_FrmMngCCSel_C DSM_TypDfp_FrmMngCCTLNpl_C DSM_TypDfp_FrmMngCCTLTO_C DSM_TypDfp_FrmMngCHRGR1Npl_C DSM_TypDfp_FrmMngCHRGR1TO_C DSM_TypDfp_FrmMngCHRGR2Npl_C DSM_TypDfp_FrmMngCHRGR2TO_C DSM_TypDfp_FrmMngChrgr1A_C DSM_TypDfp_FrmMngChrgr1C_C DSM_TypDfp_FrmMngChrgr1N_C DSM_TypDfp_FrmMngChrgr1T_C DSM_TypDfp_FrmMngChrgr1V_C DSM_TypDfp_FrmMngChrgr2A_C DSM_TypDfp_FrmMngChrgr2C_C DSM_TypDfp_FrmMngChrgr2N_C DSM_TypDfp_FrmMngChrgr2T_C DSM_TypDfp_FrmMngChrgr2V_C DSM_TypDfp_FrmMngDIA1Npl_C DSM_TypDfp_FrmMngDIA1TO_C DSM_TypDfp_FrmMngDSP1Npl_C DSM_TypDfp_FrmMngDSP1TO_C DSM_TypDfp_FrmMngDSP2Npl_C DSM_TypDfp_FrmMngDSP2TO_C DSM_TypDfp_FrmMngDSP3Npl_C DSM_TypDfp_FrmMngDSP3TO_C DSM_TypDfp_FrmMngEPB1Npl_C DSM_TypDfp_FrmMngEPB1TO_C DSM_TypDfp_FrmMngESCUNpl_C DSM_TypDfp_FrmMngESCUTO_C DSM_TypDfp_FrmMngGW1Npl_C DSM_TypDfp_FrmMngGW1TO_C DSM_TypDfp_FrmMngILMNpl_C DSM_TypDfp_FrmMngILMTO_C DSM_TypDfp_FrmMngLICHT1TO_C DSM_TypDfp_FrmMngLICHT2TO_C DSM_TypDfp_FrmMngNIV1WrngCod_C DSM_TypDfp_FrmMngNIVEAU1Npl_C DSM_TypDfp_FrmMngNIVEAU1TO_C DSM_TypDfp_FrmMngSA1Npl_C DSM_TypDfp_FrmMngSA1TO_C DSM_TypDfp_FrmMngSTIGNNpl_C DSM_TypDfp_FrmMngStIgnTO_C DSM_TypDfp_FrmMngTOSNpl_C DSM_TypDfp_FrmMngTOSTO_C DSM_TypDfp_FrmMngTSC1Npl_C DSM_TypDfp_FrmMngTSC1TO_C DSM_TypDfp_FrmMngTSC2Npl_C DSM_TypDfp_FrmMngTSC2TO_C DSM_TypDfp_FrmMngTSC3Npl_C DSM_TypDfp_FrmMngTSC3TO_C DSM_TypDfp_FrmMngTSC6Npl_C DSM_TypDfp_FrmMngTSC6TO_C DSM_TypDfp_FrmMngTrbnSpdErr_C DSM_TypDfp_FrmMngWIPERTO_C DSM_TypDfp_GbSSCD_C DSM_TypDfp_GbSSCD_HW_C DSM_TypDfp_GearbxCVTnMax_C DSM_TypDfp_GearbxClthPlaus_C DSM_TypDfp_GearbxINCCup_C DSM_TypDfp_GearbxNMinMon_C DSM_TypDfp_GearbxTSC_C DSM_TypDfp_GearbxTransConv_C DSM_TypDfp_GearbxTypeMTErr_C DSM_TypDfp_GlwCDDIAG_C DSM_TypDfp_GlwCDErr1_C DSM_TypDfp_GlwCDErr2_C DSM_TypDfp_GlwCDEvalCod_C DSM_TypDfp_GlwCDGSK2_C DSM_TypDfp_GlwCDGSK3_C DSM_TypDfp_GlwCDLmp_C DSM_TypDfp_GlwCDPLUG0_C DSM_TypDfp_GlwCDPLUG1_C DSM_TypDfp_GlwCDPLUG2_C DSM_TypDfp_GlwCDPLUG3_C DSM_TypDfp_GlwCDPLUG4_C DSM_TypDfp_GlwCDPLUG5_C DSM_TypDfp_GlwCD_LampCan_C DSM_TypDfp_GlwCDsfd_C DSM_TypDfp_HDSCD_C DSM_TypDfp_HWEMonCom_C DSM_TypDfp_HWEMonEEPROM_C DSM_TypDfp_HWEMonRcyLocked_C DSM_TypDfp_HWEMonRcySuppressed_C DSM_TypDfp_HWEMonRcyVisible_C DSM_TypDfp_HWEMonUMaxSupply_C DSM_TypDfp_HWEMonUMinSupply_C DSM_TypDfp_IATSCD_C DSM_TypDfp_IFCD_C DSM_TypDfp_ImmCtl_C DSM_TypDfp_IndSysMonIntMnf_C DSM_TypDfp_InjVlvBnk1A_C DSM_TypDfp_InjVlvBnk2A_C DSM_TypDfp_InjVlvCyl10A_C DSM_TypDfp_InjVlvCyl11A_C DSM_TypDfp_InjVlvCyl12A_C DSM_TypDfp_InjVlvCyl1A_C DSM_TypDfp_InjVlvCyl2A_C DSM_TypDfp_InjVlvCyl3A_C DSM_TypDfp_InjVlvCyl4A_C DSM_TypDfp_InjVlvCyl5A_C DSM_TypDfp_InjVlvCyl6A_C DSM_TypDfp_InjVlvCyl7A_C DSM_TypDfp_InjVlvCyl8A_C DSM_TypDfp_InjVlvCyl9A_C DSM_TypDfp_LASCD_C DSM_TypDfp_LSUCDCircNernst0_C DSM_TypDfp_LSUCDCircPumpCur0_C DSM_TypDfp_LSUCDCircVirtGnd0_C DSM_TypDfp_LSUCDHeater0_C DSM_TypDfp_LSUCDHtCoup0_C DSM_TypDfp_LSUCDO20_C DSM_TypDfp_LSUCDO2Clb0_C DSM_TypDfp_LSUCDRiClb0_C DSM_TypDfp_LSUCDSPI0_C DSM_TypDfp_LSUCDSPIBattLow0_C DSM_TypDfp_LSUCDWireIP0_C DSM_TypDfp_LSUCtlRiExc0_C DSM_TypDfp_LSUMonDyn0_C DSM_TypDfp_LSUMonFullLd0_C DSM_TypDfp_LSUMonOvrRun0_C DSM_TypDfp_LSUMonPartLd0_C DSM_TypDfp_MIL_C DSM_TypDfp_MRlyCD_C DSM_TypDfp_Montr_C DSM_TypDfp_OTSCDCanInac_C DSM_TypDfp_OTSCDCanSig_C DSM_TypDfp_OTSCD_C DSM_TypDfp_OvRMonCrCtlP_C DSM_TypDfp_OvRMonSigA_C DSM_TypDfp_OvRMon_C DSM_TypDfp_OxiCCDTPre1_C DSM_TypDfp_OxiCCDTPre_C DSM_TypDfp_PCR_BalGovDev_C DSM_TypDfp_PCR_GovDev_C DSM_TypDfp_PFltAPSens_C DSM_TypDfp_PFltCDHtg1_C DSM_TypDfp_PFltCDHtg_C DSM_TypDfp_PFltCDPDiff_C DSM_TypDfp_PFltCDTempPre1_C DSM_TypDfp_PFltCDTempPre_C DSM_TypDfp_PFltCDTempPst_C DSM_TypDfp_PFltChar_C DSM_TypDfp_PFltEngPrt_C DSM_TypDfp_PFltPresDynPlaus_C DSM_TypDfp_PFltPresHsChng_C DSM_TypDfp_PFltPresSensFrz_C DSM_TypDfp_PFltPresSensHsLn_C DSM_TypDfp_PFltPresSensSot_C DSM_TypDfp_PFltPresSens_C DSM_TypDfp_PFltRgnLckPermTstr_C DSM_TypDfp_PFltRgnLckPerm_C DSM_TypDfp_PFltRgnPerm_C DSM_TypDfp_PFltSotSimPresPerm_C DSM_TypDfp_PFltTempDwnStrmMax_C DSM_TypDfp_PFltTempDwnStrmMin_C DSM_TypDfp_PFltTempDwnStrm_C DSM_TypDfp_PFltTempPreOxiC_C DSM_TypDfp_PFltTempPrePFlt_C DSM_TypDfp_PFltTempPreTrbn_C DSM_TypDfp_PFltTempPstPFlt_C DSM_TypDfp_PFltTempSens2_C DSM_TypDfp_PFltTempSens_C DSM_TypDfp_PFltTempUpStrmMax_C DSM_TypDfp_PFltTempUpStrmMin_C DSM_TypDfp_PFltTempUpStrm_C DSM_TypDfp_PSPCD_Actr_C DSM_TypDfp_PrpCtlvLimErrPat_C DSM_TypDfp_SOPTst_C DSM_TypDfp_SSpMon1_C DSM_TypDfp_SSpMon2_C DSM_TypDfp_SSpMon3_C DSM_TypDfp_Shtrp_EGRBA_C DSM_TypDfp_Shtrp_PCRBA_C DSM_TypDfp_SrvPmpStSAEcu_C DSM_TypDfp_StSysCtlShCirBatt_C DSM_TypDfp_StrtCDOffRly_C DSM_TypDfp_StrtCDOnRly_C DSM_TypDfp_StrtCtlIlsNotPlaus_C DSM_TypDfp_StrtCtlT50ROneRly1_C DSM_TypDfp_StrtCtlT50ROneRly2_C DSM_TypDfp_StrtCtlT50RZero_C DSM_TypDfp_SysLamp_C DSM_TypDfp_T15CD_C DSM_TypDfp_T50CD_C DSM_TypDfp_TPUMon_C DSM_TypDfp_TVACD_Max_C DSM_TypDfp_TVACD_Min_C DSM_TypDfp_TVACD_SigNpl_C DSM_TypDfp_TVACD_Sig_C DSM_TypDfp_TVACD_stLineDef_C DSM_TypDfp_TVASCD_C DSM_TypDfp_TVASCD_Drft_C DSM_TypDfp_ThrVlvGvnrDvt_C DSM_TypDfp_ThrVlvJamVlv_C DSM_TypDfp_UAcc_CodeBitErr_C DSM_TypDfp_USAp_DataVariant_C DSM_TypDfp_USAp_FuncCodeRead_C DSM_TypDfp_VSACD_Max_C DSM_TypDfp_VSACD_Min_C DSM_TypDfp_VSACD_SigNpl_C DSM_TypDfp_VSSCD1_C DSM_TypDfp_VSSCD2_C DSM_TypDfp_VSSCD4_C DSM_TypDfp_VSSCDBrkLowVltg_C DSM_TypDfp_VSSCDCAN_C DSM_TypDfp_VSSCDNpl_C DSM_TypDfp_VSSCD_C DSM_TypDfp_WdCom_C /end DEF_CHARACTERISTIC
/end FUNCTION
/begin FUNCTION DSM_class "Aufbau Fehlerklassentabelle"
 /begin DEF_CHARACTERISTIC DSM_Class10DlcKd_C DSM_Class10DlcPen_C DSM_Class10Dlc_C DSM_Class10Flc_C DSM_Class10Hlc_C DSM_Class10Mil_C DSM_Class10Prio_C DSM_Class10Readiness_C DSM_Class10ResErf_C DSM_Class10Scatt_C DSM_Class10SysLamp_C DSM_Class10TDlcPen_C DSM_Class10TDlc_C DSM_Class10TFlc_C DSM_Class10THlc_C DSM_Class11DlcKd_C DSM_Class11DlcPen_C DSM_Class11Dlc_C DSM_Class11Flc_C DSM_Class11Hlc_C DSM_Class11Mil_C DSM_Class11Prio_C DSM_Class11Readiness_C DSM_Class11ResErf_C DSM_Class11Scatt_C DSM_Class11SysLamp_C DSM_Class11TDlcPen_C DSM_Class11TDlc_C DSM_Class11TFlc_C DSM_Class11THlc_C DSM_Class12DlcKd_C DSM_Class12DlcPen_C DSM_Class12Dlc_C DSM_Class12Flc_C DSM_Class12Hlc_C DSM_Class12Mil_C DSM_Class12Prio_C DSM_Class12Readiness_C DSM_Class12ResErf_C DSM_Class12Scatt_C DSM_Class12SysLamp_C DSM_Class12TDlcPen_C DSM_Class12TDlc_C DSM_Class12TFlc_C DSM_Class12THlc_C DSM_Class13DlcKd_C DSM_Class13DlcPen_C DSM_Class13Dlc_C DSM_Class13Flc_C DSM_Class13Hlc_C DSM_Class13Mil_C DSM_Class13Prio_C DSM_Class13Readiness_C DSM_Class13ResErf_C DSM_Class13Scatt_C DSM_Class13SysLamp_C DSM_Class13TDlcPen_C DSM_Class13TDlc_C DSM_Class13TFlc_C DSM_Class13THlc_C DSM_Class14DlcKd_C DSM_Class14DlcPen_C DSM_Class14Dlc_C DSM_Class14Flc_C DSM_Class14Hlc_C DSM_Class14Mil_C DSM_Class14Prio_C DSM_Class14Readiness_C DSM_Class14ResErf_C DSM_Class14Scatt_C DSM_Class14SysLamp_C DSM_Class14TDlcPen_C DSM_Class14TDlc_C DSM_Class14TFlc_C DSM_Class14THlc_C DSM_Class15DlcKd_C DSM_Class15DlcPen_C DSM_Class15Dlc_C DSM_Class15Flc_C DSM_Class15Hlc_C DSM_Class15Mil_C DSM_Class15Prio_C DSM_Class15Readiness_C DSM_Class15ResErf_C DSM_Class15Scatt_C DSM_Class15SysLamp_C DSM_Class15TDlcPen_C DSM_Class15TDlc_C DSM_Class15TFlc_C DSM_Class15THlc_C DSM_Class16DlcKd_C DSM_Class16DlcPen_C DSM_Class16Dlc_C DSM_Class16Flc_C DSM_Class16Hlc_C DSM_Class16Mil_C DSM_Class16Prio_C DSM_Class16Readiness_C DSM_Class16ResErf_C DSM_Class16Scatt_C DSM_Class16SysLamp_C DSM_Class16TDlcPen_C DSM_Class16TDlc_C DSM_Class16TFlc_C DSM_Class16THlc_C DSM_Class17DlcKd_C DSM_Class17DlcPen_C DSM_Class17Dlc_C DSM_Class17Flc_C DSM_Class17Hlc_C DSM_Class17Mil_C DSM_Class17Prio_C DSM_Class17Readiness_C DSM_Class17ResErf_C DSM_Class17Scatt_C DSM_Class17SysLamp_C DSM_Class17TDlcPen_C DSM_Class17TDlc_C DSM_Class17TFlc_C DSM_Class17THlc_C DSM_Class18DlcKd_C DSM_Class18DlcPen_C DSM_Class18Dlc_C DSM_Class18Flc_C DSM_Class18Hlc_C DSM_Class18Mil_C DSM_Class18Prio_C DSM_Class18Readiness_C DSM_Class18ResErf_C DSM_Class18Scatt_C DSM_Class18SysLamp_C DSM_Class18TDlcPen_C DSM_Class18TDlc_C DSM_Class18TFlc_C DSM_Class18THlc_C DSM_Class19DlcKd_C DSM_Class19DlcPen_C DSM_Class19Dlc_C DSM_Class19Flc_C DSM_Class19Hlc_C DSM_Class19Mil_C DSM_Class19Prio_C DSM_Class19Readiness_C DSM_Class19ResErf_C DSM_Class19Scatt_C DSM_Class19SysLamp_C DSM_Class19TDlcPen_C DSM_Class19TDlc_C DSM_Class19TFlc_C DSM_Class19THlc_C DSM_Class1DlcKd_C DSM_Class1DlcPen_C DSM_Class1Dlc_C DSM_Class1Flc_C DSM_Class1Hlc_C DSM_Class1Mil_C DSM_Class1Prio_C DSM_Class1Readiness_C DSM_Class1ResErf_C DSM_Class1Scatt_C DSM_Class1SysLamp_C DSM_Class1TDlcPen_C DSM_Class1TDlc_C DSM_Class1TFlc_C DSM_Class1THlc_C DSM_Class20DlcKd_C DSM_Class20DlcPen_C DSM_Class20Dlc_C DSM_Class20Flc_C DSM_Class20Hlc_C DSM_Class20Mil_C DSM_Class20Prio_C DSM_Class20Readiness_C DSM_Class20ResErf_C DSM_Class20Scatt_C DSM_Class20SysLamp_C DSM_Class20TDlcPen_C DSM_Class20TDlc_C DSM_Class20TFlc_C DSM_Class20THlc_C DSM_Class21DlcKd_C DSM_Class21DlcPen_C DSM_Class21Dlc_C DSM_Class21Flc_C DSM_Class21Hlc_C DSM_Class21Mil_C DSM_Class21Prio_C DSM_Class21Readiness_C DSM_Class21ResErf_C DSM_Class21Scatt_C DSM_Class21SysLamp_C DSM_Class21TDlcPen_C DSM_Class21TDlc_C DSM_Class21TFlc_C DSM_Class21THlc_C DSM_Class22DlcKd_C DSM_Class22DlcPen_C DSM_Class22Dlc_C DSM_Class22Flc_C DSM_Class22Hlc_C DSM_Class22Mil_C DSM_Class22Prio_C DSM_Class22Readiness_C DSM_Class22ResErf_C DSM_Class22Scatt_C DSM_Class22SysLamp_C DSM_Class22TDlcPen_C DSM_Class22TDlc_C DSM_Class22TFlc_C DSM_Class22THlc_C DSM_Class23DlcKd_C DSM_Class23DlcPen_C DSM_Class23Dlc_C DSM_Class23Flc_C DSM_Class23Hlc_C DSM_Class23Mil_C DSM_Class23Prio_C DSM_Class23Readiness_C DSM_Class23ResErf_C DSM_Class23Scatt_C DSM_Class23SysLamp_C DSM_Class23TDlcPen_C DSM_Class23TDlc_C DSM_Class23TFlc_C DSM_Class23THlc_C DSM_Class24DlcKd_C DSM_Class24DlcPen_C DSM_Class24Dlc_C DSM_Class24Flc_C DSM_Class24Hlc_C DSM_Class24Mil_C DSM_Class24Prio_C DSM_Class24Readiness_C DSM_Class24ResErf_C DSM_Class24Scatt_C DSM_Class24SysLamp_C DSM_Class24TDlcPen_C DSM_Class24TDlc_C DSM_Class24TFlc_C DSM_Class24THlc_C DSM_Class25DlcKd_C DSM_Class25DlcPen_C DSM_Class25Dlc_C DSM_Class25Flc_C DSM_Class25Hlc_C DSM_Class25Mil_C DSM_Class25Prio_C DSM_Class25Readiness_C DSM_Class25ResErf_C DSM_Class25Scatt_C DSM_Class25SysLamp_C DSM_Class25TDlcPen_C DSM_Class25TDlc_C DSM_Class25TFlc_C DSM_Class25THlc_C DSM_Class26DlcKd_C DSM_Class26DlcPen_C DSM_Class26Dlc_C DSM_Class26Flc_C DSM_Class26Hlc_C DSM_Class26Mil_C DSM_Class26Prio_C DSM_Class26Readiness_C DSM_Class26ResErf_C DSM_Class26Scatt_C DSM_Class26SysLamp_C DSM_Class26TDlcPen_C DSM_Class26TDlc_C DSM_Class26TFlc_C DSM_Class26THlc_C DSM_Class2DlcKd_C DSM_Class2DlcPen_C DSM_Class2Dlc_C DSM_Class2Flc_C DSM_Class2Hlc_C DSM_Class2Mil_C DSM_Class2Prio_C DSM_Class2Readiness_C DSM_Class2ResErf_C DSM_Class2Scatt_C DSM_Class2SysLamp_C DSM_Class2TDlcPen_C DSM_Class2TDlc_C DSM_Class2TFlc_C DSM_Class2THlc_C DSM_Class3DlcKd_C DSM_Class3DlcPen_C DSM_Class3Dlc_C DSM_Class3Flc_C DSM_Class3Hlc_C DSM_Class3Mil_C DSM_Class3Prio_C DSM_Class3Readiness_C DSM_Class3ResErf_C DSM_Class3Scatt_C DSM_Class3SysLamp_C DSM_Class3TDlcPen_C DSM_Class3TDlc_C DSM_Class3TFlc_C DSM_Class3THlc_C DSM_Class4DlcKd_C DSM_Class4DlcPen_C DSM_Class4Dlc_C DSM_Class4Flc_C DSM_Class4Hlc_C DSM_Class4Mil_C DSM_Class4Prio_C DSM_Class4Readiness_C DSM_Class4ResErf_C DSM_Class4Scatt_C DSM_Class4SysLamp_C DSM_Class4TDlcPen_C DSM_Class4TDlc_C DSM_Class4TFlc_C DSM_Class4THlc_C DSM_Class5DlcKd_C DSM_Class5DlcPen_C DSM_Class5Dlc_C DSM_Class5Flc_C DSM_Class5Hlc_C DSM_Class5Mil_C DSM_Class5Prio_C DSM_Class5Readiness_C DSM_Class5ResErf_C DSM_Class5Scatt_C DSM_Class5SysLamp_C DSM_Class5TDlcPen_C DSM_Class5TDlc_C DSM_Class5TFlc_C DSM_Class5THlc_C DSM_Class6DlcKd_C DSM_Class6DlcPen_C DSM_Class6Dlc_C DSM_Class6Flc_C DSM_Class6Hlc_C DSM_Class6Mil_C DSM_Class6Prio_C DSM_Class6Readiness_C DSM_Class6ResErf_C DSM_Class6Scatt_C DSM_Class6SysLamp_C DSM_Class6TDlcPen_C DSM_Class6TDlc_C DSM_Class6TFlc_C DSM_Class6THlc_C DSM_Class7DlcKd_C DSM_Class7DlcPen_C DSM_Class7Dlc_C DSM_Class7Flc_C DSM_Class7Hlc_C DSM_Class7Mil_C DSM_Class7Prio_C DSM_Class7Readiness_C DSM_Class7ResErf_C DSM_Class7Scatt_C DSM_Class7SysLamp_C DSM_Class7TDlcPen_C DSM_Class7TDlc_C DSM_Class7TFlc_C DSM_Class7THlc_C DSM_Class8DlcKd_C DSM_Class8DlcPen_C DSM_Class8Dlc_C DSM_Class8Flc_C DSM_Class8Hlc_C DSM_Class8Mil_C DSM_Class8Prio_C DSM_Class8Readiness_C DSM_Class8ResErf_C DSM_Class8Scatt_C DSM_Class8SysLamp_C DSM_Class8TDlcPen_C DSM_Class8TDlc_C DSM_Class8TFlc_C DSM_Class8THlc_C DSM_Class9DlcKd_C DSM_Class9DlcPen_C DSM_Class9Dlc_C DSM_Class9Flc_C DSM_Class9Hlc_C DSM_Class9Mil_C DSM_Class9Prio_C DSM_Class9Readiness_C DSM_Class9ResErf_C DSM_Class9Scatt_C DSM_Class9SysLamp_C DSM_Class9TDlcPen_C DSM_Class9TDlc_C DSM_Class9TFlc_C DSM_Class9THlc_C /end DEF_CHARACTERISTIC
/end FUNCTION
/end MODULE
/end PROJECT
