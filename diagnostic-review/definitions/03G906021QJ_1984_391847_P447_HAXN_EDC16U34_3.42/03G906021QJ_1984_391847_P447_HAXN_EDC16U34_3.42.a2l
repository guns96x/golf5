ASAP2_VERSION 1 3
/begin PROJECT X447 "EDC16U34"
/begin HEADER "" VERSION "VAA1" PROJECT_NO X447 /end HEADER
/begin MODULE DIM ""
/begin MOD_COMMON "" BYTE_ORDER MSB_FIRST ALIGNMENT_BYTE 1 ALIGNMENT_WORD 2 ALIGNMENT_LONG 4 ALIGNMENT_FLOAT32_IEEE 4 /end MOD_COMMON
/begin CHARACTERISTIC ACCCD_aGvtyGnd_C "Erdbeschleunigung" VALUE 0x1C21FC Kw_Ws16 0.00 Acc 9.810000 9.810000 FORMAT "%8.6" EXTENDED_LIMITS -32.76800 32.76700 /end CHARACTERISTIC
/begin CHARACTERISTIC ACCCD_aLongPhiCor_C "Korrektur Längsbeschleunigung" VALUE 0x1C21FE Kw_Ws16 30.00000 Acc -15.00000 15.00000 FORMAT "%8.5" EXTENDED_LIMITS -32.76800 32.76700 /end CHARACTERISTIC
/begin CHARACTERISTIC ACCCD_facATrnvrs_CUR "Kennlinie zur Berechnung der Längsbeschleunigungskorrektur" CURVE 0x1C2200 Kl_Xs16_Ws16 6.400000 Acc -3.200000 3.200000 FORMAT "%8.6" EXTENDED_LIMITS -32.76800 32.76700
 /begin AXIS_DESCR STD_AXIS ACCCD_aBRK2TrnvrsFlt_mp TrnvrsAcc 7 -10.00000 10.00000 FORMAT "%8.5" EXTENDED_LIMITS -327.6800 327.6700 DEPOSIT ABSOLUTE /end AXIS_DESCR
/end CHARACTERISTIC
/begin CHARACTERISTIC ACCCD_facCosPhi_CUR "Kennlinie zur Berechnung von CoSine des Eingangswinkels in radians" CURVE 0x1C221E Kl_Xs16_Ws16 1.000000 Fact 0.00 1.000000 FORMAT "%8.6" EXTENDED_LIMITS -4.000000 3.999878
 /begin AXIS_DESCR STD_AXIS ACCCD_phiRoad_mp AngleRad 35 -3.200000 3.200000 FORMAT "%8.6" EXTENDED_LIMITS -3.276800 3.276700 DEPOSIT ABSOLUTE /end AXIS_DESCR
/end CHARACTERISTIC
/begin CHARACTERISTIC ACCCD_facCwVal_C "Luftwiderstandskoeffizient" VALUE 0x1C22AC Kw_Ws16 6.400000 FricCoeff -3.200000 3.200000 FORMAT "%8.6" EXTENDED_LIMITS -3.276800 3.276700 /end CHARACTERISTIC
/begin CHARACTERISTIC ACCCD_facEnv_MAP "Kennfeld zur Korrekturberechnung des Luftwiderstandskoeffizienten" MAP 0x1C22AE Kf_Xs16_Ys16_Ws16 2.000000 Fact 0.00 2.000000 FORMAT "%8.6" EXTENDED_LIMITS -4.000000 3.999878
 /begin AXIS_DESCR STD_AXIS EATSCD_tAir Temp_Cels 6 -50.14000 199.8600 FORMAT "%8.4" EXTENDED_LIMITS -3549.940 3003.560 DEPOSIT ABSOLUTE /end AXIS_DESCR
 /begin AXIS_DESCR STD_AXIS APSCD_pVal Pres_hPa 6 0.00 3500.000 FORMAT "%8.3" EXTENDED_LIMITS -32768.00 32767.00 DEPOSIT ABSOLUTE /end AXIS_DESCR
/end CHARACTERISTIC
/begin CHARACTERISTIC ACCCD_facSinPhi_CUR "Kennlinie zur Berechnung von Sine des EingangswInkels in radians" CURVE 0x1C2312 Kl_Xs16_Ws16 2.000000 Fact -1.000000 1.000000 FORMAT "%8.6" EXTENDED_LIMITS -4.000000 3.999878
 /begin AXIS_DESCR STD_AXIS ACCCD_phiRoad_mp AngleRad 35 -3.200000 3.200000 FORMAT "%8.6" EXTENDED_LIMITS -3.276800 3.276700 DEPOSIT ABSOLUTE /end AXIS_DESCR
/end CHARACTERISTIC
/begin CHARACTERISTIC ACCCD_frStrtFrc_CUR "Kennlinie zur Berechnung des Startreibwertes" CURVE 0x1C23A0 Kl_Xs16_Ws16 64000.00 Friction -32000.00 32000.00 FORMAT "%8.2" EXTENDED_LIMITS -32768.00 32767.00
 /begin AXIS_DESCR STD_AXIS VSSCD_v Vel 6 0.00 300.0000 FORMAT "%8.4" EXTENDED_LIMITS -327.6800 327.6700 DEPOSIT ABSOLUTE /end AXIS_DESCR
/end CHARACTERISTIC
/begin CHARACTERISTIC ACCCD_mVehRef_C "Referenz-Fahrzeugmasse" VALUE 0x1C23BA Kw_Ws16 3200.000 VehMass 0.00 3200.000 FORMAT "%8.3" EXTENDED_LIMITS -3276.800 3276.700 /end CHARACTERISTIC
/begin CHARACTERISTIC ACCCD_phiArcSin_CUR "Kennlinie zur Berechnung des umgekehrten Schwimmwinkels des Eingangswertes" CURVE 0x1C23C0 Kl_Xs16_Ws16 6.400000 AngleRad -3.200000 3.200000 FORMAT "%8.6" EXTENDED_LIMITS -3.276800 3.276700
 /begin AXIS_DESCR STD_AXIS ACCCD_facAcc_mp Fact 35 -1.000000 1.000000 FORMAT "%8.6" EXTENDED_LIMITS -4.000000 3.999878 DEPOSIT ABSOLUTE /end AXIS_DESCR
/end CHARACTERISTIC
/begin CHARACTERISTIC ACCCD_tiPhiPT1_C "Zeitverzögerung für PT1-Filter zum Glätten des Fahrbahnsteigungswinkels" VALUE 0x1C2454 Kw_Wu32 4294.9673 TimeDelay_s 0.0000010000000 4294.9673 FORMAT "%9.4" /end CHARACTERISTIC
/begin CHARACTERISTIC ACCD_tiDebCanSigDef_C "Fehlerdefekterkennungszeit für den CAN-Signal-Fehler" VALUE 0x1C2734 Kw_Wu16 655350.0 Time_ms 0.00 655350.0 FORMAT "%8.1" /end CHARACTERISTIC
/begin CHARACTERISTIC ACCD_tiDebCanSigOk_C "Fehlerheilungserkennungszeit für den CAN-Signal-Fehler" VALUE 0x1C2736 Kw_Wu16 655350.0 Time_ms 0.00 655350.0 FORMAT "%8.1" /end CHARACTERISTIC
/begin CHARACTERISTIC ACCD_DebNoTempDef_C "Entprellzeit für NPL-Fehler Dig. Ausgang Klimakompressor defekt" VALUE 0x1C273E Kw_Wu16 655350.0 Time_ms 0.00 655350.0 FORMAT "%8.1" /end CHARACTERISTIC
/begin CHARACTERISTIC ACCD_DebNoTempOk_C "Entprellzeit für NPL-Fehler Dig. Ausgang Klimakompressor geheilt" VALUE 0x1C2740 Kw_Wu16 655350.0 Time_ms 0.00 655350.0 FORMAT "%8.1" /end CHARACTERISTIC
/begin CHARACTERISTIC ACCD_tiDebPACMaxDef_C "Entprellzeit für Max-Fehler defekt" VALUE 0x1C274E Kw_Wu16 655350.0 Time_ms 0.00 655350.0 FORMAT "%8.1" /end CHARACTERISTIC
/begin CHARACTERISTIC ACCD_tiDebPACMaxOk_C "Entprellzeit für Max-Fehler geheilt" VALUE 0x1C2750 Kw_Wu16 655350.0 Time_ms 0.00 655350.0 FORMAT "%8.1" /end CHARACTERISTIC
/begin CHARACTERISTIC ACCD_tiDebPACMinDef_C "Entprellzeit für Min-Fehler defekt" VALUE 0x1C2752 Kw_Wu16 655350.0 Time_ms 0.00 655350.0 FORMAT "%8.1" /end CHARACTERISTIC
/begin CHARACTERISTIC ACCD_tiDebPACMinOk_C "Entprellzeit für Min-Fehler geheilt" VALUE 0x1C2754 Kw_Wu16 655350.0 Time_ms 0.00 655350.0 FORMAT "%8.1" /end CHARACTERISTIC
/begin CHARACTERISTIC ACCD_tiDebPACSigDef_C "Entprellzeit für Sig-Fehler defekt" VALUE 0x1C2756 Kw_Wu16 655350.0 Time_ms 0.00 655350.0 FORMAT "%8.1" /end CHARACTERISTIC
/begin CHARACTERISTIC ACCD_tiDebPACSigOk_C "Entprellzeit für Sig-Fehler geheilt" VALUE 0x1C2758 Kw_Wu16 655350.0 Time_ms 0.00 655350.0 FORMAT "%8.1" /end CHARACTERISTIC
/begin CHARACTERISTIC ACCD_tiRmpLo2Hi_C "pos. Rampe um Default-Wert zu erreichen" VALUE 0x1C275C Kw_Wu32 131071999.969 RmpPresAC_hPa 0.00 131071999.969 FORMAT "%13.3" /end CHARACTERISTIC
/begin CHARACTERISTIC ACCD_tiRmpHi2Lo_C "neg. Rampe um Default-Wert zu erreichen" VALUE 0x1C2760 Kw_Wu32 131071999.969 RmpPresAC_hPa 0.00 131071999.969 FORMAT "%13.3" /end CHARACTERISTIC
/begin CHARACTERISTIC ACCD_stPwmInInv_C "PWM-Eingang invertieren (JA|NEIN)" VALUE 0x1C2768 Kw_Wu8 1.000 OneToOne 0.00 1.000 FORMAT "%5.3" EXTENDED_LIMITS 0.00 255.0 /end CHARACTERISTIC
/begin CHARACTERISTIC ACCD_tiPwmInMinPer_C "min. Periodendauer PWM-Eingang" VALUE 0x1C276A Kw_Ws16 1.000000 Period 1.000000 2.000000 FORMAT "%8.6" EXTENDED_LIMITS -3276.800 3276.700 /end CHARACTERISTIC
/begin CHARACTERISTIC ACCD_tiPwmInMaxPer_C "max. Periodendauer PWM-Eingang" VALUE 0x1C276C Kw_Ws16 719.2000 Period 100.0000 819.2000 FORMAT "%8.4" EXTENDED_LIMITS -3276.800 3276.700 /end CHARACTERISTIC
/begin CHARACTERISTIC ACCD_dcycPwmInMin_C "minimales Tastverhältnis vom PWM-Input vom Kältemitteldruck" VALUE 0x1C276E Kw_Ws16 100.0000 DtyCyc 0.00 100.0000 FORMAT "%8.4" EXTENDED_LIMITS -327.6800 327.6700 /end CHARACTERISTIC
/begin CHARACTERISTIC ACCD_dcycPwmInMax_C "maximalesTastverhältnis vom PWM-Input vom Kältemitteldruck" VALUE 0x1C2770 Kw_Ws16 100.0000 DtyCyc 0.00 100.0000 FORMAT "%8.4" EXTENDED_LIMITS -327.6800 327.6700 /end CHARACTERISTIC
/begin CHARACTERISTIC ACCD_rLin_CUR "Kennlinie zur Umwandlung des Tastverhältnisses in den Kältemitteldruck" CURVE 0x1C2772 Kl_Xs16_Ws16 1000.000 PresAC_hPa 0.00 1000.000 FORMAT "%8.3" EXTENDED_LIMITS -65536.00 65534.00
 /begin AXIS_DESCR STD_AXIS ACCD_rPwmDcycIn_mp DtyCyc 2 0.00 100.0000 FORMAT "%8.4" EXTENDED_LIMITS -327.6800 327.6700 DEPOSIT ABSOLUTE /end AXIS_DESCR
/end CHARACTERISTIC
/begin CHARACTERISTIC ACCD_stACDfl_C "Vorgabewert für ACCD_stAC" VALUE 0x1C277C Kw_Wu16 65535.00 OneToOne 0.00 65535.00 FORMAT "%8.2" /end CHARACTERISTIC
/begin CHARACTERISTIC ACCD_stComprDigIn_C "Dig. Eingang d. Bidirektionalen Schnittstelle invert.  (JA/NEIN)" VALUE 0x1C277E Kw_Wu8 1.000 OneToOne 0.00 1.000 FORMAT "%5.3" EXTENDED_LIMITS 0.00 255.0 /end CHARACTERISTIC
/begin CHARACTERISTIC ACCD_stInvOut_C "Dig. Ausgang Klimakompressor  invert.  (JA/NEIN)" VALUE 0x1C277F Kw_Wu8 1.000 OneToOne 0.00 1.000 FORMAT "%5.3" EXTENDED_LIMITS 0.00 255.0 /end CHARACTERISTIC
/begin CHARACTERISTIC ACCD_swtACtypeVal_C "Software Schalter für AC Typen information" VALUE 0x1C2782 Kw_Wu8 2.000 OneToOne 0.00 2.000 FORMAT "%5.3" EXTENDED_LIMITS 0.00 255.0 /end CHARACTERISTIC
/begin CHARACTERISTIC ACCD_swtClimatronic_C "Climatronic verbaut (JA/NEIN)" VALUE 0x1C2784 Kw_Wu8 1.000 OneToOne 0.00 1.000 FORMAT "%5.3" EXTENDED_LIMITS 0.00 255.0 /end CHARACTERISTIC
/begin CHARACTERISTIC ACCD_swtComprON_C "Schalter für Plausibilitätsprüfung mit Kältemitteldruck" VALUE 0x1C2785 Kw_Wu8 1.000 OneToOne 0.00 1.000 FORMAT "%5.3" EXTENDED_LIMITS 0.00 255.0 /end CHARACTERISTIC
/begin CHARACTERISTIC ACCD_tiComprON_C "Startverzögerung für Klimakompressor ein" VALUE 0x1C2788 Kw_Wu16 655350.0 Time_ms 0.00 655350.0 FORMAT "%8.1" /end CHARACTERISTIC
/begin CHARACTERISTIC ACCD_trqComprDfl_C "AC Kompressorlast Vorgabewert" VALUE 0x1C278C Kw_Ws16 6553.500 Trq -3276.800 3276.700 FORMAT "%8.3" /end CHARACTERISTIC
/begin CHARACTERISTIC ACCD_trqComprHi_C "obere Hystereseschwelle für Kompressor - Statusberechnbung" VALUE 0x1C278E Kw_Ws16 1000.000 Trq 0.00 1000.000 FORMAT "%8.3" EXTENDED_LIMITS -3276.800 3276.700 /end CHARACTERISTIC
/begin CHARACTERISTIC ACCD_trqComprLo_C "untere Hystereseschwelle für Kompressor - Statusberechnbung" VALUE 0x1C2790 Kw_Ws16 1000.000 Trq 0.00 1000.000 FORMAT "%8.3" EXTENDED_LIMITS -3276.800 3276.700 /end CHARACTERISTIC
/begin CHARACTERISTIC Diff_tiDebtrqLimErrPatOk_C "Fehlerheilungserkennungszeit" VALUE 0x1CD5DA Kw_Wu16 655350.0 Time_ms 0.00 655350.0 FORMAT "%8.1" /end CHARACTERISTIC
/begin CHARACTERISTIC ErLpCD_tiDebMILReqOnOk_C "Fehlerheilungserkennungszeit" VALUE 0x1D50C6 Kw_Wu16 655350.0 Time_ms 0.00 655350.0 FORMAT "%8.1" /end CHARACTERISTIC
/begin CHARACTERISTIC Gearbx_tiDebGearbxMTErrOk_C "Fehlerheilungserkennungszeit" VALUE 0x1D815A Kw_Wu16 655350.0 Time_ms 0.00 655350.0 FORMAT "%8.1" /end CHARACTERISTIC
/begin CHARACTERISTIC InjCrv_qPoI1Des_C "Fernsteuerwert der Einspritzmenge von PoI1" VALUE 0x1D2580 Kw_Ws16 100.0000 InjMassInj 0.00 100.0000 FORMAT "%8.4" EXTENDED_LIMITS -327.6800 327.6700 /end CHARACTERISTIC
/begin CHARACTERISTIC PrpCtl_tiDebvLimErrPatOk_C "Fehlerheilungserkennungszeit" VALUE 0x1EFDEA Kw_Wu16 655350.0 Time_ms 0.00 655350.0 FORMAT "%8.1" /end CHARACTERISTIC
/begin CHARACTERISTIC PrpCtl_facGovInit_CUR "Kennlinie zur Berechnung des Faktors, um den der Reglerinitlialisierungswert für den I-Anteil zu begrenzen ist" CURVE 0x1EFDEC Kl_Xs16_Ws16 1.000000 Fact 0.00 1.000000 FORMAT "%8.6" EXTENDED_LIMITS -4.000000 3.999878
 /begin AXIS_DESCR STD_AXIS VSSCD_a Acc 6 -20.00000 20.00000 FORMAT "%8.5" EXTENDED_LIMITS -32.76800 32.76700 DEPOSIT ABSOLUTE /end AXIS_DESCR
/end CHARACTERISTIC
/begin CHARACTERISTIC PrpCtl_Off4IKi_C "Regler I-Anteil für Kleinsignale - 4. Gang (status OFF)" VALUE 0x1EFE08 Kw_Wu32 159999999.963 Ki_Vel2TrqPrp 0.00 159999999.963 FORMAT "%13.3" /end CHARACTERISTIC
/begin CHARACTERISTIC PrpCtl_Off4IKiPos_C "Regler I-Anteil für negative Großsignale - 4. Gang (status OFF)" VALUE 0x1EFE0C Kw_Wu32 159999999.963 Ki_Vel2TrqPrp 0.00 159999999.963 FORMAT "%13.3" /end CHARACTERISTIC
/begin CHARACTERISTIC PrpCtl_Off4IKiNeg_C "Regler I-Anteil für positive Großsignale - 4. Gang (status OFF)" VALUE 0x1EFE10 Kw_Wu32 159999999.963 Ki_Vel2TrqPrp 0.00 159999999.963 FORMAT "%13.3" /end CHARACTERISTIC
/begin CHARACTERISTIC PrpCtl_vOff4IWinPos_C "Regler I-Anteil für negative Großsignale - 4. Gang (status OFF)" VALUE 0x1EFE14 Kw_Ws16 300.0000 Vel 0.00 300.0000 FORMAT "%8.4" EXTENDED_LIMITS -327.6800 327.6700 /end CHARACTERISTIC
/begin CHARACTERISTIC PrpCtl_vOff4IWinNeg_C "Regler I-Anteil für negative Großsignale - 4. Gang (status OFF)" VALUE 0x1EFE16 Kw_Ws16 300.0000 Vel -300.0000 0.00 FORMAT "%8.4" EXTENDED_LIMITS -327.6800 327.6700 /end CHARACTERISTIC
/begin CHARACTERISTIC PrpCtl_Off5IKi_C "Regler I-Anteil für Kleinsignale - 5. Gang (status OFF)" VALUE 0x1EFE18 Kw_Wu32 159999999.963 Ki_Vel2TrqPrp 0.00 159999999.963 FORMAT "%13.3" /end CHARACTERISTIC
/begin CHARACTERISTIC PrpCtl_Off5IKiPos_C "Regler I-Anteil für negative Großsignale - 5. Gang (status OFF)" VALUE 0x1EFE1C Kw_Wu32 159999999.963 Ki_Vel2TrqPrp 0.00 159999999.963 FORMAT "%13.3" /end CHARACTERISTIC
/begin CHARACTERISTIC PrpCtl_Off5IKiNeg_C "Regler I-Anteil für positive Großsignale - 5. Gang (status OFF)" VALUE 0x1EFE20 Kw_Wu32 159999999.963 Ki_Vel2TrqPrp 0.00 159999999.963 FORMAT "%13.3" /end CHARACTERISTIC
/begin CHARACTERISTIC PrpCtl_vOff5IWinPos_C "Regler I-Anteil für negative Großsignale - 5. Gang (status OFF)" VALUE 0x1EFE24 Kw_Ws16 300.0000 Vel 0.00 300.0000 FORMAT "%8.4" EXTENDED_LIMITS -327.6800 327.6700 /end CHARACTERISTIC
/begin CHARACTERISTIC PrpCtl_vOff5IWinNeg_C "Regler I-Anteil für negative Großsignale - 5. Gang (status OFF)" VALUE 0x1EFE26 Kw_Ws16 300.0000 Vel -300.0000 0.00 FORMAT "%8.4" EXTENDED_LIMITS -327.6800 327.6700 /end CHARACTERISTIC
/begin CHARACTERISTIC PrpCtl_OffLoGearIKi_C "Regler I-Anteil für Kleinsignale - AWD avtiv (status OFF)" VALUE 0x1EFE28 Kw_Wu32 159999999.963 Ki_Vel2TrqPrp 0.00 159999999.963 FORMAT "%13.3" /end CHARACTERISTIC
/begin CHARACTERISTIC PrpCtl_OffLoGearIKiPos_C "Regler I-Anteil für negative Kleinsignale - AWD avtiv (status OFF)" VALUE 0x1EFE2C Kw_Wu32 159999999.963 Ki_Vel2TrqPrp 0.00 159999999.963 FORMAT "%13.3" /end CHARACTERISTIC
/begin CHARACTERISTIC PrpCtl_OffLoGearIKiNeg_C "Regler I-Anteil für positive Kleinsignale - AWD avtiv (status OFF)" VALUE 0x1EFE30 Kw_Wu32 159999999.963 Ki_Vel2TrqPrp 0.00 159999999.963 FORMAT "%13.3" /end CHARACTERISTIC
/begin CHARACTERISTIC PrpCtl_vOffLoGearIWinPos_C "Regler I-Anteil für negative Großsignale - AWD avtiv (status OFF)" VALUE 0x1EFE34 Kw_Ws16 300.0000 Vel 0.00 300.0000 FORMAT "%8.4" EXTENDED_LIMITS -327.6800 327.6700 /end CHARACTERISTIC
/begin CHARACTERISTIC PrpCtl_vOffLoGearIWinNeg_C "Regler I-Anteil für negative Großsignale - AWD avtiv (status OFF)" VALUE 0x1EFE36 Kw_Ws16 300.0000 Vel -300.0000 0.00 FORMAT "%8.4" EXTENDED_LIMITS -327.6800 327.6700 /end CHARACTERISTIC
/begin CHARACTERISTIC PrpCtl_Off4PKp_C "Regler P-Anteil für Kleinsignale - 4. Gang (status OFF)" VALUE 0x1EFE38 Kw_Wu32 10485759.9976 Kp_Vel2TrqPrp 0.00 10485759.9976 FORMAT "%13.4" /end CHARACTERISTIC
/begin CHARACTERISTIC PrpCtl_Off4PKpPos_C "Regler P-Anteil für negative Großsignale - 4. Gang (status OFF)" VALUE 0x1EFE3C Kw_Wu32 10485759.9976 Kp_Vel2TrqPrp 0.00 10485759.9976 FORMAT "%13.4" /end CHARACTERISTIC
/begin CHARACTERISTIC PrpCtl_Off4PKpNeg_C "Regler P-Anteil für positive Großsignale - 4. Gang (status OFF)" VALUE 0x1EFE40 Kw_Wu32 10485759.9976 Kp_Vel2TrqPrp 0.00 10485759.9976 FORMAT "%13.4" /end CHARACTERISTIC
/begin CHARACTERISTIC PrpCtl_vOff4PWinPos_C "Regler P-Anteil für negative Großsignale - 4. Gang (status OFF)" VALUE 0x1EFE44 Kw_Ws16 300.0000 Vel 0.00 300.0000 FORMAT "%8.4" EXTENDED_LIMITS -327.6800 327.6700 /end CHARACTERISTIC
/begin CHARACTERISTIC PrpCtl_vOff4PWinNeg_C "Regler P-Anteil für negative Großsignale - 4. Gang (status OFF)" VALUE 0x1EFE46 Kw_Ws16 300.0000 Vel -300.0000 0.00 FORMAT "%8.4" EXTENDED_LIMITS -327.6800 327.6700 /end CHARACTERISTIC
/begin CHARACTERISTIC PrpCtl_Off5PKp_C "Regler P-Anteil für Kleinsignale -5 . Gang (status OFF)" VALUE 0x1EFE48 Kw_Wu32 10485759.9976 Kp_Vel2TrqPrp 0.00 10485759.9976 FORMAT "%13.4" /end CHARACTERISTIC
/begin CHARACTERISTIC PrpCtl_Off5PKpPos_C "Regler P-Anteil für negative Großsignale - 5. Gang (status OFF)" VALUE 0x1EFE4C Kw_Wu32 10485759.9976 Kp_Vel2TrqPrp 0.00 10485759.9976 FORMAT "%13.4" /end CHARACTERISTIC
/begin CHARACTERISTIC PrpCtl_Off5PKpNeg_C "Regler P-Anteil für positive Großsignale - 5. Gang (status OFF)" VALUE 0x1EFE50 Kw_Wu32 10485759.9976 Kp_Vel2TrqPrp 0.00 10485759.9976 FORMAT "%13.4" /end CHARACTERISTIC
/begin CHARACTERISTIC PrpCtl_vOff5PWinPos_C "Regler P-Anteil für negative Großsignale - 5. Gang (status OFF)" VALUE 0x1EFE54 Kw_Ws16 300.0000 Vel 0.00 300.0000 FORMAT "%8.4" EXTENDED_LIMITS -327.6800 327.6700 /end CHARACTERISTIC
/begin CHARACTERISTIC PrpCtl_vOff5PWinNeg_C "Regler P-Anteil für negative Großsignale - 5. Gang (status OFF)" VALUE 0x1EFE56 Kw_Ws16 300.0000 Vel -300.0000 0.00 FORMAT "%8.4" EXTENDED_LIMITS -327.6800 327.6700 /end CHARACTERISTIC
/begin CHARACTERISTIC PrpCtl_OffLoGearPKp_C "Regler P-Anteil für Kleinsignale - AWD avtiv (status OFF)" VALUE 0x1EFE58 Kw_Wu32 10485759.9976 Kp_Vel2TrqPrp 0.00 10485759.9976 FORMAT "%13.4" /end CHARACTERISTIC
/begin CHARACTERISTIC PrpCtl_OffLoGearPKpPos_C "Regler P-Anteil für negative Kleinsignale - AWD avtiv (status OFF)" VALUE 0x1EFE5C Kw_Wu32 10485759.9976 Kp_Vel2TrqPrp 0.00 10485759.9976 FORMAT "%13.4" /end CHARACTERISTIC
/begin CHARACTERISTIC PrpCtl_OffLoGearPKpNeg_C "Regler P-Anteil für positive Kleinsignale - AWD avtiv (status OFF)" VALUE 0x1EFE60 Kw_Wu32 10485759.9976 Kp_Vel2TrqPrp 0.00 10485759.9976 FORMAT "%13.4" /end CHARACTERISTIC
/begin CHARACTERISTIC PrpCtl_vOffLoGearPWinPos_C "Regler P-Anteil für negative Großsignale - AWD avtiv (status OFF)" VALUE 0x1EFE64 Kw_Ws16 300.0000 Vel 0.00 300.0000 FORMAT "%8.4" EXTENDED_LIMITS -327.6800 327.6700 /end CHARACTERISTIC
/begin CHARACTERISTIC PrpCtl_vOffLoGearPWinNeg_C "Regler P-Anteil für negative Großsignale - AWD avtiv (status OFF)" VALUE 0x1EFE66 Kw_Ws16 300.0000 Vel -300.0000 0.00 FORMAT "%8.4" EXTENDED_LIMITS -327.6800 327.6700 /end CHARACTERISTIC
/begin CHARACTERISTIC PrpCtl_On4IKi_C "Regler I-Anteil für Kleinsignale - 4. Gang (status ON)" VALUE 0x1EFE68 Kw_Wu32 159999999.963 Ki_Vel2TrqPrp 0.00 159999999.963 FORMAT "%13.3" /end CHARACTERISTIC
/begin CHARACTERISTIC PrpCtl_On4IKiPos_C "Regler I-Anteil für negative Großsignale - 4. Gang (status ON)" VALUE 0x1EFE6C Kw_Wu32 159999999.963 Ki_Vel2TrqPrp 0.00 159999999.963 FORMAT "%13.3" /end CHARACTERISTIC
/begin CHARACTERISTIC PrpCtl_On4IKiNeg_C "Regler I-Anteil für positive Großsignale - 4. Gang (status ON)" VALUE 0x1EFE70 Kw_Wu32 159999999.963 Ki_Vel2TrqPrp 0.00 159999999.963 FORMAT "%13.3" /end CHARACTERISTIC
/begin CHARACTERISTIC PrpCtl_vOn4IWinPos_C "Regler I-Anteil für negative Großsignale - 4. Gang (status ON)" VALUE 0x1EFE74 Kw_Ws16 300.0000 Vel 0.00 300.0000 FORMAT "%8.4" EXTENDED_LIMITS -327.6800 327.6700 /end CHARACTERISTIC
/begin CHARACTERISTIC PrpCtl_vOn4IWinNeg_C "Regler I-Anteil für negative Großsignale - 4. Gang (status ON)" VALUE 0x1EFE76 Kw_Ws16 300.0000 Vel -300.0000 0.00 FORMAT "%8.4" EXTENDED_LIMITS -327.6800 327.6700 /end CHARACTERISTIC
/begin CHARACTERISTIC PrpCtl_On5IKi_C "Regler I-Anteil für Kleinsignale - 5. Gang (status ON)" VALUE 0x1EFE78 Kw_Wu32 159999999.963 Ki_Vel2TrqPrp 0.00 159999999.963 FORMAT "%13.3" /end CHARACTERISTIC
/begin CHARACTERISTIC PrpCtl_On5IKiPos_C "Regler I-Anteil für negative Großsignale - 5. Gang (status ON)" VALUE 0x1EFE7C Kw_Wu32 159999999.963 Ki_Vel2TrqPrp 0.00 159999999.963 FORMAT "%13.3" /end CHARACTERISTIC
/begin CHARACTERISTIC PrpCtl_On5IKiNeg_C "Regler I-Anteil für positive Großsignale - 5. Gang (status ON)" VALUE 0x1EFE80 Kw_Wu32 159999999.963 Ki_Vel2TrqPrp 0.00 159999999.963 FORMAT "%13.3" /end CHARACTERISTIC
/begin CHARACTERISTIC PrpCtl_vOn5IWinPos_C "Regler I-Anteil für negative Großsignale - 5. Gang (status ON)" VALUE 0x1EFE84 Kw_Ws16 300.0000 Vel 0.00 300.0000 FORMAT "%8.4" EXTENDED_LIMITS -327.6800 327.6700 /end CHARACTERISTIC
/begin CHARACTERISTIC PrpCtl_vOn5IWinNeg_C "Regler I-Anteil für negative Großsignale - 5. Gang (status ON)" VALUE 0x1EFE86 Kw_Ws16 300.0000 Vel -300.0000 0.00 FORMAT "%8.4" EXTENDED_LIMITS -327.6800 327.6700 /end CHARACTERISTIC
/begin CHARACTERISTIC PrpCtl_OnLoGearIKi_C "Regler I-Anteil für Kleinsignale - AWD avtiv (status ON)" VALUE 0x1EFE88 Kw_Wu32 159999999.963 Ki_Vel2TrqPrp 0.00 159999999.963 FORMAT "%13.3" /end CHARACTERISTIC
/begin CHARACTERISTIC PrpCtl_OnLoGearIKiPos_C "Regler I-Anteil für negative Kleinsignale - AWD avtiv (status ON)" VALUE 0x1EFE8C Kw_Wu32 159999999.963 Ki_Vel2TrqPrp 0.00 159999999.963 FORMAT "%13.3" /end CHARACTERISTIC
/begin CHARACTERISTIC PrpCtl_OnLoGearIKiNeg_C "Regler I-Anteil für positive Kleinsignale - AWD avtiv (status ON)" VALUE 0x1EFE90 Kw_Wu32 159999999.963 Ki_Vel2TrqPrp 0.00 159999999.963 FORMAT "%13.3" /end CHARACTERISTIC
/begin CHARACTERISTIC PrpCtl_vOnLoGearIWinPos_C "Regler I-Anteil für negative Großsignale - AWD avtiv (status ON)" VALUE 0x1EFE94 Kw_Ws16 300.0000 Vel 0.00 300.0000 FORMAT "%8.4" EXTENDED_LIMITS -327.6800 327.6700 /end CHARACTERISTIC
/begin CHARACTERISTIC PrpCtl_vOnLoGearIWinNeg_C "Regler I-Anteil für negative Großsignale - AWD avtiv (status ON)" VALUE 0x1EFE96 Kw_Ws16 300.0000 Vel -300.0000 0.00 FORMAT "%8.4" EXTENDED_LIMITS -327.6800 327.6700 /end CHARACTERISTIC
/begin CHARACTERISTIC PrpCtl_On4PKp_C "Regler P-Anteil für Kleinsignale - 4. Gang (status ON)" VALUE 0x1EFE98 Kw_Wu32 10485759.9976 Kp_Vel2TrqPrp 0.00 10485759.9976 FORMAT "%13.4" /end CHARACTERISTIC
/begin CHARACTERISTIC PrpCtl_On4PKpPos_C "Regler P-Anteil für negative Großsignale - 4. Gang (status ON)" VALUE 0x1EFE9C Kw_Wu32 10485759.9976 Kp_Vel2TrqPrp 0.00 10485759.9976 FORMAT "%13.4" /end CHARACTERISTIC
/begin CHARACTERISTIC PrpCtl_On4PKpNeg_C "Regler P-Anteil für positive Großsignale - 4. Gang (status ON)" VALUE 0x1EFEA0 Kw_Wu32 10485759.9976 Kp_Vel2TrqPrp 0.00 10485759.9976 FORMAT "%13.4" /end CHARACTERISTIC
/begin CHARACTERISTIC PrpCtl_vOn4PWinPos_C "Regler P-Anteil für negative Großsignale - 4. Gang (status ON)" VALUE 0x1EFEA4 Kw_Ws16 300.0000 Vel 0.00 300.0000 FORMAT "%8.4" EXTENDED_LIMITS -327.6800 327.6700 /end CHARACTERISTIC
/begin CHARACTERISTIC PrpCtl_vOn4PWinNeg_C "Regler P-Anteil für negative Großsignale - 4. Gang (status ON)" VALUE 0x1EFEA6 Kw_Ws16 300.0000 Vel -300.0000 0.00 FORMAT "%8.4" EXTENDED_LIMITS -327.6800 327.6700 /end CHARACTERISTIC
/begin CHARACTERISTIC PrpCtl_On5PKp_C "Regler P-Anteil für Kleinsignale - 5. Gang (status ON)" VALUE 0x1EFEA8 Kw_Wu32 10485759.9976 Kp_Vel2TrqPrp 0.00 10485759.9976 FORMAT "%13.4" /end CHARACTERISTIC
/begin CHARACTERISTIC PrpCtl_On5PKpPos_C "Regler P-Anteil für negative Großsignale - 4. Gang (status ON)" VALUE 0x1EFEAC Kw_Wu32 10485759.9976 Kp_Vel2TrqPrp 0.00 10485759.9976 FORMAT "%13.4" /end CHARACTERISTIC
/begin CHARACTERISTIC PrpCtl_On5PKpNeg_C "Regler P-Anteil für positive Großsignale - 4. Gang (status ON)" VALUE 0x1EFEB0 Kw_Wu32 10485759.9976 Kp_Vel2TrqPrp 0.00 10485759.9976 FORMAT "%13.4" /end CHARACTERISTIC
/begin CHARACTERISTIC PrpCtl_vOn5PWinPos_C "Regler P-Anteil für negative Großsignale - 5. Gang (status ON)" VALUE 0x1EFEB4 Kw_Ws16 300.0000 Vel 0.00 300.0000 FORMAT "%8.4" EXTENDED_LIMITS -327.6800 327.6700 /end CHARACTERISTIC
/begin CHARACTERISTIC PrpCtl_vOn5PWinNeg_C "Regler P-Anteil für negative Großsignale - 5. Gang (status ON)" VALUE 0x1EFEB6 Kw_Ws16 300.0000 Vel -300.0000 0.00 FORMAT "%8.4" EXTENDED_LIMITS -327.6800 327.6700 /end CHARACTERISTIC
/begin CHARACTERISTIC PrpCtl_OnLoGearPKp_C "Regler P-Anteil für Kleinsignale - AWD avtiv (status ON)" VALUE 0x1EFEB8 Kw_Wu32 10485759.9976 Kp_Vel2TrqPrp 0.00 10485759.9976 FORMAT "%13.4" /end CHARACTERISTIC
/begin CHARACTERISTIC PrpCtl_OnLoGearPKpPos_C "Regler P-Anteil für negative Kleinsignale - AWD avtiv (status ON)" VALUE 0x1EFEBC Kw_Wu32 10485759.9976 Kp_Vel2TrqPrp 0.00 10485759.9976 FORMAT "%13.4" /end CHARACTERISTIC
/begin CHARACTERISTIC PrpCtl_OnLoGearPKpNeg_C "Regler P-Anteil für positive Kleinsignale - AWD avtiv (status ON)" VALUE 0x1EFEC0 Kw_Wu32 10485759.9976 Kp_Vel2TrqPrp 0.00 10485759.9976 FORMAT "%13.4" /end CHARACTERISTIC
/begin CHARACTERISTIC PrpCtl_vOnLoGearPWinPos_C "Regler P-Anteil für negative Großsignale - AWD avtiv (status ON)" VALUE 0x1EFEC4 Kw_Ws16 300.0000 Vel 0.00 300.0000 FORMAT "%8.4" EXTENDED_LIMITS -327.6800 327.6700 /end CHARACTERISTIC
/begin CHARACTERISTIC PrpCtl_vOnLoGearPWinNeg_C "Regler P-Anteil für negative Großsignale - AWD avtiv (status ON)" VALUE 0x1EFEC6 Kw_Ws16 300.0000 Vel -300.0000 0.00 FORMAT "%8.4" EXTENDED_LIMITS -327.6800 327.6700 /end CHARACTERISTIC
/begin CHARACTERISTIC PrpCtl_rFltMin_C "Schwellwert für Status von Kick-Down" VALUE 0x1EFEC8 Kw_Ws16 427.6800 Prc -327.6800 100.0000 FORMAT "%8.4" EXTENDED_LIMITS -327.6800 327.6700 /end CHARACTERISTIC
/begin CHARACTERISTIC PrpCtl_tiSpdLimPT1_C "Zeitkonstante PT1-Glied" VALUE 0x1EFECC Kw_Wu32 4294.9673 TimeDelay_s 0.0000010000000 4294.9673 FORMAT "%9.4" /end CHARACTERISTIC
/begin CHARACTERISTIC PrpCtl_swtAWD1Rls_C "Schalter zum Heilungsmodus AWD1-Fehler" VALUE 0x1EFED0 Kw_Wu8 1.000 OneToOne 0.00 1.000 FORMAT "%5.3" EXTENDED_LIMITS 0.00 255.0 /end CHARACTERISTIC
/begin CHARACTERISTIC PrpCtl_swtEnaLimAWD1_C "Freigabeschalter für Höchstgeschwindigkeitsbegrenzung durch AWD-SG" VALUE 0x1EFED1 Kw_Wu8 1.000 OneToOne 0.00 1.000 FORMAT "%5.3" EXTENDED_LIMITS 0.00 255.0 /end CHARACTERISTIC
/begin CHARACTERISTIC PrpCtl_swtEnaLimNIVEAU1_C "Freigabeschalter für Höchstgeschwindigkeitsbegrenzung durch Niveau-SG" VALUE 0x1EFED2 Kw_Wu8 1.000 OneToOne 0.00 1.000 FORMAT "%5.3" EXTENDED_LIMITS 0.00 255.0 /end CHARACTERISTIC
/begin CHARACTERISTIC PrpCtl_swtHGB2Ena_C "Schalter zum Aktivieren der Höchstgeschwindigkeitsbegrenzung 2" VALUE 0x1EFED3 Kw_Wu8 1.000 OneToOne 0.00 1.000 FORMAT "%5.3" EXTENDED_LIMITS 0.00 255.0 /end CHARACTERISTIC
/begin CHARACTERISTIC PrpCtl_swtHGBEna_C "Schalter, um die im MSG-EEPROM (über Tester veränderbare)" VALUE 0x1EFED4 Kw_Wu8 1.000 OneToOne 0.00 1.000 FORMAT "%5.3" EXTENDED_LIMITS 0.00 255.0 /end CHARACTERISTIC
/begin CHARACTERISTIC PrpCtl_swtNIVEAU1Rls_C "Schalter zum Heilungsmodus NIVEAU1-Fehler" VALUE 0x1EFED5 Kw_Wu8 1.000 OneToOne 0.00 1.000 FORMAT "%5.3" EXTENDED_LIMITS 0.00 255.0 /end CHARACTERISTIC
/begin CHARACTERISTIC PrpCtl_swtNoAPPLim_C "Schalter Fahrpedalbegrenzung inaktiv" VALUE 0x1EFED6 Kw_Wu8 3.000 OneToOne 0.00 3.000 FORMAT "%5.3" EXTENDED_LIMITS 0.00 255.0 /end CHARACTERISTIC
/begin CHARACTERISTIC PrpCtl_swtVehAcc_C "Schalter zur Auswahl des Fahrbeschleunigungswerts" VALUE 0x1EFED7 Kw_Wu8 2.000 OneToOne 0.00 2.000 FORMAT "%5.3" EXTENDED_LIMITS 0.00 255.0 /end CHARACTERISTIC
/begin CHARACTERISTIC PrpCtl_tiAPPCDMin_C "Zeit bis Erkennung Leerlauf" VALUE 0x1EFED8 Kw_Wu16 2000.000 Time_ms 0.00 2000.000 FORMAT "%8.3" EXTENDED_LIMITS 0.00 655350.0 /end CHARACTERISTIC
/begin CHARACTERISTIC PrpCtl_trqAWDLim_CUR "Kennlinie zur drehzahlabhängigen Momentenbegrenzung durch Allrad1" CURVE 0x1EFEDA Kl_Xs16_Ws16 400.0000 TrqPrp 0.00 400.0000 FORMAT "%8.4" EXTENDED_LIMITS -52428.80 52427.20
 /begin AXIS_DESCR STD_AXIS Eng_nAvrg EngN 25 0.00 6000.000 FORMAT "%8.3" EXTENDED_LIMITS -32768.00 32767.00 DEPOSIT ABSOLUTE /end AXIS_DESCR
/end CHARACTERISTIC
/begin CHARACTERISTIC PrpCtl_trqNIVEAULim_CUR "Kennlinie zur drehzahlabhängigen Momentenbegrenzung durch Niveau1" CURVE 0x1EFF40 Kl_Xs16_Ws16 400.0000 TrqPrp 0.00 400.0000 FORMAT "%8.4" EXTENDED_LIMITS -52428.80 52427.20
 /begin AXIS_DESCR STD_AXIS Eng_nAvrg EngN 25 0.00 6000.000 FORMAT "%8.3" EXTENDED_LIMITS -32768.00 32767.00 DEPOSIT ABSOLUTE /end AXIS_DESCR
/end CHARACTERISTIC
/begin CHARACTERISTIC PrpCtl_trqSpdTrackOff_C "Schwellwert Sollwertnachführung ausschalten" VALUE 0x1EFFA8 Kw_Ws32 1500.00000000 TrqPrpHigh -500.000000000 1000.00000000 FORMAT "%13.8" EXTENDED_LIMITS -214748364.800 214748364.700 /end CHARACTERISTIC
/begin CHARACTERISTIC PrpCtl_vLimAWDMax_C "Maximalgeschwindigkeit durch Allrad1" VALUE 0x1EFFAC Kw_Ws16 255.0000 Vel 0.00 255.0000 FORMAT "%8.4" EXTENDED_LIMITS -327.6800 327.6700 /end CHARACTERISTIC
/begin CHARACTERISTIC PrpCtl_vLimAWDMin_C "Mimimalschwelle für Allrad1 Begrenzung" VALUE 0x1EFFAE Kw_Ws16 255.0000 Vel 0.00 255.0000 FORMAT "%8.4" EXTENDED_LIMITS -327.6800 327.6700 /end CHARACTERISTIC
/begin CHARACTERISTIC PrpCtl_vNiveauLimOffset_C "Offset-Fahrzeuggeschwindigkeit Fahrpedalbegrenzung inaktiv" VALUE 0x1EFFB0 Kw_Ws16 300.0000 Vel 0.00 300.0000 FORMAT "%8.4" EXTENDED_LIMITS -327.6800 327.6700 /end CHARACTERISTIC
/begin CHARACTERISTIC PrpCtl_vNiveauMax_C "Maximalgeschwindigkeit durch Niveau1" VALUE 0x1EFFB2 Kw_Ws16 255.0000 Vel 0.00 255.0000 FORMAT "%8.4" EXTENDED_LIMITS -327.6800 327.6700 /end CHARACTERISTIC
/begin CHARACTERISTIC PrpCtl_vSpdLimMax_C "Fahrzeughöchstgeschwindigkeit" VALUE 0x1EFFB4 Kw_Ws16 300.0000 Vel 0.00 300.0000 FORMAT "%8.4" EXTENDED_LIMITS -327.6800 327.6700 /end CHARACTERISTIC
/begin CHARACTERISTIC PrpCtl_vSpdLimThreshBck_C "Schwellwert Sollwertnachführung freilaufend von Zustand 2" VALUE 0x1EFFB6 Kw_Ws16 300.0000 Vel 0.00 300.0000 FORMAT "%8.4" EXTENDED_LIMITS -327.6800 327.6700 /end CHARACTERISTIC
/begin CHARACTERISTIC PrpCtl_vSpdLimThreshFree_C "Schwellwert Sollwertnachführung frei laufend" VALUE 0x1EFFB8 Kw_Ws16 300.0000 Vel 0.00 300.0000 FORMAT "%8.4" EXTENDED_LIMITS -327.6800 327.6700 /end CHARACTERISTIC
/begin CHARACTERISTIC PrpCtl_vSpdLimThreshOff_C "Schwellwert Sollwertnachführung ausgeschalten" VALUE 0x1EFFBA Kw_Ws16 300.0000 Vel 0.00 300.0000 FORMAT "%8.4" EXTENDED_LIMITS -327.6800 327.6700 /end CHARACTERISTIC
/begin CHARACTERISTIC PrpCtl_vSpdLimThreshOn_C "Schwellwert Sollwertnachführung eingeschalten" VALUE 0x1EFFBC Kw_Ws16 300.0000 Vel 0.00 300.0000 FORMAT "%8.4" EXTENDED_LIMITS -327.6800 327.6700 /end CHARACTERISTIC
/begin CHARACTERISTIC PrpCtl_vSpdLimTrmValLo_C "Minimalwert der Begrenzungsgeschwindigkeit" VALUE 0x1EFFBE Kw_Ws16 300.0000 Vel 0.00 300.0000 FORMAT "%8.4" EXTENDED_LIMITS -327.6800 327.6700 /end CHARACTERISTIC
/begin CHARACTERISTIC PrpCtl_VSSCDAWDMax_C "obere Grenze für aktuelle Geschwindigkeit (AWD1)" VALUE 0x1EFFC0 Kw_Ws16 255.0000 Vel 0.00 255.0000 FORMAT "%8.4" EXTENDED_LIMITS -327.6800 327.6700 /end CHARACTERISTIC
/begin CHARACTERISTIC PrpCtl_VSSCDNiveauMax_C "obere Grenze für aktuelle Geschwindigkeit (NIVEAU1)" VALUE 0x1EFFC2 Kw_Ws16 255.0000 Vel 0.00 255.0000 FORMAT "%8.4" EXTENDED_LIMITS -327.6800 327.6700 /end CHARACTERISTIC
/begin CHARACTERISTIC Prp_drAPPUp_C "Aufwärtsrampensteigung der virtuellen Fahrpedalposition" VALUE 0x1EF838 Kw_Wu32 655359.399872 RmpPrc 0.599975585938 655359.999847 FORMAT "%13.6" EXTENDED_LIMITS 0.00 655359.999847 /end CHARACTERISTIC
/begin CHARACTERISTIC Prp_drAPPDwn_C "Abwärtsrampensteigung der virtuellen Fahrpedalposition" VALUE 0x1EF83C Kw_Wu32 655359.399872 RmpPrc 0.599975585938 655359.999847 FORMAT "%13.6" EXTENDED_LIMITS 0.00 655359.999847 /end CHARACTERISTIC
/begin CHARACTERISTIC Prp_rAPPMax_C "Rampenendwert bei begrenzter CrCtl" VALUE 0x1EF842 Kw_Ws16 100.0000 Prc 0.00 100.0000 FORMAT "%8.4" EXTENDED_LIMITS -327.6800 327.6700 /end CHARACTERISTIC
/begin CHARACTERISTIC Prp_rEngLow_CUR "inverse Fahrverhaltenkennlinie für CC/ACC beschleunigt und AWD ist aktiv" CURVE 0x1EF844 Kl_Xs16_Ws16 655.3500 Prc -327.6800 327.6700 FORMAT "%8.4"
 /begin AXIS_DESCR STD_AXIS Prp_trqEng Trq 16 -3276.800 3276.700 FORMAT "%8.3" DEPOSIT ABSOLUTE /end AXIS_DESCR
/end CHARACTERISTIC
/begin CHARACTERISTIC Prp_rEngLow_MAP "Virtuelles Fahrverhaltenkennfeld bei aktiver Untersetzung." MAP 0x1EF886 Kf_Xs16_Ys16_Ws16 655.3500 Prc -327.6800 327.6700 FORMAT "%8.4"
 /begin AXIS_DESCR STD_AXIS Eng_nAvrg EngN 16 -32768.00 32767.00 FORMAT "%8.2" DEPOSIT ABSOLUTE /end AXIS_DESCR
 /begin AXIS_DESCR STD_AXIS Prp_trqEng Trq 16 -3276.800 3276.700 FORMAT "%8.3" DEPOSIT ABSOLUTE /end AXIS_DESCR
/end CHARACTERISTIC
/begin CHARACTERISTIC Prp_rEngRelLow_MAP "relativ applizierte Map für das inverse driver behaviour bei aktivierten awd" MAP 0x1EFACA Kf_Xs16_Ys16_Ws16 655.3500 Prc -327.6800 327.6700 FORMAT "%8.4"
 /begin AXIS_DESCR STD_AXIS Eng_nAvrg EngN 2 -32768.00 32767.00 FORMAT "%8.2" DEPOSIT ABSOLUTE /end AXIS_DESCR
 /begin AXIS_DESCR STD_AXIS Prp_rtrqEng_mp Prc 2 -327.6800 327.6700 FORMAT "%8.4" DEPOSIT ABSOLUTE /end AXIS_DESCR
/end CHARACTERISTIC
/begin CHARACTERISTIC Prp_rEngRel_MAP "relativ applizierte Map für das inverse driver behaviour" MAP 0x1EFADE Kf_Xs16_Ys16_Ws16 655.3500 Prc -327.6800 327.6700 FORMAT "%8.4"
 /begin AXIS_DESCR STD_AXIS Eng_nAvrg EngN 2 -32768.00 32767.00 FORMAT "%8.2" DEPOSIT ABSOLUTE /end AXIS_DESCR
 /begin AXIS_DESCR STD_AXIS Prp_rtrqEng_mp Prc 2 -327.6800 327.6700 FORMAT "%8.4" DEPOSIT ABSOLUTE /end AXIS_DESCR
/end CHARACTERISTIC
/begin CHARACTERISTIC Prp_rEng_CUR "inverse Fahrverhaltenkennlinie für Mastershift" CURVE 0x1EFAF2 Kl_Xs16_Ws16 655.3500 Prc -327.6800 327.6700 FORMAT "%8.4"
 /begin AXIS_DESCR STD_AXIS Prp_trqEng Trq 16 -3276.800 3276.700 FORMAT "%8.3" DEPOSIT ABSOLUTE /end AXIS_DESCR
/end CHARACTERISTIC
/begin CHARACTERISTIC Prp_rEng_MAP "inverses Fahrverhaltenkennfeld für konventionelle Triebstrangsteuerung" MAP 0x1EFB34 Kf_Xs16_Ys16_Ws16 655.3500 Prc -327.6800 327.6700 FORMAT "%8.4"
 /begin AXIS_DESCR STD_AXIS Eng_nAvrg EngN 16 -32768.00 32767.00 FORMAT "%8.2" DEPOSIT ABSOLUTE /end AXIS_DESCR
 /begin AXIS_DESCR STD_AXIS Prp_trqEng Trq 16 -3276.800 3276.700 FORMAT "%8.3" DEPOSIT ABSOLUTE /end AXIS_DESCR
/end CHARACTERISTIC
/begin CHARACTERISTIC Prp_rTrqLimThres_C "maximal zulässiger Beladungswert" VALUE 0x1EFD78 Kw_Ws16 327.6700 Prc 0.00 327.6700 FORMAT "%8.4" EXTENDED_LIMITS -327.6800 327.6700 /end CHARACTERISTIC
/begin CHARACTERISTIC Prp_swtCCOnVal_C "Wert von Schalter Prp_swtCCOn" VALUE 0x1EF834 Kw_Wu8 1.000 OneToOne 0.00 1.000 FORMAT "%5.3" EXTENDED_LIMITS 0.00 255.0 /end CHARACTERISTIC
/begin CHARACTERISTIC Prp_swtCCOnType_C "Typ von Schalter Prp_swtCCOn" VALUE 0x1EF835 Kw_Wu8 1.000 OneToOne 1.000 2.000 FORMAT "%5.3" EXTENDED_LIMITS 0.00 255.0 /end CHARACTERISTIC
/begin CHARACTERISTIC Prp_swtCCSelVal_C "Wert von Schalter Prp_swtCCSel" VALUE 0x1EF836 Kw_Wu8 1.000 OneToOne 0.00 1.000 FORMAT "%5.3" EXTENDED_LIMITS 0.00 255.0 /end CHARACTERISTIC
/begin CHARACTERISTIC Prp_swtCCSelType_C "Typ von Schalter Prp_swtCCSel" VALUE 0x1EF837 Kw_Wu8 1.000 OneToOne 1.000 2.000 FORMAT "%5.3" EXTENDED_LIMITS 0.00 255.0 /end CHARACTERISTIC
/begin CHARACTERISTIC Prp_swtMapRel_C "benutze eine relativ applizierte Map für das inverse driver behaviour" VALUE 0x1EFD7B Kw_Wu8 1.000 OneToOne 0.00 1.000 FORMAT "%5.3" EXTENDED_LIMITS 0.00 255.0 /end CHARACTERISTIC
/begin CHARACTERISTIC Prp_swtrAPPMaxVal_C "Schalter zum Auswählen von Prp_rAPPMax_C (0) oder Prp_rTrqLim (1) als Ersatzwert für APP" VALUE 0x1EFD7C Kw_Wu8 1.000 OneToOne 0.00 1.000 FORMAT "%5.3" EXTENDED_LIMITS 0.00 255.0 /end CHARACTERISTIC
/begin CHARACTERISTIC Prp_swtrAPP_C "Ausgabe Virtueller Fahrpedalwert nur wenn CrCtl/ACC aktiv" VALUE 0x1EFD7D Kw_Wu8 1.000 OneToOne 0.00 1.000 FORMAT "%5.3" EXTENDED_LIMITS 0.00 255.0 /end CHARACTERISTIC
/begin CHARACTERISTIC Prp_swtrEngCur_C "Freigabe der Kennlinie Prp_rEng_CUR" VALUE 0x1EFD7E Kw_Wu8 3.000 OneToOne 0.00 3.000 FORMAT "%5.3" EXTENDED_LIMITS 0.00 255.0 /end CHARACTERISTIC
/begin CHARACTERISTIC Prp_trqThresEng_CUR "Schwellwert-Kennlinie zur Unterscheidung zwischen Zug- und Schubbetrieb" CURVE 0x1EFD80 Kl_Xs16_Ws16 300.0000 Trq 0.00 300.0000 FORMAT "%8.4" EXTENDED_LIMITS -3276.800 3276.700
 /begin AXIS_DESCR STD_AXIS Eng_nAvrg EngN 25 0.00 6000.000 FORMAT "%8.3" EXTENDED_LIMITS -32768.00 32767.00 DEPOSIT ABSOLUTE /end AXIS_DESCR
/end CHARACTERISTIC
/begin CHARACTERISTIC Rtmo_adCallingBegin_cu32 "Beginn des Adressbereiches der aufrufenden Funktion zum Messen der aufgerufenen Funktion" VALUE 0x1EFFE4 Kw_Wu32 4294967295.00 OneToOne 0.00 4294967295.00 FORMAT "%13.2" /end CHARACTERISTIC
/begin CHARACTERISTIC Rtmo_adCallingEnd_cu32 "Ende des Adressbereiches der aufrufenden Funktion zum Messen der aufgerufenen Funktion" VALUE 0x1EFFE8 Kw_Wu32 4294967295.00 OneToOne 0.00 4294967295.00 FORMAT "%13.2" /end CHARACTERISTIC
/begin CHARACTERISTIC Rtmo_adStart_cu32 "Startadresse der zu messenden Funktion" VALUE 0x1EFFEC Kw_Wu32 4294967295.00 OneToOne 0.00 4294967295.00 FORMAT "%13.2" /end CHARACTERISTIC
/begin CHARACTERISTIC Rtmo_stIntOverhead_cu8 "gemessener/vermuteter Interrupt Overhead, als Korrekturfaktor für Laufzeitmessung" VALUE 0x1EFFF0 Kw_Wu8 255.0 OneToOne 0.00 255.0 FORMAT "%5.1" /end CHARACTERISTIC
/begin CHARACTERISTIC Rtmo_stSampleTime_cu8 "Messzykluszeit: 0: keine Messung; 1-253: 100 ms Raster für jeden 1-253 Durchgang; 254: 10/20ms; 255: segment sync." VALUE 0x1EFFF1 Kw_Wu8 255.0 OneToOne 0.00 255.0 FORMAT "%5.1" /end CHARACTERISTIC
/begin CHARACTERISTIC Rtmo_swLoadMode_cu8 "bit 0:Messung ein/aus bit 1: Maximum zurücksetzen" VALUE 0x1EFFF2 Kw_Wu8 255.0 OneToOne 0.00 255.0 FORMAT "%5.1" /end CHARACTERISTIC
/begin CHARACTERISTIC Rtmo_swMode_cu8 "rtmo Konfig: bit0: reset of Min/Max, bit1: function/task, bit2: depend. of Funct/Tasks, bit3: Netto/Brutto" VALUE 0x1EFFF3 Kw_Wu8 13.00 OneToOne 0.00 13.00 FORMAT "%5.2" EXTENDED_LIMITS 0.00 255.0 /end CHARACTERISTIC
/begin CHARACTERISTIC SigTst_StrtCDRLYOffRlyEn_C "Stellertestüberwachung Freigabemaske für das Starter Aus-Relais" VALUE 0x1F04B1 Kw_Wu8 7.000 OneToOne 0.00 7.000 FORMAT "%5.3" EXTENDED_LIMITS 0.00 255.0 /end CHARACTERISTIC
/begin CHARACTERISTIC SigTst_StrtCDRLYOnRlyEn_C "Stellertestüberwachung Freigabemaske für das Starter Ein-Relais" VALUE 0x1F04B2 Kw_Wu8 7.000 OneToOne 0.00 7.000 FORMAT "%5.3" EXTENDED_LIMITS 0.00 255.0 /end CHARACTERISTIC
/begin CHARACTERISTIC SigTst_TVAEn_C "Stellertestüberwachung Freigabemaske für Drosselklappensteller" VALUE 0x1F04B3 Kw_Wu8 7.000 OneToOne 0.00 7.000 FORMAT "%5.3" EXTENDED_LIMITS 0.00 255.0 /end CHARACTERISTIC
/begin CHARACTERISTIC SigTst_VSAEn_C "Stellertestüberwachung Freigabemaske für Drallniveausteller" VALUE 0x1F04B4 Kw_Wu8 7.000 OneToOne 0.00 7.000 FORMAT "%5.3" EXTENDED_LIMITS 0.00 255.0 /end CHARACTERISTIC
/begin CHARACTERISTIC Sig_ctDSMOffset_C "Offset für Umweltbedingungen im Fehlerspeicher" VALUE 0x1C10B4 Kw_Ws16 65535.00 OneToOne -32768.00 32767.00 FORMAT "%8.2" /end CHARACTERISTIC
/begin CHARACTERISTIC Sig_ctDSMScale_C "Faktor für Umweltbedingungen im Fehlerspeicher" VALUE 0x1C10B6 Kw_Wu16 6.553500 FactHigh 0.00 6.553500 FORMAT "%8.6" /end CHARACTERISTIC
/begin CHARACTERISTIC Sig_ctCANOffset_C "Offset für Signal auf CAN Bus" VALUE 0x1C10B8 Kw_Ws16 65535.00 OneToOne -32768.00 32767.00 FORMAT "%8.2" /end CHARACTERISTIC
/begin CHARACTERISTIC Sig_ctCANScale_C "Faktor für Signal auf CAN Bus" VALUE 0x1C10BA Kw_Wu16 6.553500 FactHigh 0.00 6.553500 FORMAT "%8.6" /end CHARACTERISTIC
/begin CHARACTERISTIC Sig_ctDIAOffset_C "Offset für Signal auf Diagnoseschnittstelle" VALUE 0x1C10BC Kw_Ws16 65535.00 OneToOne -32768.00 32767.00 FORMAT "%8.2" /end CHARACTERISTIC
/begin CHARACTERISTIC Sig_ctDIAScale_C "Faktor für Signal auf Diagnoseschnittstelle" VALUE 0x1C10BE Kw_Wu16 6.553500 FactHigh 0.00 6.553500 FORMAT "%8.6" /end CHARACTERISTIC
/begin CHARACTERISTIC Sig_FactASModDSMOffset_C "Offset für Umrechnung von ecu -> dsm" VALUE 0x1C10F0 Kw_Ws16 65535.00 OneToOne -32768.00 32767.00 FORMAT "%8.2" /end CHARACTERISTIC
/begin CHARACTERISTIC Sig_FactASModDSMScale_C "Skalierungsfaktor für Umrechnung von ecu -> dsm" VALUE 0x1C10F2 Kw_Wu16 6.553500 FactHigh 0.00 6.553500 FORMAT "%8.6" /end CHARACTERISTIC
/begin CHARACTERISTIC Sig_FactASModCANOffset_C "Offset für Umrechnung von ecu -> can" VALUE 0x1C10F4 Kw_Ws16 65535.00 OneToOne -32768.00 32767.00 FORMAT "%8.2" /end CHARACTERISTIC
/begin CHARACTERISTIC Sig_FactASModCANScale_C "Skalierungsfaktor für Umrechnung von ecu -> can" VALUE 0x1C10F6 Kw_Wu16 6.553500 FactHigh 0.00 6.553500 FORMAT "%8.6" /end CHARACTERISTIC
/begin CHARACTERISTIC Sig_FactASModDIAOffset_C "Offset für Umrechnung von ecu -> dia" VALUE 0x1C10F8 Kw_Ws16 65535.00 OneToOne -32768.00 32767.00 FORMAT "%8.2" /end CHARACTERISTIC
/begin CHARACTERISTIC Sig_FactASModDIAScale_C "Skalierungsfaktor für Umrechnung von ecu -> dia" VALUE 0x1C10FA Kw_Wu16 6.553500 FactHigh 0.00 6.553500 FORMAT "%8.6" /end CHARACTERISTIC
/begin CHARACTERISTIC Sig_rASModDSMOffset_C "Offset für die Umrechnung ecu -> dsm" VALUE 0x1C12B8 Kw_Ws16 65535.00 OneToOne -32768.00 32767.00 FORMAT "%8.2" /end CHARACTERISTIC
/begin CHARACTERISTIC Sig_rASModDSMScale_C "Skalierungsfaktor für die Umrechnung ecu -> dsm" VALUE 0x1C12BA Kw_Wu16 6.553500 FactHigh 0.00 6.553500 FORMAT "%8.6" /end CHARACTERISTIC
/begin CHARACTERISTIC Sig_rASModCANOffset_C "Offset für die Umrechnung ecu -> can" VALUE 0x1C12BC Kw_Ws16 65535.00 OneToOne -32768.00 32767.00 FORMAT "%8.2" /end CHARACTERISTIC
/begin CHARACTERISTIC Sig_rASModCANScale_C "Skalierungsfaktor für die Umrechnung ecu -> can" VALUE 0x1C12BE Kw_Wu16 6.553500 FactHigh 0.00 6.553500 FORMAT "%8.6" /end CHARACTERISTIC
/begin CHARACTERISTIC Sig_rASModDIAOffset_C "Offset für die Umrechnung ecu -> dia" VALUE 0x1C12C0 Kw_Ws16 65535.00 OneToOne -32768.00 32767.00 FORMAT "%8.2" /end CHARACTERISTIC
/begin CHARACTERISTIC Sig_rASModDIAScale_C "Skalierungsfaktor für die Umrechnung ecu -> dia" VALUE 0x1C12C2 Kw_Wu16 6.553500 FactHigh 0.00 6.553500 FORMAT "%8.6" /end CHARACTERISTIC
/begin CHARACTERISTIC SOPTst_numSOPTst_C "Anzahl der Testläufe im Fall eines Fehlers" VALUE 0x1F04B8 Kw_Wu8 100.0 OneToOne 0.00 100.0 FORMAT "%5.1" EXTENDED_LIMITS 0.00 255.0 /end CHARACTERISTIC
/begin CHARACTERISTIC SOPTst_stActvWD_C "Aktivierung Watchdogtest" VALUE 0x1F04B9 Kw_Wu8 1.000 OneToOne 0.00 1.000 FORMAT "%5.3" EXTENDED_LIMITS 0.00 255.0 /end CHARACTERISTIC
/begin CHARACTERISTIC SOPTst_tiWaitWDAOff_C "Wartezeit nach dem Abschalten der WDA Leitung um SV-Ansteuerung zu unterbinden" VALUE 0x1F04BC Kw_Wu32 4.00000000000 Time_msUI 0.00 4.00000000000 FORMAT "%13.11" EXTENDED_LIMITS 0.00 4294967295.00 /end CHARACTERISTIC
/begin CHARACTERISTIC SOPTst_tiWaitWDAOn_C "Wartezeit für das Anschalten der WDA Leitung" VALUE 0x1F04C0 Kw_Wu32 15.0000000000 Time_msUI 0.00 15.0000000000 FORMAT "%13.10" EXTENDED_LIMITS 0.00 4294967295.00 /end CHARACTERISTIC
/begin CHARACTERISTIC SrvPmp_DebStSADef_C "Entprellzeit für Lenkwinkelsteuergerätefehler" VALUE 0x1F04C6 Kw_Wu16 655350.0 Time_ms 0.00 655350.0 FORMAT "%8.1" /end CHARACTERISTIC
/begin CHARACTERISTIC SrvPmp_DebStSAOk_C "Heilungszeit für Lenkwinkelsteuergerätefehler" VALUE 0x1F04C8 Kw_Wu16 655350.0 Time_ms 0.00 655350.0 FORMAT "%8.1" /end CHARACTERISTIC
/begin CHARACTERISTIC SrvPmp_facAdjValDef_C "Ersatzwert für Abgleich Leistungsanforderung Servopumpe" VALUE 0x1F04CA Kw_Ws16 0.00 Fact 1.000000 1.000000 FORMAT "%8.6" EXTENDED_LIMITS -4.000000 3.999878 /end CHARACTERISTIC
/begin CHARACTERISTIC SrvPmp_facAdjValMax_C "Maximalwert für Abgleich Leistungsanforderung Servopumpe" VALUE 0x1F04CC Kw_Ws16 3.199951 Fact 0.00 3.199951 FORMAT "%8.6" EXTENDED_LIMITS -4.000000 3.999878 /end CHARACTERISTIC
/begin CHARACTERISTIC SrvPmp_facAdjValMin_C "Minimalwert für Abgleich Leistungsanforderung Servopumpe" VALUE 0x1F04CE Kw_Ws16 3.199951 Fact 0.00 3.199951 FORMAT "%8.6" EXTENDED_LIMITS -4.000000 3.999878 /end CHARACTERISTIC
/begin CHARACTERISTIC SrvPmp_pwrDes_C "mittlerer Leistungsbedarf der Servopumpe" VALUE 0x1F04D0 Kw_Ws16 318830.8 Pwr -308831.1 9999.689 FORMAT "%8.1" EXTENDED_LIMITS -308831.1 308821.7 /end CHARACTERISTIC
/begin CHARACTERISTIC SrvPmp_pwrPhiSteer_MAP "Verlustleistung in Abhängigkeit von VSSCD_v und FrmMng_phiSteer" MAP 0x1F04D2 Kf_Xs16_Ys16_Ws16 1998.053 Pwr 0.00 1998.053 FORMAT "%8.3" EXTENDED_LIMITS -308831.1 308821.7
 /begin AXIS_DESCR STD_AXIS VSSCD_v Vel 8 0.00 300.0000 FORMAT "%8.4" EXTENDED_LIMITS -327.6800 327.6700 DEPOSIT ABSOLUTE /end AXIS_DESCR
 /begin AXIS_DESCR STD_AXIS FrmMng_phiSteer PhiSteer 11 -1433.600 1433.500 FORMAT "%8.3" EXTENDED_LIMITS -3276.800 3276.700 DEPOSIT ABSOLUTE /end AXIS_DESCR
/end CHARACTERISTIC
/begin CHARACTERISTIC SrvPmp_pwrVPhiSteer_MAP "Verlustleistung in Abhängigkeit von VSSCD_v und FrmMng_vPhiSteer" MAP 0x1F05AC Kf_Xs16_Ys16_Ws16 1998.053 Pwr 0.00 1998.053 FORMAT "%8.3" EXTENDED_LIMITS -308831.1 308821.7
 /begin AXIS_DESCR STD_AXIS VSSCD_v Vel 8 0.00 300.0000 FORMAT "%8.4" EXTENDED_LIMITS -327.6800 327.6700 DEPOSIT ABSOLUTE /end AXIS_DESCR
 /begin AXIS_DESCR STD_AXIS FrmMng_vPhiSteer VPhiSteer 8 -1433.600 1433.500 FORMAT "%8.3" EXTENDED_LIMITS -3276.800 3276.700 DEPOSIT ABSOLUTE /end AXIS_DESCR
/end CHARACTERISTIC
/begin CHARACTERISTIC SrvPmp_stSAEcuMax_C "Fehlerstatus des Lenkwinkelsteuergerätes muss grösser sein um einen Fehler auszulösen" VALUE 0x1F0650 Kw_Wu8 3.000 OneToOne 0.00 3.000 FORMAT "%5.3" EXTENDED_LIMITS 0.00 255.0 /end CHARACTERISTIC
/begin CHARACTERISTIC SSpMon_DebSRCHighSplyVltgDef1_C "Fehlerentprellung SRC High für Sensorversorgungsspannung 1" VALUE 0x1F0652 Kw_Wu16 655350.0 Time_ms 0.00 655350.0 FORMAT "%8.1" /end CHARACTERISTIC
/begin CHARACTERISTIC SSpMon_DebSRCHighSplyVltgOk1_C "Heilungsentprellung SRC High für Sensorversorgungsspannung 1" VALUE 0x1F0654 Kw_Wu16 655350.0 Time_ms 0.00 655350.0 FORMAT "%8.1" /end CHARACTERISTIC
/begin CHARACTERISTIC SSpMon_DebSRCHighSplyVltgDef2_C "Fehlerentprellung SRC High für Sensorversorgungsspannung 2" VALUE 0x1F0656 Kw_Wu16 655350.0 Time_ms 0.00 655350.0 FORMAT "%8.1" /end CHARACTERISTIC
/begin CHARACTERISTIC SSpMon_DebSRCHighSplyVltgOk2_C "Heilungsentprellung SRC High für Sensorversorgungsspannung 2" VALUE 0x1F0658 Kw_Wu16 655350.0 Time_ms 0.00 655350.0 FORMAT "%8.1" /end CHARACTERISTIC
/begin CHARACTERISTIC SSpMon_DebSRCHighSplyVltgDef3_C "Fehlerentprellung SRC High für Sensorversorgungsspannung 3" VALUE 0x1F065A Kw_Wu16 655350.0 Time_ms 0.00 655350.0 FORMAT "%8.1" /end CHARACTERISTIC
/begin CHARACTERISTIC SSpMon_DebSRCHighSplyVltgOk3_C "Heilungsentprellung SRC High für Sensorversorgungsspannung 3" VALUE 0x1F065C Kw_Wu16 655350.0 Time_ms 0.00 655350.0 FORMAT "%8.1" /end CHARACTERISTIC
/begin CHARACTERISTIC SSpMon_DebSRCLowSplyVltgDef1_C "Defektentprellung SRC Low für Sensorversorgungsspannung 1" VALUE 0x1F065E Kw_Wu16 655350.0 Time_ms 0.00 655350.0 FORMAT "%8.1" /end CHARACTERISTIC
/begin CHARACTERISTIC SSpMon_DebSRCLowSplyVltgOk1_C "Heilungsentprellung SRC Low für Sensorversorgungsspannung 1" VALUE 0x1F0660 Kw_Wu16 655350.0 Time_ms 0.00 655350.0 FORMAT "%8.1" /end CHARACTERISTIC
/begin CHARACTERISTIC SSpMon_DebSRCLowSplyVltgDef2_C "Defektentprellung SRC Low für Sensorversorgungsspannung 2" VALUE 0x1F0662 Kw_Wu16 655350.0 Time_ms 0.00 655350.0 FORMAT "%8.1" /end CHARACTERISTIC
/begin CHARACTERISTIC SSpMon_DebSRCLowSplyVltgOk2_C "Heilungsentprellung SRC Low für Sensorversorgungsspannung 2" VALUE 0x1F0664 Kw_Wu16 655350.0 Time_ms 0.00 655350.0 FORMAT "%8.1" /end CHARACTERISTIC
/begin CHARACTERISTIC SSpMon_DebSRCLowSplyVltgDef3_C "Defektentprellung SRC Low für Sensorversorgungsspannung 3" VALUE 0x1F0666 Kw_Wu16 655350.0 Time_ms 0.00 655350.0 FORMAT "%8.1" /end CHARACTERISTIC
/begin CHARACTERISTIC SSpMon_DebSRCLowSplyVltgOk3_C "Heilungsentprellung SRC Low für Sensorversorgungsspannung 3" VALUE 0x1F0668 Kw_Wu16 655350.0 Time_ms 0.00 655350.0 FORMAT "%8.1" /end CHARACTERISTIC
/begin CHARACTERISTIC StrtCD_uSRCMinOffRly_C "SRC-Min des Spannungsrohwertes" VALUE 0x1F066A Kw_Ws16 5000.000 Volt 0.00 5000.000 FORMAT "%8.3" EXTENDED_LIMITS -160156.4 160151.5 /end CHARACTERISTIC
/begin CHARACTERISTIC StrtCD_uSRCMaxOffRly_C "SRC-Max des Spannungsrohwertes" VALUE 0x1F066C Kw_Ws16 5000.000 Volt 0.00 5000.000 FORMAT "%8.3" EXTENDED_LIMITS -160156.4 160151.5 /end CHARACTERISTIC
/begin CHARACTERISTIC StrtCD_uLinOffRly_CUR "Linearisierungskennlinie fuer Klemme 50 Aus-Relais" CURVE 0x1F066E Kl_Xs16_Ws16 5000.000 Volt 0.00 5000.000 FORMAT "%8.3" EXTENDED_LIMITS -160156.4 160151.5
 /begin AXIS_DESCR STD_AXIS StrtCD_uPhyValOffRly Volt 2 0.00 5000.000 FORMAT "%8.3" EXTENDED_LIMITS -160156.4 160151.5 DEPOSIT ABSOLUTE /end AXIS_DESCR
/end CHARACTERISTIC
/begin CHARACTERISTIC StrtCD_uSRCMinOnRly_C "SRC-Min des Spannungsrohwertes" VALUE 0x1F068E Kw_Ws16 5000.000 Volt 0.00 5000.000 FORMAT "%8.3" EXTENDED_LIMITS -160156.4 160151.5 /end CHARACTERISTIC
/begin CHARACTERISTIC StrtCD_uSRCMaxOnRly_C "SRC-Max des Spannungsrohwertes" VALUE 0x1F0690 Kw_Ws16 5000.000 Volt 0.00 5000.000 FORMAT "%8.3" EXTENDED_LIMITS -160156.4 160151.5 /end CHARACTERISTIC
/begin CHARACTERISTIC StrtCD_uLinOnRly_CUR "Linearisierungskennlinie fuer Klemme 50 Ein-Relais" CURVE 0x1F0692 Kl_Xs16_Ws16 5000.000 Volt 0.00 5000.000 FORMAT "%8.3" EXTENDED_LIMITS -160156.4 160151.5
 /begin AXIS_DESCR STD_AXIS StrtCD_uPhyValOnRly Volt 2 0.00 5000.000 FORMAT "%8.3" EXTENDED_LIMITS -160156.4 160151.5 DEPOSIT ABSOLUTE /end AXIS_DESCR
/end CHARACTERISTIC
/begin CHARACTERISTIC StrtCD_stInvOutOffRly_C "Invertiertes Signal des Starter Aus-Relais" VALUE 0x1F0678 Kw_Wu8 1.000 OneToOne 0.00 1.000 FORMAT "%5.3" EXTENDED_LIMITS 0.00 255.0 /end CHARACTERISTIC
/begin CHARACTERISTIC StrtCD_stInvOutOnRly_C "Invertiertes Signal des Starter Ein-Relais" VALUE 0x1F069C Kw_Wu8 1.000 OneToOne 0.00 1.000 FORMAT "%5.3" EXTENDED_LIMITS 0.00 255.0 /end CHARACTERISTIC
/begin CHARACTERISTIC StrtCD_stPwrStgDiaOffRly_C "Aktivierung der Abschaltbedingungen der Endstufendiagnose" VALUE 0x1F0679 Kw_Wu8 255.0 OneToOne 0.00 255.0 FORMAT "%5.1" /end CHARACTERISTIC
/begin CHARACTERISTIC StrtCD_stPwrStgDiaOnRly_C "Aktivierung der Abschaltbedingungen der Endstufendiagnose" VALUE 0x1F069D Kw_Wu8 255.0 OneToOne 0.00 255.0 FORMAT "%5.1" /end CHARACTERISTIC
/begin CHARACTERISTIC StrtCD_tiNoLoadDefOfR_C "Fehlerentprellzeit für Leerlauf des Starter Aus Relais" VALUE 0x1F067A Kw_Wu16 655350.0 Time_ms 0.00 655350.0 FORMAT "%8.1" /end CHARACTERISTIC
/begin CHARACTERISTIC StrtCD_tiNoLoadOkOfR_C "Heilungsentprellzeit für Leerlauf des Starter Aus-Relais" VALUE 0x1F067C Kw_Wu16 655350.0 Time_ms 0.00 655350.0 FORMAT "%8.1" /end CHARACTERISTIC
/begin CHARACTERISTIC StrtCD_tiNoLoadDefOnR_C "Fehlerentprellzeit für Leerlauf des Starter Ein-Relais" VALUE 0x1F069E Kw_Wu16 655350.0 Time_ms 0.00 655350.0 FORMAT "%8.1" /end CHARACTERISTIC
/begin CHARACTERISTIC StrtCD_tiNoLoadOkOnR_C "Heilungsentprellzeit für Leerlauf des Starter Ein-Relais" VALUE 0x1F06A0 Kw_Wu16 655350.0 Time_ms 0.00 655350.0 FORMAT "%8.1" /end CHARACTERISTIC
/begin CHARACTERISTIC StrtCD_tiShrtBatDefOfR_C "Fehlerentprellzeit für Kurzschluß nach U-Batt des Starter Aus-Relais" VALUE 0x1F067E Kw_Wu16 655350.0 Time_ms 0.00 655350.0 FORMAT "%8.1" /end CHARACTERISTIC
/begin CHARACTERISTIC StrtCD_tiShrtBatOkOfR_C "Heilungsentprellzeit für Kurzschluß nach U-Batt des Starter Aus-Relais" VALUE 0x1F0680 Kw_Wu16 655350.0 Time_ms 0.00 655350.0 FORMAT "%8.1" /end CHARACTERISTIC
/begin CHARACTERISTIC StrtCD_tiShrtBatDefOnR_C "Fehlerentprellzeit für Kurzschluß nach U-Batt des Starter Ein-Relais" VALUE 0x1F06A2 Kw_Wu16 655350.0 Time_ms 0.00 655350.0 FORMAT "%8.1" /end CHARACTERISTIC
/begin CHARACTERISTIC StrtCD_tiShrtBatOkOnR_C "Heilungsentprellzeit für Kurzschluß nach U-Batt des Starter Ein-Relais" VALUE 0x1F06A4 Kw_Wu16 655350.0 Time_ms 0.00 655350.0 FORMAT "%8.1" /end CHARACTERISTIC
/begin CHARACTERISTIC StrtCD_tiShrtGndDefOfR_C "Fehlerentprellzeit für Kurzschluß nach Masse des Starter Aus-Relais" VALUE 0x1F0682 Kw_Wu16 655350.0 Time_ms 0.00 655350.0 FORMAT "%8.1" /end CHARACTERISTIC
/begin CHARACTERISTIC StrtCD_tiShrtGndOkOfR_C "Heilungsentprellzeit für Kurzschluß nach Masse des Starter Aus-Relais" VALUE 0x1F0684 Kw_Wu16 655350.0 Time_ms 0.00 655350.0 FORMAT "%8.1" /end CHARACTERISTIC
/begin CHARACTERISTIC StrtCD_tiShrtGndDefOnR_C "Fehlerentprellzeit für Kurzschluß nach Masse des Starter Ein-Relais" VALUE 0x1F06A6 Kw_Wu16 655350.0 Time_ms 0.00 655350.0 FORMAT "%8.1" /end CHARACTERISTIC
/begin CHARACTERISTIC StrtCD_tiShrtGndOkOnR_C "Heilungsentprellzeit für Kurzschluß nach Masse des Starter Ein-Relais" VALUE 0x1F06A8 Kw_Wu16 655350.0 Time_ms 0.00 655350.0 FORMAT "%8.1" /end CHARACTERISTIC
/begin CHARACTERISTIC StrtCD_uNoLoadMaxOffR_C "Maximalspannung für Lastabfall" VALUE 0x1F0686 Kw_Ws16 5000.000 Volt 0.00 5000.000 FORMAT "%8.3" EXTENDED_LIMITS -160156.4 160151.5 /end CHARACTERISTIC
/begin CHARACTERISTIC StrtCD_uNoLoadMaxOnR_C "Maximalspannung für Lastabfall" VALUE 0x1F06AA Kw_Ws16 5000.000 Volt 0.00 5000.000 FORMAT "%8.3" EXTENDED_LIMITS -160156.4 160151.5 /end CHARACTERISTIC
/begin CHARACTERISTIC StrtCD_uNoLoadMinOffR_C "Minimalspannung für Lastabfall" VALUE 0x1F0688 Kw_Ws16 5000.000 Volt 0.00 5000.000 FORMAT "%8.3" EXTENDED_LIMITS -160156.4 160151.5 /end CHARACTERISTIC
/begin CHARACTERISTIC StrtCD_uNoLoadMinOnR_C "Minimalspannung für Lastabfall" VALUE 0x1F06AC Kw_Ws16 5000.000 Volt 0.00 5000.000 FORMAT "%8.3" EXTENDED_LIMITS -160156.4 160151.5 /end CHARACTERISTIC
/begin CHARACTERISTIC StrtCD_uShortBatMinOffR_C "Minimalspannung für Kurzschluß nach U-Batt." VALUE 0x1F068A Kw_Ws16 5000.000 Volt 0.00 5000.000 FORMAT "%8.3" EXTENDED_LIMITS -160156.4 160151.5 /end CHARACTERISTIC
/begin CHARACTERISTIC StrtCD_uShortBatMinOnR_C "Minimalspannung für Kurzschluß nach U-Batt." VALUE 0x1F06AE Kw_Ws16 5000.000 Volt 0.00 5000.000 FORMAT "%8.3" EXTENDED_LIMITS -160156.4 160151.5 /end CHARACTERISTIC
/begin CHARACTERISTIC StrtCD_uShortGndMaxOffR_C "Maximalspannung für Kurzschluß nach U-Batt" VALUE 0x1F068C Kw_Ws16 5000.000 Volt 0.00 5000.000 FORMAT "%8.3" EXTENDED_LIMITS -160156.4 160151.5 /end CHARACTERISTIC
/begin CHARACTERISTIC StrtCD_uShortGndMaxOnR_C "Maximalspannung für Kurzschluß nach Masse" VALUE 0x1F06B0 Kw_Ws16 5000.000 Volt 0.00 5000.000 FORMAT "%8.3" EXTENDED_LIMITS -160156.4 160151.5 /end CHARACTERISTIC
/begin CHARACTERISTIC StSysCtl_CntEepWrtAtm_C "Max. EEProm Schreibversuche" VALUE 0x1F099E Kw_Wu8 3.000 OneToOne 0.00 3.000 FORMAT "%5.3" EXTENDED_LIMITS 0.00 255.0 /end CHARACTERISTIC
/begin CHARACTERISTIC StSysCtl_cntT50DebVal_C "Maximal zulässige Startanforderungen" VALUE 0x1F09A0 Kw_Wu16 255.0000 OneToOne 0.00 255.0000 FORMAT "%8.4" EXTENDED_LIMITS 0.00 65535.00 /end CHARACTERISTIC
/begin CHARACTERISTIC StSysCtl_ctCaSImpT50On_C "Zählschwelle für Nockenwellenimpulse seit T50 ein für Erkennung kein Kurbelwellensignal" VALUE 0x1F0998 Kw_Wu16 65535.00 OneToOne 0.00 65535.00 FORMAT "%8.2" /end CHARACTERISTIC
/begin CHARACTERISTIC StSysCtl_tiDebShCirBattDef_C "Fehlerentprellzeit für Interlockschalter Kurzschluß gegen Ubatt[ms]" VALUE 0x1F09A2 Kw_Wu16 655350.0 Time_ms 0.00 655350.0 FORMAT "%8.1" /end CHARACTERISTIC
/begin CHARACTERISTIC StSysCtl_tiDebShCirBattOk_C "Heilungsentprellzeit für Interlockschalter Kurzschluß gegen Ubatt[ms]" VALUE 0x1F09A4 Kw_Wu16 655350.0 Time_ms 0.00 655350.0 FORMAT "%8.1" /end CHARACTERISTIC
/begin CHARACTERISTIC StSysCtl_nThresEngaErr_C "Drehzahlschwelle zur Einspurfehler Detektion" VALUE 0x1F09A6 Kw_Ws16 6000.000 EngN 0.00 6000.000 FORMAT "%8.3" EXTENDED_LIMITS -32768.00 32767.00 /end CHARACTERISTIC
/begin CHARACTERISTIC StSysCtl_nThresEngaN_C "Drehzahlschwelle für Stillstandserkennung" VALUE 0x1F09A8 Kw_Ws16 6000.000 EngN 0.00 6000.000 FORMAT "%8.3" EXTENDED_LIMITS -32768.00 32767.00 /end CHARACTERISTIC
/begin CHARACTERISTIC StSysCtl_nThresEngT_CUR "motortemperaturabhängige Drehzahlschwelle" CURVE 0x1F09AA Kl_Xs16_Ws16 6000.000 EngN 0.00 6000.000 FORMAT "%8.3" EXTENDED_LIMITS -32768.00 32767.00
 /begin AXIS_DESCR STD_AXIS Eng_tEng Temp_Cels 7 -50.14000 199.8600 FORMAT "%8.4" EXTENDED_LIMITS -3549.940 3003.560 DEPOSIT ABSOLUTE /end AXIS_DESCR
/end CHARACTERISTIC
/begin CHARACTERISTIC StSysCtl_nThresZeroN_C "Drehzahl zum Testen des Motorstillstandes" VALUE 0x1F09C8 Kw_Ws16 6000.000 EngN 0.00 6000.000 FORMAT "%8.3" EXTENDED_LIMITS -32768.00 32767.00 /end CHARACTERISTIC
/begin CHARACTERISTIC StSysCtl_stT50CDOff_C "Applizierbarer Wert bei ausgeschaltener Funktion" VALUE 0x1F09CA Kw_Wu8 1.000 OneToOne 0.00 1.000 FORMAT "%5.3" EXTENDED_LIMITS 0.00 255.0 /end CHARACTERISTIC
/begin CHARACTERISTIC StSysCtl_stT50CDOn_C "Applizierbarer Wert bei ausgeschaltener Funktion" VALUE 0x1F09CB Kw_Wu8 1.000 OneToOne 0.00 1.000 FORMAT "%5.3" EXTENDED_LIMITS 0.00 255.0 /end CHARACTERISTIC
/begin CHARACTERISTIC StSysCtl_swtEnResetDisengage_C "Starterausspurenbit zurücksetzen im Nachlauf (1: enable; 0: disable)" VALUE 0x1F09CC Kw_Wu8 1.000 OneToOne 0.00 1.000 FORMAT "%5.3" EXTENDED_LIMITS 0.00 255.0 /end CHARACTERISTIC
/begin CHARACTERISTIC StSysCtl_swtEnResetRelease_C "Schalter, der das Zurücksetzen der Starterfreigabe im Nachlauf ermöglicht" VALUE 0x1F099A Kw_Wu8 1.000 OneToOne 0.00 1.000 FORMAT "%5.3" EXTENDED_LIMITS 0.00 255.0 /end CHARACTERISTIC
/begin CHARACTERISTIC StSysCtl_swtRlyErrIgn_C "Relais-Fehler kann den Start abbrechen" VALUE 0x1F09CD Kw_Wu8 1.000 OneToOne 0.00 1.000 FORMAT "%5.3" EXTENDED_LIMITS 0.00 255.0 /end CHARACTERISTIC
/begin CHARACTERISTIC StSysCtl_swtStStrtLock_C "K15 Sperre (0: inaktiv/1: aktiv)" VALUE 0x1F09CE Kw_Wu8 1.000 OneToOne 0.00 1.000 FORMAT "%5.3" EXTENDED_LIMITS 0.00 255.0 /end CHARACTERISTIC
/begin CHARACTERISTIC StSysCtl_swtStSysCtlMn_C "Hauptschalter der Startersteuerung (1: SW/0: HW)" VALUE 0x1F09CF Kw_Wu8 1.000 OneToOne 0.00 1.000 FORMAT "%5.3" EXTENDED_LIMITS 0.00 255.0 /end CHARACTERISTIC
/begin CHARACTERISTIC StSysCtl_swtStSysCtlMode_C "Startersteuerung Modus (0: BSG/Kessy/1: ECU)" VALUE 0x1F09D0 Kw_Wu8 1.000 OneToOne 0.00 1.000 FORMAT "%5.3" EXTENDED_LIMITS 0.00 255.0 /end CHARACTERISTIC
/begin CHARACTERISTIC StSysCtl_swtT50ErrIgn_C "Klemme 50-Fehler soll den Start abbrechen (Ja / Nein)" VALUE 0x1F09D1 Kw_Wu8 1.000 OneToOne 0.00 1.000 FORMAT "%5.3" EXTENDED_LIMITS 0.00 255.0 /end CHARACTERISTIC
/begin CHARACTERISTIC StSysCtl_tiEngaErr_C "Zeit für Erkennung eines Einspurfehlers" VALUE 0x1F09D2 Kw_Wu16 655140.0 Time_ms 0.00 655140.0 FORMAT "%8.1" EXTENDED_LIMITS 0.00 655350.0 /end CHARACTERISTIC
/begin CHARACTERISTIC StSysCtl_tiIlsNPlausDef_C "Fehlerentprellzeit für Interlock nicht plausibel" VALUE 0x1F09D4 Kw_Wu16 655350.0 Time_ms 0.00 655350.0 FORMAT "%8.1" /end CHARACTERISTIC
/begin CHARACTERISTIC StSysCtl_tiIlsNPlausOk_C "Heilungsentprellzeit für Interlock nicht plausibel" VALUE 0x1F09D6 Kw_Wu16 655350.0 Time_ms 0.00 655350.0 FORMAT "%8.1" /end CHARACTERISTIC
/begin CHARACTERISTIC StSysCtl_tiIlsPlausAT_C "Zeitverzoegerung zum Starten (Ausblenden) der Interlockplausibilisierung nach einem Gangwechsel beim Automat" VALUE 0x1F09D8 Kw_Wu16 655140.0 Time_ms 0.00 655140.0 FORMAT "%8.1" EXTENDED_LIMITS 0.00 655350.0 /end CHARACTERISTIC
/begin CHARACTERISTIC StSysCtl_tiOnlyOffRly_C "Zeit bis zum Auschalten des Aus-Relais" VALUE 0x1F09DA Kw_Wu16 655140.0 Time_ms 0.00 655140.0 FORMAT "%8.1" EXTENDED_LIMITS 0.00 655350.0 /end CHARACTERISTIC
/begin CHARACTERISTIC StSysCtl_tiRlyDiag_C "Zeit zwischen den Relais beim Ausschalten" VALUE 0x1F09DC Kw_Wu16 655140.0 Time_ms 0.00 655140.0 FORMAT "%8.1" EXTENDED_LIMITS 0.00 655350.0 /end CHARACTERISTIC
/begin CHARACTERISTIC StSysCtl_tiShtOff_C "Zeitverzoegerung fuer die Abschaltung" VALUE 0x1F09DE Kw_Wu16 655140.0 Time_ms 0.00 655140.0 FORMAT "%8.1" EXTENDED_LIMITS 0.00 655350.0 /end CHARACTERISTIC
/begin CHARACTERISTIC StSysCtl_tiT50on_C "T50 Zeitschwelle für Erkennung kein Kurbelwellensignal" VALUE 0x1F099C Kw_Wu16 655140.0 Time_ms 0.00 655140.0 FORMAT "%8.1" EXTENDED_LIMITS 0.00 655350.0 /end CHARACTERISTIC
/begin CHARACTERISTIC StSysCtl_tiT50ROneRly1Def_C "Entprellzeit für Rückmeldeleitung immer noch High Ein-Relais defekt" VALUE 0x1F09E0 Kw_Wu16 655350.0 Time_ms 0.00 655350.0 FORMAT "%8.1" /end CHARACTERISTIC
/begin CHARACTERISTIC StSysCtl_tiT50ROneRly1Ok_C "Entprellzeit für Fehlerheilung bei Rückmeldeleitung immer noch High Ein-Relais" VALUE 0x1F09E2 Kw_Wu16 655350.0 Time_ms 0.00 655350.0 FORMAT "%8.1" /end CHARACTERISTIC
/begin CHARACTERISTIC StSysCtl_tiT50ROneRly2Def_C "Entprellzeit für Fehlererkennung Rückmeldeleitung immer noch High Aus-Relais" VALUE 0x1F09E4 Kw_Wu16 655350.0 Time_ms 0.00 655350.0 FORMAT "%8.1" /end CHARACTERISTIC
/begin CHARACTERISTIC StSysCtl_tiT50ROneRly2Ok_C "Entprellzeit für Fehlerheilung Rückmeldeleitung immer noch High Aus-Relais" VALUE 0x1F09E6 Kw_Wu16 655350.0 Time_ms 0.00 655350.0 FORMAT "%8.1" /end CHARACTERISTIC
/begin CHARACTERISTIC StSysCtl_tiT50RZeroDef_C "Entprellzeit für Fehlererkennung Rückmeldeleitung immer noch LOW" VALUE 0x1F09E8 Kw_Wu16 655350.0 Time_ms 0.00 655350.0 FORMAT "%8.1" /end CHARACTERISTIC
/begin CHARACTERISTIC StSysCtl_tiT50RZeroOk_C "Entprellzeit für Fehlerheilung bei Rückmeldeleitung immer noch LOW" VALUE 0x1F09EA Kw_Wu16 655350.0 Time_ms 0.00 655350.0 FORMAT "%8.1" /end CHARACTERISTIC
/begin CHARACTERISTIC StSysCtl_tiThresAddCor_C "Additionswert für Timerwert im Notfahrmodus" VALUE 0x1F09EC Kw_Wu16 655140.0 Time_ms 0.00 655140.0 FORMAT "%8.1" EXTENDED_LIMITS 0.00 655350.0 /end CHARACTERISTIC
/begin CHARACTERISTIC StSysCtl_tiThresEngT_CUR "motortemperaturabhängige Maximalzeit" CURVE 0x1F09EE Kl_Xs16_Ws16 327570.0 Time_ms 0.00 327570.0 FORMAT "%8.1" EXTENDED_LIMITS -327680.0 327670.0
 /begin AXIS_DESCR STD_AXIS Eng_tEng Temp_Cels 7 -50.14000 199.8600 FORMAT "%8.4" EXTENDED_LIMITS -3549.940 3003.560 DEPOSIT ABSOLUTE /end AXIS_DESCR
/end CHARACTERISTIC
/begin CHARACTERISTIC StSysCtl_tiThresVel_C "Fahrgeschwindigkeitszeitschwelle" VALUE 0x1F0A0C Kw_Wu16 655140.0 Time_ms 0.00 655140.0 FORMAT "%8.1" EXTENDED_LIMITS 0.00 655350.0 /end CHARACTERISTIC
/begin CHARACTERISTIC StSysCtl_tiThresZeroN_C "Zeit zum Testen des Motorstillstandes" VALUE 0x1F0A0E Kw_Wu16 655140.0 Time_ms 0.00 655140.0 FORMAT "%8.1" EXTENDED_LIMITS 0.00 655350.0 /end CHARACTERISTIC
/begin CHARACTERISTIC StSysCtl_TMaxNrm_MAP "Zeit für Startmomenten Verzögerung" MAP 0x1F0A10 Kf_Xs16_Ys16_Ws16 10000.00 Time_ms 0.00 10000.00 FORMAT "%8.2" EXTENDED_LIMITS -327680.0 327670.0
 /begin AXIS_DESCR STD_AXIS Eng_tEng Temp_Cels 10 -50.14000 149.8600 FORMAT "%8.4" EXTENDED_LIMITS -3549.940 3003.560 DEPOSIT ABSOLUTE /end AXIS_DESCR
 /begin AXIS_DESCR STD_AXIS GlwCtl_tiPreGlw GlwCtl_Time_ms 10 0.00 335500.0 FORMAT "%8.1" EXTENDED_LIMITS 0.00 6553500. DEPOSIT ABSOLUTE /end AXIS_DESCR
/end CHARACTERISTIC
/begin CHARACTERISTIC StSysCtl_vThresVel_C "Fahrgeschwindigkeitsschwelle" VALUE 0x1F0B04 Kw_Ws16 300.0000 Vel 0.00 300.0000 FORMAT "%8.4" EXTENDED_LIMITS -327.6800 327.6700 /end CHARACTERISTIC
/begin CHARACTERISTIC StSys_ctRevMin_C "Umdrehungszählerschwelle seit Initialisierung" VALUE 0x1F06B6 Kw_Wu16 200.0000 OneToOne 0.00 200.0000 FORMAT "%8.4" EXTENDED_LIMITS 0.00 65535.00 /end CHARACTERISTIC
/begin CHARACTERISTIC StSys_nAdjMax_C "Abgleichende-Drehzahl" VALUE 0x1F0704 Kw_Ws16 65535.00 EngN -32768.00 32767.00 FORMAT "%8.2" /end CHARACTERISTIC
/begin CHARACTERISTIC StSys_nEngOffHi_C "obere Drehzahlschwelle: Motor geht während dem Start aus" VALUE 0x1F06B2 Kw_Ws16 65535.00 EngN -32768.00 32767.00 FORMAT "%8.2" /end CHARACTERISTIC
/begin CHARACTERISTIC StSys_nEngOffLo_C "untere Drehzahlschwelle: Motor geht während dem Start aus" VALUE 0x1F06B4 Kw_Ws16 65535.00 EngN -32768.00 32767.00 FORMAT "%8.2" /end CHARACTERISTIC
/begin CHARACTERISTIC StSys_nFreezeTrqRmp_C "Rampenbegrenzungsdrehzahl" VALUE 0x1F08C8 Kw_Ws16 65535.00 EngN -32768.00 32767.00 FORMAT "%8.2" /end CHARACTERISTIC
/begin CHARACTERISTIC StSys_nReleaseTrqRmp_C "Rampenfreigabedrehzahl" VALUE 0x1F08CA Kw_Ws16 65535.00 EngN -32768.00 32767.00 FORMAT "%8.2" /end CHARACTERISTIC
/begin CHARACTERISTIC StSys_nStrtCutOut_MAP "Kennfeld zur Bestimmung der Startabwurf-Drehzahl" MAP 0x1F06B8 Kf_Xs16_Ys16_Ws16 6000.000 EngN 0.00 6000.000 FORMAT "%8.3" EXTENDED_LIMITS -32768.00 32767.00
 /begin AXIS_DESCR STD_AXIS Eng_tEng Temp_Cels 6 -50.14000 149.8600 FORMAT "%8.4" EXTENDED_LIMITS -3549.940 3003.560 DEPOSIT ABSOLUTE /end AXIS_DESCR
 /begin AXIS_DESCR STD_AXIS APSCD_pVal Pres_hPa 4 0.00 3500.000 FORMAT "%8.3" EXTENDED_LIMITS -32768.00 32767.00 DEPOSIT ABSOLUTE /end AXIS_DESCR
/end CHARACTERISTIC
/begin CHARACTERISTIC StSys_nThrestEng_CUR "Zweimassenschwungrad Kennlinie für Drehzahlschwelle" CURVE 0x1F08EC Kl_Xs16_Ws16 5960.000 EngN 40.00000 6000.000 FORMAT "%8.3" EXTENDED_LIMITS -32768.00 32767.00
 /begin AXIS_DESCR STD_AXIS Eng_tEng Temp_Cels 5 -50.14000 149.8600 FORMAT "%8.4" EXTENDED_LIMITS -3549.940 3003.560 DEPOSIT ABSOLUTE /end AXIS_DESCR
/end CHARACTERISTIC
/begin CHARACTERISTIC StSys_nThresTMFW_C "Drehzahlschwelle für Zweimassenschwungrad" VALUE 0x1F0902 Kw_Ws16 5960.000 EngN 40.00000 6000.000 FORMAT "%8.3" EXTENDED_LIMITS -32768.00 32767.00 /end CHARACTERISTIC
/begin CHARACTERISTIC StSys_numAvrgRun_C "Anzahl der Durchläufe für die Erkennung des Batteriespannungsgradienten" VALUE 0x1F0904 Kw_Wu8 9.000 OneToOne 1.000 10.00 FORMAT "%5.2" EXTENDED_LIMITS 0.00 255.0 /end CHARACTERISTIC
/begin CHARACTERISTIC StSys_nUpLiThrestEng_CUR "Zweimassenschwungrad Kennlinie für obere Drehzahlschwelle" CURVE 0x1F0906 Kl_Xs16_Ws16 5960.000 EngN 40.00000 6000.000 FORMAT "%8.3" EXTENDED_LIMITS -32768.00 32767.00
 /begin AXIS_DESCR STD_AXIS Eng_tEng Temp_Cels 5 -50.14000 149.8600 FORMAT "%8.4" EXTENDED_LIMITS -3549.940 3003.560 DEPOSIT ABSOLUTE /end AXIS_DESCR
/end CHARACTERISTIC
/begin CHARACTERISTIC StSys_swtEnaMultShutOff_C "Mehrmalige Abschaltung des Starmomentes pro Fahrzyklus (Ja/Nein)" VALUE 0x1F091C Kw_Wu8 1.000 OneToOne 0.00 1.000 FORMAT "%5.3" EXTENDED_LIMITS 0.00 255.0 /end CHARACTERISTIC
/begin CHARACTERISTIC StSys_swtT50Sel_C "Auswahl zwischen T50, T50R und CAN als Quelle für die Startmomentenabschaltung" VALUE 0x1F091D Kw_Wu8 5.000 OneToOne 0.00 5.000 FORMAT "%5.3" EXTENDED_LIMITS 0.00 255.0 /end CHARACTERISTIC
/begin CHARACTERISTIC StSys_swtTMFWSel_C "Für Selektierung zwischen Batteriespannungsgardient und T50, T50-Rx oder CAN als Quelle für Startmomenetenabschaltung" VALUE 0x1F091E Kw_Wu8 1.000 OneToOne 0.00 1.000 FORMAT "%5.3" EXTENDED_LIMITS 0.00 255.0 /end CHARACTERISTIC
/begin CHARACTERISTIC StSys_tFuelHi_C "Schwelle über der die Kraftstofftemeperatur für heiß erkannt wird" VALUE 0x1F08CC Kw_Ws16 3053.700 Temp_Cels -50.14000 3003.560 FORMAT "%8.3" EXTENDED_LIMITS -3549.940 3003.560 /end CHARACTERISTIC
/begin CHARACTERISTIC StSys_tFuelLo_C "Schwelle unter der die Kraftstofftemeperatur für kalt erkannt wird" VALUE 0x1F08CE Kw_Ws16 3053.700 Temp_Cels -50.14000 3003.560 FORMAT "%8.3" EXTENDED_LIMITS -3549.940 3003.560 /end CHARACTERISTIC
/begin CHARACTERISTIC StSys_tiDelnUpLiThres_C "Wartezeit für das Erreichen der oberen Drehzahlschwelle" VALUE 0x1F0920 Kw_Wu16 20000.00 Time_ms 0.00 20000.00 FORMAT "%8.2" EXTENDED_LIMITS 0.00 655350.0 /end CHARACTERISTIC
/begin CHARACTERISTIC StSys_tiDelTMFW_C "Wartezeit für Zweimassenschwungrad" VALUE 0x1F0922 Kw_Wu16 20000.00 Time_ms 0.00 20000.00 FORMAT "%8.2" EXTENDED_LIMITS 0.00 655350.0 /end CHARACTERISTIC
/begin CHARACTERISTIC StSys_tiEngTempValid_C "Verzögerungszeit bis Motortemperatur gueltig" VALUE 0x1F08D0 Kw_Wu16 655350.0 Time_ms 0.00 655350.0 FORMAT "%8.1" /end CHARACTERISTIC
/begin CHARACTERISTIC StSys_tiRlsHtg_C "Zeitverzögerung für den Freigabestatus des Heizungssystems ist auf TRUE zu setzen" VALUE 0x1F0700 Kw_Wu16 655350.0 Time_ms 0.00 655350.0 FORMAT "%8.1" /end CHARACTERISTIC
/begin CHARACTERISTIC StSys_tiShutOff_MAP "Zeit der Startmomentverzögerung" MAP 0x1F0924 Kf_Xs16_Ys16_Ws16 10000.00 Time_ms 0.00 10000.00 FORMAT "%8.2" EXTENDED_LIMITS -327680.0 327670.0
 /begin AXIS_DESCR STD_AXIS Eng_tEng Temp_Cels 10 -50.14000 149.8600 FORMAT "%8.4" EXTENDED_LIMITS -3549.940 3003.560 DEPOSIT ABSOLUTE /end AXIS_DESCR
 /begin AXIS_DESCR STD_AXIS GlwCtl_tiPreGlw GlwCtl_Time_ms 4 0.00 335500.0 FORMAT "%8.1" EXTENDED_LIMITS 0.00 6553500. DEPOSIT ABSOLUTE /end AXIS_DESCR
/end CHARACTERISTIC
/begin CHARACTERISTIC StSys_tiStrtCutOut_C "Startabwurf-Sperrzeit" VALUE 0x1F0702 Kw_Wu16 655350.0 Time_ms 0.00 655350.0 FORMAT "%8.1" /end CHARACTERISTIC
/begin CHARACTERISTIC StSys_trqAdjMax_C "maximales Moment fuer den Startabgleich" VALUE 0x1F0706 Kw_Ws16 6553.500 Trq -3276.800 3276.700 FORMAT "%8.3" /end CHARACTERISTIC
/begin CHARACTERISTIC StSys_trqAdjVal_C "Abgleichwert fuer das Startmoment" VALUE 0x1F0708 Kw_Ws16 6553.500 Trq -3276.800 3276.700 FORMAT "%8.3" /end CHARACTERISTIC
/begin CHARACTERISTIC StSys_dtrqColdInc_C "Momentinkrement fuer kalten Motor" VALUE 0x1F08D4 Kw_Wu32 6553594.99817 RmpTrq 5.00030517578 6553599.99847 FORMAT "%13.5" EXTENDED_LIMITS 0.00 6553599.99847 /end CHARACTERISTIC
/begin CHARACTERISTIC StSys_tiColdRmpLck_C "Rampensperrzeit fur kalten Motor" VALUE 0x1F08D8 Kw_Wu16 655350.0 Time_ms 0.00 655350.0 FORMAT "%8.1" /end CHARACTERISTIC
/begin CHARACTERISTIC StSys_trqColdLim_C "Grenzmoment fuer kalten Motor" VALUE 0x1F08DA Kw_Ws16 3276.700 Trq 0.00 3276.700 FORMAT "%8.3" EXTENDED_LIMITS -3276.800 3276.700 /end CHARACTERISTIC
/begin CHARACTERISTIC StSys_dtrqHotInc_C "Momentinkrement fuer heißen Motor" VALUE 0x1F08DC Kw_Wu32 6553594.99817 RmpTrq 5.00030517578 6553599.99847 FORMAT "%13.5" EXTENDED_LIMITS 0.00 6553599.99847 /end CHARACTERISTIC
/begin CHARACTERISTIC StSys_tiHotRmpLck_C "Rampensperrzeit fur heißen Motor" VALUE 0x1F08E0 Kw_Wu16 655350.0 Time_ms 0.00 655350.0 FORMAT "%8.1" /end CHARACTERISTIC
/begin CHARACTERISTIC StSys_trqHotLim_C "Grenzmoment fuer heißen Motor" VALUE 0x1F08E2 Kw_Ws16 3276.700 Trq 0.00 3276.700 FORMAT "%8.3" EXTENDED_LIMITS -3276.800 3276.700 /end CHARACTERISTIC
/begin CHARACTERISTIC StSys_trqStrtAddCor_C "Startbasismomenterhöhung für Notfahrmodus" VALUE 0x1F070A Kw_Ws16 1000.000 Trq 0.00 1000.000 FORMAT "%8.3" EXTENDED_LIMITS -3276.800 3276.700 /end CHARACTERISTIC
/begin CHARACTERISTIC StSys_trqStrtBas_MAP "Basismoment fuer den Start" MAP 0x1F070C Kf_Xs16_Ys16_Ws16 3276.700 Trq 0.00 3276.700 FORMAT "%8.3" EXTENDED_LIMITS -3276.800 3276.700
 /begin AXIS_DESCR STD_AXIS Eng_nAvrg EngN 9 0.00 6000.000 FORMAT "%8.3" EXTENDED_LIMITS -32768.00 32767.00 DEPOSIT ABSOLUTE /end AXIS_DESCR
 /begin AXIS_DESCR STD_AXIS Eng_tEng Temp_Cels 10 -50.14000 199.8600 FORMAT "%8.4" EXTENDED_LIMITS -3549.940 3003.560 DEPOSIT ABSOLUTE /end AXIS_DESCR
/end CHARACTERISTIC
/begin CHARACTERISTIC StSys_trqStrt_MAP "Kennfeld für Startmoment ab Klemme 50" MAP 0x1F07EA Kf_Xs16_Ys16_Ws16 3276.700 Trq 0.00 3276.700 FORMAT "%8.3" EXTENDED_LIMITS -3276.800 3276.700
 /begin AXIS_DESCR STD_AXIS Eng_nAvrg EngN 9 0.00 6000.000 FORMAT "%8.3" EXTENDED_LIMITS -32768.00 32767.00 DEPOSIT ABSOLUTE /end AXIS_DESCR
 /begin AXIS_DESCR STD_AXIS Eng_tEng Temp_Cels 10 -50.14000 199.8600 FORMAT "%8.4" EXTENDED_LIMITS -3549.940 3003.560 DEPOSIT ABSOLUTE /end AXIS_DESCR
/end CHARACTERISTIC
/begin CHARACTERISTIC StSys_dtrqWarmInc_C "Momentinkrement fuer warmen Motor" VALUE 0x1F08E4 Kw_Wu32 6553594.99817 RmpTrq 5.00030517578 6553599.99847 FORMAT "%13.5" EXTENDED_LIMITS 0.00 6553599.99847 /end CHARACTERISTIC
/begin CHARACTERISTIC StSys_tiWarmRmpLck_C "Rampensperrzeit fur warmen Motor" VALUE 0x1F08E8 Kw_Wu16 655350.0 Time_ms 0.00 655350.0 FORMAT "%8.1" /end CHARACTERISTIC
/begin CHARACTERISTIC StSys_trqWarmLim_C "Grenzmoment fuer warmen Motor" VALUE 0x1F08EA Kw_Ws16 3276.700 Trq 0.00 3276.700 FORMAT "%8.3" EXTENDED_LIMITS -3276.800 3276.700 /end CHARACTERISTIC
/begin CHARACTERISTIC StSys_uAltTMFW_C "Batteriespannungsänderung für Zweimassenschwungrad" VALUE 0x1F0994 Kw_Ws16 20782.00 Volt_Batt_PerSec_20ms 0.00 20782.00 FORMAT "%8.2" EXTENDED_LIMITS -332837.0 332826.9 /end CHARACTERISTIC
/begin CHARACTERISTIC StSys_uThresTMFW_C "Batteriespannungsschwelle für Zweimassenschwungrad" VALUE 0x1F0996 Kw_Ws16 20782.00 Volt_Batt 0.00 20782.00 FORMAT "%8.2" EXTENDED_LIMITS -665674.1 665653.8 /end CHARACTERISTIC
/begin CHARACTERISTIC SvLpCD_dGradFillCrv_C "Faktor für die Konvertierung der Füllstandszeit in die Einzelfüllstandsdifferenz" VALUE 0x1F0FEC Kw_Ws16 64.00000 RatVolLength1 -32.00000 32.00000 FORMAT "%8.5" EXTENDED_LIMITS -256.0000 255.9922 /end CHARACTERISTIC
/begin CHARACTERISTIC SvLpCD_tiEngNPT1_C "Zeitkonstante für das PT1-Filter für die Motordrehzahl" VALUE 0x1F0FF0 Kw_Wu32 4294.9673 TimeDelay_s 0.0000010000000 4294.9673 FORMAT "%9.4" /end CHARACTERISTIC
/begin CHARACTERISTIC SvLpCD_lFillLvl_CUR "Kennlinie für die Berechnung der Füllstände von der Füllstandszeit" CURVE 0x1F0FF4 Kl_Xs16_Ws16 131.0680 Length1_mm 0.00 131.0680 FORMAT "%8.4" EXTENDED_LIMITS -131.0720 131.0680
 /begin AXIS_DESCR STD_AXIS FrmMng_tiTOSFillLvl1 Time_RtmLowRes 13 100.0000 1123.000 FORMAT "%8.3" EXTENDED_LIMITS 0.00 6553.500 DEPOSIT ABSOLUTE /end AXIS_DESCR
/end CHARACTERISTIC
/begin CHARACTERISTIC SvLpCD_lOilWarn_MAP "Ölwarnschwellen - Kompensationskennfeld" MAP 0x1F102A Kf_Xs16_Ys16_Ws16 131.0680 Length1_mm 0.00 131.0680 FORMAT "%8.4" EXTENDED_LIMITS -131.0720 131.0680
 /begin AXIS_DESCR STD_AXIS SvLpCD_nAvrgFlt EngN 13 0.00 6000.000 FORMAT "%8.3" EXTENDED_LIMITS -32768.00 32767.00 DEPOSIT ABSOLUTE /end AXIS_DESCR
 /begin AXIS_DESCR STD_AXIS OTSCD_tEngOilWIV Temp_Cels 13 -40.04000 149.9600 FORMAT "%8.4" EXTENDED_LIMITS -3549.940 3003.560 DEPOSIT ABSOLUTE /end AXIS_DESCR
/end CHARACTERISTIC
/begin CHARACTERISTIC SvLpCD_nEngMax_C "Maximalgrenzwert der Motordrehzahl für die Berechnung der Summe der Einzelfüllstandsdifferenzen" VALUE 0x1F11B4 Kw_Ws16 4000.000 EngN 0.00 4000.000 FORMAT "%8.3" EXTENDED_LIMITS -32768.00 32767.00 /end CHARACTERISTIC
/begin CHARACTERISTIC SvLpCD_nEngMin_C "Minimalgrenzwert der Motordrehzahl für die Berechnung der Summe der Einzelfüllstandsdifferenzen" VALUE 0x1F11B6 Kw_Ws16 4000.000 EngN 0.00 4000.000 FORMAT "%8.3" EXTENDED_LIMITS -32768.00 32767.00 /end CHARACTERISTIC
/begin CHARACTERISTIC SvLpCD_tiFillLvlMax_C "Maximalgrenzwert für die Füllstandszeit" VALUE 0x1F11B8 Kw_Wu16 6553.500 Time_RtmLowRes 0.00 6553.500 FORMAT "%8.3" /end CHARACTERISTIC
/begin CHARACTERISTIC SvLpCD_tiFillLvlMin_C "Minimalgrenzwert für die Füllstandszeit" VALUE 0x1F11BA Kw_Wu16 6553.500 Time_RtmLowRes 0.00 6553.500 FORMAT "%8.3" /end CHARACTERISTIC
/begin CHARACTERISTIC SvLpCD_tOilMax_C "Maximalgrenzwert der Öltemperatur für die Berechnung der Summe der Einzelfüllstandsdifferenzen" VALUE 0x1F11BC Kw_Ws16 190.0000 Temp_Cels -40.04000 149.9600 FORMAT "%8.4" EXTENDED_LIMITS -3549.940 3003.560 /end CHARACTERISTIC
/begin CHARACTERISTIC SvLpCD_tOilMin_C "Minimalgrenzwert der Öltemperatur für die Berechnung der Summe der Einzelfüllstandsdifferenzen" VALUE 0x1F11BE Kw_Ws16 190.0000 Temp_Cels -40.04000 149.9600 FORMAT "%8.4" EXTENDED_LIMITS -3549.940 3003.560 /end CHARACTERISTIC
/begin CHARACTERISTIC SvLp_dOilLoad_MAP "Öltemp.- und Drehzahlabhängige Berechnung für WIV2" MAP 0x1F0B08 Kf_Xs16_Ys16_Ws16 65400.00 OneToOne -32700.00 32700.00 FORMAT "%8.2" EXTENDED_LIMITS -32768.00 32767.00
 /begin AXIS_DESCR STD_AXIS Eng_nAvrg EngN 8 0.00 6500.000 FORMAT "%8.3" EXTENDED_LIMITS -32768.00 32767.00 DEPOSIT ABSOLUTE /end AXIS_DESCR
 /begin AXIS_DESCR STD_AXIS OTSCD_tEngOil Temp_Cels 8 -53.14000 226.8600 FORMAT "%8.4" EXTENDED_LIMITS -3549.940 3003.560 DEPOSIT ABSOLUTE /end AXIS_DESCR
/end CHARACTERISTIC
/begin CHARACTERISTIC SvLp_facQI_MAP "Kennfeld für die Guetefaktorberechnung" MAP 0x1F0BAC Kf_Xs16_Ys16_Ws16 3.000000 Fact1 0.00 3.000000 FORMAT "%8.6" EXTENDED_LIMITS -256.0000 255.9922
 /begin AXIS_DESCR STD_AXIS SvLpCD_nAvrgFlt EngN 9 0.00 6000.000 FORMAT "%8.3" EXTENDED_LIMITS -32768.00 32767.00 DEPOSIT ABSOLUTE /end AXIS_DESCR
 /begin AXIS_DESCR STD_AXIS SvLp_aTrnvrsFlt_mp TrnvrsAcc 9 -1.270000 1.270000 FORMAT "%8.6" EXTENDED_LIMITS -327.6800 327.6700 DEPOSIT ABSOLUTE /end AXIS_DESCR
/end CHARACTERISTIC
/begin CHARACTERISTIC SvLp_facSoot_C "Referenzfaktor für das Rußäquivalent" VALUE 0x1F0C76 Kw_Wu8 25.50 Fact_WearSoot 0.00 25.50 FORMAT "%5.2" /end CHARACTERISTIC
/begin CHARACTERISTIC SvLp_facWear_C "Referenzfaktor für das Verschleißäquivalent" VALUE 0x1F0C77 Kw_Wu8 25.50 Fact_WearSoot 0.00 25.50 FORMAT "%5.2" /end CHARACTERISTIC
/begin CHARACTERISTIC SvLp_lEquCalc_C "Normalisierungsfaktor für die Ruß- / Verschleißäquivalentberechnung" VALUE 0x1F0C78 Kw_Wu8 127500. Dist1 0.00 127500. FORMAT "%5.0" /end CHARACTERISTIC
/begin CHARACTERISTIC SvLp_lOilLoad_MAP "Öltemp.- und Drehzahlabhängige Berechnung" MAP 0x1F0C7A Kf_Xs16_Ys16_Ws16 32767.00 Length 0.00 32767.00 FORMAT "%8.2" EXTENDED_LIMITS -32768.00 32767.00
 /begin AXIS_DESCR STD_AXIS Eng_nAvrg EngN 8 0.00 6500.000 FORMAT "%8.3" EXTENDED_LIMITS -32768.00 32767.00 DEPOSIT ABSOLUTE /end AXIS_DESCR
 /begin AXIS_DESCR STD_AXIS OTSCD_tEngOilWIV Temp_Cels 8 -53.14000 226.8600 FORMAT "%8.4" EXTENDED_LIMITS -3549.940 3003.560 DEPOSIT ABSOLUTE /end AXIS_DESCR
/end CHARACTERISTIC
/begin CHARACTERISTIC SvLp_lSootLoad_MAP "Drehzahl- und Einspritzmengenabhängige Berechnung" MAP 0x1F0D1E Kf_Xs16_Ys16_Ws16 32767.00 Length 0.00 32767.00 FORMAT "%8.2" EXTENDED_LIMITS -32768.00 32767.00
 /begin AXIS_DESCR STD_AXIS Eng_nAvrg EngN 9 0.00 6500.000 FORMAT "%8.3" EXTENDED_LIMITS -32768.00 32767.00 DEPOSIT ABSOLUTE /end AXIS_DESCR
 /begin AXIS_DESCR STD_AXIS InjCtl_qSetUnBal InjMass 9 0.00 60.00000 FORMAT "%8.5" EXTENDED_LIMITS -327.6800 327.6700 DEPOSIT ABSOLUTE /end AXIS_DESCR
/end CHARACTERISTIC
/begin CHARACTERISTIC SvLp_lSotLdRgn1_MAP "Kennfeld für Russeintrag bei Regeneration 1[m]" MAP 0x1F0DE8 Kf_Xs16_Ys16_Ws16 32767.00 Length 0.00 32767.00 FORMAT "%8.2" EXTENDED_LIMITS -32768.00 32767.00
 /begin AXIS_DESCR STD_AXIS Eng_nAvrg EngN 8 0.00 6500.000 FORMAT "%8.3" EXTENDED_LIMITS -32768.00 32767.00 DEPOSIT ABSOLUTE /end AXIS_DESCR
 /begin AXIS_DESCR STD_AXIS InjCrv_qTot InjMass 8 0.00 60.00000 FORMAT "%8.5" EXTENDED_LIMITS -327.6800 327.6700 DEPOSIT ABSOLUTE /end AXIS_DESCR
/end CHARACTERISTIC
/begin CHARACTERISTIC SvLp_lSotLdRgn2_MAP "Kennfeld für Russeintrag bei Regeneration 2 [m]" MAP 0x1F0E8C Kf_Xs16_Ys16_Ws16 32767.00 Length 0.00 32767.00 FORMAT "%8.2" EXTENDED_LIMITS -32768.00 32767.00
 /begin AXIS_DESCR STD_AXIS Eng_nAvrg EngN 8 0.00 6500.000 FORMAT "%8.3" EXTENDED_LIMITS -32768.00 32767.00 DEPOSIT ABSOLUTE /end AXIS_DESCR
 /begin AXIS_DESCR STD_AXIS InjCrv_qTot InjMass 8 0.00 60.00000 FORMAT "%8.5" EXTENDED_LIMITS -327.6800 327.6700 DEPOSIT ABSOLUTE /end AXIS_DESCR
/end CHARACTERISTIC
/begin CHARACTERISTIC SvLp_lSotLdRgn3_MAP "Kennfeld für Russeintrag bei Regeneration 3 [m]" MAP 0x1F0F30 Kf_Xs16_Ys16_Ws16 32767.00 Length 0.00 32767.00 FORMAT "%8.2" EXTENDED_LIMITS -32768.00 32767.00
 /begin AXIS_DESCR STD_AXIS Eng_nAvrg EngN 8 0.00 6500.000 FORMAT "%8.3" EXTENDED_LIMITS -32768.00 32767.00 DEPOSIT ABSOLUTE /end AXIS_DESCR
 /begin AXIS_DESCR STD_AXIS InjCrv_qTot InjMass 8 0.00 60.00000 FORMAT "%8.5" EXTENDED_LIMITS -327.6800 327.6700 DEPOSIT ABSOLUTE /end AXIS_DESCR
/end CHARACTERISTIC
/begin CHARACTERISTIC SvLp_stSotLdRgnMsk1_C "Maske für Umschaltung des Russeintragskennfeldes bei Regeneration 1[]" VALUE 0x1F0FD4 Kw_Wu32 1.00000000000 OneToOne 0.00 1.00000000000 FORMAT "%13.11" EXTENDED_LIMITS 0.00 4294967295.00 /end CHARACTERISTIC
/begin CHARACTERISTIC SvLp_stSotLdRgnMsk2_C "Maske für Umschaltung des Russeintragskennfeldes bei Regeneration 2 []" VALUE 0x1F0FD8 Kw_Wu32 1.00000000000 OneToOne 0.00 1.00000000000 FORMAT "%13.11" EXTENDED_LIMITS 0.00 4294967295.00 /end CHARACTERISTIC
/begin CHARACTERISTIC SvLp_stSotLdRgnMsk3_C "Maske für Umschaltung des Russeintragskennfeldes bei Regeneration 3 []" VALUE 0x1F0FDC Kw_Wu32 1.00000000000 OneToOne 0.00 1.00000000000 FORMAT "%13.11" EXTENDED_LIMITS 0.00 4294967295.00 /end CHARACTERISTIC
/begin CHARACTERISTIC SvLp_swtPresentVal_C "Schalterstellung, ob SI berechnet wird" VALUE 0x1F0FE0 Kw_Wu8 1.000 OneToOne 0.00 1.000 FORMAT "%5.3" EXTENDED_LIMITS 0.00 255.0 /end CHARACTERISTIC
/begin CHARACTERISTIC SvLp_swtPresentType_C "Schaltertype" VALUE 0x1F0FE1 Kw_Wu8 1.000 OneToOne 1.000 2.000 FORMAT "%5.3" EXTENDED_LIMITS 0.00 255.0 /end CHARACTERISTIC
/begin CHARACTERISTIC SvLp_swtqSetUnBal_C "Wahlschalter für Einspritzung (0 = Gesamteinsprizmenge, 1 = Haupteinspritzung)" VALUE 0x1F0FE2 Kw_Wu8 1.000 OneToOne 0.00 1.000 FORMAT "%5.3" EXTENDED_LIMITS 0.00 255.0 /end CHARACTERISTIC
/begin CHARACTERISTIC SvLp_tiPlausWIV_C "Zeit während der Kurzzeitmittelwert und Ölstandszahler auf 0 gesetzt werden" VALUE 0x1F0FE4 Kw_Wu16 655350.0 Time_ms 0.00 655350.0 FORMAT "%8.1" /end CHARACTERISTIC
/begin CHARACTERISTIC SvLp_tiShTiMeanVal_C "Zeitraum über den der Kurzzeitmittelwert berechnet wird" VALUE 0x1F0FE6 Kw_Wu16 655350.0 Time_ms 0.00 655350.0 FORMAT "%8.1" /end CHARACTERISTIC
/begin CHARACTERISTIC SvLp_tiTrnvrsAccPT1_C "Zeitkonstante für PT1 Filter (Querbeschleunigung)" VALUE 0x1F0FE8 Kw_Wu32 4294.9673 TimeDelay_s 0.0000010000000 4294.9673 FORMAT "%9.4" /end CHARACTERISTIC
/begin CHARACTERISTIC T15CD_uSRCMin_C "Untere Grenze des SRC der Klemme 15" VALUE 0x1F11C0 Kw_Ws16 20782.00 Volt_Batt 0.00 20782.00 FORMAT "%8.2" EXTENDED_LIMITS -665674.1 665653.8 /end CHARACTERISTIC
/begin CHARACTERISTIC T15CD_uSRCMax_C "Obere Grenze des SRC der Klemme 15" VALUE 0x1F11C2 Kw_Ws16 20782.00 Volt_Batt 0.00 20782.00 FORMAT "%8.2" EXTENDED_LIMITS -665674.1 665653.8 /end CHARACTERISTIC
/begin CHARACTERISTIC T15CD_uLin_CUR "Kennlinie für Linearisierung des Rohwerts der Klemme 15" CURVE 0x1F11C4 Kl_Xs16_Ws16 5200.579 Volt_Batt 0.00 5200.579 FORMAT "%8.3" EXTENDED_LIMITS -665674.1 665653.8
 /begin AXIS_DESCR STD_AXIS T15CD_uRawVal Volt_Batt 5 -665674.1 665653.8 FORMAT "%8.1" DEPOSIT ABSOLUTE /end AXIS_DESCR
/end CHARACTERISTIC
/begin CHARACTERISTIC T15CD_uCutOffHysXLow_C "Untere Hysteresegrenze für Klemme 15 Spannungsüberwachung" VALUE 0x1F11DA Kw_Ws16 5200.579 Volt_Batt 0.00 5200.579 FORMAT "%8.3" EXTENDED_LIMITS -665674.1 665653.8 /end CHARACTERISTIC
/begin CHARACTERISTIC T15CD_uCutOffHysXHigh_C "Obere Hysteresegrenze für Klemme 15 Spannungsüberwachung" VALUE 0x1F11DC Kw_Ws16 5200.579 Volt_Batt 0.00 5200.579 FORMAT "%8.3" EXTENDED_LIMITS -665674.1 665653.8 /end CHARACTERISTIC
/begin CHARACTERISTIC T15CD_stCutOffHysYLow_C "Unterer Ausgangswert der Hysterese der Klemme 15 Spannungsüberwachung" VALUE 0x1F11DE Kw_Ws16 1.000000 OneToOne 0.00 1.000000 FORMAT "%8.6" EXTENDED_LIMITS -32768.00 32767.00 /end CHARACTERISTIC
/begin CHARACTERISTIC T15CD_stCutOffHysYHigh_C "Oberer Ausgangswert der Hysterese der Klemme 15 Spannungsüberwachung" VALUE 0x1F11E0 Kw_Ws16 1.000000 OneToOne 0.00 1.000000 FORMAT "%8.6" EXTENDED_LIMITS -32768.00 32767.00 /end CHARACTERISTIC
/begin CHARACTERISTIC T15CD_DebNplDef_C "Fehlerentprellzeit für Plausibilitätsfehler" VALUE 0x1F11E2 Kw_Wu16 655350.0 Time_ms 0.00 655350.0 FORMAT "%8.1" /end CHARACTERISTIC
/begin CHARACTERISTIC T15CD_DebNplOk_C "Heilungsentprellzeit für Plausibilitätsfehler" VALUE 0x1F11E4 Kw_Wu16 655350.0 Time_ms 0.00 655350.0 FORMAT "%8.1" /end CHARACTERISTIC
/begin CHARACTERISTIC T15CD_tiDebNeg_C "Filterzeitkonstante der Klemme 15 für fallende Flanken" VALUE 0x1F11E6 Kw_Wu16 655350.0 TimeDeb 0.00 655350.0 FORMAT "%8.1" /end CHARACTERISTIC
/begin CHARACTERISTIC T15CD_tiDebPos_C "Filterzeitkonstante der Klemme 15 für steigende Flanken" VALUE 0x1F11E8 Kw_Wu16 655350.0 TimeDeb 0.00 655350.0 FORMAT "%8.1" /end CHARACTERISTIC
/begin CHARACTERISTIC T15CD_DebSRCHighDef_C "Fehlerentprellzeit für SRC-High Fehler" VALUE 0x1F11EA Kw_Wu16 655350.0 Time_ms 0.00 655350.0 FORMAT "%8.1" /end CHARACTERISTIC
/begin CHARACTERISTIC T15CD_DebSRCHighOk_C "Heilungsentprellzeit für SRC-High Fehler" VALUE 0x1F11EC Kw_Wu16 655350.0 Time_ms 0.00 655350.0 FORMAT "%8.1" /end CHARACTERISTIC
/begin CHARACTERISTIC T15CD_DebSRCLowDef_C "Fehlerentprellzeit für SRC-Low Fehler" VALUE 0x1F11EE Kw_Wu16 655350.0 Time_ms 0.00 655350.0 FORMAT "%8.1" /end CHARACTERISTIC
/begin CHARACTERISTIC T15CD_DebSRCLowOk_C "Heilungsentprellzeit für SRC-Low Fehler" VALUE 0x1F11F0 Kw_Wu16 655350.0 Time_ms 0.00 655350.0 FORMAT "%8.1" /end CHARACTERISTIC
/begin CHARACTERISTIC T15CD_dtRmpSlpUp_C "Aufwärts-Rampenschrittweite für Klemme 15 Analogwerterfassung" VALUE 0x1F11F4 Kw_Wu32 1331348143.43 RmpVoltBatt 0.929935936354 1331348144.36 FORMAT "%13.2" EXTENDED_LIMITS 0.00 1331348144.36 /end CHARACTERISTIC
/begin CHARACTERISTIC T15CD_dtRmpSlpDwn_C "Abwärts-Rampenschrittweite für Klemme 15 Analogwerterfassung" VALUE 0x1F11F8 Kw_Wu32 1331348143.43 RmpVoltBatt 0.929935936354 1331348144.36 FORMAT "%13.2" EXTENDED_LIMITS 0.00 1331348144.36 /end CHARACTERISTIC
/begin CHARACTERISTIC T15CD_stCutOffPreset_C "Initialisierungswert für die Message der CAN/Suspendmode-Überwachungsabschaltung" VALUE 0x1F11FC Kw_Wu8 1.000 OneToOne 0.00 1.000 FORMAT "%5.3" EXTENDED_LIMITS 0.00 255.0 /end CHARACTERISTIC
/begin CHARACTERISTIC T15CD_stInvIn_C "Invertierungsparameter für Klemme 15 Eingangssignal" VALUE 0x1F11FD Kw_Wu8 1.000 OneToOne 0.00 1.000 FORMAT "%5.3" EXTENDED_LIMITS 0.00 255.0 /end CHARACTERISTIC
/begin CHARACTERISTIC T15CD_tiucoPT1_C "Zeitkonstante für PT1-Filterung der linearisierten Klemme 15" VALUE 0x1F1200 Kw_Wu32 4294.9673 TimeDelay_s 0.0000010000000 4294.9673 FORMAT "%9.4" /end CHARACTERISTIC
/begin CHARACTERISTIC T15CD_stSensIDWord_C "Geberkennwort für Analogauswertung der Klemme 15" VALUE 0x1F1204 Kw_Wu16 65535.00 OneToOne 0.00 65535.00 FORMAT "%8.2" /end CHARACTERISTIC
/begin CHARACTERISTIC T15CD_uDfl_C "Vorgabewert für Analogwert der Klemme 15" VALUE 0x1F1206 Kw_Ws16 5200.579 Volt_Batt 0.00 5200.579 FORMAT "%8.3" EXTENDED_LIMITS -665674.1 665653.8 /end CHARACTERISTIC
/begin CHARACTERISTIC T15CD_uA2DThres_C "Schwellwert für Umwandlung des analogen in digitalen Klemme 15-Wert" VALUE 0x1F1208 Kw_Ws16 5200.579 Volt_Batt 0.00 5200.579 FORMAT "%8.3" EXTENDED_LIMITS -665674.1 665653.8 /end CHARACTERISTIC
/begin CHARACTERISTIC T15CD_uCutOffPreset_C "Initialisierungswert für die PT1-Filterung der linearisierten Klemme 15" VALUE 0x1F120A Kw_Ws16 5200.579 Volt_Batt 0.00 5200.579 FORMAT "%8.3" EXTENDED_LIMITS -665674.1 665653.8 /end CHARACTERISTIC
/begin CHARACTERISTIC T50CD_tiDebShortCircBatDef_C "Fehlerentprellzeit für Kurzschluss von Klemme 50 nach Ubatt" VALUE 0x1F120C Kw_Wu16 655350.0 Time_ms 0.00 655350.0 FORMAT "%8.1" /end CHARACTERISTIC
/begin CHARACTERISTIC T50CD_tiDebShortCircBatOk_C "Heilung-Entprellzeit für Kurzschluss von Klemme 50 nach Ubatt" VALUE 0x1F120E Kw_Wu16 655350.0 Time_ms 0.00 655350.0 FORMAT "%8.1" /end CHARACTERISTIC
/begin CHARACTERISTIC T50CD_tiDebShortCircGndDef_C "Fehlerentprellzeit für Kurzschluss von Klemme 50 nach Masse" VALUE 0x1F1210 Kw_Wu16 655350.0 Time_ms 0.00 655350.0 FORMAT "%8.1" /end CHARACTERISTIC
/begin CHARACTERISTIC T50CD_tiDebShortCircGndOk_C "Heilung-Entprellzeit für Kurzschluss von Klemme 50 nach Masse" VALUE 0x1F1212 Kw_Wu16 655350.0 Time_ms 0.00 655350.0 FORMAT "%8.1" /end CHARACTERISTIC
/begin CHARACTERISTIC T50CD_tiDebNplDef_C "Defekt-Entprellzeit für Fehler ""Klemme 50 permanent high""" VALUE 0x1F1214 Kw_Wu16 655350.0 Time_ms 0.00 655350.0 FORMAT "%8.1" /end CHARACTERISTIC
/begin CHARACTERISTIC T50CD_tiDebNplOk_C "Heilung-Entprellzeit für Fehler ""Klemme 50 permanent high""" VALUE 0x1F1216 Kw_Wu16 655350.0 Time_ms 0.00 655350.0 FORMAT "%8.1" /end CHARACTERISTIC
/begin CHARACTERISTIC T50CD_tiDigInDebNeg_C "Entprellzeit für negative Flanken" VALUE 0x1F1218 Kw_Wu16 655350.0 TimeDeb 0.00 655350.0 FORMAT "%8.1" /end CHARACTERISTIC
/begin CHARACTERISTIC T50CD_tiDigInDebPos_C "Entprellzeit für positive Flanken" VALUE 0x1F121A Kw_Wu16 655350.0 TimeDeb 0.00 655350.0 FORMAT "%8.1" /end CHARACTERISTIC
/begin CHARACTERISTIC T50CD_tiRxDigInDebNeg_C "Entprellzeit der neg. Flanke der Anlasserückmeldeleitung" VALUE 0x1F1220 Kw_Wu16 655350.0 TimeDeb 0.00 655350.0 FORMAT "%8.1" /end CHARACTERISTIC
/begin CHARACTERISTIC T50CD_tiRxDigInDebPos_C "Entprellzeit der pos. Flanke der Anlasserrückmeldeleitung" VALUE 0x1F1222 Kw_Wu16 655350.0 TimeDeb 0.00 655350.0 FORMAT "%8.1" /end CHARACTERISTIC
/begin CHARACTERISTIC T50CD_stDigInvIn_C "Invertierungsparameter des Eingangssignals" VALUE 0x1F121C Kw_Wu8 1.000 OneToOne 0.00 1.000 FORMAT "%5.3" EXTENDED_LIMITS 0.00 255.0 /end CHARACTERISTIC
/begin CHARACTERISTIC T50CD_stRxDigInvIn_C "Invertierungsparameter des Eingangssignals" VALUE 0x1F1224 Kw_Wu8 1.000 OneToOne 0.00 1.000 FORMAT "%5.3" EXTENDED_LIMITS 0.00 255.0 /end CHARACTERISTIC
/begin CHARACTERISTIC T50CD_swtDigInPresentVal_C "Softwareschalter ob Klemme 50 vorhanden ist (0 = Nein; 1 = Ja)" VALUE 0x1F121D Kw_Wu8 1.000 OneToOne 0.00 1.000 FORMAT "%5.3" EXTENDED_LIMITS 0.00 255.0 /end CHARACTERISTIC
/begin CHARACTERISTIC T50CD_swtDigInPresentType_C "Type des Softwareschalters" VALUE 0x1F121E Kw_Wu8 0.00 OneToOne 2.000 2.000 FORMAT "%5.3" EXTENDED_LIMITS 0.00 255.0 /end CHARACTERISTIC
/begin CHARACTERISTIC T50CD_swtRxDigInPVal_C "Softwareschalter ob Anlasserrückmeldeleitung vorhanden (0 = Nein; 1 = Ja)" VALUE 0x1F1225 Kw_Wu8 1.000 OneToOne 0.00 1.000 FORMAT "%5.3" EXTENDED_LIMITS 0.00 255.0 /end CHARACTERISTIC
/begin CHARACTERISTIC T50CD_swtRxDigInPType_C "Type des Softwareschalters" VALUE 0x1F1226 Kw_Wu8 0.00 OneToOne 2.000 2.000 FORMAT "%5.3" EXTENDED_LIMITS 0.00 255.0 /end CHARACTERISTIC
/begin CHARACTERISTIC TAA_ctIncsGap_CA "Lückenkonfiguration des Geberrads für Inkrementwinkel-Lernverfahren" VAL_BLK 0x1F1284 Kwb_Wu8 10.00 OneToOne 0.00 10.00 FORMAT "%5.2" EXTENDED_LIMITS 0.00 255.0 NUMBER 2 /end CHARACTERISTIC
/begin CHARACTERISTIC TAA_facDynMax_C "maximal zulässige Dynamik für Inkrementwinkel-Lernverfahren" VALUE 0x1F1228 Kw_Ws16 1.000000 Fact 0.00 1.000000 FORMAT "%8.6" EXTENDED_LIMITS -4.000000 3.999878 /end CHARACTERISTIC
/begin CHARACTERISTIC TAA_facSinTab_CA "Filterkoeffizienten für Inkrementwinkel-Lernverfahren" VAL_BLK 0x1F122A Kwb_Ws16 2.000000 FacTrigFct -1.000000 1.000000 FORMAT "%8.6" EXTENDED_LIMITS -8.000000 7.999756 NUMBER 30 /end CHARACTERISTIC
/begin CHARACTERISTIC TAA_nAdaptMid_CA "Mittendrehzahlen Lernbereiche für Inkrementwinkel-Lernverfahren" VAL_BLK 0x1F1266 Kwb_Wu16 6000.000 EngN 0.00 6000.000 FORMAT "%8.3" EXTENDED_LIMITS 0.00 65535.00 NUMBER 3 /end CHARACTERISTIC
/begin CHARACTERISTIC TAA_nAdaptRng_CA "Breite der Lernbereiche für Inkrementwinkel-Lernverfahren" VAL_BLK 0x1F126C Kwb_Wu16 6000.000 EngN 0.00 6000.000 FORMAT "%8.3" EXTENDED_LIMITS 0.00 65535.00 NUMBER 3 /end CHARACTERISTIC
/begin CHARACTERISTIC TAA_nMax_C "maximale Drehzahl für Inkrementwinkel-Lernverfahren" VALUE 0x1F1286 Kw_Wu16 6000.000 EngN 0.00 6000.000 FORMAT "%8.3" EXTENDED_LIMITS 0.00 65535.00 /end CHARACTERISTIC
/begin CHARACTERISTIC TAA_nMin_C "minimale Drehzahl für Inkrementwinkel-Lernverfahren" VALUE 0x1F1288 Kw_Wu16 6000.000 EngN 0.00 6000.000 FORMAT "%8.3" EXTENDED_LIMITS 0.00 65535.00 /end CHARACTERISTIC
/begin CHARACTERISTIC TAA_numActv_CA "Anzahl auszuwertender Inkremente je Rechenraster im Inkrementwinkel-Lernverfahren" VAL_BLK 0x1F128A Kwb_Wu8 125.0 OneToOne 0.00 125.0 FORMAT "%5.1" EXTENDED_LIMITS 0.00 255.0 NUMBER 8 /end CHARACTERISTIC
/begin CHARACTERISTIC TAA_numGapIpoIncs_C "Anzahl Inkremente für Lückeninterpolation in Inkrementwinkel-Lernverfahren" VALUE 0x1F1272 Kw_Wu8 9.000 OneToOne 1.000 10.00 FORMAT "%5.2" EXTENDED_LIMITS 0.00 255.0 /end CHARACTERISTIC
/begin CHARACTERISTIC TAA_numRevCorr_C "Anzahl Kurbelwellenumdrehungen für Aktualisierung Korrekturwerte im Inkrementwinkel-Lernverfahren" VALUE 0x1F1292 Kw_Wu8 19.00 OneToOne 1.000 20.00 FORMAT "%5.2" EXTENDED_LIMITS 0.00 255.0 /end CHARACTERISTIC
/begin CHARACTERISTIC TAA_numSinTab_C "Anzahl Filterkoeffizienten für Inkrementwinkel-Lernverfahren" VALUE 0x1F1273 Kw_Wu8 30.00 OneToOne 0.00 30.00 FORMAT "%5.2" EXTENDED_LIMITS 0.00 255.0 /end CHARACTERISTIC
/begin CHARACTERISTIC TAA_phiDiffMax_CA "Schwellwert für Einschwingzustand Inkrementwinkel-Lernverfahren" VAL_BLK 0x1F1274 Kwb_Ws16 0.2499390 AngleHResCrS 0.00 0.2499390 FORMAT "%9.7" EXTENDED_LIMITS -6.000000 5.999817 NUMBER 3 /end CHARACTERISTIC
/begin CHARACTERISTIC TAA_stAdaptMode_C "Interpolationsmodus für Korrektur der Inkrementwinkel" VALUE 0x1F1293 Kw_Wu8 4.000 OneToOne 0.00 4.000 FORMAT "%5.3" EXTENDED_LIMITS 0.00 255.0 /end CHARACTERISTIC
/begin CHARACTERISTIC TAA_stCorrInv_C "Optimierung Inkrementwinkel-Korrekturwerte für Zumessalgorithmus in TPU" VALUE 0x1F127A Kw_Wu8 1.000 OneToOne 0.00 1.000 FORMAT "%5.3" EXTENDED_LIMITS 0.00 255.0 /end CHARACTERISTIC
/begin CHARACTERISTIC TAA_stEvalFin_C "letzter auszuführender Teilalgorithmus im Inkrementwinkel-Lernverfahren" VALUE 0x1F1294 Kw_Wu16 32768.00 OneToOne 0.00 32768.00 FORMAT "%8.2" EXTENDED_LIMITS 0.00 65535.00 /end CHARACTERISTIC
/begin CHARACTERISTIC TAA_stExtp_C "Freigabe für Extrapolation der Inkrementwinkel-Korrekturwerte" VALUE 0x1F1296 Kw_Wu8 1.000 OneToOne 0.00 1.000 FORMAT "%5.3" EXTENDED_LIMITS 0.00 255.0 /end CHARACTERISTIC
/begin CHARACTERISTIC TAA_stGearMax_C "maximale Gangstufe für Aktivierung Inkrementwinkel-Lernverfahren" VALUE 0x1F1298 Kw_Wu16 7.000000 OneToOne 0.00 7.000000 FORMAT "%8.6" EXTENDED_LIMITS 0.00 65535.00 /end CHARACTERISTIC
/begin CHARACTERISTIC TAA_stGearMin_C "minimale Gangstufe für Aktivierung Inkrementwinkel-Lernverfahren" VALUE 0x1F129A Kw_Wu16 7.000000 OneToOne 0.00 7.000000 FORMAT "%8.6" EXTENDED_LIMITS 0.00 65535.00 /end CHARACTERISTIC
/begin CHARACTERISTIC TAA_stMainSpdRng_C "Hauptdrehzahlbereich für Inkrementwinkel-Lernverfahren" VALUE 0x1F127B Kw_Wu8 255.0 OneToOne 0.00 255.0 FORMAT "%5.1" /end CHARACTERISTIC
/begin CHARACTERISTIC TAA_stReqRstVal_C "Löschanforderung für Adaptionswerte Inkrementwinkel-Lernen" VALUE 0x1F127C Kw_Wu8 1.000 OneToOne 0.00 1.000 FORMAT "%5.3" EXTENDED_LIMITS 0.00 255.0 /end CHARACTERISTIC
/begin CHARACTERISTIC TAA_stTstMode_C "Freigabe Testmodus Inkrementwinkel-Lernverfahren" VALUE 0x1F129D Kw_Wu8 31.00 OneToOne 0.00 31.00 FORMAT "%5.2" EXTENDED_LIMITS 0.00 255.0 /end CHARACTERISTIC
/begin CHARACTERISTIC TAA_tiIncDvtFlt_C "Filterzeitkonstante für Inkrementwinkel-Abweichungen" VALUE 0x1F1280 Kw_Wu32 99.782961 TimeDelay_s 0.099999239 99.882960 FORMAT "%9.5" EXTENDED_LIMITS 0.0000010000000 4294.9673 /end CHARACTERISTIC
/begin CHARACTERISTIC TAA_tiEnaDel_C "Wartezeit nach Schubübergang für Aktivierung Inkrementwinkel-Lernverfahren" VALUE 0x1F129E Kw_Wu16 100.0000 Time_s 0.00 100.0000 FORMAT "%8.4" EXTENDED_LIMITS 0.00 655.3500 /end CHARACTERISTIC
/begin CHARACTERISTIC TAA_vMin_C "minimale Fahrzeuggeschwindigkeit für Aktivierung Inkrementwinkel-Lernverfahren" VALUE 0x1F12A0 Kw_Wu16 300.0000 Vel 0.00 300.0000 FORMAT "%8.4" EXTENDED_LIMITS 0.00 655.3500 /end CHARACTERISTIC
/begin CHARACTERISTIC ThrVlv_ctRlsAttempts_C "Schwelle der Anzahl der Losreißversuche für Erkennung einer verklemmten Drosselklappe" VALUE 0x1F13F4 Kw_Wu8 255.0 OneToOne 0.00 255.0 FORMAT "%5.1" /end CHARACTERISTIC
/begin CHARACTERISTIC ThrVlv_DKdNegShOff_C "D-Verstärkung des PID-Reglers bei negativen Großsignalen bei Schließen gegen Abstellschlagen" VALUE 0x1F12E4 Kw_Ws32 10.0000000000 Kd 0.00 10.0000000000 FORMAT "%13.10" EXTENDED_LIMITS -32768.0000000 32767.9999847 /end CHARACTERISTIC
/begin CHARACTERISTIC ThrVlv_DKdNeg_C "D-Verstärkung des PID-Reglers bei negativen Großsignalen" VALUE 0x1F12E8 Kw_Ws32 10.0000000000 Kd 0.00 10.0000000000 FORMAT "%13.10" EXTENDED_LIMITS -32768.0000000 32767.9999847 /end CHARACTERISTIC
/begin CHARACTERISTIC ThrVlv_DKdPosShOff_C "D-Verstärkung des PID-Reglers bei positiven Großsignalen bei Schließen gegen Abstellschlagen" VALUE 0x1F12EC Kw_Ws32 10.0000000000 Kd 0.00 10.0000000000 FORMAT "%13.10" EXTENDED_LIMITS -32768.0000000 32767.9999847 /end CHARACTERISTIC
/begin CHARACTERISTIC ThrVlv_DKdPos_C "D-Verstärkung des PID-Reglers bei positiven Großsignalen" VALUE 0x1F12F0 Kw_Ws32 10.0000000000 Kd 0.00 10.0000000000 FORMAT "%13.10" EXTENDED_LIMITS -32768.0000000 32767.9999847 /end CHARACTERISTIC
/begin CHARACTERISTIC ThrVlv_iEff_CUR "Kennlinie zur Modellierung des Effektivstroms" CURVE 0x1F12F4 Kl_Xs16_Ws16 10.00000 Curr_A 0.00 10.00000 FORMAT "%8.5" EXTENDED_LIMITS -327.6800 327.6700
 /begin AXIS_DESCR STD_AXIS ThrVlv_rAbsTVA_mp DtyCyc 8 0.00 100.0000 FORMAT "%8.4" EXTENDED_LIMITS -327.6800 327.6700 DEPOSIT ABSOLUTE /end AXIS_DESCR
/end CHARACTERISTIC
/begin CHARACTERISTIC ThrVlv_IKiFrcSlp_C "I-Verstärkung des Integrators zur Kompensation der Reibung" VALUE 0x1F1318 Kw_Wu32 999.999931082 Ki 0.00 999.999931082 FORMAT "%13.8" EXTENDED_LIMITS 0.00 999999.999767 /end CHARACTERISTIC
/begin CHARACTERISTIC ThrVlv_IKiMechBnd_C "I-Verstärkung des Lagereglers in der Nähe der mechansichen Anschläge" VALUE 0x1F131C Kw_Wu32 999.999931082 Ki 0.00 999.999931082 FORMAT "%13.8" EXTENDED_LIMITS 0.00 999999.999767 /end CHARACTERISTIC
/begin CHARACTERISTIC ThrVlv_IKiNegShOff_C "I-Verstärkung des PID-Reglers bei negativen Großsignalen bei Schließen gegen Abstellschlagen" VALUE 0x1F1320 Kw_Wu32 100.000062957 Ki 0.00 100.000062957 FORMAT "%13.9" EXTENDED_LIMITS 0.00 999999.999767 /end CHARACTERISTIC
/begin CHARACTERISTIC ThrVlv_IKiNeg_C "I-Verstärkung des PID-Reglers bei negativen Großsignalen" VALUE 0x1F1324 Kw_Wu32 100.000062957 Ki 0.00 100.000062957 FORMAT "%13.9" EXTENDED_LIMITS 0.00 999999.999767 /end CHARACTERISTIC
/begin CHARACTERISTIC ThrVlv_IKiPosShOff_C "I-Verstärkung des PID-Reglers bei positiven Großsignalen bei Schließen gegen Abstellschlagen" VALUE 0x1F1328 Kw_Wu32 100.000062957 Ki 0.00 100.000062957 FORMAT "%13.9" EXTENDED_LIMITS 0.00 999999.999767 /end CHARACTERISTIC
/begin CHARACTERISTIC ThrVlv_IKiPos_C "I-Verstärkung des PID-Reglers bei positiven Großsignalen" VALUE 0x1F132C Kw_Wu32 100.000062957 Ki 0.00 100.000062957 FORMAT "%13.9" EXTENDED_LIMITS 0.00 999999.999767 /end CHARACTERISTIC
/begin CHARACTERISTIC ThrVlv_nMinTVAActv_C "Drehzahlschwelle zur Aktivierung der Drosselklappe" VALUE 0x1F1330 Kw_Ws16 6000.000 EngN 0.00 6000.000 FORMAT "%8.3" EXTENDED_LIMITS -32768.00 32767.00 /end CHARACTERISTIC
/begin CHARACTERISTIC ThrVlv_numMaxClean_C "Anzahl der Reinigungsversuche" VALUE 0x1F12A2 Kw_Wu8 255.0 OneToOne 0.00 255.0 FORMAT "%5.1" /end CHARACTERISTIC
/begin CHARACTERISTIC ThrVlv_PKpNegShOff_C "P-Verstärkung des PID-Reglers bei negativen Großsignalen bei Schließen gegen Abstellschlagen" VALUE 0x1F1334 Kw_Ws32 10.0000000000 Kp 0.00 10.0000000000 FORMAT "%13.10" EXTENDED_LIMITS -32768.0000000 32767.9999847 /end CHARACTERISTIC
/begin CHARACTERISTIC ThrVlv_PKpNeg_C "P-Verstärkung des PID-Reglers bei negativen Großsignalen" VALUE 0x1F1338 Kw_Ws32 10.0000000000 Kp 0.00 10.0000000000 FORMAT "%13.10" EXTENDED_LIMITS -32768.0000000 32767.9999847 /end CHARACTERISTIC
/begin CHARACTERISTIC ThrVlv_PKpPosShOff_C "P-Verstärkung des PID-Reglers bei positiven Großsignalen bei Schließen gegen Abstellschlagen" VALUE 0x1F133C Kw_Ws32 10.0000000000 Kp 0.00 10.0000000000 FORMAT "%13.10" EXTENDED_LIMITS -32768.0000000 32767.9999847 /end CHARACTERISTIC
/begin CHARACTERISTIC ThrVlv_PKpPos_C "P-Verstärkung des PID-Reglers bei positiven Großsignalen" VALUE 0x1F1340 Kw_Ws32 10.0000000000 Kp 0.00 10.0000000000 FORMAT "%13.10" EXTENDED_LIMITS -32768.0000000 32767.9999847 /end CHARACTERISTIC
/begin CHARACTERISTIC ThrVlv_tiDesValFlt_C "Zeitkonstante für Filterung des Lagesollwerts" VALUE 0x1F1344 Kw_Wu32 4294.9673 TimeDelay_s 0.0000010000000 4294.9673 FORMAT "%9.4" /end CHARACTERISTIC
/begin CHARACTERISTIC ThrVlv_rCleanClsd_C "Sollwertvorgabe Schliessen bei  aktiver Reinigungsfunktion" VALUE 0x1F12A4 Kw_Ws16 100.0000 DtyCyc 0.00 100.0000 FORMAT "%8.4" EXTENDED_LIMITS -327.6800 327.6700 /end CHARACTERISTIC
/begin CHARACTERISTIC ThrVlv_rCleanOpn_C "Sollwertvorgabe Öffnen bei aktiver Reinigungsfunktion" VALUE 0x1F12A6 Kw_Ws16 100.0000 DtyCyc 0.00 100.0000 FORMAT "%8.4" EXTENDED_LIMITS -327.6800 327.6700 /end CHARACTERISTIC
/begin CHARACTERISTIC ThrVlv_rCurrMax_C "Grenze zur Parameterumschaltung des thermischen Überlastschutzes" VALUE 0x1F1348 Kw_Ws16 100.0000 DtyCyc 0.00 100.0000 FORMAT "%8.4" EXTENDED_LIMITS -327.6800 327.6700 /end CHARACTERISTIC
/begin CHARACTERISTIC ThrVlv_rDesTVA_CUR "Korrekturkennlinie für Sollwert Regelklappensteller" CURVE 0x1F12A8 Kl_Xs16_Ws16 100.0000 DtyCyc 0.00 100.0000 FORMAT "%8.4" EXTENDED_LIMITS -327.6800 327.6700
 /begin AXIS_DESCR STD_AXIS AirCtl_rTVA Prc 8 0.00 100.0000 FORMAT "%8.4" EXTENDED_LIMITS -327.6800 327.6700 DEPOSIT ABSOLUTE /end AXIS_DESCR
/end CHARACTERISTIC
/begin CHARACTERISTIC ThrVlv_rDesValClsdActvShOff_C "Grenzwert des Lagesollwerts ab dem auf komplettes Schließen erkannt wird bei Schließen gegen Abstellschlagen" VALUE 0x1F134A Kw_Ws16 120.0000 DtyCyc 0.00 120.0000 FORMAT "%8.4" EXTENDED_LIMITS -327.6800 327.6700 /end CHARACTERISTIC
/begin CHARACTERISTIC ThrVlv_rDesValClsdActv_C "Grenzwert des Lagesollwerts ab dem auf komplettes Schließen erkannt wird" VALUE 0x1F134C Kw_Ws16 120.0000 DtyCyc 0.00 120.0000 FORMAT "%8.4" EXTENDED_LIMITS -327.6800 327.6700 /end CHARACTERISTIC
/begin CHARACTERISTIC ThrVlv_rDesValClsdInactvShOff_C "Grenzwert des Lagesollwerts unterhalb dessen der Status komplettes Schließen deaktiviert wird bei Schließen gegen Abstellschlag" VALUE 0x1F134E Kw_Ws16 120.0000 DtyCyc 0.00 120.0000 FORMAT "%8.4" EXTENDED_LIMITS -327.6800 327.6700 /end CHARACTERISTIC
/begin CHARACTERISTIC ThrVlv_rDesValClsdInactv_C "Grenzwert des Lagesollwerts unterhalb dessen der Status komplettes Schließen deaktiviert wird" VALUE 0x1F1350 Kw_Ws16 120.0000 DtyCyc 0.00 120.0000 FORMAT "%8.4" EXTENDED_LIMITS -327.6800 327.6700 /end CHARACTERISTIC
/begin CHARACTERISTIC ThrVlv_rDesValMaxShOff_C "oberer Grenzwert für Lagesollwert bei Schließen gegen Abstellschlagen" VALUE 0x1F1352 Kw_Ws16 150.0000 DtyCyc 0.00 150.0000 FORMAT "%8.4" EXTENDED_LIMITS -327.6800 327.6700 /end CHARACTERISTIC
/begin CHARACTERISTIC ThrVlv_rDesValMax_C "oberer Grenzwert für Lagesollwert" VALUE 0x1F1354 Kw_Ws16 150.0000 DtyCyc 0.00 150.0000 FORMAT "%8.4" EXTENDED_LIMITS -327.6800 327.6700 /end CHARACTERISTIC
/begin CHARACTERISTIC ThrVlv_rDesValMinShOff_C "unterer Grenzwert für Lagesollwert bei Schließen gegen Abstellschlagen" VALUE 0x1F1356 Kw_Ws16 150.0000 DtyCyc -50.00000 100.0000 FORMAT "%8.4" EXTENDED_LIMITS -327.6800 327.6700 /end CHARACTERISTIC
/begin CHARACTERISTIC ThrVlv_rDesValMin_C "unterer Grenzwert für Lagesollwert" VALUE 0x1F1358 Kw_Ws16 150.0000 DtyCyc -50.00000 100.0000 FORMAT "%8.4" EXTENDED_LIMITS -327.6800 327.6700 /end CHARACTERISTIC
/begin CHARACTERISTIC ThrVlv_rDesValOpnActv_C "Grenzwert des Lagesollwerts ab dem auf komplettes Öffnen erkannt wird" VALUE 0x1F135A Kw_Ws16 120.0000 DtyCyc -20.00000 100.0000 FORMAT "%8.4" EXTENDED_LIMITS -327.6800 327.6700 /end CHARACTERISTIC
/begin CHARACTERISTIC ThrVlv_rDesValOpnInactv_C "Grenzwert des Lagesollwerts unterhalb dessen der Status komplettes Öffnen deaktiviert wird" VALUE 0x1F135C Kw_Ws16 120.0000 DtyCyc -20.00000 100.0000 FORMAT "%8.4" EXTENDED_LIMITS -327.6800 327.6700 /end CHARACTERISTIC
/begin CHARACTERISTIC ThrVlv_rDesValStyAvrg_C "Mittelwert des oszillierenden Ersatzsollwerts" VALUE 0x1F12CA Kw_Ws16 100.0000 DtyCyc 0.00 100.0000 FORMAT "%8.4" EXTENDED_LIMITS -327.6800 327.6700 /end CHARACTERISTIC
/begin CHARACTERISTIC ThrVlv_rDesValStyHiThres_C "obere Grenze zur Aktivierung des Ersatzsollwerts" VALUE 0x1F12CC Kw_Ws16 110.0000 DtyCyc -10.00000 100.0000 FORMAT "%8.4" EXTENDED_LIMITS -327.6800 327.6700 /end CHARACTERISTIC
/begin CHARACTERISTIC ThrVlv_rDesValStyLoThres_C "untere Grenze zur Aktivierung des Ersatzsollwerts" VALUE 0x1F12CE Kw_Ws16 110.0000 DtyCyc -10.00000 100.0000 FORMAT "%8.4" EXTENDED_LIMITS -327.6800 327.6700 /end CHARACTERISTIC
/begin CHARACTERISTIC ThrVlv_rDesValStyOscMax_C "maximale Amplitude des oszillierenden Ersatzsollwerts" VALUE 0x1F12D0 Kw_Ws16 10.00000 DtyCyc 0.00 10.00000 FORMAT "%8.5" EXTENDED_LIMITS -327.6800 327.6700 /end CHARACTERISTIC
/begin CHARACTERISTIC ThrVlv_rDesValStySlp_C "Änderungsgeschwindigkeit des Ersatzsollwerts" VALUE 0x1F12D2 Kw_Ws16 10.00000 DtyCycSlp 0.00 10.00000 FORMAT "%8.5" EXTENDED_LIMITS -32.76800 32.76700 /end CHARACTERISTIC
/begin CHARACTERISTIC ThrVlv_rDMaxShOff_C "maximale Geschwindigkeit unterhalb der auf komplettes Schließen erkannt wird bei Schließen gegen Abstellschlagen" VALUE 0x1F135E Kw_Ws16 200.0000 DtyCyc -100.0000 100.0000 FORMAT "%8.4" EXTENDED_LIMITS -327.6800 327.6700 /end CHARACTERISTIC
/begin CHARACTERISTIC ThrVlv_rDMax_C "maximale Geschwindigkeit unterhalb der auf komplettes schließen erkannt wird" VALUE 0x1F1360 Kw_Ws16 200.0000 DtyCyc -100.0000 100.0000 FORMAT "%8.4" EXTENDED_LIMITS -327.6800 327.6700 /end CHARACTERISTIC
/begin CHARACTERISTIC ThrVlv_rDMin_C "Maximale Geschwindigkeit der Klappe unterhalb der auf komplettes Öffnen erkannt wird" VALUE 0x1F1362 Kw_Ws16 200.0000 DtyCyc -100.0000 100.0000 FORMAT "%8.4" EXTENDED_LIMITS -327.6800 327.6700 /end CHARACTERISTIC
/begin CHARACTERISTIC ThrVlv_rDvtMax_C "Grenze für Erkennung auf positive bleibende Regelabweichung" VALUE 0x1F13F6 Kw_Ws16 100.0000 DtyCyc 0.00 100.0000 FORMAT "%8.4" EXTENDED_LIMITS -327.6800 327.6700 /end CHARACTERISTIC
/begin CHARACTERISTIC ThrVlv_rDvtMin_C "Grenze für Erkennung auf negative bleibende Regelabweichung" VALUE 0x1F13F8 Kw_Ws16 100.0000 DtyCyc -100.0000 0.00 FORMAT "%8.4" EXTENDED_LIMITS -327.6800 327.6700 /end CHARACTERISTIC
/begin CHARACTERISTIC ThrVlv_rFrcMax_C "maximales Tastverhältnis der Reibungskompensation" VALUE 0x1F1364 Kw_Ws16 30.00000 DtyCyc 0.00 30.00000 FORMAT "%8.5" EXTENDED_LIMITS -327.6800 327.6700 /end CHARACTERISTIC
/begin CHARACTERISTIC ThrVlv_rFrc_C "Tastverhältnis zur Kompensation der Gleitreibung" VALUE 0x1F1366 Kw_Ws16 10.00000 DtyCyc 0.00 10.00000 FORMAT "%8.5" EXTENDED_LIMITS -327.6800 327.6700 /end CHARACTERISTIC
/begin CHARACTERISTIC ThrVlv_rGvnrDvtFrcInactv_C "Grenzwert der Regelabweichung, unterhalb dessen keine Kompensation der Reibung stattfindet" VALUE 0x1F1368 Kw_Ws16 110.0000 DtyCyc -10.00000 100.0000 FORMAT "%8.4" EXTENDED_LIMITS -327.6800 327.6700 /end CHARACTERISTIC
/begin CHARACTERISTIC ThrVlv_rGvnrDvtMaxFrcRmp_C "Grenzwert der Regelabweichung, unterhalb dessen eine Kompensation der Haftreibung stattfindet" VALUE 0x1F136A Kw_Ws16 110.0000 DtyCyc -10.00000 100.0000 FORMAT "%8.4" EXTENDED_LIMITS -327.6800 327.6700 /end CHARACTERISTIC
/begin CHARACTERISTIC ThrVlv_rGvnrDvtThres_C "Schwellwert für die Ausblendung des D-Anteils des PID-Reglers" VALUE 0x1F136C Kw_Ws16 100.0000 DtyCyc 0.00 100.0000 FORMAT "%8.4" EXTENDED_LIMITS -327.6800 327.6700 /end CHARACTERISTIC
/begin CHARACTERISTIC ThrVlv_rGvnrMaxMechBnd_C "Maximal zulässige Regler-Stellgröße in Umgebung der mechanischen Anschläge" VALUE 0x1F136E Kw_Ws16 100.0000 DtyCyc 0.00 100.0000 FORMAT "%8.4" EXTENDED_LIMITS -327.6800 327.6700 /end CHARACTERISTIC
/begin CHARACTERISTIC ThrVlv_rGvnrMinMechBnd_C "Minimal zulässige Regler-Stellgröße in Umgebung der mechanischen Anschläge" VALUE 0x1F1370 Kw_Ws16 100.0000 DtyCyc -100.0000 0.00 FORMAT "%8.4" EXTENDED_LIMITS -327.6800 327.6700 /end CHARACTERISTIC
/begin CHARACTERISTIC ThrVlv_rGvnrMax_C "maximal zulässige Stellgröße des PID-Reglerausgangs" VALUE 0x1F1372 Kw_Ws16 100.0000 DtyCyc 0.00 100.0000 FORMAT "%8.4" EXTENDED_LIMITS -327.6800 327.6700 /end CHARACTERISTIC
/begin CHARACTERISTIC ThrVlv_rGvnrMin_C "minimal zulässige Stellgröße des PID-Reglerausgangs" VALUE 0x1F1374 Kw_Ws16 100.0000 DtyCyc -100.0000 0.00 FORMAT "%8.4" EXTENDED_LIMITS -327.6800 327.6700 /end CHARACTERISTIC
/begin CHARACTERISTIC ThrVlv_rGvnrMax_CUR "Kennlinie im thermischen Überlastschutz zur Begrenzung des Reglerausganges" CURVE 0x1F1376 Kl_Xs16_Ws16 100.0000 DtyCyc 0.00 100.0000 FORMAT "%8.4" EXTENDED_LIMITS -327.6800 327.6700
 /begin AXIS_DESCR STD_AXIS ThrVlv_iEffFlt_mp Curr_A 3 0.00 10.00000 FORMAT "%8.5" EXTENDED_LIMITS -327.6800 327.6700 DEPOSIT ABSOLUTE /end AXIS_DESCR
/end CHARACTERISTIC
/begin CHARACTERISTIC ThrVlv_rInitIMax_C "Oberer Grenzwert für die Initialisierung des Lagereglers bei Verlassen der mechansichen Anschläge" VALUE 0x1F1384 Kw_Ws16 100.0000 DtyCyc 0.00 100.0000 FORMAT "%8.4" EXTENDED_LIMITS -327.6800 327.6700 /end CHARACTERISTIC
/begin CHARACTERISTIC ThrVlv_rInitIMin_C "Unterer Grenzwert für die Initialisierung des Lagereglers bei Verlassen der mechansichen Anschläge" VALUE 0x1F1386 Kw_Ws16 100.0000 DtyCyc 0.00 100.0000 FORMAT "%8.4" EXTENDED_LIMITS -327.6800 327.6700 /end CHARACTERISTIC
/begin CHARACTERISTIC ThrVlv_rInitI_C "Initialisierungswert des I-Anteils bei deaktivierten PI-Regler" VALUE 0x1F1388 Kw_Ws16 200.0000 DtyCyc -100.0000 100.0000 FORMAT "%8.4" EXTENDED_LIMITS -327.6800 327.6700 /end CHARACTERISTIC
/begin CHARACTERISTIC ThrVlv_RlsKiNeg_C "Faktor für Rampe der Losreißfunktion bei negativer Regelabweichung" VALUE 0x1F13FC Kw_Wu32 100000.000000 Ki_ThrVlv 0.00 100000.000000 FORMAT "%13.6" EXTENDED_LIMITS 0.00 66076419.9231 /end CHARACTERISTIC
/begin CHARACTERISTIC ThrVlv_RlsKiPos_C "Faktor für Rampe der Losreißfunktion bei positiver Regelabweichung" VALUE 0x1F1400 Kw_Wu32 100000.000000 Ki_ThrVlv 0.00 100000.000000 FORMAT "%13.6" EXTENDED_LIMITS 0.00 66076419.9231 /end CHARACTERISTIC
/begin CHARACTERISTIC ThrVlv_rOutDFrcRmpThres_C "Grenzwert unterhalb dessen der Integrator zur Kompensation der Haftreibung gestartet wird" VALUE 0x1F138A Kw_Ws16 100.0000 DtyCyc 0.00 100.0000 FORMAT "%8.4" EXTENDED_LIMITS -327.6800 327.6700 /end CHARACTERISTIC
/begin CHARACTERISTIC ThrVlv_rOutDMaxShOff_C "maximal zulässige Stellgröße des D-Anteils des PID-Reglers bei Schließen gegen Abstellschlagen" VALUE 0x1F138C Kw_Ws16 100.0000 DtyCyc 0.00 100.0000 FORMAT "%8.4" EXTENDED_LIMITS -327.6800 327.6700 /end CHARACTERISTIC
/begin CHARACTERISTIC ThrVlv_rOutDMax_C "maximal zulässige Stellgröße des D-Anteils des PID-Reglers" VALUE 0x1F138E Kw_Ws16 100.0000 DtyCyc 0.00 100.0000 FORMAT "%8.4" EXTENDED_LIMITS -327.6800 327.6700 /end CHARACTERISTIC
/begin CHARACTERISTIC ThrVlv_rOutIMaxMechBnd_C "oberer Grenzwert des I-Anteils des Lagereglers bei zu schließender oder zu öffnender Klappe" VALUE 0x1F1390 Kw_Ws16 100.0000 DtyCyc 0.00 100.0000 FORMAT "%8.4" EXTENDED_LIMITS -327.6800 327.6700 /end CHARACTERISTIC
/begin CHARACTERISTIC ThrVlv_rOutIMax_C "oberer Grenzwert des I-Anteils des Lagereglers" VALUE 0x1F1392 Kw_Ws16 100.0000 DtyCyc 0.00 100.0000 FORMAT "%8.4" EXTENDED_LIMITS -327.6800 327.6700 /end CHARACTERISTIC
/begin CHARACTERISTIC ThrVlv_rPIDWinNegShOff_C "untere Kleinsignalgrenze des PID-Reglers bei Schließen gegen Abstellschlagen" VALUE 0x1F1394 Kw_Ws16 100.0000 DtyCyc -100.0000 0.00 FORMAT "%8.4" EXTENDED_LIMITS -327.6800 327.6700 /end CHARACTERISTIC
/begin CHARACTERISTIC ThrVlv_rPIDWinNeg_C "untere Kleinsignalgrenze des PID-Reglers" VALUE 0x1F1396 Kw_Ws16 100.0000 DtyCyc -100.0000 0.00 FORMAT "%8.4" EXTENDED_LIMITS -327.6800 327.6700 /end CHARACTERISTIC
/begin CHARACTERISTIC ThrVlv_rPIDWinPosShOff_C "obere Kleinsignalgrenze des PID-Reglers bei Schließen gegen Abstellschlagen" VALUE 0x1F1398 Kw_Ws16 100.0000 DtyCyc 0.00 100.0000 FORMAT "%8.4" EXTENDED_LIMITS -327.6800 327.6700 /end CHARACTERISTIC
/begin CHARACTERISTIC ThrVlv_rPIDWinPos_C "obere Kleinsignalgrenze des PID-Reglers" VALUE 0x1F139A Kw_Ws16 100.0000 DtyCyc 0.00 100.0000 FORMAT "%8.4" EXTENDED_LIMITS -327.6800 327.6700 /end CHARACTERISTIC
/begin CHARACTERISTIC ThrVlv_rRampEnd_C "Endwert des zusätzlichen Lagesollwerts für komplettes schließen" VALUE 0x1F139C Kw_Ws16 100.0000 DtyCyc 0.00 100.0000 FORMAT "%8.4" EXTENDED_LIMITS -327.6800 327.6700 /end CHARACTERISTIC
/begin CHARACTERISTIC ThrVlv_rRelPosMax_C "Grenzwert der Ist-Lage ab dem auf komplettes Öffnen erkannt wird" VALUE 0x1F139E Kw_Ws16 120.0000 DtyCyc -20.00000 100.0000 FORMAT "%8.4" EXTENDED_LIMITS -327.6800 327.6700 /end CHARACTERISTIC
/begin CHARACTERISTIC ThrVlv_rRelPosMinShOff_C "Grenzwert des Lageistwerts ab dem auf komplettes Schließen erkannt wird bei Schließen gegen Abstellschlagen" VALUE 0x1F13A0 Kw_Ws16 120.0000 DtyCyc 0.00 120.0000 FORMAT "%8.4" EXTENDED_LIMITS -327.6800 327.6700 /end CHARACTERISTIC
/begin CHARACTERISTIC ThrVlv_rRelPosMin_C "Grenzwert des Lageistwerts ab dem auf komplettes Schließen erkannt wird" VALUE 0x1F13A2 Kw_Ws16 120.0000 DtyCyc 0.00 120.0000 FORMAT "%8.4" EXTENDED_LIMITS -327.6800 327.6700 /end CHARACTERISTIC
/begin CHARACTERISTIC ThrVlv_rRelPosTVAActv_C "Minimaler Lageistwert zur Aktivierung des Reglers" VALUE 0x1F13A4 Kw_Ws16 655.3500 DtyCyc -327.6800 327.6700 FORMAT "%8.4" /end CHARACTERISTIC
/begin CHARACTERISTIC ThrVlv_rRlsDvt_C "maximale Regelabweichung für Erkennen eines erfolgreichen Losreißversuches" VALUE 0x1F1404 Kw_Ws16 100.0000 DtyCyc 0.00 100.0000 FORMAT "%8.4" EXTENDED_LIMITS -327.6800 327.6700 /end CHARACTERISTIC
/begin CHARACTERISTIC ThrVlv_rRlsMax_C "maximal zulässiges Ansteuertastverhältnis der Losreißfunktiuon" VALUE 0x1F1406 Kw_Ws16 100.0000 DtyCyc 0.00 100.0000 FORMAT "%8.4" EXTENDED_LIMITS -327.6800 327.6700 /end CHARACTERISTIC
/begin CHARACTERISTIC ThrVlv_rRls_C "Schwelle für Erkennung eines erfolgreichen Losreißversuches" VALUE 0x1F1408 Kw_Ws16 100.0000 DtyCyc 0.00 100.0000 FORMAT "%8.4" EXTENDED_LIMITS -327.6800 327.6700 /end CHARACTERISTIC
/begin CHARACTERISTIC ThrVlv_rTVAThresCls_C "Momentschwelle ab der geschlossen erkannt wird" VALUE 0x1F13A6 Kw_Ws16 100.0000 DtyCyc 0.00 100.0000 FORMAT "%8.4" EXTENDED_LIMITS -327.6800 327.6700 /end CHARACTERISTIC
/begin CHARACTERISTIC ThrVlv_rTVAThresOpn_C "Momentenschwelle ab der geöffnetes Ventil erkannt wird" VALUE 0x1F13A8 Kw_Ws16 100.0000 DtyCyc -100.0000 0.00 FORMAT "%8.4" EXTENDED_LIMITS -327.6800 327.6700 /end CHARACTERISTIC
/begin CHARACTERISTIC ThrVlv_slpRampShOff_C "Anstieg des zusätzlichen Lagesollwerts für komplettes Schließen der Drosselklappe bei Schließen gegen Abstellschlagen" VALUE 0x1F13AC Kw_Wu32 100.000000000 RmpDtyCyc 0.00 100.000000000 FORMAT "%13.9" EXTENDED_LIMITS 0.00 655359.999847 /end CHARACTERISTIC
/begin CHARACTERISTIC ThrVlv_slpRamp_C "Anstieg des zusätzlichen Lagesollwerts für komplettes schließen der Klappe" VALUE 0x1F13B0 Kw_Wu32 100.000000000 RmpDtyCyc 0.00 100.000000000 FORMAT "%13.9" EXTENDED_LIMITS 0.00 655359.999847 /end CHARACTERISTIC
/begin CHARACTERISTIC ThrVlv_SmlSigNegDKdShOff_C "D-Verstärkung des PID-Reglers bei negativen Kleinsignale bei Schließen gegen Abstellschlagen" VALUE 0x1F13B4 Kw_Ws32 10.0000000000 Kd 0.00 10.0000000000 FORMAT "%13.10" EXTENDED_LIMITS -32768.0000000 32767.9999847 /end CHARACTERISTIC
/begin CHARACTERISTIC ThrVlv_SmlSigNegDKd_C "D-Verstärkung des PID-Reglers bei negativen Kleinsignalen" VALUE 0x1F13B8 Kw_Ws32 10.0000000000 Kd 0.00 10.0000000000 FORMAT "%13.10" EXTENDED_LIMITS -32768.0000000 32767.9999847 /end CHARACTERISTIC
/begin CHARACTERISTIC ThrVlv_SmlSigNegIKiShOff_C "I-Verstärkung des PID-Reglers bei negativen Kleinsignalen bei Schließen gegen Abstellschlagen" VALUE 0x1F13BC Kw_Wu32 100.000062957 Ki 0.00 100.000062957 FORMAT "%13.9" EXTENDED_LIMITS 0.00 999999.999767 /end CHARACTERISTIC
/begin CHARACTERISTIC ThrVlv_SmlSigNegIKi_C "I-Verstärkung des PID-Reglers bei negativen Kleinsignalen" VALUE 0x1F13C0 Kw_Wu32 100.000062957 Ki 0.00 100.000062957 FORMAT "%13.9" EXTENDED_LIMITS 0.00 999999.999767 /end CHARACTERISTIC
/begin CHARACTERISTIC ThrVlv_SmlSigNegPKpShOff_C "P-Verstärkung des PID-Reglers bei negativen Kleinsignale bei Schließen gegen Abstellschlagen" VALUE 0x1F13C4 Kw_Ws32 10.0000000000 Kp 0.00 10.0000000000 FORMAT "%13.10" EXTENDED_LIMITS -32768.0000000 32767.9999847 /end CHARACTERISTIC
/begin CHARACTERISTIC ThrVlv_SmlSigNegPKp_C "P-Verstärkung des PID-Reglers bei negativen Kleinsignalen" VALUE 0x1F13C8 Kw_Ws32 10.0000000000 Kp 0.00 10.0000000000 FORMAT "%13.10" EXTENDED_LIMITS -32768.0000000 32767.9999847 /end CHARACTERISTIC
/begin CHARACTERISTIC ThrVlv_SmlSigPosDKdShOff_C "D-Verstärkung des PID-Reglers bei positiven Kleinsignalen bei Schließen gegen Abstellschlagen" VALUE 0x1F13CC Kw_Ws32 10.0000000000 Kd 0.00 10.0000000000 FORMAT "%13.10" EXTENDED_LIMITS -32768.0000000 32767.9999847 /end CHARACTERISTIC
/begin CHARACTERISTIC ThrVlv_SmlSigPosDKd_C "D-Verstärkung des PID-Reglers bei positiven Kleinsignalen" VALUE 0x1F13D0 Kw_Ws32 10.0000000000 Kd 0.00 10.0000000000 FORMAT "%13.10" EXTENDED_LIMITS -32768.0000000 32767.9999847 /end CHARACTERISTIC
/begin CHARACTERISTIC ThrVlv_SmlSigPosIKiShOff_C "I-Verstärkung des PID-Reglers bei positiven Kleinsignalen bei Schließen gegen Abstellschlagen" VALUE 0x1F13D4 Kw_Wu32 100.000062957 Ki 0.00 100.000062957 FORMAT "%13.9" EXTENDED_LIMITS 0.00 999999.999767 /end CHARACTERISTIC
/begin CHARACTERISTIC ThrVlv_SmlSigPosIKi_C "I-Verstärkung des PID-Reglers bei positiven Kleinsignalen" VALUE 0x1F13D8 Kw_Wu32 100.000062957 Ki 0.00 100.000062957 FORMAT "%13.9" EXTENDED_LIMITS 0.00 999999.999767 /end CHARACTERISTIC
/begin CHARACTERISTIC ThrVlv_SmlSigPosPKpShOff_C "P-Verstärkung des PID-Reglers bei positiven Kleinsignalen bei Schließen gegen Abstellschlagen" VALUE 0x1F13DC Kw_Ws32 10.0000000000 Kp 0.00 10.0000000000 FORMAT "%13.10" EXTENDED_LIMITS -32768.0000000 32767.9999847 /end CHARACTERISTIC
/begin CHARACTERISTIC ThrVlv_SmlSigPosPKp_C "P-Verstärkung des PID-Reglers bei positiven Kleinsignalen" VALUE 0x1F13E0 Kw_Ws32 10.0000000000 Kp 0.00 10.0000000000 FORMAT "%13.10" EXTENDED_LIMITS -32768.0000000 32767.9999847 /end CHARACTERISTIC
/begin CHARACTERISTIC ThrVlv_swtFeatClnTVA_C "Aktivierungschalter der Reinigungsfunktion" VALUE 0x1F12D4 Kw_Wu8 1.000 OneToOne 0.00 1.000 FORMAT "%5.3" EXTENDED_LIMITS 0.00 255.0 /end CHARACTERISTIC
/begin CHARACTERISTIC ThrVlv_swtGvnrByp_C "Schalter für die Umgehung der Lagereglerfunktion der Regelklappe" VALUE 0x1F140A Kw_Wu8 1.000 OneToOne 0.00 1.000 FORMAT "%5.3" EXTENDED_LIMITS 0.00 255.0 /end CHARACTERISTIC
/begin CHARACTERISTIC ThrVlv_tEngMax_C "Maximale erlaubte Motortemperatur zum aktivieren der Reinigungsfunktion" VALUE 0x1F12D6 Kw_Ws16 250.0000 Temp_Cels -50.14000 199.8600 FORMAT "%8.4" EXTENDED_LIMITS -3549.940 3003.560 /end CHARACTERISTIC
/begin CHARACTERISTIC ThrVlv_tEngMin_C "Minimale erlaubte Motortemperatur zum aktivieren der Reinigungsfunktion" VALUE 0x1F12D8 Kw_Ws16 250.0000 Temp_Cels -50.14000 199.8600 FORMAT "%8.4" EXTENDED_LIMITS -3549.940 3003.560 /end CHARACTERISTIC
/begin CHARACTERISTIC ThrVlv_tiCleanClsd_C "Zeitvorgabe Schliessen bei aktiver Reinigungsfunktion" VALUE 0x1F12DA Kw_Wu16 655350.0 Time_ms 0.00 655350.0 FORMAT "%8.1" /end CHARACTERISTIC
/begin CHARACTERISTIC ThrVlv_tiCleanOpn_C "Zeitvorgabe Öffnen bei aktiver Reinigungsfunktion" VALUE 0x1F12DC Kw_Wu16 655350.0 Time_ms 0.00 655350.0 FORMAT "%8.1" /end CHARACTERISTIC
/begin CHARACTERISTIC ThrVlv_tiCurrFltParFst_C "Filterparameter im thermischen Überlastschutz für hohe Absolutwerte des Reglerausganges." VALUE 0x1F13E4 Kw_Wu32 4294.9663 TimeDelay_s 0.0010000001 4294.9673 FORMAT "%9.4" EXTENDED_LIMITS 0.0000010000000 4294.9673 /end CHARACTERISTIC
/begin CHARACTERISTIC ThrVlv_tiCurrFltParSlw_C "Filterparameter im thermischen Überlastschutz für niedrige Absolutwerte des Reglerausganges." VALUE 0x1F13E8 Kw_Wu32 4294.9663 TimeDelay_s 0.0010000001 4294.9673 FORMAT "%9.4" EXTENDED_LIMITS 0.0000010000000 4294.9673 /end CHARACTERISTIC
/begin CHARACTERISTIC ThrVlv_DebGvnrDvtMaxDef_C "Vorentprellzeit für Erkennung auf positive bleibende Regelabweichung" VALUE 0x1F140C Kw_Wu16 1000.000 Time_ms 0.00 1000.000 FORMAT "%8.3" EXTENDED_LIMITS 0.00 655350.0 /end CHARACTERISTIC
/begin CHARACTERISTIC ThrVlv_DebGvnrDvtMaxOk_C "Vorentprellzeit für Heilung bei positiver bleibender Regelabweichung" VALUE 0x1F140E Kw_Wu16 1000.000 Time_ms 0.00 1000.000 FORMAT "%8.3" EXTENDED_LIMITS 0.00 655350.0 /end CHARACTERISTIC
/begin CHARACTERISTIC ThrVlv_DebGvnrDvtMinDef_C "Vorentprellzeit für Erkennung auf negative bleibende Regelabweichung" VALUE 0x1F1410 Kw_Wu16 1000.000 Time_ms 0.00 1000.000 FORMAT "%8.3" EXTENDED_LIMITS 0.00 655350.0 /end CHARACTERISTIC
/begin CHARACTERISTIC ThrVlv_DebGvnrDvtMinOk_C "Vorentprellzeit für Heilung bei negativer bleibender Regelabweichung" VALUE 0x1F1412 Kw_Wu16 1000.000 Time_ms 0.00 1000.000 FORMAT "%8.3" EXTENDED_LIMITS 0.00 655350.0 /end CHARACTERISTIC
/begin CHARACTERISTIC ThrVlv_tiGvnrDT1ShOff_C "Zeitkonstante des DT1-Gliedes im PID-Regler bei Schließen gegen Abstellschlagen" VALUE 0x1F13EC Kw_Wu32 4294.9663 TimeDelay_s 0.0010000001 4294.9673 FORMAT "%9.4" EXTENDED_LIMITS 0.0000010000000 4294.9673 /end CHARACTERISTIC
/begin CHARACTERISTIC ThrVlv_tiGvnrDT1_C "Zeitkonstante des DT1-Gliedes im PID-Regler" VALUE 0x1F13F0 Kw_Wu32 4294.9663 TimeDelay_s 0.0010000001 4294.9673 FORMAT "%9.4" EXTENDED_LIMITS 0.0000010000000 4294.9673 /end CHARACTERISTIC
/begin CHARACTERISTIC ThrVlv_tiRepRls_C "Wartezeit für wiederholtes Starten der Losreißfunktion" VALUE 0x1F1414 Kw_Wu32 3600.00000000 Time_s 0.00 3600.00000000 FORMAT "%13.8" EXTENDED_LIMITS 0.00 42949672.9500 /end CHARACTERISTIC
/begin CHARACTERISTIC ThrVlv_tiRlsSuc_C "Wartezeit zum Heilen der Regelabweichung nach Losreißversuch" VALUE 0x1F1418 Kw_Wu16 10.00000 Time_s 0.00 10.00000 FORMAT "%8.5" EXTENDED_LIMITS 0.00 655.3500 /end CHARACTERISTIC
/begin CHARACTERISTIC ThrVlv_tiRls_C "Laufzeit für Losreißfunktion" VALUE 0x1F141A Kw_Wu16 5.000000 Time_s 0.00 5.000000 FORMAT "%8.6" EXTENDED_LIMITS 0.00 655.3500 /end CHARACTERISTIC
/begin CHARACTERISTIC ThrVlv_uBattMax_C "Maximale erlaubte Batteriespannung zum aktivieren der Reinigungsfunktion" VALUE 0x1F12DE Kw_Ws16 28603.18 Volt_Batt 0.00 28603.18 FORMAT "%8.2" EXTENDED_LIMITS -665674.1 665653.8 /end CHARACTERISTIC
/begin CHARACTERISTIC ThrVlv_uBattMin_C "Minimale erlaubte Batteriespannung zum aktivieren der Reinigungsfunktion" VALUE 0x1F12E0 Kw_Ws16 28603.18 Volt_Batt 0.00 28603.18 FORMAT "%8.2" EXTENDED_LIMITS -665674.1 665653.8 /end CHARACTERISTIC
/begin CHARACTERISTIC Tp20_swtAppl_C "Applikations Schalter zum Umschalten zwischen K-Line und Can" VALUE 0x1F141C Kw_Wu8 255.0 OneToOne 0.00 255.0 FORMAT "%5.1" /end CHARACTERISTIC
/begin CHARACTERISTIC Tp20_swtFuncEnbl_C "Applikationsvariable für die Dienste TP20APPL_CAN_MUTESET_MSK, TP20APPL_CAN_MUTERESET_MSK, TP20APPL_DFES_FCMCLEAR_MSK" VALUE 0x1F141D Kw_Wu8 255.0 OneToOne 0.00 255.0 FORMAT "%5.1" /end CHARACTERISTIC
/begin CHARACTERISTIC Tp20_tiCanMuteTimeOut_C "Zeit für Timeout der CAN-Deaktivierung durch Tp2.0 broadcast Service" VALUE 0x1F141E Kw_Wu16 655.1400 Time_s 0.00 655.1400 FORMAT "%8.4" EXTENDED_LIMITS 0.00 655.3500 /end CHARACTERISTIC
/begin CHARACTERISTIC Tp20_vCanMuteThres_C "Obere Grenze Zur Deaktivierung CAN-Messages durch ein Tp2.0 Broadcast Services" VALUE 0x1F1420 Kw_Ws16 5.000000 Vel 0.00 5.000000 FORMAT "%8.6" EXTENDED_LIMITS -327.6800 327.6700 /end CHARACTERISTIC
/begin CHARACTERISTIC TPUMon_ctDfctLim_C "Oberer Entprellzähler Grenzwert für Defekterkennung" VALUE 0x1C1FD8 Kw_Wu16 65535.00 OneToOne 0.00 65535.00 FORMAT "%8.2" /end CHARACTERISTIC
/begin CHARACTERISTIC TPUMon_ctTPU_C "Index der auf den Messpunkten dargestellten TPU" VALUE 0x1C1FDA Kw_Wu8 255.0 OneToOne 0.00 255.0 FORMAT "%5.1" /end CHARACTERISTIC
/begin CHARACTERISTIC TPUMon_tiDiffMaxLimit_C "Maximal zulässige einzelne Timerdifferenz" VALUE 0x1C1FDC Kw_Ws32 2147483647.00 TimeUSResolution 0.00 2147483647.00 FORMAT "%13.2" EXTENDED_LIMITS -2147483648.00 2147483647.00 /end CHARACTERISTIC
/begin CHARACTERISTIC TPUMon_tiDiffMinLimit_C "Minimal zulässige einzelne Timerdifferenz (negativer Wert)" VALUE 0x1C1FE0 Kw_Ws32 2147483648.00 TimeUSResolution -2147483648.00 0.00 FORMAT "%13.2" EXTENDED_LIMITS -2147483648.00 2147483647.00 /end CHARACTERISTIC
/begin CHARACTERISTIC TPUMon_tiDiffSumLimit_C "Maximal zulässige Betragsumme Timerdifferenz" VALUE 0x1C1FE4 Kw_Ws32 2147483647.00 TimeUSResolution 0.00 2147483647.00 FORMAT "%13.2" EXTENDED_LIMITS -2147483648.00 2147483647.00 /end CHARACTERISTIC
/begin CHARACTERISTIC TstTog_Code_C "Test des Testercodes" VAL_BLK 0x1F1422 Kwb_Wu16 65535.00 OneToOne 0.00 65535.00 FORMAT "%8.2" NUMBER 35 /end CHARACTERISTIC
/begin CHARACTERISTIC TstTog_Demand_C "Signalnummer des Testers" VAL_BLK 0x1F1468 Kwb_Wu8 255.000000000 SigTstName 0.00 255.000000000 FORMAT "%13.9" NUMBER 35 /end CHARACTERISTIC
/begin CHARACTERISTIC TstTog_DemStartMaxEngN_C "maximale Motordrehzahl für den Start des Test" VALUE 0x1F148C Kw_Ws16 65535.00 EngN -32768.00 32767.00 FORMAT "%8.2" /end CHARACTERISTIC
/begin CHARACTERISTIC TstTog_K2SigBlkVal1_MAP "Signalblock für Wert 1" MAP 0x1F148E Kf_Xs16_Ys16_Ws16 32766.00 OneToOne 0.00 32766.00 FORMAT "%8.2" EXTENDED_LIMITS -32768.00 32767.00
 /begin AXIS_DESCR STD_AXIS TstTog_DNULL_mp OneToOne 4 1.000 4.000 FORMAT "%5.3" EXTENDED_LIMITS 0.00 255.0 DEPOSIT ABSOLUTE /end AXIS_DESCR
 /begin AXIS_DESCR STD_AXIS TstTog_ActRout_mp OneToOne 35 0.00 34.00 FORMAT "%5.2" EXTENDED_LIMITS 0.00 255.0 DEPOSIT ABSOLUTE /end AXIS_DESCR
/end CHARACTERISTIC
/begin CHARACTERISTIC TstTog_K2SigBlkVal2_MAP "Signalblock für Wert 2" MAP 0x1F15F8 Kf_Xs16_Ys16_Ws16 32766.00 OneToOne 0.00 32766.00 FORMAT "%8.2" EXTENDED_LIMITS -32768.00 32767.00
 /begin AXIS_DESCR STD_AXIS TstTog_DNULL_mp OneToOne 4 1.000 4.000 FORMAT "%5.3" EXTENDED_LIMITS 0.00 255.0 DEPOSIT ABSOLUTE /end AXIS_DESCR
 /begin AXIS_DESCR STD_AXIS TstTog_ActRout_mp OneToOne 35 0.00 34.00 FORMAT "%5.2" EXTENDED_LIMITS 0.00 255.0 DEPOSIT ABSOLUTE /end AXIS_DESCR
/end CHARACTERISTIC
/begin CHARACTERISTIC TstTog_tiBetweenTogVal_C "Zeit zwischen Tastverhältnisveränderungen" VAL_BLK 0x1F1762 Kwb_Wu16 655350.0 Time_ms 0.00 655350.0 FORMAT "%8.1" NUMBER 35 /end CHARACTERISTIC
/begin CHARACTERISTIC TstTog_tiMaxUserInput_C "Variable Zeit für den User, wann der Stellertest beendet wird" VALUE 0x1F17A8 Kw_Wu16 655.3500 Time_s 0.00 655.3500 FORMAT "%8.4" /end CHARACTERISTIC
/begin CHARACTERISTIC TstTog_tiRoutDemMax_C "Zeit des Testers um ein Kommando zu wiederholen" VALUE 0x1F17AA Kw_Wu16 655350.0 Time_ms 0.00 655350.0 FORMAT "%8.1" /end CHARACTERISTIC
/begin CHARACTERISTIC TstTog_Val1_C "1. Tastverhältnis" VAL_BLK 0x1F17AC Kwb_Ws16 655.3500 DtyCyc -327.6800 327.6700 FORMAT "%8.4" NUMBER 35 /end CHARACTERISTIC
/begin CHARACTERISTIC TstTog_Val2_C "2. Tastverhältnis" VAL_BLK 0x1F17F2 Kwb_Ws16 655.3500 DtyCyc -327.6800 327.6700 FORMAT "%8.4" NUMBER 35 /end CHARACTERISTIC
/begin CHARACTERISTIC TVACD_ctPwrStgOnMax_C "Maximaler Zähler für Powerstage On im Fehlerfall" VALUE 0x1F1838 Kw_Wu16 65535.00 OneToOne 0.00 65535.00 FORMAT "%8.2" /end CHARACTERISTIC
/begin CHARACTERISTIC TVACD_DebExcTempDef_C "Fehlerentprellzeit für Übertemperatur" VALUE 0x1F183A Kw_Wu16 655350.0 Time_ms 0.00 655350.0 FORMAT "%8.1" /end CHARACTERISTIC
/begin CHARACTERISTIC TVACD_DebExcTempOk_C "Heilungsentprellzeit für Übertemperatur" VALUE 0x1F183C Kw_Wu16 655350.0 Time_ms 0.00 655350.0 FORMAT "%8.1" /end CHARACTERISTIC
/begin CHARACTERISTIC TVACD_DebNoLoadDef_C "Fehlerentprellzeit für Lastabfall" VALUE 0x1F183E Kw_Wu16 655350.0 Time_ms 0.00 655350.0 FORMAT "%8.1" /end CHARACTERISTIC
/begin CHARACTERISTIC TVACD_DebNoLoadOk_C "Heilungsentprellzeit für Lastabfall" VALUE 0x1F1840 Kw_Wu16 655350.0 Time_ms 0.00 655350.0 FORMAT "%8.1" /end CHARACTERISTIC
/begin CHARACTERISTIC TVACD_DebShortCircBatDef_C "Fehlerentprellzeit für Kurzschluß nach Batterie" VALUE 0x1F1842 Kw_Wu16 655350.0 Time_ms 0.00 655350.0 FORMAT "%8.1" /end CHARACTERISTIC
/begin CHARACTERISTIC TVACD_DebShortCircBatOk_C "Heilungsentprellzeit für Kurzschluß nach Batterie" VALUE 0x1F1844 Kw_Wu16 655350.0 Time_ms 0.00 655350.0 FORMAT "%8.1" /end CHARACTERISTIC
/begin CHARACTERISTIC TVACD_DebShortCircGndDef_C "Fehlerentprellzeit für Kurzschluß nach Masse" VALUE 0x1F1846 Kw_Wu16 655350.0 Time_ms 0.00 655350.0 FORMAT "%8.1" /end CHARACTERISTIC
/begin CHARACTERISTIC TVACD_DebShortCircGndOk_C "Heilungsentprellzeit für Kurzschluß nach Masse" VALUE 0x1F1848 Kw_Wu16 655350.0 Time_ms 0.00 655350.0 FORMAT "%8.1" /end CHARACTERISTIC
/begin CHARACTERISTIC TVACD_DebSigCJ220Def_C "Drosselklappen-Defektzeit bei CJ220-Ansteuerung" VALUE 0x1F184A Kw_Wu16 655350.0 Time_ms 0.00 655350.0 FORMAT "%8.1" /end CHARACTERISTIC
/begin CHARACTERISTIC TVACD_DebSigCJ220Ok_C "Drosselklappen-Heilzeit bei CJ220-Ansteuerung" VALUE 0x1F184C Kw_Wu16 655350.0 Time_ms 0.00 655350.0 FORMAT "%8.1" /end CHARACTERISTIC
/begin CHARACTERISTIC TVACD_facLpGnStrt_C "Kompensation des Korrekturfaktors im Zustand START" VALUE 0x1F184E Kw_Ws16 7.999878 Fact -4.000000 3.999878 FORMAT "%8.6" /end CHARACTERISTIC
/begin CHARACTERISTIC TVACD_numDia_C "Applikationsparameter fuer Diagnose-Signal von Drossel-Steller" VALUE 0x1F1850 Kw_Wu8 20.0000000000 NumPinDia 1.00000000000 21.0000000000 FORMAT "%13.10" /end CHARACTERISTIC
/begin CHARACTERISTIC TVACD_numDisCJ220_C "Selektion des CJ220 disable pins" VALUE 0x1F1851 Kw_Wu8 22.0000000000 NumPinDioOut 0.00 22.0000000000 FORMAT "%13.10" /end CHARACTERISTIC
/begin CHARACTERISTIC TVACD_numPwmOut1_C "Applicationsparameter für Endstufen-Pin Auswahl -Ausgang1(CJ230)" VALUE 0x1F1852 Kw_Wu8 11.0000000000 NumPinPwmOut 2.00000000000 13.0000000000 FORMAT "%13.10" /end CHARACTERISTIC
/begin CHARACTERISTIC TVACD_numPwmOut2_C "Applicationsparameter für Endstufen-Pin Auswahl - Ausgang2(CJ230)" VALUE 0x1F1853 Kw_Wu8 11.0000000000 NumPinPwmOut 2.00000000000 13.0000000000 FORMAT "%13.10" /end CHARACTERISTIC
/begin CHARACTERISTIC TVACD_numPwmOut_C "Applikationsparameter fuer Drosselwert-Steller" VALUE 0x1F1854 Kw_Wu8 11.0000000000 NumPinPwmOut 2.00000000000 13.0000000000 FORMAT "%13.10" /end CHARACTERISTIC
/begin CHARACTERISTIC TVACD_tiPT1FacCor_C "PT1-Filterzeitkonstante" VALUE 0x1F1858 Kw_Wu32 4294.9673 TimeDelay_s 0.0000010000000 4294.9673 FORMAT "%9.4" /end CHARACTERISTIC
/begin CHARACTERISTIC TVACD_stInvOut_C "Invertierungsparameter für das Signal der Drosselklappenstellerendstufe" VALUE 0x1F185C Kw_Wu8 1.000 OneToOne 0.00 1.000 FORMAT "%5.3" EXTENDED_LIMITS 0.00 255.0 /end CHARACTERISTIC
/begin CHARACTERISTIC TVACD_tiPer_C "Periodendauer Drosselklappensteller" VALUE 0x1F185E Kw_Ws16 6553.500 Period -3276.800 3276.700 FORMAT "%8.3" /end CHARACTERISTIC
/begin CHARACTERISTIC TVACD_rCnv_CUR "Kennlinie zur konvertierung von Öffnungsgrad in Tastverhältnis" CURVE 0x1F1860 Kl_Xs16_Ws16 200.0000 DtyCyc -100.0000 100.0000 FORMAT "%8.4" EXTENDED_LIMITS -327.6800 327.6700
 /begin AXIS_DESCR STD_AXIS ThrVlv_rTVA DtyCyc 25 -100.0000 200.0000 FORMAT "%8.4" EXTENDED_LIMITS -327.6800 327.6700 DEPOSIT ABSOLUTE /end AXIS_DESCR
/end CHARACTERISTIC
/begin CHARACTERISTIC TVACD_rOutMax_C "Maximal auszugebendes Tastverhältnis" VALUE 0x1F18C6 Kw_Ws16 655.3500 DtyCyc -327.6800 327.6700 FORMAT "%8.4" /end CHARACTERISTIC
/begin CHARACTERISTIC TVACD_rOutMin_C "Minimal auszugebendes Tastverhältnis" VALUE 0x1F18C8 Kw_Ws16 655.3500 DtyCyc -327.6800 327.6700 FORMAT "%8.4" /end CHARACTERISTIC
/begin CHARACTERISTIC TVACD_rTst_C "Tastverhältnis, dass im Fehlerfall zyklisch ausgegeben wird" VALUE 0x1F18CA Kw_Ws16 100.0000 DtyCyc 0.00 100.0000 FORMAT "%8.4" EXTENDED_LIMITS -327.6800 327.6700 /end CHARACTERISTIC
/begin CHARACTERISTIC TVACD_stPwrStgActv_C "Aktivierung der Abschaltbedingungen der Endstufe" VALUE 0x1F18CC Kw_Wu8 255.0 OneToOne 0.00 255.0 FORMAT "%5.1" /end CHARACTERISTIC
/begin CHARACTERISTIC TVACD_stPwrStgDia_C "Aktivierung der Abschaltbedingungen der Endstufendiagnose" VALUE 0x1F18CD Kw_Wu8 255.0 OneToOne 0.00 255.0 FORMAT "%5.1" /end CHARACTERISTIC
/begin CHARACTERISTIC TVACD_stSPICtl_C "Parameter zur Anzeige der verwendeten Endstufenart ( 1 = SPI kontrollierbare Endstufe, 0 = nicht SPI-Endstufe )" VALUE 0x1F18CE Kw_Wu8 1.000 OneToOne 0.00 1.000 FORMAT "%5.3" EXTENDED_LIMITS 0.00 255.0 /end CHARACTERISTIC
/begin CHARACTERISTIC TVACD_swt_C "Schalter Batteriespannungskorrektur (0 = AUS, 1 = EIN);H-bridge package (0 = EIN, 1 = AUS)" VALUE 0x1F18CF Kw_Wu8 255.0 OneToOne 0.00 255.0 FORMAT "%5.1" /end CHARACTERISTIC
/begin CHARACTERISTIC TVACD_tiBtwTst_C "Zeitabstand, in dem im Fehlerfall die Endstufe getestet wird" VALUE 0x1F18D0 Kw_Wu16 29980.00 Time_ms 20.00000 30000.00 FORMAT "%8.2" EXTENDED_LIMITS 0.00 655350.0 /end CHARACTERISTIC
/begin CHARACTERISTIC TVACD_tiPwrStgOn_C "Zeit für welche die Endstufe im Fehlerfall eingeschalten wird (nur nicht SPI kontrolliert)" VALUE 0x1F18D2 Kw_Wu16 500.0000 Time_ms 0.00 500.0000 FORMAT "%8.4" EXTENDED_LIMITS 0.00 655350.0 /end CHARACTERISTIC
/begin CHARACTERISTIC TVASCD_DebNplstErrDef_C "Fehlerentprellzeit für Anmeldefehler der Statusleitung" VALUE 0x1F18D4 Kw_Wu16 65535.00 OneToOne 0.00 65535.00 FORMAT "%8.2" /end CHARACTERISTIC
/begin CHARACTERISTIC TVASCD_DebNplstErrOk_C "Heilungsentprellzeit für Anmeldefehler der Statusleitung" VALUE 0x1F18D6 Kw_Wu16 65535.00 OneToOne 0.00 65535.00 FORMAT "%8.2" /end CHARACTERISTIC
/begin CHARACTERISTIC TVASCD_DebSigstErrDef_C "Fehlerentprellzeit für Signalfehler der Statusleitung" VALUE 0x1F18D8 Kw_Wu16 655350.0 Time_ms 0.00 655350.0 FORMAT "%8.1" /end CHARACTERISTIC
/begin CHARACTERISTIC TVASCD_DebSigstErrOk_C "Heilungsentprellzeit für Signalfehler der Statusleitung" VALUE 0x1F18DA Kw_Wu16 655350.0 Time_ms 0.00 655350.0 FORMAT "%8.1" /end CHARACTERISTIC
/begin CHARACTERISTIC TVASCD_DebSRCHighDef_C "Fehlerentprellzeit für SRC-High Fehler für TVA Sensorsigna" VALUE 0x1F18DC Kw_Wu16 655350.0 Time_ms 0.00 655350.0 FORMAT "%8.1" /end CHARACTERISTIC
/begin CHARACTERISTIC TVASCD_DebSRCHighOk_C "Heilungsentprellzeit für SRC-High Fehler für TVA Sensorsignal" VALUE 0x1F18DE Kw_Wu16 655350.0 Time_ms 0.00 655350.0 FORMAT "%8.1" /end CHARACTERISTIC
/begin CHARACTERISTIC TVASCD_DebSRCLowDef_C "Fehlerentprellzeit für SRC-Low Fehler für TVA Sensorsignal" VALUE 0x1F18E0 Kw_Wu16 655350.0 Time_ms 0.00 655350.0 FORMAT "%8.1" /end CHARACTERISTIC
/begin CHARACTERISTIC TVASCD_DebSRCLowOk_C "Heilungsentprellzeit für SRC-Low Fehler für TVA Sensorsignal" VALUE 0x1F18E2 Kw_Wu16 655350.0 Time_ms 0.00 655350.0 FORMAT "%8.1" /end CHARACTERISTIC
/begin CHARACTERISTIC TVASCD_numAdc_C "Applikationsparameter für Abgasrückführsensor" VALUE 0x1F18E4 Kw_Wu8 23.0000000000 NumPinAdc 2.00000000000 25.0000000000 FORMAT "%13.10" /end CHARACTERISTIC
/begin CHARACTERISTIC TVASCD_drRmpSlpUp_C "Aufwärtsschrittweite der Rampe für TVA Sensorsignal" VALUE 0x1F18E8 Kw_Wu32 655359.999847 RmpDtyCyc 0.00 655359.999847 FORMAT "%13.6" /end CHARACTERISTIC
/begin CHARACTERISTIC TVASCD_drRmpSlpDwn_C "Abwärtsschrittweite der Rampe für TVA Sensorsignal" VALUE 0x1F18EC Kw_Wu32 655359.999847 RmpDtyCyc 0.00 655359.999847 FORMAT "%13.6" /end CHARACTERISTIC
/begin CHARACTERISTIC TVASCD_stDigInInvStLine_C "Invertierungsparameter für die Status-Leitung" VALUE 0x1F18F0 Kw_Wu8 1.000 OneToOne 0.00 1.000 FORMAT "%5.3" EXTENDED_LIMITS 0.00 255.0 /end CHARACTERISTIC
/begin CHARACTERISTIC TVASCD_swtDigInPresent_C "Schalter zur Deaktivierung des digitalen Eingangs von TVASCD" VALUE 0x1F18F1 Kw_Wu8 1.000 OneToOne 0.00 1.000 FORMAT "%5.3" EXTENDED_LIMITS 0.00 255.0 /end CHARACTERISTIC
/begin CHARACTERISTIC TVASCD_swtSensType_C "Auswahlschalter Sensortyp Drosselklappe" VALUE 0x1F18F2 Kw_Wu8 1.000 OneToOne 0.00 1.000 FORMAT "%5.3" EXTENDED_LIMITS 0.00 255.0 /end CHARACTERISTIC
/begin CHARACTERISTIC TVASCD_tEngMax_C "Maximal zulässige Motortemperatur zur Freigabe der Nullpunktanpassung" VALUE 0x1F18F4 Kw_Ws16 250.0000 Temp_Cels -50.14000 199.8600 FORMAT "%8.4" EXTENDED_LIMITS -3549.940 3003.560 /end CHARACTERISTIC
/begin CHARACTERISTIC TVASCD_tEngMin_C "Minimal zulässige Motortemperatur zur Freigabe der Nullpunktanpassung" VALUE 0x1F18F6 Kw_Ws16 250.0000 Temp_Cels -50.14000 199.8600 FORMAT "%8.4" EXTENDED_LIMITS -3549.940 3003.560 /end CHARACTERISTIC
/begin CHARACTERISTIC TVASCD_tiAvrg_C "Zeit zur Mittelwertbildung der Spannungswerte an den gelernten mechanischen Anschlägen" VALUE 0x1F18F8 Kw_Wu16 20000.00 Time_ms 0.00 20000.00 FORMAT "%8.2" EXTENDED_LIMITS 0.00 655350.0 /end CHARACTERISTIC
/begin CHARACTERISTIC TVASCD_tiDebRst_C "Entprellzeit nach Klemme 15 reset im Nachlauf" VALUE 0x1F18FA Kw_Wu16 28200.00 Time_ms 1800.000 30000.00 FORMAT "%8.2" EXTENDED_LIMITS 0.00 655350.0 /end CHARACTERISTIC
/begin CHARACTERISTIC TVASCD_tiHigh_C "minimal notwendige Zeit für High-Signal der Statusleitung bei Überwachung" VALUE 0x1F18FC Kw_Wu16 29980.00 Time_ms 20.00000 30000.00 FORMAT "%8.2" EXTENDED_LIMITS 0.00 655350.0 /end CHARACTERISTIC
/begin CHARACTERISTIC TVASCD_tiLow_C "maximalE Zeit für anfängliches Low-Signal der Statusleitung bei Beginn der Überwachung" VALUE 0x1F18FE Kw_Wu16 29980.00 Time_ms 20.00000 30000.00 FORMAT "%8.2" EXTENDED_LIMITS 0.00 655350.0 /end CHARACTERISTIC
/begin CHARACTERISTIC TVASCD_stSensIDWord_C "Sensor-ID für TVA Sensorsignal" VALUE 0x1F1900 Kw_Wu16 65535.00 OneToOne 0.00 65535.00 FORMAT "%8.2" /end CHARACTERISTIC
/begin CHARACTERISTIC TVASCD_rDfl_C "Vorgabewert für TVA Sensorsignal" VALUE 0x1F1902 Kw_Ws16 100.0000 DtyCyc 0.00 100.0000 FORMAT "%8.4" EXTENDED_LIMITS -327.6800 327.6700 /end CHARACTERISTIC
/begin CHARACTERISTIC TVASCD_uAvrgClsd_C "mittlerer Spannungswert bei geschlossenem Ventil" VALUE 0x1F1904 Kw_Ws16 5200.391 Volt 0.00 5200.391 FORMAT "%8.3" EXTENDED_LIMITS -160156.4 160151.5 /end CHARACTERISTIC
/begin CHARACTERISTIC TVASCD_uAvrgOpn_C "mittlerer Spannungswert bei geöffnetem Ventil" VALUE 0x1F1906 Kw_Ws16 5200.391 Volt 0.00 5200.391 FORMAT "%8.3" EXTENDED_LIMITS -160156.4 160151.5 /end CHARACTERISTIC
/begin CHARACTERISTIC TVASCD_uBattMax_C "Maximal zulässige Batteriespannung zur Freigabe der Nullpunktanpassung" VALUE 0x1F1908 Kw_Ws16 28603.18 Volt_Batt 0.00 28603.18 FORMAT "%8.2" EXTENDED_LIMITS -665674.1 665653.8 /end CHARACTERISTIC
/begin CHARACTERISTIC TVASCD_uBattMin_C "Minimal zulässige Batteriespannung zur Freigabe der Nullpunktanpassung" VALUE 0x1F190A Kw_Ws16 28603.18 Volt_Batt 0.00 28603.18 FORMAT "%8.2" EXTENDED_LIMITS -665674.1 665653.8 /end CHARACTERISTIC
/begin CHARACTERISTIC TVASCD_uRawMaxClsd_C "obere Drifterkennungsschwelle bei geschlossenem Ventil" VALUE 0x1F190C Kw_Ws16 5000.000 Volt 0.00 5000.000 FORMAT "%8.3" EXTENDED_LIMITS -160156.4 160151.5 /end CHARACTERISTIC
/begin CHARACTERISTIC TVASCD_uRawMaxOpn_C "obere Drifterkennungsschwelle bei geöffnetem Ventil" VALUE 0x1F190E Kw_Ws16 5000.000 Volt 0.00 5000.000 FORMAT "%8.3" EXTENDED_LIMITS -160156.4 160151.5 /end CHARACTERISTIC
/begin CHARACTERISTIC TVASCD_uRawMinClsd_C "untere Drifterkennungsschwelle bei geschlossenem Ventil" VALUE 0x1F1910 Kw_Ws16 5000.000 Volt 0.00 5000.000 FORMAT "%8.3" EXTENDED_LIMITS -160156.4 160151.5 /end CHARACTERISTIC
/begin CHARACTERISTIC TVASCD_uRawMinOpn_C "untere Drifterkennungsschwelle bei geöffnetem Ventil" VALUE 0x1F1912 Kw_Ws16 5000.000 Volt 0.00 5000.000 FORMAT "%8.3" EXTENDED_LIMITS -160156.4 160151.5 /end CHARACTERISTIC
/begin CHARACTERISTIC TVASCD_uRawSRCMax_C "SRC Max Spannungsrohwert für TVA Sensorsigna" VALUE 0x1F1914 Kw_Ws16 5200.391 Volt 0.00 5200.391 FORMAT "%8.3" EXTENDED_LIMITS -160156.4 160151.5 /end CHARACTERISTIC
/begin CHARACTERISTIC TVASCD_uRawSRCMin_C "SRC Min Spannungsrohwert für TVA Sensorsignal" VALUE 0x1F1916 Kw_Ws16 5200.391 Volt 0.00 5200.391 FORMAT "%8.3" EXTENDED_LIMITS -160156.4 160151.5 /end CHARACTERISTIC
/begin CHARACTERISTIC UAcc_ACCodePos_C "AC-Stellung im Funktionscode" VALUE 0x1F2694 Kw_Wu8 255.0 OneToOne 0.00 255.0 FORMAT "%5.1" /end CHARACTERISTIC
/begin CHARACTERISTIC UAcc_AltCodePos_C "Generatorfunktionscode-Position innerhalb der Funktionscodierung" VALUE 0x1F2696 Kw_Wu8 255.0 OneToOne 0.00 255.0 FORMAT "%5.1" /end CHARACTERISTIC
/begin CHARACTERISTIC UAcc_ESPCodePos_C "ESP-Stellung im Funktionscode" VALUE 0x1F2697 Kw_Wu8 255.0 OneToOne 0.00 255.0 FORMAT "%5.1" /end CHARACTERISTIC
/begin CHARACTERISTIC UAcc_FanCodePos_C "Lüfterfunktionscode-Position innerhalb der Funktionscodierung" VALUE 0x1F2698 Kw_Wu8 255.0 OneToOne 0.00 255.0 FORMAT "%5.1" /end CHARACTERISTIC
/begin CHARACTERISTIC UAcc_LogReqPWMxSpdResetdeAct2_C "Paßwort zum Deaktivieren der HGB 2" VALUE 0x1C14A0 Kw_Wu16 55535.00 OneToOne 10000.00 65535.00 FORMAT "%8.2" EXTENDED_LIMITS 0.00 65535.00 /end CHARACTERISTIC
/begin CHARACTERISTIC UAcc_VehVelCodePos_C "Stellung der Fahrzeugeschwindigkeit im Funktionscode" VALUE 0x1F269B Kw_Wu8 255.0 OneToOne 0.00 255.0 FORMAT "%5.1" /end CHARACTERISTIC
/begin CHARACTERISTIC UAcc_WIVCodePos_C "WIV-Stellung im Funktionscode" VALUE 0x1F269C Kw_Wu8 255.0 OneToOne 0.00 255.0 FORMAT "%5.1" /end CHARACTERISTIC
/begin CHARACTERISTIC VehDa_lStore_C "EEPROM Speicherintervall im Betrieb" VALUE 0x1F32BC Kw_Wu32 4294967295.00 Length 0.00 4294967295.00 FORMAT "%13.2" /end CHARACTERISTIC
/begin CHARACTERISTIC VehDa_nFTSThres_C "Drehzahlschwelle Betriebsstundenerfassung für FTS" VALUE 0x1F32C2 Kw_Ws16 65535.00 EngN -32768.00 32767.00 FORMAT "%8.2" /end CHARACTERISTIC
/begin CHARACTERISTIC VehDa_nThres_C "Drehzahlschwelle für Betriebsstundenerfassung" VALUE 0x1F32C4 Kw_Ws16 65535.00 EngN -32768.00 32767.00 FORMAT "%8.2" /end CHARACTERISTIC
/begin CHARACTERISTIC VehDa_qFTSThres_C "Einspritzmengenschwelle Betriebsstundenerfassung für FTS" VALUE 0x1F32C6 Kw_Ws16 655.3500 InjMass -327.6800 327.6700 FORMAT "%8.4" /end CHARACTERISTIC
/begin CHARACTERISTIC VehDa_qThres_C "akt. Einspritzmengenschwelle für Betriebsstundenerfassung" VALUE 0x1F32C8 Kw_Ws16 655.3500 InjMass -327.6800 327.6700 FORMAT "%8.4" /end CHARACTERISTIC
/begin CHARACTERISTIC VehDa_rVnMax_C "maximales v/n-Verhältnis" VALUE 0x1F32CA Kw_Ws16 0.3276700 VelToN 0.00 0.3276700 FORMAT "%9.7" EXTENDED_LIMITS -0.3276800 0.3276700 /end CHARACTERISTIC
/begin CHARACTERISTIC VehDa_tiNPT1_C "T1 Zeitkonstante zur Vorfilterung der Motordrehzahl für v/n-Verhältnis" VALUE 0x1F32CC Kw_Wu32 4294.9673 TimeDelay_s 0.0000010000000 4294.9673 FORMAT "%9.4" /end CHARACTERISTIC
/begin CHARACTERISTIC VehDa_tiStore_C "EEPROM Speicherintervall im Betrieb" VALUE 0x1F32D0 Kw_Wu32 4294967295.00 TimeEngOn 0.00 4294967295.00 FORMAT "%13.2" /end CHARACTERISTIC
/begin CHARACTERISTIC VehDa_tiVnPT1_C "T1 Zeitkonstante zur Filterung des v/n-Verhältnisses" VALUE 0x1F32D4 Kw_Wu32 4294.9673 TimeDelay_s 0.0000010000000 4294.9673 FORMAT "%9.4" /end CHARACTERISTIC
/begin CHARACTERISTIC VSACD_ctPwrStgOnMax_C "Maximaler Zähler für Powerstage On im Fehlerfall" VALUE 0x1F32D8 Kw_Wu16 65535.00 OneToOne 0.00 65535.00 FORMAT "%8.2" /end CHARACTERISTIC
/begin CHARACTERISTIC VSACD_DebExcTempDef_C "Fehlerentprellzeit für Übertemperatur" VALUE 0x1F32DA Kw_Wu16 655350.0 Time_ms 0.00 655350.0 FORMAT "%8.1" /end CHARACTERISTIC
/begin CHARACTERISTIC VSACD_DebExcTempOk_C "Heilungsentprellzeit für Übertemperatur" VALUE 0x1F32DC Kw_Wu16 655350.0 Time_ms 0.00 655350.0 FORMAT "%8.1" /end CHARACTERISTIC
/begin CHARACTERISTIC VSACD_DebNoLoadDef_C "Fehlerentprellzeit für Lastabfall" VALUE 0x1F32DE Kw_Wu16 655350.0 Time_ms 0.00 655350.0 FORMAT "%8.1" /end CHARACTERISTIC
/begin CHARACTERISTIC VSACD_DebNoLoadOk_C "Heilungsentprellzeit für Lastabfall" VALUE 0x1F32E0 Kw_Wu16 655350.0 Time_ms 0.00 655350.0 FORMAT "%8.1" /end CHARACTERISTIC
/begin CHARACTERISTIC VSACD_DebShortCircBatDef_C "Fehlerentprellzeit für Kurzschluß nach Batterie" VALUE 0x1F32E2 Kw_Wu16 655350.0 Time_ms 0.00 655350.0 FORMAT "%8.1" /end CHARACTERISTIC
/begin CHARACTERISTIC VSACD_DebShortCircBatOk_C "Heilungsentprellzeit für Kurzschluß nach Batterie" VALUE 0x1F32E4 Kw_Wu16 655350.0 Time_ms 0.00 655350.0 FORMAT "%8.1" /end CHARACTERISTIC
/begin CHARACTERISTIC VSACD_DebShortCircGndDef_C "Fehlerentprellzeit für Kurzschluß nach Masse" VALUE 0x1F32E6 Kw_Wu16 655350.0 Time_ms 0.00 655350.0 FORMAT "%8.1" /end CHARACTERISTIC
/begin CHARACTERISTIC VSACD_DebShortCircGndOk_C "Heilungsentprellzeit für Kurzschluß nach Masse" VALUE 0x1F32E8 Kw_Wu16 655350.0 Time_ms 0.00 655350.0 FORMAT "%8.1" /end CHARACTERISTIC
/begin CHARACTERISTIC VSACD_stInvOut_C "Invertierungsparameter für das Signal der Drallniveaustellerendstufe" VALUE 0x1F32EA Kw_Wu8 1.000 OneToOne 0.00 1.000 FORMAT "%5.3" EXTENDED_LIMITS 0.00 255.0 /end CHARACTERISTIC
/begin CHARACTERISTIC VSACD_tiPer_C "Periodendauer des Ausgangssignal für den Drallniveausteller" VALUE 0x1F32EC Kw_Ws16 6553.500 Period -3276.800 3276.700 FORMAT "%8.3" /end CHARACTERISTIC
/begin CHARACTERISTIC VSACD_rCnv_CUR "Kennlinie zur Konvertierung von Öffnungsgrad in Tastverhältnis" CURVE 0x1F32EE Kl_Xs16_Ws16 100.0000 DtyCyc 0.00 100.0000 FORMAT "%8.4" EXTENDED_LIMITS -327.6800 327.6700
 /begin AXIS_DESCR STD_AXIS IndSys_rVSA DtyCyc 25 -100.0000 200.0000 FORMAT "%8.4" EXTENDED_LIMITS -327.6800 327.6700 DEPOSIT ABSOLUTE /end AXIS_DESCR
/end CHARACTERISTIC
/begin CHARACTERISTIC VSACD_rOutMax_C "Maximal auszugebendes Tastverhältnis" VALUE 0x1F3354 Kw_Ws16 655.3500 DtyCyc -327.6800 327.6700 FORMAT "%8.4" /end CHARACTERISTIC
/begin CHARACTERISTIC VSACD_rOutMin_C "Minimal auszugebendes Tastverhältnis" VALUE 0x1F3356 Kw_Ws16 655.3500 DtyCyc -327.6800 327.6700 FORMAT "%8.4" /end CHARACTERISTIC
/begin CHARACTERISTIC VSACD_stPwrStgActv_C "Aktivierung der Abschaltbedingungen der Endstufe" VALUE 0x1F3358 Kw_Wu8 255.0 OneToOne 0.00 255.0 FORMAT "%5.1" /end CHARACTERISTIC
/begin CHARACTERISTIC VSACD_stPwrStgDia_C "Aktivierung der Abschaltbedingungen der Endstufendiagnose" VALUE 0x1F3359 Kw_Wu8 255.0 OneToOne 0.00 255.0 FORMAT "%5.1" /end CHARACTERISTIC
/begin CHARACTERISTIC VSACD_stSPICtl_C "Parameter zur Anzeige der verwendeten Endstufenart (1 = SPI kontrollierbar, 0 = nicht SPI kontrollierbar)" VALUE 0x1F335A Kw_Wu8 1.000 OneToOne 0.00 1.000 FORMAT "%5.3" EXTENDED_LIMITS 0.00 255.0 /end CHARACTERISTIC
/begin CHARACTERISTIC VSACD_swtLambdaIgnore_C "Applikationsschalter zum Abschalten der Lambdasonden-Bedingung" VALUE 0x1F335B Kw_Wu8 1.000 OneToOne 0.00 1.000 FORMAT "%5.3" EXTENDED_LIMITS 0.00 255.0 /end CHARACTERISTIC
/begin CHARACTERISTIC VSACD_swt_C "Schalter Batteriespannungskorrektur (0 = AUS, 1 = EIN);H - Brücke-Paket  (0 = EIN, 1 = AUS)" VALUE 0x1F335C Kw_Wu8 255.0 OneToOne 0.00 255.0 FORMAT "%5.1" /end CHARACTERISTIC
/begin CHARACTERISTIC VSACD_tiBtwTst_C "Zeitabstand, in dem im Fehlerfall die Endstufe getestet wird" VALUE 0x1F335E Kw_Wu16 29980.00 Time_ms 20.00000 30000.00 FORMAT "%8.2" EXTENDED_LIMITS 0.00 655350.0 /end CHARACTERISTIC
/begin CHARACTERISTIC VSACD_tiPwrStgOn_C "Zeit für welche die Endstufe im Fehlerfall eingeschalten wird (nur nicht SPI kontrolliert)" VALUE 0x1F3360 Kw_Wu16 500.0000 Time_ms 0.00 500.0000 FORMAT "%8.4" EXTENDED_LIMITS 0.00 655350.0 /end CHARACTERISTIC
/begin CHARACTERISTIC VSSCD_ctAvrgAccn_C "Zähler zum Berechnen der durchschnittlichen Beschleunigung über eine bestimmte Periode (ct * 20 msec)" VALUE 0x1F3364 Kw_Wu8 4.000 OneToOne 1.000 5.000 FORMAT "%5.3" EXTENDED_LIMITS 0.00 255.0 /end CHARACTERISTIC
/begin CHARACTERISTIC VSSCD_DebBrkLowVltgDef_C "Fehlerentprellzeit für Geschwindigkeitssensorunterspannung aus BRK1" VALUE 0x1F3366 Kw_Wu16 655350.0 Time_ms 0.00 655350.0 FORMAT "%8.1" /end CHARACTERISTIC
/begin CHARACTERISTIC VSSCD_DebBrkLowVltgOk_C "Heilzeit für Geschwindigkeitssensorunterspannung in BRK1" VALUE 0x1F3368 Kw_Wu16 655350.0 Time_ms 0.00 655350.0 FORMAT "%8.1" /end CHARACTERISTIC
/begin CHARACTERISTIC VSSCD_DebCanMsgSigDef_C "Defekt-Entprellzeit CAN-spezifischer Botschaftsfehler für Fahrgeschwindigkeit" VALUE 0x1F336A Kw_Wu16 655350.0 Time_ms 0.00 655350.0 FORMAT "%8.1" /end CHARACTERISTIC
/begin CHARACTERISTIC VSSCD_DebCanMsgSigOk_C "Heil-Entprellzeit CAN-spezifischer Botschaftsfehler für Fahrgeschwindigkeit" VALUE 0x1F336C Kw_Wu16 655350.0 Time_ms 0.00 655350.0 FORMAT "%8.1" /end CHARACTERISTIC
/begin CHARACTERISTIC VSSCD_tiDebCANSigDef_C "Entprellzeit CAN-Signalfehler" VALUE 0x1F336E Kw_Wu16 655350.0 Time_ms 0.00 655350.0 FORMAT "%8.1" /end CHARACTERISTIC
/begin CHARACTERISTIC VSSCD_tiDebCANSigOk_C "Heilungszeit CAN-Signalfehler" VALUE 0x1F3370 Kw_Wu16 655350.0 Time_ms 0.00 655350.0 FORMAT "%8.1" /end CHARACTERISTIC
/begin CHARACTERISTIC VSSCD_DebCanSigDef_C "Entprellzeit CAN Signal für Fahrgeschwindigkeit defekt" VALUE 0x1F3372 Kw_Wu16 655350.0 Time_ms 0.00 655350.0 FORMAT "%8.1" /end CHARACTERISTIC
/begin CHARACTERISTIC VSSCD_DebCanSigOk_C "Entprellzeit Heilung CAN-Signal für Fahrgeschwindigkeit" VALUE 0x1F3374 Kw_Wu16 655350.0 Time_ms 0.00 655350.0 FORMAT "%8.1" /end CHARACTERISTIC
/begin CHARACTERISTIC VSSCD_DebMaxDef_C "Entprellzeit für Defekterkennung bei Maximumtest der Fahrgeschwindigkeit" VALUE 0x1F3376 Kw_Wu16 655350.0 Time_ms 0.00 655350.0 FORMAT "%8.1" /end CHARACTERISTIC
/begin CHARACTERISTIC VSSCD_DebMaxOk_C "Entprellzeit für Heilung bei Maximumtest der Fahrgeschwindigkeit" VALUE 0x1F3378 Kw_Wu16 655350.0 Time_ms 0.00 655350.0 FORMAT "%8.1" /end CHARACTERISTIC
/begin CHARACTERISTIC VSSCD_DebPlaDef_C "Entprellzeit für Defekterkennung bei Plausibilitätstest der Fahrgeschwindigkeit" VALUE 0x1F337A Kw_Wu16 655350.0 Time_ms 0.00 655350.0 FORMAT "%8.1" /end CHARACTERISTIC
/begin CHARACTERISTIC VSSCD_DebPlaOk_C "Entprellzeit für Heilung bei Plausibilitätstest der Fahrgeschwindigkeit" VALUE 0x1F337C Kw_Wu16 655350.0 Time_ms 0.00 655350.0 FORMAT "%8.1" /end CHARACTERISTIC
/begin CHARACTERISTIC VSSCD_DebSigDef_C "Entprellzeit defekt für ungültiges Eingangssignal Fahrgeschwindigkeit" VALUE 0x1F337E Kw_Wu16 655350.0 Time_ms 0.00 655350.0 FORMAT "%8.1" /end CHARACTERISTIC
/begin CHARACTERISTIC VSSCD_DebSigOk_C "Entprellzeit für Heilung ungültiges Eingangssignal der Fahrgeschwindigkeit" VALUE 0x1F3380 Kw_Wu16 655350.0 Time_ms 0.00 655350.0 FORMAT "%8.1" /end CHARACTERISTIC
/begin CHARACTERISTIC VSSCD_DebPlausDef_C "Fahrgeschwindigkeitssignal Defekterkennungszeit fuer Plausibilitaetsfehler mit Schub" VALUE 0x1F3382 Kw_Wu16 655350.0 Time_ms 0.00 655350.0 FORMAT "%8.1" /end CHARACTERISTIC
/begin CHARACTERISTIC VSSCD_DebPlausOk_C "Fahrgeschwindigkeitssignal Heilzeit fuer Plausibilitaetsfehler mit Schub" VALUE 0x1F3384 Kw_Wu16 655350.0 Time_ms 0.00 655350.0 FORMAT "%8.1" /end CHARACTERISTIC
/begin CHARACTERISTIC VSSCD_ImpPerDist_C "Streckenfaktor: FGG-Impulse pro Strecke" VALUE 0x1F33DC Kw_Wu32 17.500000000000000 VSS_DistFac 2.5000000000000000 20.000000000000000 FORMAT "%20.17" EXTENDED_LIMITS 0.83819031734908711 3600000000.0000000 /end CHARACTERISTIC
/begin CHARACTERISTIC VSSCD_nMinErr_C "Minimalschwelle für die Geschwindigkeit um einen Fehler zu erkennen" VALUE 0x1F3386 Kw_Ws16 32767.00 EngN 0.00 32767.00 FORMAT "%8.2" EXTENDED_LIMITS -32768.00 32767.00 /end CHARACTERISTIC
/begin CHARACTERISTIC VSSCD_nThresPla_C "Drehzahschwelle für NPL-Test der Fahrgeschwindigkeit" VALUE 0x1F3388 Kw_Ws16 32767.00 EngN 0.00 32767.00 FORMAT "%8.2" EXTENDED_LIMITS -32768.00 32767.00 /end CHARACTERISTIC
/begin CHARACTERISTIC VSSCD_numSegSens_C "Anzahl der Segmente des FGG" VALUE 0x1F338A Kw_Wu8 8.000 OneToOne 4.000 12.00 FORMAT "%5.2" EXTENDED_LIMITS 0.00 255.0 /end CHARACTERISTIC
/begin CHARACTERISTIC VSSCD_qThresPla_C "Einspritzschwelle für NPL-Test der Fahrgeschwindigkeit" VALUE 0x1F338C Kw_Ws16 327.6700 InjMass 0.00 327.6700 FORMAT "%8.4" EXTENDED_LIMITS -327.6800 327.6700 /end CHARACTERISTIC
/begin CHARACTERISTIC VSSCD_daRmpSlpUp_C "Rampensteigung für Übergang auf Defektwert" VALUE 0x1F3390 Kw_Wu32 5.00000000000 RmpAcc 0.00 5.00000000000 FORMAT "%13.11" EXTENDED_LIMITS 0.00 65535.9999847 /end CHARACTERISTIC
/begin CHARACTERISTIC VSSCD_daRmpSlpDwn_C "Rampensteigung für Übergang auf Defektwert" VALUE 0x1F3394 Kw_Wu32 5.00000000000 RmpAcc 0.00 5.00000000000 FORMAT "%13.11" EXTENDED_LIMITS 0.00 65535.9999847 /end CHARACTERISTIC
/begin CHARACTERISTIC VSSCD_stSensIDWord_C "Variantenschalter Defektverhalten" VALUE 0x1F3398 Kw_Wu8 5.000 OneToOne 0.00 5.000 FORMAT "%5.3" EXTENDED_LIMITS 0.00 255.0 /end CHARACTERISTIC
/begin CHARACTERISTIC VSSCD_swtAccSrc_C "Auswahlschalter für Quelle der Fahrzeugbeschleunigung" VALUE 0x1F3399 Kw_Wu8 1.000 OneToOne 0.00 1.000 FORMAT "%5.3" EXTENDED_LIMITS 0.00 255.0 /end CHARACTERISTIC
/begin CHARACTERISTIC VSSCD_swtSigVal_C "Signalquelle Fahrgeschwindigkeit, Datensatzwert für SW-Schalter VSSCD_swtSig (0: HW FGG, 1: CAN)" VALUE 0x1F339A Kw_Wu8 5.000 OneToOne 0.00 5.000 FORMAT "%5.3" EXTENDED_LIMITS 0.00 255.0 /end CHARACTERISTIC
/begin CHARACTERISTIC VSSCD_swtSigType_C "Einlesen SW-Schalter VSSCD_swtSig aus E2PROM (1) oder VSSCD_swtSigVal_C (2) bei Ini." VALUE 0x1F339B Kw_Wu8 1.000 OneToOne 1.000 2.000 FORMAT "%5.3" EXTENDED_LIMITS 0.00 255.0 /end CHARACTERISTIC
/begin CHARACTERISTIC VSSCD_tiAccFlt_CUR "Filterzeitkonstante für nichtlineare Filterung der Beschleunigung" CURVE 0x1F339C Kl_Xs16_Ws16 3999.990 Time_s 0.01000000 4000.000 FORMAT "%8.3" EXTENDED_LIMITS -327.6800 327.6700
 /begin AXIS_DESCR STD_AXIS VSSCD_aFilt1 Acc 8 -3.200000 3.200000 FORMAT "%8.6" EXTENDED_LIMITS -32.76800 32.76700 DEPOSIT ABSOLUTE /end AXIS_DESCR
/end CHARACTERISTIC
/begin CHARACTERISTIC VSSCD_tiAPT1_C "Zeitkonstante Filterung Fahrbeschleunigung" VALUE 0x1F33C0 Kw_Wu32 4294.9673 TimeDelay_s 0.0000010000000 4294.9673 FORMAT "%9.4" /end CHARACTERISTIC
/begin CHARACTERISTIC VSSCD_tiPlausOvrRun_C "Fahrgeschwindigkeitsignal Timer fuer Plausibilitaet mit Schub" VALUE 0x1F33C4 Kw_Wu16 655350.0 Time_ms 0.00 655350.0 FORMAT "%8.1" /end CHARACTERISTIC
/begin CHARACTERISTIC VSSCD_tiPT1_C "Zeitkonstante Beschleunigungsfilter 1" VALUE 0x1F33C8 Kw_Wu32 4294.9673 TimeDelay_s 0.0000010000000 4294.9673 FORMAT "%9.4" /end CHARACTERISTIC
/begin CHARACTERISTIC VSSCD_tiVPT1_C "Zeitkonstante Filterung Fahrgeschwindigkeit" VALUE 0x1F33CC Kw_Wu32 4294.9673 TimeDelay_s 0.0000010000000 4294.9673 FORMAT "%9.4" /end CHARACTERISTIC
/begin CHARACTERISTIC VSSCD_vDfl_C "Vorgabewert Fahrgeschwindigkeit" VALUE 0x1F33D0 Kw_Ws16 327.6700 Vel 0.00 327.6700 FORMAT "%8.4" EXTENDED_LIMITS -327.6800 327.6700 /end CHARACTERISTIC
/begin CHARACTERISTIC VSSCD_vMax_C "v-Schwelle für Max-Test der Fahrgeschwindigkeit" VALUE 0x1F33D2 Kw_Ws16 327.6700 Vel 0.00 327.6700 FORMAT "%8.4" EXTENDED_LIMITS -327.6800 327.6700 /end CHARACTERISTIC
/begin CHARACTERISTIC VSSCD_vMin_C "Minimum-Schwelle für v=0 Erkennung" VALUE 0x1F33D4 Kw_Ws16 20.00000 Vel 0.00 20.00000 FORMAT "%8.5" EXTENDED_LIMITS -327.6800 327.6700 /end CHARACTERISTIC
/begin CHARACTERISTIC VSSCD_vRawMin_C "Fahrgeschwindigkeitssignal Rohwert Minimum Schwelle für Plausibilität mit Schub" VALUE 0x1F33D6 Kw_Ws16 5.000000 Vel 0.00 5.000000 FORMAT "%8.6" EXTENDED_LIMITS -327.6800 327.6700 /end CHARACTERISTIC
/begin CHARACTERISTIC VSSCD_vThresPla_C "v-Schwelle für NPL-Test der Fahrgeschwindigkeit" VALUE 0x1F33D8 Kw_Ws16 327.6700 Vel 0.00 327.6700 FORMAT "%8.4" EXTENDED_LIMITS -327.6800 327.6700 /end CHARACTERISTIC
/begin COMPU_METHOD Acc "Fahrzeugbeschleunigung" RAT_FUNC "%6.5" "[m/s^2]" COEFFS 0 1000 0 0 0 1 /end COMPU_METHOD
/begin COMPU_METHOD AirVolPerTime "Umrechnungsformel für Luftvolumenstrom" RAT_FUNC "%6.3" "m^3/h" COEFFS 0 10 0 0 0 1 /end COMPU_METHOD
/begin COMPU_METHOD AngleHResCrS "Kurbelwellenwinkel in erhöhter Auflösung (Faktor FACT_ANG_HRES gegenüber normaler Auflösung)" RAT_FUNC "%6.5" "[deg CrS]" COEFFS 0 5461.33333333334 0 0 0 1 /end COMPU_METHOD
/begin COMPU_METHOD AngleRad "Winkelanzeige in Radians" RAT_FUNC "%7.6" "[rad]" COEFFS 0 10000 0 0 0 1 /end COMPU_METHOD
/begin COMPU_METHOD Curr_A "Umrechnung für Strom in Ampere" RAT_FUNC "%6.4" "A" COEFFS 0 100 0 0 0 1 /end COMPU_METHOD
/begin COMPU_METHOD Dist1 "Umrechnungsformel für Strecke in km" RAT_FUNC "%6.0" "[km]" COEFFS 0 0.002 0 0 0 1 /end COMPU_METHOD
/begin COMPU_METHOD DtyCyc "Tastverhaeltnis" RAT_FUNC "%6.4" "[%]" COEFFS 0 100 0 0 0 1 /end COMPU_METHOD
/begin COMPU_METHOD DtyCycSlp "Konvertierungsformel fuer Duty Cycle mit einer Steigungsaufloesung von 0.001" RAT_FUNC "%6.5" "%/s" COEFFS 0 1000 0 0 0 1 /end COMPU_METHOD
/begin COMPU_METHOD EngN "Motordrehzahl" RAT_FUNC "%6.2" "[rpm]" COEFFS 0 1 0 0 0 1 /end COMPU_METHOD
/begin COMPU_METHOD Fact "Faktor mit Auflösung 1 / 8192, hauptsächlich für einen Faktorenbereich 0...1 verwendet" RAT_FUNC "%6.5" "[-]" COEFFS 0 8192 0 0 0 1 /end COMPU_METHOD
/begin COMPU_METHOD Fact1 "Faktor mit Auflösung 0,01 (100 mal höherer Bereich als Fact)" RAT_FUNC "%6.4" "[-]" COEFFS 0 128 0 0 0 1 /end COMPU_METHOD
/begin COMPU_METHOD FactHigh "Faktor mit Auflösung 1/4096, hauptsächlich für einen Faktorenbereich 0.1...10 verwendet" RAT_FUNC "%7.6" "[-]" COEFFS 0 10000 0 0 0 1 /end COMPU_METHOD
/begin COMPU_METHOD FacTrigFct "Umrechnungsformel für trigonometrische Funktionen (Sinus / Cosinus)" RAT_FUNC "%6.5" "[-]" COEFFS 0 4096 0 0 0 1 /end COMPU_METHOD
/begin COMPU_METHOD Fact_WearSoot "Umrechnung für Ruß/Verschleißerfassungsfaktor" RAT_FUNC "%6.3" "[-]" COEFFS 0 10 0 0 0 1 /end COMPU_METHOD
/begin COMPU_METHOD FricCoeff "Friktion Koeffizient in [N/(km/hr)^2]" RAT_FUNC "%7.6" "[N/(km/hr)^2]" COEFFS 0 10000 0 0 0 1 /end COMPU_METHOD
/begin COMPU_METHOD Friction "Friktion oder Widerstand in [N]" RAT_FUNC "%6.2" "[Kgm/s^2]" COEFFS 0 1 0 0 0 1 /end COMPU_METHOD
/begin COMPU_METHOD GlwCtl_Time_ms "zur Zeitumrechnung von um den Faktor 10 größeren Zeiten als Time_ms" RAT_FUNC "%6.0" "[ms]" COEFFS 0 0.01 0 0 0 1 /end COMPU_METHOD
/begin COMPU_METHOD InjMass "Einspritzmenge" RAT_FUNC "%6.4" "[mg/hub]" COEFFS 0 100 0 0 0 1 /end COMPU_METHOD
/begin COMPU_METHOD InjMassInj "Einspritzmenge pro Einspritzung (mg/Einspritzung)" RAT_FUNC "%6.4" "[mg/inj]" COEFFS 0 100 0 0 0 1 /end COMPU_METHOD
/begin COMPU_METHOD Kd "Differentialverstärkung Kd (gleiche Einheit/Umrechnungsformel an Ein- und Ausgang)" RAT_FUNC "%7.6" "[1/1]" COEFFS 0 65536 0 0 0 1 /end COMPU_METHOD
/begin COMPU_METHOD Ki "Integrale Verstärkung Ki (gleiche Einheit/Umrechnungsregel an Ein- und Ausgang)" RAT_FUNC "%6.5" "[1/s]" COEFFS 0 4294.967296 0 0 0 1 /end COMPU_METHOD
/begin COMPU_METHOD Ki_ThrVlv "Integrationsverstärkung für Losreißfunktion" RAT_FUNC "%6.4" "1/s" COEFFS 0 65 0 0 0 1 /end COMPU_METHOD
/begin COMPU_METHOD Ki_Vel2TrqPrp "Integralverstärkung (Fahrgeschwindigkeit zu Vortriebsmoment)" RAT_FUNC "%6.4" "[Nm/(Km/h)/s]" COEFFS 0 26.8435456 0 0 0 1 /end COMPU_METHOD
/begin COMPU_METHOD Kp "proportionale Verstärkung Kp (gleiche Einheit/Umrechnungsregel an Ein- und Ausgang)" RAT_FUNC "%7.6" "[1/1]" COEFFS 0 65536 0 0 0 1 /end COMPU_METHOD
/begin COMPU_METHOD Kp_Vel2TrqPrp "Proportionalverstärkung (Fahrgeschwindigkeit zu Vortriebsmoment)" RAT_FUNC "%6.4" "[Nm/(Km/h)]" COEFFS 0 409.6 0 0 0 1 /end COMPU_METHOD
/begin COMPU_METHOD Length "Länge in Meter" RAT_FUNC "%6.2" "[m]" COEFFS 0 1 0 0 0 1 /end COMPU_METHOD
/begin COMPU_METHOD Length1_mm "Umrechnungsformel für Länge in mm" RAT_FUNC "%6.4" "[mm]" COEFFS 0 250 0 0 0 1 /end COMPU_METHOD
/begin COMPU_METHOD NumPinAdc "verbale Umrechnung für ADC Signale" TAB_VERB "%6.3" "" COMPU_TAB_REF NumPinAdc /end COMPU_METHOD
/begin COMPU_VTAB NumPinAdc "verbale Umrechnung für ADC Signale" TAB_VERB 5 2 "Exhaust_Gas_Recirculation_Sensor" 14 "Throttle_Valve_Position_Sensor" 17 "Fuel_Temperature_Sensor" 24 "1st_APP_Sensor" 25 "2nd_APP_Sensor" /end COMPU_VTAB
/begin COMPU_METHOD NumPinDia "Verbale Umrechnung für Diagnose Signale" TAB_VERB "%6.3" "" COMPU_TAB_REF NumPinDia /end COMPU_METHOD
/begin COMPU_VTAB NumPinDia "Verbale Umrechnung für Diagnose Signale" TAB_VERB 4 1 "Glow_Relay_DiaSig" 8 "EGR_Actuator_DiaSig" 13 "Throttle_Valve_Actuator_DiaSig" 21 "Glw_Sys_GSK3_DiaSig" /end COMPU_VTAB
/begin COMPU_METHOD NumPinDioOut "Verbale Umrechnung für Digitalausgang Signale" TAB_VERB "%6.3" "" COMPU_TAB_REF NumPinDioOut /end COMPU_METHOD
/begin COMPU_VTAB NumPinDioOut "Verbale Umrechnung für Digitalausgang Signale" TAB_VERB 4 0 "Glow_Relay" 20 "Glow_Lamp" 21 "EGR_Disable_HBridge" 22 "TVA_Disable_HBridge" /end COMPU_VTAB
/begin COMPU_METHOD NumPinPwmOut "Verbale Umrechnung für PWM-Ausgang Signale" TAB_VERB "%6.3" "" COMPU_TAB_REF NumPinPwmOut /end COMPU_METHOD
/begin COMPU_VTAB NumPinPwmOut "Verbale Umrechnung für PWM-Ausgang Signale" TAB_VERB 7 2 "GlwSys_GSK3_Actuator" 3 "Throttle_Valve_Actuator" 5 "EGR_Actuator1" 6 "EGR_Actuator2" 7 "Throttle_Valve_HBridge1" 8 "Throttle_Valve_HBridge2" 13 "EGR_Actuator" /end COMPU_VTAB
/begin COMPU_METHOD OneToOne "eins zu eins (physikalischer Wert ist gleich dem internen Wert)" RAT_FUNC "%6.2" "[-]" COEFFS 0 1 0 0 0 1 /end COMPU_METHOD
/begin COMPU_METHOD Period "Periodendauer" RAT_FUNC "%6.3" "[ms]" COEFFS 0 10 0 0 0 1 /end COMPU_METHOD
/begin COMPU_METHOD PhiSteer "Lenkwinkel in Grad, Umrechnung vom CAN in internen Wert" RAT_FUNC "%6.3" "[deg]" COEFFS 0 10 0 0 0 1 /end COMPU_METHOD
/begin COMPU_METHOD Prc "Prozent, gleiche interne Auflösung wie Fact, aber Darstellung in Prozent (0...100%)" RAT_FUNC "%6.4" "[%]" COEFFS 0 100 0 0 0 1 /end COMPU_METHOD
/begin COMPU_METHOD PresAC_hPa "Druck (Klimatisierung) angezeigt in [hPa]" RAT_FUNC "%6.2" "[hPa]" COEFFS 0 0.5 0 0 0 1 /end COMPU_METHOD
/begin COMPU_METHOD Pres_hPa "Druck (angezeigt in [hPa])" RAT_FUNC "%6.2" "[hPa]" COEFFS 0 1 0 0 0 1 /end COMPU_METHOD
/begin COMPU_METHOD Pwr "Leistung" RAT_FUNC "%6.2" "[W]" COEFFS 0 0.10610329539459 0 0 0 1 /end COMPU_METHOD
/begin COMPU_METHOD RatVolLength1 "Umrechnungsformel für Liter/mm" RAT_FUNC "%6.4" "[ml/mm]" COEFFS 0 128 0 0 0 1 /end COMPU_METHOD
/begin COMPU_METHOD RmpAcc "Beschleunigungsrampe - Gradient" RAT_FUNC "%7.6" "[m/s^2/s]" COEFFS 0 65536 0 0 0 1 /end COMPU_METHOD
/begin COMPU_METHOD RmpDtyCyc "Rampengradient für Tastverhältnis" RAT_FUNC "%6.5" "[%/s]" COEFFS 0 6553.6 0 0 0 1 /end COMPU_METHOD
/begin COMPU_METHOD RmpPrc "Prozent Rampengradient" RAT_FUNC "%6.5" "[%/s]" COEFFS 0 6553.6 0 0 0 1 /end COMPU_METHOD
/begin COMPU_METHOD RmpPresAC_hPa "Rampenanstieg für Klimaanlagendruck angezeigt in [hPa/s]" RAT_FUNC "%6.4" "[hPa/s]" COEFFS 0 32.768 0 0 0 1 /end COMPU_METHOD
/begin COMPU_METHOD RmpTrq "Rampengradient für Motormoment" RAT_FUNC "%6.4" "[Nm/s]" COEFFS 0 655.36 0 0 0 1 /end COMPU_METHOD
/begin COMPU_METHOD RmpVoltBatt "Rampengradient für Batteriespannung" RAT_FUNC "%6.3" "[mV/s]" COEFFS 0 3.22602867866423 0 0 0 1 /end COMPU_METHOD
/begin COMPU_METHOD SigTstName "Verbale Umrechnung für Stellertest Referenz Nummern" TAB_VERB "%6.3" "[-]" COMPU_TAB_REF SigTstName /end COMPU_METHOD
/begin COMPU_VTAB SigTstName "Verbale Umrechnung für Stellertest Referenz Nummern" TAB_VERB 37 0 "SigTst_AC" 1 "SigTst_AFV" 2 "SigTst_AOHtCDHt1" 3 "SigTst_AOHtCDHt2" 4 "SigTst_AltRLYExc" 5 "SigTst_BPA" 6 "SigTst_BPA2" 7 "SigTst_CtAp" 8 "SigTst_CtT" 9 "SigTst_EGR" 10 "SigTst_EGRClgBypVlv" 11 "SigTst_ENGMENG" 12 "SigTst_ENGMENG1" 13 "SigTst_ENGMENG2" 14 "SigTst_ENGMGEAR" 15 "SigTst_ENGMGEAR1" 16 "SigTst_ENGMGEAR2" 17 "SigTst_EngM" 18 "SigTst_Fan1" 19 "SigTst_Fan2" 20 "SigTst_FlClgCD" 21 "SigTst_FlPpCD" 22 "SigTst_GLWLAMP" 23 "SigTst_GLWRLY" 24 "SigTst_GLWRLYGSK3" 25 "SigTst_LSUCDHt0" 26 "SigTst_MILLAMP" 27 "SigTst_PFltLmp" 28 "SigTst_PFltRLYHtg" 29 "SigTst_PSP" 30 "SigTst_SYSLAMP" 31 "SigTst_StrtCDRLYOffRly" 32 "SigTst_StrtCDRLYOnRly" 33 "SigTst_TVA" 34 "SigTst_VSA" 35 "SigTst_WDAL" 255 "SigTst_unused" /end COMPU_VTAB
/begin COMPU_METHOD Temp_Cels "Temperatur dargestellt in °C (gleiche interne Darstellung wie Temp_Kelv)" RAT_FUNC "%6.1" "[deg C]" COEFFS 0 10 2731.4 0 0 1 /end COMPU_METHOD
/begin COMPU_METHOD TimeDeb "Entprellzeit in Millisekunden für Libraryfunktion Debounce" RAT_FUNC "%6.1" "[ms]" COEFFS 0 0.1 0 0 0 1 /end COMPU_METHOD
/begin COMPU_METHOD TimeDelay_s "Zeitkonstante T1 (in s) für PT1, DT1, etc." RAT_FUNC "%9.3" "[s]" COEFFS 0 0 1 0 0.00023283064365387 0 /end COMPU_METHOD
/begin COMPU_METHOD TimeEngOn "Motorbetriebszeit in Sekunden" RAT_FUNC "%6.2" "[s]" COEFFS 0 1 0 0 0 1 /end COMPU_METHOD
/begin COMPU_METHOD TimeUSResolution "Zeit in Mikrosekunden für TPU Zeiten, Auflösung 1 us" RAT_FUNC "%6.2" "[us]" COEFFS 0 1 0 0 0 1 /end COMPU_METHOD
/begin COMPU_METHOD Time_ms "Zeit in ms für Fehlerentprellung (DSM) und SW-Timer" RAT_FUNC "%6.1" "[ms]" COEFFS 0 0.1 0 0 0 1 /end COMPU_METHOD
/begin COMPU_METHOD Time_msUI "Zeit in ms ohne Auflösung" RAT_FUNC "%6.2" "[ms]" COEFFS 0 1 0 0 0 1 /end COMPU_METHOD
/begin COMPU_METHOD Time_RtmLowRes "Zeit mit niedriger Auflösung für Laufzeitmessung" RAT_FUNC "%6.3" "[ms]" COEFFS 0 10 0 0 0 1 /end COMPU_METHOD
/begin COMPU_METHOD Time_s "Zeit in s für Fehlerentprellung (DSM) und SW-Timer" RAT_FUNC "%6.4" "[s]" COEFFS 0 100 0 0 0 1 /end COMPU_METHOD
/begin COMPU_METHOD TrnvrsAcc "Umrechnung für Querbeschleunigung" RAT_FUNC "%6.4" "[g]" COEFFS 0 100 0 0 0 1 /end COMPU_METHOD
/begin COMPU_METHOD Trq "Motormoment" RAT_FUNC "%6.3" "[Nm]" COEFFS 0 10 0 0 0 1 /end COMPU_METHOD
/begin COMPU_METHOD TrqPrp "Vortriebsmoment" RAT_FUNC "%6.2" "[Nm]" COEFFS 0 0.625 0 0 0 1 /end COMPU_METHOD
/begin COMPU_METHOD TrqPrpHigh "vortriebsmoment" RAT_FUNC "%6.3" "[Nm]" COEFFS 0 10 0 0 0 1 /end COMPU_METHOD
/begin COMPU_METHOD VehMass "Fahrzeugmasse in Kg" RAT_FUNC "%6.3" "[Kg]" COEFFS 0 10 0 0 0 1 /end COMPU_METHOD
/begin COMPU_METHOD Vel "Fahrzeuggeschwindigkeit, gleiche interne Auflösung wie Vel_SI" RAT_FUNC "%6.4" "[km/h]" COEFFS 0 100 0 0 0 1 /end COMPU_METHOD
/begin COMPU_METHOD VelToN "Verhältnis Fahrzeuggeschwindigkeit zu Motordrehzahl v/n" RAT_FUNC "%8.7" "[(km/h)/rpm]" COEFFS 0 100000 0 0 0 1 /end COMPU_METHOD
/begin COMPU_METHOD Volt "Spannung in V (von ADC)" RAT_FUNC "%6.2" "[mV]" COEFFS 0 0.2046 0 0 0 1 /end COMPU_METHOD
/begin COMPU_METHOD Volt_Batt "Batteriespannung" RAT_FUNC "%6.1" "[mV]" COEFFS 0 0.0492252911173131 0 0 0 1 /end COMPU_METHOD
/begin COMPU_METHOD Volt_Batt_PerSec_20ms "Batteriespannung (mit Aufweitungsfaktor) pro Sekunde (für 20ms Task) - [(du/dt) mV/s]" RAT_FUNC "%6.1" "[mV/s]" COEFFS 0 0.0984505822346261 0 0 0 1 /end COMPU_METHOD
/begin COMPU_METHOD VPhiSteer "Lenkwinkelgeschwindigkeit in Grad, Umrechnung vom CAN in internen Wert" RAT_FUNC "%6.3" "[deg/s]" COEFFS 0 10 0 0 0 1 /end COMPU_METHOD
/begin COMPU_METHOD VSS_DistFac "Streckenfaktor für FGG" RAT_FUNC "%20.2" "[Imp/m]" COEFFS 0 0 1 0 2.77777777777778e-10 0 /end COMPU_METHOD
/begin RECORD_LAYOUT Kf_Xs16_Ys16_Ws16 NO_AXIS_PTS_X 1 SWORD NO_AXIS_PTS_Y 2 SWORD AXIS_PTS_X 3 SWORD INDEX_INCR DIRECT AXIS_PTS_Y 4 SWORD INDEX_INCR DIRECT FNC_VALUES 5 SWORD COLUMN_DIR DIRECT /end RECORD_LAYOUT
/begin RECORD_LAYOUT Kl_Xs16_Ws16 NO_AXIS_PTS_X 1 SWORD AXIS_PTS_X 2 SWORD INDEX_INCR DIRECT FNC_VALUES 3 SWORD COLUMN_DIR DIRECT /end RECORD_LAYOUT
/begin RECORD_LAYOUT Kwb_Ws16 FNC_VALUES 1 SWORD COLUMN_DIR DIRECT /end RECORD_LAYOUT
/begin RECORD_LAYOUT Kwb_Wu16 FNC_VALUES 1 UWORD COLUMN_DIR DIRECT /end RECORD_LAYOUT
/begin RECORD_LAYOUT Kwb_Wu8 FNC_VALUES 1 UBYTE COLUMN_DIR DIRECT /end RECORD_LAYOUT
/begin RECORD_LAYOUT Kw_Ws16 FNC_VALUES 1 SWORD COLUMN_DIR DIRECT /end RECORD_LAYOUT
/begin RECORD_LAYOUT Kw_Ws32 FNC_VALUES 1 SLONG COLUMN_DIR DIRECT /end RECORD_LAYOUT
/begin RECORD_LAYOUT Kw_Wu16 FNC_VALUES 1 UWORD COLUMN_DIR DIRECT /end RECORD_LAYOUT
/begin RECORD_LAYOUT Kw_Wu32 FNC_VALUES 1 ULONG COLUMN_DIR DIRECT /end RECORD_LAYOUT
/begin RECORD_LAYOUT Kw_Wu8 FNC_VALUES 1 UBYTE COLUMN_DIR DIRECT /end RECORD_LAYOUT
/begin FUNCTION PrpCtl_MaxSpdLim "Höchstgeschwindigkeitsbegrenzung"
 /begin DEF_CHARACTERISTIC PrpCtl_Off4IKiNeg_C PrpCtl_Off4IKiPos_C PrpCtl_Off4IKi_C PrpCtl_Off4PKpNeg_C PrpCtl_Off4PKpPos_C PrpCtl_Off4PKp_C PrpCtl_Off5IKiNeg_C PrpCtl_Off5IKiPos_C PrpCtl_Off5IKi_C PrpCtl_Off5PKpNeg_C PrpCtl_Off5PKpPos_C PrpCtl_Off5PKp_C PrpCtl_OffLoGearIKiNeg_C PrpCtl_OffLoGearIKiPos_C PrpCtl_OffLoGearIKi_C PrpCtl_OffLoGearPKpNeg_C PrpCtl_OffLoGearPKpPos_C PrpCtl_OffLoGearPKp_C PrpCtl_On4IKiNeg_C PrpCtl_On4IKiPos_C PrpCtl_On4IKi_C PrpCtl_On4PKpNeg_C PrpCtl_On4PKpPos_C PrpCtl_On4PKp_C PrpCtl_On5IKiNeg_C PrpCtl_On5IKiPos_C PrpCtl_On5IKi_C PrpCtl_On5PKpNeg_C PrpCtl_On5PKpPos_C PrpCtl_On5PKp_C PrpCtl_OnLoGearIKiNeg_C PrpCtl_OnLoGearIKiPos_C PrpCtl_OnLoGearIKi_C PrpCtl_OnLoGearPKpNeg_C PrpCtl_OnLoGearPKpPos_C PrpCtl_OnLoGearPKp_C PrpCtl_facGovInit_CUR PrpCtl_swtHGB2Ena_C PrpCtl_swtHGBEna_C PrpCtl_swtVehAcc_C PrpCtl_trqAWDLim_CUR PrpCtl_trqNIVEAULim_CUR PrpCtl_trqSpdTrackOff_C PrpCtl_vOff4IWinNeg_C PrpCtl_vOff4IWinPos_C PrpCtl_vOff4PWinNeg_C PrpCtl_vOff4PWinPos_C PrpCtl_vOff5IWinNeg_C PrpCtl_vOff5IWinPos_C PrpCtl_vOff5PWinNeg_C PrpCtl_vOff5PWinPos_C PrpCtl_vOffLoGearIWinNeg_C PrpCtl_vOffLoGearIWinPos_C PrpCtl_vOffLoGearPWinNeg_C PrpCtl_vOffLoGearPWinPos_C PrpCtl_vOn4IWinNeg_C PrpCtl_vOn4IWinPos_C PrpCtl_vOn4PWinNeg_C PrpCtl_vOn4PWinPos_C PrpCtl_vOn5IWinNeg_C PrpCtl_vOn5IWinPos_C PrpCtl_vOn5PWinNeg_C PrpCtl_vOn5PWinPos_C PrpCtl_vOnLoGearIWinNeg_C PrpCtl_vOnLoGearIWinPos_C PrpCtl_vOnLoGearPWinNeg_C PrpCtl_vOnLoGearPWinPos_C PrpCtl_vSpdLimThreshBck_C PrpCtl_vSpdLimTrmValLo_C /end DEF_CHARACTERISTIC
/end FUNCTION
/begin FUNCTION PrpCtl_MaxSpdLimExt "Höchstgeschwindigkeitsbegrenzung durch externe Steuergeräte"
 /begin DEF_CHARACTERISTIC PrpCtl_VSSCDAWDMax_C PrpCtl_VSSCDNiveauMax_C PrpCtl_rFltMin_C PrpCtl_swtAWD1Rls_C PrpCtl_swtEnaLimAWD1_C PrpCtl_swtEnaLimNIVEAU1_C PrpCtl_swtNIVEAU1Rls_C PrpCtl_swtNoAPPLim_C PrpCtl_tiAPPCDMin_C PrpCtl_vLimAWDMax_C PrpCtl_vLimAWDMin_C PrpCtl_vNiveauLimOffset_C PrpCtl_vNiveauMax_C /end DEF_CHARACTERISTIC
/end FUNCTION
/begin FUNCTION PrpCtl_SpdLimMode "Vortriebsregelung - Geschwindigkeitsbegrenzer Modusauswahl"
 /begin DEF_CHARACTERISTIC PrpCtl_tiSpdLimPT1_C PrpCtl_vSpdLimMax_C PrpCtl_vSpdLimThreshFree_C PrpCtl_vSpdLimThreshOff_C PrpCtl_vSpdLimThreshOn_C /end DEF_CHARACTERISTIC
/end FUNCTION
/begin FUNCTION Prp_DemSel "Anforderungs-Auswahl"
 /begin DEF_CHARACTERISTIC Prp_swtCCOnType_C Prp_swtCCOnVal_C Prp_swtCCSelType_C Prp_swtCCSelVal_C /end DEF_CHARACTERISTIC
/end FUNCTION
/begin FUNCTION Prp_VirtAPP "virtuelle Fahrpedalstellung"
 /begin DEF_CHARACTERISTIC Prp_drAPPDwn_C Prp_drAPPUp_C Prp_rAPPMax_C Prp_rEngLow_CUR Prp_rEngLow_MAP Prp_rEngRelLow_MAP Prp_rEngRel_MAP Prp_rEng_CUR Prp_rEng_MAP Prp_rTrqLimThres_C Prp_swtMapRel_C Prp_swtrAPPMaxVal_C Prp_swtrAPP_C Prp_swtrEngCur_C Prp_trqThresEng_CUR /end DEF_CHARACTERISTIC
/end FUNCTION
/begin FUNCTION PrsPrt "Personenschutz" /begin SUB_FUNCTION AirbCD /end SUB_FUNCTION /end FUNCTION
/begin FUNCTION Rail_SetPointEnvCorSlowPermRgn "Weighing factor calculation  for permanent  regeneration"
 /begin DEF_CHARACTERISTIC ACCCD_aGvtyGnd_C ACCCD_aLongPhiCor_C ACCCD_facATrnvrs_CUR ACCCD_facCosPhi_CUR ACCCD_facCwVal_C ACCCD_facEnv_MAP ACCCD_facSinPhi_CUR ACCCD_frStrtFrc_CUR ACCCD_mVehRef_C ACCCD_phiArcSin_CUR ACCCD_tiPhiPT1_C /end DEF_CHARACTERISTIC
/end FUNCTION
/begin FUNCTION Remote_Control "Label für den Remote Control Betrieb" /begin DEF_CHARACTERISTIC InjCrv_qPoI1Des_C /end DEF_CHARACTERISTIC /end FUNCTION
/begin FUNCTION Rtmo "run time measurement online"
 /begin DEF_CHARACTERISTIC Rtmo_adCallingBegin_cu32 Rtmo_adCallingEnd_cu32 Rtmo_adStart_cu32 Rtmo_stIntOverhead_cu8 Rtmo_stSampleTime_cu8 Rtmo_swLoadMode_cu8 Rtmo_swMode_cu8 /end DEF_CHARACTERISTIC
/end FUNCTION
/begin FUNCTION SSpMon "Versorgungsspannungsüberwachung"
 /begin DEF_CHARACTERISTIC SSpMon_DebSRCHighSplyVltgDef1_C SSpMon_DebSRCHighSplyVltgDef2_C SSpMon_DebSRCHighSplyVltgDef3_C SSpMon_DebSRCHighSplyVltgOk1_C SSpMon_DebSRCHighSplyVltgOk2_C SSpMon_DebSRCHighSplyVltgOk3_C SSpMon_DebSRCLowSplyVltgDef1_C SSpMon_DebSRCLowSplyVltgDef2_C SSpMon_DebSRCLowSplyVltgDef3_C SSpMon_DebSRCLowSplyVltgOk1_C SSpMon_DebSRCLowSplyVltgOk2_C SSpMon_DebSRCLowSplyVltgOk3_C /end DEF_CHARACTERISTIC
/end FUNCTION
/begin FUNCTION Signal_Input "Signalerfassung"
 /begin SUB_FUNCTION AFSCD_Co BPSCD_Co BrkCD_Co CTSCD_Co EnvDa IATSCD_Co IgnLck OTSCD_Co TVASCD VSSCD_Co /end SUB_FUNCTION
/end FUNCTION
/begin FUNCTION Signals_Base "Sakalierungsfaktoren für Umrechnungen und Schnittstellensignale"
 /begin DEF_CHARACTERISTIC Sig_FactASModCANOffset_C Sig_FactASModCANScale_C Sig_FactASModDIAOffset_C Sig_FactASModDIAScale_C Sig_FactASModDSMOffset_C Sig_FactASModDSMScale_C Sig_ctCANOffset_C Sig_ctCANScale_C Sig_ctDIAOffset_C Sig_ctDIAScale_C Sig_ctDSMOffset_C Sig_ctDSMScale_C Sig_rASModCANOffset_C Sig_rASModCANScale_C Sig_rASModDIAOffset_C Sig_rASModDIAScale_C Sig_rASModDSMOffset_C Sig_rASModDSMScale_C /end DEF_CHARACTERISTIC
/end FUNCTION
/begin FUNCTION SopTst "Power-Up-Function test of disabling security pathes"
 /begin DEF_CHARACTERISTIC SOPTst_numSOPTst_C SOPTst_stActvWD_C SOPTst_tiWaitWDAOff_C SOPTst_tiWaitWDAOn_C /end DEF_CHARACTERISTIC
/end FUNCTION
/begin FUNCTION SrvPmp "Servopumpe" /begin SUB_FUNCTION SrvPmp_DetSrvPmpPwr /end SUB_FUNCTION /end FUNCTION
/begin FUNCTION SrvPmp_DetSrvPmpPwr "Bestimmung des Leistungsbedarfs der Servopumpe"
 /begin DEF_CHARACTERISTIC SrvPmp_DebStSADef_C SrvPmp_DebStSAOk_C SrvPmp_facAdjValDef_C SrvPmp_facAdjValMax_C SrvPmp_facAdjValMin_C SrvPmp_pwrDes_C SrvPmp_pwrPhiSteer_MAP SrvPmp_pwrVPhiSteer_MAP SrvPmp_stSAEcuMax_C /end DEF_CHARACTERISTIC
/end FUNCTION
/begin FUNCTION StSys "Startsystem"
 /begin SUB_FUNCTION StSysCtl StSys_Strt StSys_StrtBas StSys_StrtCtl StSys_StrtRmp StSys_TrqShutOff StrtCD /end SUB_FUNCTION
/end FUNCTION
/begin FUNCTION StSysCtl "Startersteuerung Logik" /begin SUB_FUNCTION StSysCtl_Logic StSysCtl_StrtCtl /end SUB_FUNCTION /end FUNCTION
/begin FUNCTION StSysCtl_Logic "Starter-Steuerungslogik"
 /begin DEF_CHARACTERISTIC StSysCtl_CntEepWrtAtm_C StSysCtl_TMaxNrm_MAP StSysCtl_swtEnResetDisengage_C StSysCtl_swtRlyErrIgn_C StSysCtl_swtStStrtLock_C StSysCtl_swtStSysCtlMn_C StSysCtl_swtStSysCtlMode_C StSysCtl_tiEngaErr_C StSysCtl_tiOnlyOffRly_C StSysCtl_tiRlyDiag_C StSysCtl_tiT50ROneRly1Def_C StSysCtl_tiT50ROneRly1Ok_C StSysCtl_tiT50ROneRly2Def_C StSysCtl_tiT50ROneRly2Ok_C StSysCtl_tiT50RZeroDef_C StSysCtl_tiT50RZeroOk_C /end DEF_CHARACTERISTIC
/end FUNCTION
/begin FUNCTION StSysCtl_StrtCtl "Startersteuerung"
 /begin DEF_CHARACTERISTIC StSysCtl_cntT50DebVal_C StSysCtl_ctCaSImpT50On_C StSysCtl_nThresEngT_CUR StSysCtl_nThresEngaErr_C StSysCtl_nThresEngaN_C StSysCtl_nThresZeroN_C StSysCtl_stT50CDOff_C StSysCtl_stT50CDOn_C StSysCtl_swtT50ErrIgn_C StSysCtl_tiDebShCirBattDef_C StSysCtl_tiDebShCirBattOk_C StSysCtl_tiIlsNPlausDef_C StSysCtl_tiIlsNPlausOk_C StSysCtl_tiIlsPlausAT_C StSysCtl_tiShtOff_C StSysCtl_tiT50on_C StSysCtl_tiThresAddCor_C StSysCtl_tiThresEngT_CUR StSysCtl_tiThresVel_C StSysCtl_tiThresZeroN_C StSysCtl_vThresVel_C /end DEF_CHARACTERISTIC
/end FUNCTION
/begin FUNCTION StSys_Strt "Startabwurf"
 /begin DEF_CHARACTERISTIC StSys_ctRevMin_C StSys_nEngOffHi_C StSys_nEngOffLo_C StSys_nStrtCutOut_MAP StSys_tiRlsHtg_C StSys_tiStrtCutOut_C /end DEF_CHARACTERISTIC
/end FUNCTION
/begin FUNCTION StSys_StrtBas "Startbasismoment"
 /begin DEF_CHARACTERISTIC StSys_nAdjMax_C StSys_trqAdjMax_C StSys_trqAdjVal_C StSys_trqStrtAddCor_C StSys_trqStrtBas_MAP StSys_trqStrt_MAP /end DEF_CHARACTERISTIC
/end FUNCTION
/begin FUNCTION StSys_StrtCtl "Startsystem Anlassersteuerung" /begin DEF_CHARACTERISTIC StSysCtl_swtEnResetRelease_C /end DEF_CHARACTERISTIC /end FUNCTION
/begin FUNCTION StSys_StrtRmp "Startrampe"
 /begin DEF_CHARACTERISTIC StSys_dtrqColdInc_C StSys_dtrqHotInc_C StSys_dtrqWarmInc_C StSys_nFreezeTrqRmp_C StSys_nReleaseTrqRmp_C StSys_tFuelHi_C StSys_tFuelLo_C StSys_tiColdRmpLck_C StSys_tiEngTempValid_C StSys_tiHotRmpLck_C StSys_tiWarmRmpLck_C StSys_trqColdLim_C StSys_trqHotLim_C StSys_trqWarmLim_C /end DEF_CHARACTERISTIC
/end FUNCTION
/begin FUNCTION StSys_TrqShutOff "Startmomentabschaltung"
 /begin DEF_CHARACTERISTIC StSys_nThresTMFW_C StSys_nThrestEng_CUR StSys_nUpLiThrestEng_CUR StSys_numAvrgRun_C StSys_swtEnaMultShutOff_C StSys_swtT50Sel_C StSys_swtTMFWSel_C StSys_tiDelTMFW_C StSys_tiDelnUpLiThres_C StSys_tiShutOff_MAP StSys_uAltTMFW_C StSys_uThresTMFW_C /end DEF_CHARACTERISTIC
/end FUNCTION
/begin FUNCTION Start_of_injection "Spritzbeginn" /begin SUB_FUNCTION InjCrv_Co /end SUB_FUNCTION /end FUNCTION
/begin FUNCTION StrtCD "Ansteuerung Automatischer Starter" /begin SUB_FUNCTION StrtCD_OffRly StrtCD_OnRly /end SUB_FUNCTION /end FUNCTION
/begin FUNCTION StrtCD_OffRly "Starter Aus-Relais Komponententreiber"
 /begin DEF_CHARACTERISTIC SigTst_StrtCDRLYOffRlyEn_C StrtCD_stInvOutOffRly_C StrtCD_stPwrStgDiaOffRly_C StrtCD_tiNoLoadDefOfR_C StrtCD_tiNoLoadOkOfR_C StrtCD_tiShrtBatDefOfR_C StrtCD_tiShrtBatOkOfR_C StrtCD_tiShrtGndDefOfR_C StrtCD_tiShrtGndOkOfR_C StrtCD_uLinOffRly_CUR StrtCD_uNoLoadMaxOffR_C StrtCD_uNoLoadMinOffR_C StrtCD_uSRCMaxOffRly_C StrtCD_uSRCMinOffRly_C StrtCD_uShortBatMinOffR_C StrtCD_uShortGndMaxOffR_C /end DEF_CHARACTERISTIC
/end FUNCTION
/begin FUNCTION StrtCD_OnRly "Starter Ein-Relais Komponententreiber"
 /begin DEF_CHARACTERISTIC SigTst_StrtCDRLYOnRlyEn_C StrtCD_stInvOutOnRly_C StrtCD_stPwrStgDiaOnRly_C StrtCD_tiNoLoadDefOnR_C StrtCD_tiNoLoadOkOnR_C StrtCD_tiShrtBatDefOnR_C StrtCD_tiShrtBatOkOnR_C StrtCD_tiShrtGndDefOnR_C StrtCD_tiShrtGndOkOnR_C StrtCD_uLinOnRly_CUR StrtCD_uNoLoadMaxOnR_C StrtCD_uNoLoadMinOnR_C StrtCD_uSRCMaxOnRly_C StrtCD_uSRCMinOnRly_C StrtCD_uShortBatMinOnR_C StrtCD_uShortGndMaxOnR_C /end DEF_CHARACTERISTIC
/end FUNCTION
/begin FUNCTION SvLp "Wartungsintervallverlängerung"
 /begin DEF_CHARACTERISTIC SvLp_facQI_MAP SvLp_facSoot_C SvLp_facWear_C SvLp_lEquCalc_C SvLp_lSootLoad_MAP SvLp_lSotLdRgn1_MAP SvLp_lSotLdRgn2_MAP SvLp_lSotLdRgn3_MAP SvLp_stSotLdRgnMsk1_C SvLp_stSotLdRgnMsk2_C SvLp_stSotLdRgnMsk3_C SvLp_swtPresentType_C SvLp_swtPresentVal_C SvLp_swtqSetUnBal_C SvLp_tiPlausWIV_C SvLp_tiShTiMeanVal_C SvLp_tiTrnvrsAccPT1_C /end DEF_CHARACTERISTIC
/end FUNCTION
/begin FUNCTION SvLpCD "Komponententreiber Wartungsintervallverlängerung"
 /begin DEF_CHARACTERISTIC SvLpCD_dGradFillCrv_C SvLpCD_lFillLvl_CUR SvLpCD_lOilWarn_MAP SvLpCD_nEngMax_C SvLpCD_nEngMin_C SvLpCD_tOilMax_C SvLpCD_tOilMin_C SvLpCD_tiEngNPT1_C SvLpCD_tiFillLvlMax_C SvLpCD_tiFillLvlMin_C /end DEF_CHARACTERISTIC
/end FUNCTION
/begin FUNCTION SvLp_Co "Berechnung der Flexiblen Serviceintervallanzeige" /begin DEF_CHARACTERISTIC SvLp_dOilLoad_MAP SvLp_lOilLoad_MAP /end DEF_CHARACTERISTIC /end FUNCTION
/begin FUNCTION Swirl "Drall" /begin SUB_FUNCTION IndSys_CalcSwirl VSACD_Co /end SUB_FUNCTION /end FUNCTION
/begin FUNCTION T15CD "Klemme 15 Komponententreiber" /begin SUB_FUNCTION T15CD_Co /end SUB_FUNCTION /end FUNCTION
/begin FUNCTION T15CD_Co "Klemme 15 Komponententreiber"
 /begin DEF_CHARACTERISTIC T15CD_DebNplDef_C T15CD_DebNplOk_C T15CD_DebSRCHighDef_C T15CD_DebSRCHighOk_C T15CD_DebSRCLowDef_C T15CD_DebSRCLowOk_C T15CD_dtRmpSlpDwn_C T15CD_dtRmpSlpUp_C T15CD_stCutOffHysYHigh_C T15CD_stCutOffHysYLow_C T15CD_stCutOffPreset_C T15CD_stInvIn_C T15CD_stSensIDWord_C T15CD_tiDebNeg_C T15CD_tiDebPos_C T15CD_tiucoPT1_C T15CD_uA2DThres_C T15CD_uCutOffHysXHigh_C T15CD_uCutOffHysXLow_C T15CD_uCutOffPreset_C T15CD_uDfl_C T15CD_uLin_CUR T15CD_uSRCMax_C T15CD_uSRCMin_C /end DEF_CHARACTERISTIC
/end FUNCTION
/begin FUNCTION T50CD "Komponententreiber Klemme 50" /begin SUB_FUNCTION T50CD_Co T50CD_Rx /end SUB_FUNCTION /end FUNCTION
/begin FUNCTION T50CD_Co "Koordinator für Klemme 50 Komponententreiber"
 /begin DEF_CHARACTERISTIC T50CD_stDigInvIn_C T50CD_swtDigInPresentType_C T50CD_swtDigInPresentVal_C T50CD_tiDebNplDef_C T50CD_tiDebNplOk_C T50CD_tiDebShortCircBatDef_C T50CD_tiDebShortCircBatOk_C T50CD_tiDebShortCircGndDef_C T50CD_tiDebShortCircGndOk_C T50CD_tiDigInDebNeg_C T50CD_tiDigInDebPos_C /end DEF_CHARACTERISTIC
/end FUNCTION
/begin FUNCTION T50CD_Rx "Anlasserrückmeldeleitung Komponententreiber"
 /begin DEF_CHARACTERISTIC T50CD_stRxDigInvIn_C T50CD_swtRxDigInPType_C T50CD_swtRxDigInPVal_C T50CD_tiRxDigInDebNeg_C T50CD_tiRxDigInDebPos_C /end DEF_CHARACTERISTIC
/end FUNCTION
/begin FUNCTION TAA_Adapt "Inkrementwinkel-Lernverfahren / Kernalgorithmus"
 /begin DEF_CHARACTERISTIC TAA_facDynMax_C TAA_facSinTab_CA TAA_nAdaptMid_CA TAA_nAdaptRng_CA TAA_numGapIpoIncs_C TAA_numSinTab_C TAA_phiDiffMax_CA TAA_stCorrInv_C TAA_stMainSpdRng_C TAA_stReqRstVal_C TAA_tiIncDvtFlt_C /end DEF_CHARACTERISTIC
/end FUNCTION
/begin FUNCTION TAA_Ctrl "Inkrementwinkel-Lernverfahren / Steuerung der Adaption"
 /begin DEF_CHARACTERISTIC TAA_ctIncsGap_CA TAA_nMax_C TAA_nMin_C TAA_numActv_CA TAA_numRevCorr_C TAA_stAdaptMode_C TAA_stEvalFin_C TAA_stExtp_C TAA_stGearMax_C TAA_stGearMin_C TAA_stTstMode_C TAA_tiEnaDel_C TAA_vMin_C /end DEF_CHARACTERISTIC
/end FUNCTION
/begin FUNCTION TP20 "Transportprotokoll 2.0"
 /begin DEF_CHARACTERISTIC Tp20_swtAppl_C Tp20_swtFuncEnbl_C Tp20_tiCanMuteTimeOut_C Tp20_vCanMuteThres_C /end DEF_CHARACTERISTIC
/end FUNCTION
/begin FUNCTION TPUMon "Timer Überwachung"
 /begin DEF_CHARACTERISTIC TPUMon_ctDfctLim_C TPUMon_ctTPU_C TPUMon_tiDiffMaxLimit_C TPUMon_tiDiffMinLimit_C TPUMon_tiDiffSumLimit_C /end DEF_CHARACTERISTIC
/end FUNCTION
/begin FUNCTION TVACD_Co "Drosselklappensteller Komponententreiber"
 /begin DEF_CHARACTERISTIC SigTst_TVAEn_C TVACD_DebExcTempDef_C TVACD_DebExcTempOk_C TVACD_DebNoLoadDef_C TVACD_DebNoLoadOk_C TVACD_DebShortCircBatDef_C TVACD_DebShortCircBatOk_C TVACD_DebShortCircGndDef_C TVACD_DebShortCircGndOk_C TVACD_DebSigCJ220Def_C TVACD_DebSigCJ220Ok_C TVACD_ctPwrStgOnMax_C TVACD_facLpGnStrt_C TVACD_numDia_C TVACD_numDisCJ220_C TVACD_numPwmOut1_C TVACD_numPwmOut2_C TVACD_numPwmOut_C TVACD_rCnv_CUR TVACD_rOutMax_C TVACD_rOutMin_C TVACD_rTst_C TVACD_stInvOut_C TVACD_stPwrStgActv_C TVACD_stPwrStgDia_C TVACD_stSPICtl_C TVACD_swt_C TVACD_tiBtwTst_C TVACD_tiPT1FacCor_C TVACD_tiPer_C TVACD_tiPwrStgOn_C /end DEF_CHARACTERISTIC
/end FUNCTION
/begin FUNCTION TVASCD "Analogwertverarbeitung des Drosselklappensteller-Sensors" /begin SUB_FUNCTION TVASCD_Co /end SUB_FUNCTION /end FUNCTION
/begin FUNCTION TVASCD_Co "Analogwertverarbeitung des Drosselklappensteller-Sensors"
 /begin DEF_CHARACTERISTIC TVASCD_DebNplstErrDef_C TVASCD_DebNplstErrOk_C TVASCD_DebSRCHighDef_C TVASCD_DebSRCHighOk_C TVASCD_DebSRCLowDef_C TVASCD_DebSRCLowOk_C TVASCD_DebSigstErrDef_C TVASCD_DebSigstErrOk_C TVASCD_drRmpSlpDwn_C TVASCD_drRmpSlpUp_C TVASCD_numAdc_C TVASCD_rDfl_C TVASCD_stDigInInvStLine_C TVASCD_stSensIDWord_C TVASCD_swtDigInPresent_C TVASCD_swtSensType_C TVASCD_tEngMax_C TVASCD_tEngMin_C TVASCD_tiAvrg_C TVASCD_tiDebRst_C TVASCD_tiHigh_C TVASCD_tiLow_C TVASCD_uAvrgClsd_C TVASCD_uAvrgOpn_C TVASCD_uBattMax_C TVASCD_uBattMin_C TVASCD_uRawMaxClsd_C TVASCD_uRawMaxOpn_C TVASCD_uRawMinClsd_C TVASCD_uRawMinOpn_C TVASCD_uRawSRCMax_C TVASCD_uRawSRCMin_C /end DEF_CHARACTERISTIC
/end FUNCTION
/begin FUNCTION ThrVlv_Co "actuator coordinator for Throttle Valve"
 /begin DEF_CHARACTERISTIC ThrVlv_numMaxClean_C ThrVlv_rCleanClsd_C ThrVlv_rCleanOpn_C ThrVlv_rDesTVA_CUR ThrVlv_rDesValStyAvrg_C ThrVlv_rDesValStyHiThres_C ThrVlv_rDesValStyLoThres_C ThrVlv_rDesValStyOscMax_C ThrVlv_rDesValStySlp_C ThrVlv_swtFeatClnTVA_C ThrVlv_tEngMax_C ThrVlv_tEngMin_C ThrVlv_tiCleanClsd_C ThrVlv_tiCleanOpn_C ThrVlv_uBattMax_C ThrVlv_uBattMin_C /end DEF_CHARACTERISTIC
/end FUNCTION
/begin FUNCTION ThrVlv_Governor "Throttle Valve Control : Governor"
 /begin DEF_CHARACTERISTIC ThrVlv_DKdNegShOff_C ThrVlv_DKdNeg_C ThrVlv_DKdPosShOff_C ThrVlv_DKdPos_C ThrVlv_IKiFrcSlp_C ThrVlv_IKiMechBnd_C ThrVlv_IKiNegShOff_C ThrVlv_IKiNeg_C ThrVlv_IKiPosShOff_C ThrVlv_IKiPos_C ThrVlv_PKpNegShOff_C ThrVlv_PKpNeg_C ThrVlv_PKpPosShOff_C ThrVlv_PKpPos_C ThrVlv_SmlSigNegDKdShOff_C ThrVlv_SmlSigNegDKd_C ThrVlv_SmlSigNegIKiShOff_C ThrVlv_SmlSigNegIKi_C ThrVlv_SmlSigNegPKpShOff_C ThrVlv_SmlSigNegPKp_C ThrVlv_SmlSigPosDKdShOff_C ThrVlv_SmlSigPosDKd_C ThrVlv_SmlSigPosIKiShOff_C ThrVlv_SmlSigPosIKi_C ThrVlv_SmlSigPosPKpShOff_C ThrVlv_SmlSigPosPKp_C ThrVlv_iEff_CUR ThrVlv_nMinTVAActv_C ThrVlv_rCurrMax_C ThrVlv_rDMaxShOff_C ThrVlv_rDMax_C ThrVlv_rDMin_C ThrVlv_rDesValClsdActvShOff_C ThrVlv_rDesValClsdActv_C ThrVlv_rDesValClsdInactvShOff_C ThrVlv_rDesValClsdInactv_C ThrVlv_rDesValMaxShOff_C ThrVlv_rDesValMax_C ThrVlv_rDesValMinShOff_C ThrVlv_rDesValMin_C ThrVlv_rDesValOpnActv_C ThrVlv_rDesValOpnInactv_C ThrVlv_rFrcMax_C ThrVlv_rFrc_C ThrVlv_rGvnrDvtFrcInactv_C ThrVlv_rGvnrDvtMaxFrcRmp_C ThrVlv_rGvnrDvtThres_C ThrVlv_rGvnrMaxMechBnd_C ThrVlv_rGvnrMax_C ThrVlv_rGvnrMax_CUR ThrVlv_rGvnrMinMechBnd_C ThrVlv_rGvnrMin_C ThrVlv_rInitIMax_C ThrVlv_rInitIMin_C ThrVlv_rInitI_C ThrVlv_rOutDFrcRmpThres_C ThrVlv_rOutDMaxShOff_C ThrVlv_rOutDMax_C ThrVlv_rOutIMaxMechBnd_C ThrVlv_rOutIMax_C ThrVlv_rPIDWinNegShOff_C ThrVlv_rPIDWinNeg_C ThrVlv_rPIDWinPosShOff_C ThrVlv_rPIDWinPos_C ThrVlv_rRampEnd_C ThrVlv_rRelPosMax_C ThrVlv_rRelPosMinShOff_C ThrVlv_rRelPosMin_C ThrVlv_rRelPosTVAActv_C ThrVlv_rRlsMax_C ThrVlv_rTVAThresCls_C ThrVlv_rTVAThresOpn_C ThrVlv_slpRampShOff_C ThrVlv_slpRamp_C ThrVlv_swtGvnrByp_C ThrVlv_tiCurrFltParFst_C ThrVlv_tiCurrFltParSlw_C ThrVlv_tiDesValFlt_C ThrVlv_tiGvnrDT1ShOff_C ThrVlv_tiGvnrDT1_C /end DEF_CHARACTERISTIC
/end FUNCTION
/begin FUNCTION ThrVlv_Monitor "Throttle Valve Control : Monitoring function"
 /begin DEF_CHARACTERISTIC ThrVlv_DebGvnrDvtMaxDef_C ThrVlv_DebGvnrDvtMaxOk_C ThrVlv_DebGvnrDvtMinDef_C ThrVlv_DebGvnrDvtMinOk_C ThrVlv_RlsKiNeg_C ThrVlv_RlsKiPos_C ThrVlv_ctRlsAttempts_C ThrVlv_rDvtMax_C ThrVlv_rDvtMin_C ThrVlv_rRlsDvt_C ThrVlv_rRls_C ThrVlv_tiRepRls_C ThrVlv_tiRlsSuc_C ThrVlv_tiRls_C /end DEF_CHARACTERISTIC
/end FUNCTION
/begin FUNCTION TstSeq "Stellgliedtestsequenz" /begin SUB_FUNCTION BasAdj TstTog /end SUB_FUNCTION /end FUNCTION
/begin FUNCTION TstTog "Funktionen welche nötig sind um die automatischen Testeranforderungen zu gewährleisten" /begin SUB_FUNCTION TstTog_Co /end SUB_FUNCTION /end FUNCTION
/begin FUNCTION TstTog_Co "Koordinator des TstTog"
 /begin DEF_CHARACTERISTIC TstTog_Code_C TstTog_DemStartMaxEngN_C TstTog_Demand_C TstTog_K2SigBlkVal1_MAP TstTog_K2SigBlkVal2_MAP TstTog_Val1_C TstTog_Val2_C TstTog_tiBetweenTogVal_C TstTog_tiMaxUserInput_C TstTog_tiRoutDemMax_C /end DEF_CHARACTERISTIC
/end FUNCTION
/begin FUNCTION UAcc_FuncCode_Proc "This process receives the Function Code sent from USAp module ( from EEPROM ),  and extract the relevant bits for different func"
 /begin DEF_CHARACTERISTIC UAcc_ACCodePos_C UAcc_AltCodePos_C UAcc_ESPCodePos_C UAcc_FanCodePos_C UAcc_LogReqPWMxSpdResetdeAct2_C UAcc_VehVelCodePos_C UAcc_WIVCodePos_C /end DEF_CHARACTERISTIC
/end FUNCTION
/begin FUNCTION VSACD_Co "Drallniveausteller Komponententreiber"
 /begin DEF_CHARACTERISTIC SigTst_VSAEn_C VSACD_DebExcTempDef_C VSACD_DebExcTempOk_C VSACD_DebNoLoadDef_C VSACD_DebNoLoadOk_C VSACD_DebShortCircBatDef_C VSACD_DebShortCircBatOk_C VSACD_DebShortCircGndDef_C VSACD_DebShortCircGndOk_C VSACD_ctPwrStgOnMax_C VSACD_rCnv_CUR VSACD_rOutMax_C VSACD_rOutMin_C VSACD_stInvOut_C VSACD_stPwrStgActv_C VSACD_stPwrStgDia_C VSACD_stSPICtl_C VSACD_swtLambdaIgnore_C VSACD_swt_C VSACD_tiBtwTst_C VSACD_tiPer_C VSACD_tiPwrStgOn_C /end DEF_CHARACTERISTIC
/end FUNCTION
/begin FUNCTION VSSCD_Co "Fahrgeschwindigkeitsgeber Komponententreiber"
 /begin DEF_CHARACTERISTIC VSSCD_DebBrkLowVltgDef_C VSSCD_DebBrkLowVltgOk_C VSSCD_DebCanMsgSigDef_C VSSCD_DebCanMsgSigOk_C VSSCD_DebCanSigDef_C VSSCD_DebCanSigOk_C VSSCD_DebMaxDef_C VSSCD_DebMaxOk_C VSSCD_DebPlaDef_C VSSCD_DebPlaOk_C VSSCD_DebPlausDef_C VSSCD_DebPlausOk_C VSSCD_DebSigDef_C VSSCD_DebSigOk_C VSSCD_ImpPerDist_C VSSCD_ctAvrgAccn_C VSSCD_daRmpSlpDwn_C VSSCD_daRmpSlpUp_C VSSCD_nMinErr_C VSSCD_nThresPla_C VSSCD_numSegSens_C VSSCD_qThresPla_C VSSCD_stSensIDWord_C VSSCD_swtAccSrc_C VSSCD_swtSigType_C VSSCD_swtSigVal_C VSSCD_tiAPT1_C VSSCD_tiAccFlt_CUR VSSCD_tiDebCANSigDef_C VSSCD_tiDebCANSigOk_C VSSCD_tiPT1_C VSSCD_tiPlausOvrRun_C VSSCD_tiVPT1_C VSSCD_vDfl_C VSSCD_vMax_C VSSCD_vMin_C VSSCD_vRawMin_C VSSCD_vThresPla_C /end DEF_CHARACTERISTIC
/end FUNCTION
/begin FUNCTION VehDa_LoadCalc "Ermittlung des Fahrzeugnutzungsprofil"
 /begin DEF_CHARACTERISTIC ACCD_DebNoTempDef_C ACCD_DebNoTempOk_C ACCD_dcycPwmInMax_C ACCD_dcycPwmInMin_C ACCD_rLin_CUR ACCD_stACDfl_C ACCD_stComprDigIn_C ACCD_stInvOut_C ACCD_stPwmInInv_C ACCD_swtACtypeVal_C ACCD_swtClimatronic_C ACCD_swtComprON_C ACCD_tiComprON_C ACCD_tiDebCanSigDef_C ACCD_tiDebCanSigOk_C ACCD_tiDebPACMaxDef_C ACCD_tiDebPACMaxOk_C ACCD_tiDebPACMinDef_C ACCD_tiDebPACMinOk_C ACCD_tiDebPACSigDef_C ACCD_tiDebPACSigOk_C ACCD_tiPwmInMaxPer_C ACCD_tiPwmInMinPer_C ACCD_tiRmpHi2Lo_C ACCD_tiRmpLo2Hi_C ACCD_trqComprDfl_C ACCD_trqComprHi_C ACCD_trqComprLo_C Diff_tiDebtrqLimErrPatOk_C ErLpCD_tiDebMILReqOnOk_C Gearbx_tiDebGearbxMTErrOk_C PrpCtl_tiDebvLimErrPatOk_C /end DEF_CHARACTERISTIC
/end FUNCTION
/begin FUNCTION VehDa_lSumCalc "Wegstreckenermittlung" /begin DEF_CHARACTERISTIC VehDa_lStore_C /end DEF_CHARACTERISTIC /end FUNCTION
/begin FUNCTION VehDa_rVnCalc "Verhältnis Fahrzeuggeschwindigkeit zu Motordrehzahl" /begin DEF_CHARACTERISTIC VehDa_rVnMax_C VehDa_tiNPT1_C VehDa_tiVnPT1_C /end DEF_CHARACTERISTIC /end FUNCTION
/begin FUNCTION VehDa_tiEngOnCalc "Erfassung der aktuellen Betriebszeit"
 /begin DEF_CHARACTERISTIC VehDa_nFTSThres_C VehDa_nThres_C VehDa_qFTSThres_C VehDa_qThres_C VehDa_tiStore_C /end DEF_CHARACTERISTIC
/end FUNCTION
/end MODULE
/end PROJECT
