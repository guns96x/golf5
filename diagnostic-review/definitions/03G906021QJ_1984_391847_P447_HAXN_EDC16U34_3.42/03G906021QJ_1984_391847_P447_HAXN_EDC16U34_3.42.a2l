ASAP2_VERSION 1 3
/begin PROJECT X447 "EDC16U34"
/begin HEADER "" VERSION "VAA1" PROJECT_NO X447 /end HEADER
/begin MODULE DIM ""
/begin MOD_COMMON "" BYTE_ORDER MSB_FIRST ALIGNMENT_BYTE 1 ALIGNMENT_WORD 2 ALIGNMENT_LONG 4 ALIGNMENT_FLOAT32_IEEE 4 /end MOD_COMMON
/begin MEASUREMENT Prp_rVirtPerm_mp "Virtueller Fahrpedalwert" SWORD Prc 1 100 -327.6800 327.6700 FORMAT "%8.4" ECU_ADDRESS 0x9FF8DE /end MEASUREMENT
/begin MEASUREMENT Prp_stACC_mp "Zustand virtueller Pedalwert aus Prp_rEng_CUR wegen ACC" UBYTE OneToOne 1 100 0.00 255.0 FORMAT "%5.1" ECU_ADDRESS 0x9FFF94 /end MEASUREMENT
/begin MEASUREMENT Prp_stCrCtl_mp "Zustand virtueller Pedalwert aus Prp_rEng_CUR wegen CrCtl" UBYTE OneToOne 1 100 0.00 255.0 FORMAT "%5.1" ECU_ADDRESS 0x9FFF95 /end MEASUREMENT
/begin MEASUREMENT Prp_stTrqTypePrp "Indikator ob Verlustmomentenkompensation applikativ deaktiviert ist" UBYTE OneToOne 1 100 0.00 255.0 FORMAT "%5.1" ECU_ADDRESS 0x7F953A /end MEASUREMENT
/begin MEASUREMENT Prp_stVirtAPP_mp "virtuellle PWG-Stellung überschreibt die gemessene" UBYTE OneToOne 1 100 0.00 255.0 FORMAT "%5.1" ECU_ADDRESS 0x9FFF96 /end MEASUREMENT
/begin MEASUREMENT Prp_swtCANrAPP "" UBYTE OneToOne 1 100 0.00 255.0 FORMAT "%5.1" ECU_ADDRESS 0x7F953B /end MEASUREMENT
/begin MEASUREMENT Prp_swtCCOn "Freischaltung für FGR" UBYTE OneToOne 1 100 0.00 255.0 FORMAT "%5.1" ECU_ADDRESS 0x7F953C /end MEASUREMENT
/begin MEASUREMENT Prp_swtCCSel "Auswahlschalter für verbaute Art der FGR" UBYTE OneToOne 1 100 0.00 255.0 FORMAT "%5.1" ECU_ADDRESS 0x7F953D /end MEASUREMENT
/begin MEASUREMENT Prp_swtrAPP "Ausgabe Virtueller Fahrpedalwert nur wenn CrCtl/ACC activ" UBYTE OneToOne 1 100 0.00 255.0 FORMAT "%5.1" ECU_ADDRESS 0x7F953E /end MEASUREMENT
/begin MEASUREMENT Prp_trqDesCC "Momentenanforderung FGR oder ACC" SLONG TrqPrpHigh 1 100 -214748364.800 214748364.700 FORMAT "%13.3" ECU_ADDRESS 0x7F9EA4 /end MEASUREMENT
/begin MEASUREMENT Prp_trqDesUnLim "Wunschmoment vor Höchstgeschwindigkeitsbegrenzung" SLONG TrqPrpHigh 1 100 -214748364.800 214748364.700 FORMAT "%13.3" ECU_ADDRESS 0x7F9EA8 /end MEASUREMENT
/begin MEASUREMENT Prp_trqEng "Vortriebsmoment in innerem Moment" SWORD Trq 1 100 -3276.800 3276.700 FORMAT "%8.3" ECU_ADDRESS 0x7F9C58 /end MEASUREMENT
/begin MEASUREMENT Prp_trqLead "Vorhaltmoment des Vortriebs" SLONG TrqPrpHigh 1 100 -214748364.800 214748364.700 FORMAT "%13.3" ECU_ADDRESS 0x7F9EAC /end MEASUREMENT
/begin MEASUREMENT Prp_trqLeadCC "Vortriebsvorhaltemoment abhängig von Fahrgeschwindigkeitsregelung" SLONG TrqPrpHigh 1 100 -214748364.800 214748364.700 FORMAT "%13.3" ECU_ADDRESS 0x7F9EB0 /end MEASUREMENT
/begin MEASUREMENT Prp_trqLimNoSmkMax_mp "maximal mögleiches inners Motormoment ohne Berücksichtigung der Rauchbegrenzung" SWORD Trq 1 100 -3276.800 3276.700 FORMAT "%8.3" ECU_ADDRESS 0x9FF8E0 /end MEASUREMENT
/begin MEASUREMENT Prp_trqRaw "Vortriebsmomentwunsch vor Führungsformer" SLONG TrqPrpHigh 1 100 -214748364.800 214748364.700 FORMAT "%13.3" ECU_ADDRESS 0x7F9EB4 /end MEASUREMENT
/begin MEASUREMENT Prp_trqRawInr "Vortriebsmomentwunsch im Motor" SWORD Trq 1 100 -3276.800 3276.700 FORMAT "%8.3" ECU_ADDRESS 0x7F9C5A /end MEASUREMENT
/begin MEASUREMENT Prp_trqThresPrp_mp "Drehmomentenschwelle zur Unterscheidung zwischen Zug- und Schubbetrieb" SWORD Trq 1 100 -3276.800 3276.700 FORMAT "%8.3" ECU_ADDRESS 0x9FF8E2 /end MEASUREMENT
/begin MEASUREMENT PSPCD_stOutHWE_mp "Vorvoerderpumpe Ausgangssignals" UBYTE OneToOne 1 100 0.00 255.0 FORMAT "%5.1" ECU_ADDRESS 0x9FFF9F /end MEASUREMENT
/begin MEASUREMENT PSP_stLogicOut "Quelle für Aktivierung der Vorförderpumpr (1=Ein / 0=Aus)" UBYTE OneToOne 1 100 0.00 255.0 FORMAT "%5.1" ECU_ADDRESS 0x7F9536 /end MEASUREMENT
/begin MEASUREMENT Rtmo_ctInterrupt_u32 "Anzahl der Unterbrechungen der zu messenden Funktion innerhalb des letzten Messzyklus (keine reentranten Interrupts)" ULONG OneToOne 1 100 0.00 4294967295.00 FORMAT "%13.2" ECU_ADDRESS 0x7FCD48 /end MEASUREMENT
/begin MEASUREMENT Rtmo_ctReentrantSample_u32 "Aufrufanzahl der zu messenden Funktion innerhalb des letzten Messzyklus, wobei Funktion bereits aktiv war (reentranter Aufruf)" ULONG OneToOne 1 100 0.00 4294967295.00 FORMAT "%13.2" ECU_ADDRESS 0x7FCD50 /end MEASUREMENT
/begin MEASUREMENT Rtmo_ctSampleProc_u8 "Zähler wird nach jeder Messwertermittlung inkrementiert" UBYTE OneToOne 1 100 0.00 255.0 FORMAT "%5.1" ECU_ADDRESS 0x7FCD60 /end MEASUREMENT
/begin MEASUREMENT Rtmo_ctSample_u32 "Anzahl der Aufrufe der zu messenden Funktion innerhalb des letzten Messzyklus (keine reentranten Aufrufe)" ULONG OneToOne 1 100 0.00 4294967295.00 FORMAT "%13.2" ECU_ADDRESS 0x7FCD4C /end MEASUREMENT
/begin MEASUREMENT Rtmo_tiAbsMax_u32 "Maximale Laufzeit der zu messenden Funktion seit letztem Rücksetzen (Rtmo_swMinMaxReset_cu8)" ULONG TimeSys_us 1 100 0.00 1228361874.73 FORMAT "%13.2" ECU_ADDRESS 0x7FCD44 /end MEASUREMENT
/begin MEASUREMENT Rtmo_tiAbsMin_u32 "Minimale Laufzeit der zu messenden Funktion seit letztem Rücksetzen (Rtmo_swMinMaxReset_cu8)" ULONG TimeSys_us 1 100 0.00 1228361874.73 FORMAT "%13.2" ECU_ADDRESS 0x7FCD40 /end MEASUREMENT
/begin MEASUREMENT Rtmo_tiAvrg_u32 "durchschnittliche Laufzeit der zu messenden Funktion innerhalb des letzten Messzyklus" ULONG TimeSys_us 1 100 0.00 1228361874.73 FORMAT "%13.2" ECU_ADDRESS 0x7FCD34 /end MEASUREMENT
/begin MEASUREMENT Rtmo_tiLoad_u32 "aktuelle Laufzeit" ULONG RtmoTicksToPercent 1 100 -122736.187473 100.000000000 FORMAT "%13.6" ECU_ADDRESS 0x7FAA70 /end MEASUREMENT
/begin MEASUREMENT Rtmo_tiMaxCallDist_u32 "Maximaler Zeitabstand zwischen zwei Funktions/Task-Aufrufen" ULONG TimeSys_us 1 100 0.00 1228361874.73 FORMAT "%13.2" ECU_ADDRESS 0x7FCD58 /end MEASUREMENT
/begin MEASUREMENT Rtmo_tiMaxLoad_u32 "Maximale Laufzeit" ULONG RtmoTicksToPercent 1 100 -122736.187473 100.000000000 FORMAT "%13.6" ECU_ADDRESS 0x7FCD5C /end MEASUREMENT
/begin MEASUREMENT Rtmo_tiMax_u32 "Maximale Laufzeit der zu messenden Funktion innerhalb des letzten Messzyklus" ULONG TimeSys_us 1 100 0.00 1228361874.73 FORMAT "%13.2" ECU_ADDRESS 0x7FCD3C /end MEASUREMENT
/begin MEASUREMENT Rtmo_tiMinCallDist_u32 "Minimaler Zeitabstand zwischen zwei Funktions/Task-Aufrufen" ULONG TimeSys_us 1 100 0.00 1228361874.73 FORMAT "%13.2" ECU_ADDRESS 0x7FCD54 /end MEASUREMENT
/begin MEASUREMENT Rtmo_tiMin_u32 "Minimale Laufzeit der zu messenden Funktion innerhalb des letzten Messzyklus" ULONG TimeSys_us 1 100 0.00 1228361874.73 FORMAT "%13.2" ECU_ADDRESS 0x7FCD38 /end MEASUREMENT
/begin MEASUREMENT Rttp_stRttpEnable "Status vom Tuningschutz bei der Initialisierung" UBYTE OneToOne 1 100 0.00 255.0 FORMAT "%5.1" ECU_ADDRESS 0x7F9540 /end MEASUREMENT
/begin MEASUREMENT Shtrp_ActFreeTstTog "aktuelle frei applizierbare Shtrp Stellertest Position" UBYTE OneToOne 1 100 0.00 255.0 FORMAT "%5.1" ECU_ADDRESS 0x7F9544 /end MEASUREMENT
/begin MEASUREMENT Shtrp_ActRout_mp "Status des aktuellen Short Trip Tests  (Diagnose)" UBYTE OneToOne 1 100 0.00 255.0 FORMAT "%5.1" ECU_ADDRESS 0x9FFFA0 /end MEASUREMENT
/begin MEASUREMENT Shtrp_ctRemain "Anzahl der noch offenen Short Trip Einzeltests" UBYTE OneToOne 1 100 0.00 255.0 FORMAT "%5.1" ECU_ADDRESS 0x7F9545 /end MEASUREMENT
/begin MEASUREMENT Shtrp_DispMode_mp "Dummy Wert" UBYTE OneToOne 1 100 0.00 255.0 FORMAT "%5.1" ECU_ADDRESS 0x9FFFA1 /end MEASUREMENT
/begin MEASUREMENT Shtrp_EGRBA_mDeltaMin_mp "Differenz zwischen 1. und 2. Testwert + Trimmwert für die Shtrp-Diagnose" SWORD AirMassPerCyl 1 100 -3276.800 3276.700 FORMAT "%8.3" ECU_ADDRESS 0x9FF8F2 /end MEASUREMENT
/begin MEASUREMENT Shtrp_EGRBA_mMax_mp "erlaubter Maximalwert für den Luftmassenwert + Trimmwert für die Shtrp-Diagnose" SWORD AirMassPerCyl 1 100 -3276.800 3276.700 FORMAT "%8.3" ECU_ADDRESS 0x9FF8F4 /end MEASUREMENT
/begin MEASUREMENT Shtrp_EGRBA_mMin_mp "erlaubter Minimalwert für den Luftmassenwert + Trimmwert für die Shtrp-Diagnose" SWORD AirMassPerCyl 1 100 -3276.800 3276.700 FORMAT "%8.3" ECU_ADDRESS 0x9FF8F6 /end MEASUREMENT
/begin MEASUREMENT Shtrp_EGRBA_tiDelay_mp "Zeit zwischen dem Ansteuern des Aktuators und dem Durchführen der Diagnose + Trimmwert" UWORD Time_ms 1 100 0.00 655350.0 FORMAT "%8.1" ECU_ADDRESS 0x9FF8F8 /end MEASUREMENT
/begin MEASUREMENT Shtrp_LSU_position_mp "Status des LSU Short Trip Tests" UBYTE OneToOne 1 100 0.00 255.0 FORMAT "%5.1" ECU_ADDRESS 0x9FFFA2 /end MEASUREMENT
/begin MEASUREMENT Shtrp_mAirPerCylFlt "Gefilterter Luftmassenwert für die Shorttrip Diagnose" SWORD AirMassPerCyl 1 100 -3276.800 3276.700 FORMAT "%8.3" ECU_ADDRESS 0x7F9C60 /end MEASUREMENT
/begin MEASUREMENT Shtrp_nRmpSlpDwn "Rampensteigung für verringerde Drehzahlwerte für Shtrp" ULONG RmpEngN_LIGov 1 100 0.00 9362285.71211 FORMAT "%13.5" ECU_ADDRESS 0x7F9EB8 /end MEASUREMENT
/begin MEASUREMENT Shtrp_nRmpSlpUp "Rampensteigung für erhöhende Drehzahlwerte für Shtrp" ULONG RmpEngN_LIGov 1 100 0.00 9362285.71211 FORMAT "%13.5" ECU_ADDRESS 0x7F9EBC /end MEASUREMENT
/begin MEASUREMENT Shtrp_nSetPointDia "Drehzahlanforderung der Short Trip Diagnose" SWORD EngN 1 100 -32768.00 32767.00 FORMAT "%8.2" ECU_ADDRESS 0x7F9C62 /end MEASUREMENT
/begin MEASUREMENT Shtrp_numCurrTst "Nummer des aktuellen Short Trip Einzeltest" UBYTE OneToOne 1 100 0.00 255.0 FORMAT "%5.1" ECU_ADDRESS 0x7F9546 /end MEASUREMENT
/begin MEASUREMENT Shtrp_PCRBA_pDeltaMax_mp "maximale zulässige Differenz + Trimmwert" SWORD Pres_hPa 1 100 -32768.00 32767.00 FORMAT "%8.2" ECU_ADDRESS 0x9FF8FA /end MEASUREMENT
/begin MEASUREMENT Shtrp_PCRBA_pDeltaMin_mp "minimale zulässige Differenz + Trimmwert" SWORD Pres_hPa 1 100 -32768.00 32767.00 FORMAT "%8.2" ECU_ADDRESS 0x9FF8FC /end MEASUREMENT
/begin MEASUREMENT Shtrp_PCRBA_tiDelay_mp "Zeit zwischen dem Ansteuern des Aktuators und dem Durchführen der Diagnose + Trimmwert" UWORD Time_ms 1 100 0.00 655350.0 FORMAT "%8.1" ECU_ADDRESS 0x9FF8FE /end MEASUREMENT
/begin MEASUREMENT Shtrp_pLinFlt "Gefilterter Ladedruck für die Shorttrip Diagnose" SWORD Pres_hPa 1 100 -32768.00 32767.00 FORMAT "%8.2" ECU_ADDRESS 0x7F9C64 /end MEASUREMENT
/begin MEASUREMENT Shtrp_rEGRBA "Tastverhältnis der EGR Endstufe bei Short Trip EGR Grundeinstellungstest" SWORD Prc 1 100 -327.6800 327.6700 FORMAT "%8.4" ECU_ADDRESS 0x7F9C66 /end MEASUREMENT
/begin MEASUREMENT Shtrp_rPCRBA "Tastverhältnis der EGR Endstufe bei Short Trip PCR Grundeinstellungstest" SWORD Prc 1 100 -327.6800 327.6700 FORMAT "%8.4" ECU_ADDRESS 0x7F9C68 /end MEASUREMENT
/begin MEASUREMENT Shtrp_rTVA "Tastverhältnis der TVA Endstufe bei Short Trip TVA Grundeinstellungstest" SWORD Prc 1 100 -327.6800 327.6700 FORMAT "%8.4" ECU_ADDRESS 0x7F9C6A /end MEASUREMENT
/begin MEASUREMENT Shtrp_st "Status der Short Trip Statemachine" UBYTE OneToOne 1 100 0.00 255.0 FORMAT "%5.1" ECU_ADDRESS 0x7F9547 /end MEASUREMENT
/begin MEASUREMENT Shtrp_stAct "Staus der Short Trip Diagnose (aktiv/nicht aktiv)" UBYTE OneToOne 1 100 0.00 255.0 FORMAT "%5.1" ECU_ADDRESS 0x7F9548 /end MEASUREMENT
/begin MEASUREMENT Shtrp_stActRout_mp "Status der Weiterschaltbedingungen zur Freigabe der Short Trip Diagnose" UBYTE OneToOne 1 100 0.00 255.0 FORMAT "%5.1" ECU_ADDRESS 0x9FFFA3 /end MEASUREMENT
/begin MEASUREMENT Shtrp_stAllowed "Bitcodierter Status der Short Trip Aktivierungsbedingungen" ULONG OneToOne 1 100 0.00 4294967295.00 FORMAT "%13.2" ECU_ADDRESS 0x7F9EC0 /end MEASUREMENT
/begin MEASUREMENT Shtrp_stFCM "Information ob Fehlerspeicher im aktuellen Fahrzyklus gelöscht wurde" UBYTE OneToOne 1 100 0.00 255.0 FORMAT "%5.1" ECU_ADDRESS 0x7F9549 /end MEASUREMENT
/begin MEASUREMENT Shtrp_stReset "Reset-Status zum Rücksetzen des Zyklusflags von Dfp_AFSCD_PlSetyDrft_mp" UBYTE OneToOne 1 100 0.00 255.0 FORMAT "%5.1" ECU_ADDRESS 0x7F954A /end MEASUREMENT
/begin MEASUREMENT Shtrp_stRgnStg "Schalterstellung vom Regenerationsstufenschlater im Shorttrip T3 Test" UBYTE OneToOne 1 100 0.00 255.0 FORMAT "%5.1" ECU_ADDRESS 0x7F954B /end MEASUREMENT
/begin MEASUREMENT Shtrp_stRoutDem_mp "Zeigt die Kommunikation mit dem Tester (Anforderung vom Tester)    (Diagnose)" UBYTE OneToOne 1 100 0.00 255.0 FORMAT "%5.1" ECU_ADDRESS 0x9FFFA4 /end MEASUREMENT
/begin MEASUREMENT Shtrp_stT3Tst "Zustand des Shorttrip T3 Tests" UBYTE OneToOne 1 100 0.00 255.0 FORMAT "%5.1" ECU_ADDRESS 0x7F954C /end MEASUREMENT
/begin MEASUREMENT Shtrp_stTstState "Bitcodierter Status der automatischen Grundeinstellung bei der Short Trip Diagnose" UWORD OneToOne 1 100 0.00 65535.00 FORMAT "%8.2" ECU_ADDRESS 0x7F9C6C /end MEASUREMENT
/begin MEASUREMENT Signals_PID0x1C "Info für Generic Scan Tool (OBD-Tester) für welche Vorschrift das Fahrzeug appliziert wurde" UBYTE OneToOne 1 100 0.00 255.0 FORMAT "%5.1" ECU_ADDRESS 0x7F954E /end MEASUREMENT
/begin MEASUREMENT signals_stTestNLim_mp "Meßpunkt für Status Drehzahlbegrenzung von Stellertests" UBYTE OneToOne 1 100 0.00 255.0 FORMAT "%5.1" ECU_ADDRESS 0x9FFFA5 /end MEASUREMENT
/begin MEASUREMENT signals_stTest_mp "Meßpunkt für Status Stellertest" ULONG OneToOne 1 100 0.00 4294967295.00 FORMAT "%13.2" ECU_ADDRESS 0x9FE6F0 /end MEASUREMENT
/begin MEASUREMENT signals_tiTstRemain_mp "Meßpunkt für verbleibende Zeit bis zur Abschaltung Stellertest über Zeitgrenze" UWORD Time_ms 1 100 0.00 655350.0 FORMAT "%8.1" ECU_ADDRESS 0x9FF900 /end MEASUREMENT
/begin MEASUREMENT SOPTst_stCyl "Endstufen die sich trotz redundanter Abschaltung aktivieren ließen" UBYTE OneToOne 1 100 0.00 255.0 FORMAT "%5.1" ECU_ADDRESS 0x7F9542 /end MEASUREMENT
/begin MEASUREMENT SOPTst_stShOffAR "Abschaltpfadtest im Nachlauf" UWORD OneToOne 1 100 0.00 65535.00 FORMAT "%8.2" ECU_ADDRESS 0x7F9C5C /end MEASUREMENT
/begin MEASUREMENT SrvPmp_facDemandEEP_mp "Limitierter Ableichwert von EEPROM Wert SRVPMP_PWR_DEMAND" SWORD Fact 1 100 -4.000000 3.999878 FORMAT "%8.6" ECU_ADDRESS 0x9FF902 /end MEASUREMENT
/begin MEASUREMENT SrvPmp_pwrDes "Leistungsbedarf der Servopumpe" SWORD Pwr 1 100 -308831.1 308821.7 FORMAT "%8.1" ECU_ADDRESS 0x7F9C6E /end MEASUREMENT
/begin MEASUREMENT SrvPmp_pwrDesActVal_mp "Aktueller Leistungsverlust durch Lenkhilfepumpe" SWORD Pwr 1 100 -308831.1 308821.7 FORMAT "%8.1" ECU_ADDRESS 0x9FF904 /end MEASUREMENT
/begin MEASUREMENT SrvPmp_pwrLead "Leistungsvorhalt der Servopumpe" SWORD Pwr 1 100 -308831.1 308821.7 FORMAT "%8.1" ECU_ADDRESS 0x7F9C70 /end MEASUREMENT
/begin MEASUREMENT SrvPmp_pwrPhiSteer_mp "Leistungsverlust Lenkwinkelabhängig" SWORD Pwr 1 100 -308831.1 308821.7 FORMAT "%8.1" ECU_ADDRESS 0x9FF906 /end MEASUREMENT
/begin MEASUREMENT SrvPmp_pwrVPhiSteer_mp "Leistungsverlust in Abhängigkeit von der Lenkwinkelgeschwindigkeit" SWORD Pwr 1 100 -308831.1 308821.7 FORMAT "%8.1" ECU_ADDRESS 0x9FF908 /end MEASUREMENT
/begin MEASUREMENT SSpMon_stRaw_1_mp "Rohwert der Defekterkennung der Sensorversorgungsspannung 1" SWORD OneToOne 1 100 -32768.00 32767.00 FORMAT "%8.2" ECU_ADDRESS 0x9FF90A /end MEASUREMENT
/begin MEASUREMENT SSpMon_stRaw_2_mp "Rohwert der Defekterkennung der Sensorversorgungsspannung 2" SWORD OneToOne 1 100 -32768.00 32767.00 FORMAT "%8.2" ECU_ADDRESS 0x9FF90C /end MEASUREMENT
/begin MEASUREMENT SSpMon_stRaw_3_mp "Rohwert der Defekterkennung der Sensorversorgungsspannung 3" SWORD OneToOne 1 100 -32768.00 32767.00 FORMAT "%8.2" ECU_ADDRESS 0x9FF90E /end MEASUREMENT
/begin MEASUREMENT SSpMon_stSSpErr "Fehlerstatus der Sensorversorgungsspannungen" UWORD OneToOne 1 100 0.00 65535.00 FORMAT "%8.2" ECU_ADDRESS 0x7F9C5E /end MEASUREMENT
/begin MEASUREMENT StrtCD_stPwrStgOffRly_mp "Endstufenfehlerinformation des Starter Aus-Relais" UWORD OneToOne 1 100 0.00 65535.00 FORMAT "%8.2" ECU_ADDRESS 0x9FF910 /end MEASUREMENT
/begin MEASUREMENT StrtCD_stPwrStgOnRly_mp "Endstufenfehlerinformation des Starter Ein-Relais" UWORD OneToOne 1 100 0.00 65535.00 FORMAT "%8.2" ECU_ADDRESS 0x9FF912 /end MEASUREMENT
/begin MEASUREMENT StrtCD_uPhyValOffRly "Spannung der Endstufe Klemme 50 Aus-Relais" SWORD Volt 1 100 -160156.4 160151.5 FORMAT "%8.1" ECU_ADDRESS 0x7F9C7A /end MEASUREMENT
/begin MEASUREMENT StrtCD_uPhyValOnRly "Spannung der Endstufe Klemme 50 Ein-Relais" SWORD Volt 1 100 -160156.4 160151.5 FORMAT "%8.1" ECU_ADDRESS 0x7F9C7C /end MEASUREMENT
/begin MEASUREMENT StSysCtl_cntT50DebVal_mp "Anzahl an T50-Startanforderungen" UWORD OneToOne 1 100 0.00 65535.00 FORMAT "%8.2" ECU_ADDRESS 0x9FF92A /end MEASUREMENT
/begin MEASUREMENT StSysCtl_ctCaSImpT50On_mp "Zähler für Nockenwellenimpulse seit T50 steigende Flanke" UWORD OneToOne 1 100 0.00 65535.00 FORMAT "%8.2" ECU_ADDRESS 0x9FF928 /end MEASUREMENT
/begin MEASUREMENT StSysCtl_stEepDiagRly_mp "Relais Abschaltfolge (0: Aus-Relais/1: Ein-Relais)" UBYTE OneToOne 1 100 0.00 255.0 FORMAT "%5.1" ECU_ADDRESS 0x9FFFAC /end MEASUREMENT
/begin MEASUREMENT StSysCtl_stIlsPlsAlive "Plausibilitaetserkennung des Interlocksignals" UBYTE OneToOne 1 100 0.00 255.0 FORMAT "%5.1" ECU_ADDRESS 0x7F954F /end MEASUREMENT
/begin MEASUREMENT StSysCtl_stIlsPlsShtOff "Status der Abschaltung durch Fehler in der Interlockplausibilitaet" UBYTE OneToOne 1 100 0.00 255.0 FORMAT "%5.1" ECU_ADDRESS 0x7F9550 /end MEASUREMENT
/begin MEASUREMENT StSysCtl_stNoCrSSigAct "Flag für kein Kurbelwellen jedoch Nockenwellensignal erkannt" UBYTE OneToOne 1 100 0.00 255.0 FORMAT "%5.1" ECU_ADDRESS 0x7F9551 /end MEASUREMENT
/begin MEASUREMENT StSysCtl_stNoCrSSig_mp "Bitcodierter Status für Erkennung kein Kurbewellensignal" UBYTE OneToOne 1 100 0.00 255.0 FORMAT "%5.1" ECU_ADDRESS 0x9FFFAA /end MEASUREMENT
/begin MEASUREMENT StSysCtl_stRlyDiag_mp "Welches Relais soll diagnostiziert werden (0: Aus-Relais/1: Ein-Relais)" UBYTE OneToOne 1 100 0.00 255.0 FORMAT "%5.1" ECU_ADDRESS 0x9FFFAD /end MEASUREMENT
/begin MEASUREMENT StSysCtl_stStandStillAR_mp "Motorstillstand im vorigen Nachlauf erkannt." UBYTE OneToOne 1 100 0.00 255.0 FORMAT "%5.1" ECU_ADDRESS 0x9FFFAE /end MEASUREMENT
/begin MEASUREMENT StSysCtl_stStrtCncl "Startabbruch Status" UBYTE OneToOne 1 100 0.00 255.0 FORMAT "%5.1" ECU_ADDRESS 0x7F9552 /end MEASUREMENT
/begin MEASUREMENT StSysCtl_stStrtCncl_mp "Startabbruch Bedingungen Bit codiert" UWORD OneToOne 1 100 0.00 65535.00 FORMAT "%8.2" ECU_ADDRESS 0x7FDE32 /end MEASUREMENT
/begin MEASUREMENT StSysCtl_stStrtCtlMode "Message zum Anzeigen von StSysCtl_swtStSysCtlMode_C" UBYTE OneToOne 1 100 0.00 255.0 FORMAT "%5.1" ECU_ADDRESS 0x7F9553 /end MEASUREMENT
/begin MEASUREMENT StSysCtl_stStrtDisengaFrm "Start Ausspur Status" UBYTE OneToOne 1 100 0.00 255.0 FORMAT "%5.1" ECU_ADDRESS 0x7F9554 /end MEASUREMENT
/begin MEASUREMENT StSysCtl_stStrtEngRlsBSG_mp "Status der Starterfreigabe von BSG/Kessy" UBYTE OneToOne 1 100 0.00 255.0 FORMAT "%5.1" ECU_ADDRESS 0x9FFFAB /end MEASUREMENT
/begin MEASUREMENT StSysCtl_stStrtEngRlsMSG_mp "Status der Starterfreigabe von MSG" UBYTE OneToOne 1 100 0.00 255.0 FORMAT "%5.1" ECU_ADDRESS 0x9FFFAF /end MEASUREMENT
/begin MEASUREMENT StSysCtl_stStrtRlsFrm "Starterfreigabe Status" UBYTE OneToOne 1 100 0.00 255.0 FORMAT "%5.1" ECU_ADDRESS 0x7F9555 /end MEASUREMENT
/begin MEASUREMENT StSysCtl_stT15Lock_mp "K15 Sperre Status" UBYTE OneToOne 1 100 0.00 255.0 FORMAT "%5.1" ECU_ADDRESS 0x9FFFB0 /end MEASUREMENT
/begin MEASUREMENT StSysCtl_stT50CDOff "Status des Starter Aus-Relais" UBYTE OneToOne 1 100 0.00 255.0 FORMAT "%5.1" ECU_ADDRESS 0x7F9556 /end MEASUREMENT
/begin MEASUREMENT StSysCtl_stT50CDOn "Status des Starter Ein-Relais" UBYTE OneToOne 1 100 0.00 255.0 FORMAT "%5.1" ECU_ADDRESS 0x7F9557 /end MEASUREMENT
/begin MEASUREMENT StSysCtl_stTmrStrtCtl_mp "Starttimer Status" UBYTE OneToOne 1 100 0.00 255.0 FORMAT "%5.1" ECU_ADDRESS 0x9FFFB1 /end MEASUREMENT
/begin MEASUREMENT StSys_dtrqInc_mp "gültiges Momentinkrement" ULONG RmpTrq 1 100 0.00 6553599.99847 FORMAT "%13.5" ECU_ADDRESS 0x9FE6F4 /end MEASUREMENT
/begin MEASUREMENT StSys_duBattDiff_mp "Differenz der letzen Mittelungsdurchläufe für die Batteriewerte" SWORD Volt_Batt_PerSec_20ms 1 100 -332837.0 332826.9 FORMAT "%8.1" ECU_ADDRESS 0x9FF920 /end MEASUREMENT
/begin MEASUREMENT StSys_nThresStrtCutOut_mp "Startabwurfdrehzahl" SWORD EngN 1 100 -32768.00 32767.00 FORMAT "%8.2" ECU_ADDRESS 0x9FF914 /end MEASUREMENT
/begin MEASUREMENT StSys_nThrestEng_mp "Temperaturabhängige Drehzahlschwelle für Zweimassenschwungrad" SWORD EngN 1 100 -32768.00 32767.00 FORMAT "%8.2" ECU_ADDRESS 0x9FF922 /end MEASUREMENT
/begin MEASUREMENT StSys_nUpLiThrestEng_mp "Temperaturabhängige obere Drehzahlschwelle für Zweimassenschwungrad" SWORD EngN 1 100 -32768.00 32767.00 FORMAT "%8.2" ECU_ADDRESS 0x9FF924 /end MEASUREMENT
/begin MEASUREMENT StSys_stMonTrqShutOff_mp "Bitcodierte Messpunkt für die Überwachung der Startmomentsabschaltung" UBYTE OneToOne 1 100 0.00 255.0 FORMAT "%5.1" ECU_ADDRESS 0x9FFFA8 /end MEASUREMENT
/begin MEASUREMENT StSys_stRlsHtg "Freigabestatus des Heizungssystems" UBYTE OneToOne 1 100 0.00 255.0 FORMAT "%5.1" ECU_ADDRESS 0x7F9558 /end MEASUREMENT
/begin MEASUREMENT StSys_stRmpMon "Zustand der Startmomenterhoehung" UBYTE OneToOne 1 100 0.00 255.0 FORMAT "%5.1" ECU_ADDRESS 0x7F9559 /end MEASUREMENT
/begin MEASUREMENT StSys_stShutOffTimer "Status des Timers für Startmomentenabschaltung" UBYTE OneToOne 1 100 0.00 255.0 FORMAT "%5.1" ECU_ADDRESS 0x7F955A /end MEASUREMENT
/begin MEASUREMENT StSys_stSpareStrt "Startart (0: normal Start/1: Notstart)" UBYTE OneToOne 1 100 0.00 255.0 FORMAT "%5.1" ECU_ADDRESS 0x7F955B /end MEASUREMENT
/begin MEASUREMENT StSys_stStallEng_mp "Bit für abgestorbenen Motor" UBYTE OneToOne 1 100 0.00 255.0 FORMAT "%5.1" ECU_ADDRESS 0x9FFFA7 /end MEASUREMENT
/begin MEASUREMENT StSys_stStarter "status der applizierten Quelle für die Erkennung des Startmomentenabschaltung" UBYTE OneToOne 1 100 0.00 255.0 FORMAT "%5.1" ECU_ADDRESS 0x7F955C /end MEASUREMENT
/begin MEASUREMENT StSys_stStarterOK_mp "gesepeicherte Signalstatus für die Erkennung der Startmomenetenabschaltung" UBYTE OneToOne 1 100 0.00 255.0 FORMAT "%5.1" ECU_ADDRESS 0x9FFFA6 /end MEASUREMENT
/begin MEASUREMENT StSys_stStarterRES "Statusmessage ob das applizierte Signal für die Erkennung der Startmomentsabschaltung fehlerhaft ist oder nicht" UBYTE OneToOne 1 100 0.00 255.0 FORMAT "%5.1" ECU_ADDRESS 0x7F955D /end MEASUREMENT
/begin MEASUREMENT StSys_stStrt "Startzustand" UBYTE OneToOne 1 100 0.00 255.0 FORMAT "%5.1" ECU_ADDRESS 0x7F955E /end MEASUREMENT
/begin MEASUREMENT StSys_stStrtCutOutMon "Zustand des Startabwurfs" UBYTE OneToOne 1 100 0.00 255.0 FORMAT "%5.1" ECU_ADDRESS 0x7F955F /end MEASUREMENT
/begin MEASUREMENT StSys_stTMFW_mp "Statusbits für Zweimassenschwungrad" UBYTE OneToOne 1 100 0.00 255.0 FORMAT "%5.1" ECU_ADDRESS 0x9FFFA9 /end MEASUREMENT
/begin MEASUREMENT StSys_stTrqShutOff "globales Interface fuer die Startmomentabschaltung" UBYTE OneToOne 1 100 0.00 255.0 FORMAT "%5.1" ECU_ADDRESS 0x7F9560 /end MEASUREMENT
/begin MEASUREMENT StSys_tiRmpLck_mp "gültige Rampensperrzeit" UWORD Time_ms 1 100 0.00 655350.0 FORMAT "%8.1" ECU_ADDRESS 0x9FF91C /end MEASUREMENT
/begin MEASUREMENT StSys_tiShutOff_mp "Abschaltzeit des Startmoments" UWORD Time_ms 1 100 0.00 655350.0 FORMAT "%8.1" ECU_ADDRESS 0x9FF926 /end MEASUREMENT
/begin MEASUREMENT StSys_trqAddCor "zusaetzliches Korrekturmoment f. Startmoment" SWORD Trq 1 100 -3276.800 3276.700 FORMAT "%8.3" ECU_ADDRESS 0x7F9C72 /end MEASUREMENT
/begin MEASUREMENT StSys_trqAdj_mp "Startmomentkorrektur" SWORD Trq 1 100 -3276.800 3276.700 FORMAT "%8.3" ECU_ADDRESS 0x9FF916 /end MEASUREMENT
/begin MEASUREMENT StSys_trqBas "Startbasismoment" SWORD Trq 1 100 -3276.800 3276.700 FORMAT "%8.3" ECU_ADDRESS 0x7F9C74 /end MEASUREMENT
/begin MEASUREMENT StSys_trqLim_mp "Grenzmoment beim Startvorgang" SWORD Trq 1 100 -3276.800 3276.700 FORMAT "%8.3" ECU_ADDRESS 0x9FF91E /end MEASUREMENT
/begin MEASUREMENT StSys_trqRmpState "Moment der Startrampe" SWORD Trq 1 100 -3276.800 3276.700 FORMAT "%8.3" ECU_ADDRESS 0x7F9C76 /end MEASUREMENT
/begin MEASUREMENT StSys_trqStrt "inneres Moment Startwert" SWORD Trq 1 100 -3276.800 3276.700 FORMAT "%8.3" ECU_ADDRESS 0x7F9C78 /end MEASUREMENT
/begin MEASUREMENT StSys_trqStrtBas_mp "Basismoment fuer Start" SWORD Trq 1 100 -3276.800 3276.700 FORMAT "%8.3" ECU_ADDRESS 0x9FF918 /end MEASUREMENT
/begin MEASUREMENT StSys_trqValEEP_mp "Limitierter EEPROM Abgleichwert von STARTING_TRQ" SWORD Trq 1 100 -3276.800 3276.700 FORMAT "%8.3" ECU_ADDRESS 0x9FF91A /end MEASUREMENT
/begin MEASUREMENT SvLpCD_dFillLvlCnt "Anzahl der plausiblen Füllstände" UBYTE OneToOne 1 100 0.00 255.0 FORMAT "%5.1" ECU_ADDRESS 0x7F9561 /end MEASUREMENT
/begin MEASUREMENT SvLpCD_lFillLvl_1_mp "Füllstand 1" UWORD Length1_mm 1 100 0.00 262.1400 FORMAT "%8.4" ECU_ADDRESS 0x9FF93C /end MEASUREMENT
/begin MEASUREMENT SvLpCD_lFillLvl_2_mp "Füllstand 2" UWORD Length1_mm 1 100 0.00 262.1400 FORMAT "%8.4" ECU_ADDRESS 0x9FF93E /end MEASUREMENT
/begin MEASUREMENT SvLpCD_lFillLvl_3_mp "Füllstand 3" UWORD Length1_mm 1 100 0.00 262.1400 FORMAT "%8.4" ECU_ADDRESS 0x9FF940 /end MEASUREMENT
/begin MEASUREMENT SvLpCD_lFillLvl_4_mp "Füllstand 4" UWORD Length1_mm 1 100 0.00 262.1400 FORMAT "%8.4" ECU_ADDRESS 0x9FF942 /end MEASUREMENT
/begin MEASUREMENT SvLpCD_ltmpMin2 "Ölwarnungskompensation" UWORD Length1_mm 1 100 0.00 262.1400 FORMAT "%8.4" ECU_ADDRESS 0x7F9C7E /end MEASUREMENT
/begin MEASUREMENT SvLpCD_nAvrgFlt "geglättete Drehzahl" SWORD EngN 1 100 -32768.00 32767.00 FORMAT "%8.2" ECU_ADDRESS 0x7F9C80 /end MEASUREMENT
/begin MEASUREMENT SvLpCD_stFillLvlNotPlaus "Status der Füllstandsplausibilisierung" UBYTE OneToOne 1 100 0.00 255.0 FORMAT "%5.1" ECU_ADDRESS 0x7F9562 /end MEASUREMENT
/begin MEASUREMENT SvLpCD_volSingleDiff_1_mp "Einzelfüllstandsdifferenz 1" SWORD volFillLvl_ml 1 100 -32768.00 32767.00 FORMAT "%8.2" ECU_ADDRESS 0x9FF944 /end MEASUREMENT
/begin MEASUREMENT SvLpCD_volSingleDiff_2_mp "Einzelfüllstandsdifferenz 2" SWORD volFillLvl_ml 1 100 -32768.00 32767.00 FORMAT "%8.2" ECU_ADDRESS 0x9FF946 /end MEASUREMENT
/begin MEASUREMENT SvLpCD_volSingleDiff_3_mp "Einzelfüllstandsdifferenz 3" SWORD volFillLvl_ml 1 100 -32768.00 32767.00 FORMAT "%8.2" ECU_ADDRESS 0x9FF948 /end MEASUREMENT
/begin MEASUREMENT SvLpCD_volSingleDiff_4_mp "Einzelfüllstandsdifferenz 4" SWORD volFillLvl_ml 1 100 -32768.00 32767.00 FORMAT "%8.2" ECU_ADDRESS 0x9FF94A /end MEASUREMENT
/begin MEASUREMENT SvLpCD_volSumSingleDiff "Summe der einzelnen Füllstandsmengenunterschiede" SWORD volFillLvl_ml 1 100 -32768.00 32767.00 FORMAT "%8.2" ECU_ADDRESS 0x7F9C82 /end MEASUREMENT
/begin MEASUREMENT SvLp_aTrnvrsFlt_mp "geglättete Querbeschleunigung(PT1)" SWORD TrnvrsAcc 1 100 -327.6800 327.6700 FORMAT "%8.4" ECU_ADDRESS 0x9FF92C /end MEASUREMENT
/begin MEASUREMENT SvLp_dOilLoad "Öltemp.- und Drehzahlabhängige Berechnung" UWORD Fact_WearSootIdx 1 100 0.00 0.001310700 FORMAT "%11.9" ECU_ADDRESS 0x7F9C84 /end MEASUREMENT
/begin MEASUREMENT SvLp_dOilLoadWIV2 "Öltemp.- und Drehzahlabhängige Berechnung für WIV2" SWORD OneToOne 1 100 -32768.00 32767.00 FORMAT "%8.2" ECU_ADDRESS 0x7F9C86 /end MEASUREMENT
/begin MEASUREMENT SvLp_dOilLvlCnt "Ölstandszähler" UBYTE OneToOne 1 100 0.00 255.0 FORMAT "%5.1" ECU_ADDRESS 0x7F9563 /end MEASUREMENT
/begin MEASUREMENT SvLp_dOilLvlCnt_tmp_mp "Ölstandszähler für die Plausibilisierung der Füllstandszeit" UBYTE OneToOne 1 100 0.00 255.0 FORMAT "%5.1" ECU_ADDRESS 0x9FFFB2 /end MEASUREMENT
/begin MEASUREMENT SvLp_dSootLoad "Drehzahl- und Einspritzmengenabhängige Berechnung" UWORD Fact_WearSootIdx 1 100 0.00 0.001310700 FORMAT "%11.9" ECU_ADDRESS 0x7F9C88 /end MEASUREMENT
/begin MEASUREMENT SvLp_dSootLoadByp_mp "Bypass message für SvLp_dSootLoad" UWORD Fact_WearSootIdx 1 100 0.00 0.001310700 FORMAT "%11.9" ECU_ADDRESS 0x9FF92E /end MEASUREMENT
/begin MEASUREMENT SvLp_dSootLoadWIV2 "Drehzahl- und Einspritzmengenabhängige Berechnung für WIV2" SWORD OneToOne 1 100 -32768.00 32767.00 FORMAT "%8.2" ECU_ADDRESS 0x7F9C8A /end MEASUREMENT
/begin MEASUREMENT SvLp_dSootLoadWIV2Byp_mp "Bypass message für SvLp_dSootLoadWIV2" SWORD OneToOne 1 100 -32768.00 32767.00 FORMAT "%8.2" ECU_ADDRESS 0x9FF930 /end MEASUREMENT
/begin MEASUREMENT SvLp_dSootWear_z_mp "Zähler zur Anzeige der Summe der Ruß-/Verschleißindizes über einen Zeitraum von 2.4s" UBYTE OneToOne 1 100 0.00 255.0 FORMAT "%5.1" ECU_ADDRESS 0x9FFFB3 /end MEASUREMENT
/begin MEASUREMENT SvLp_facQI_mp "Guete-Faktor für die Berechnung des Kurzzeitmittelwerts und des Ölstandzählers" UWORD OneToOne 1 100 0.00 65535.00 FORMAT "%8.2" ECU_ADDRESS 0x9FF932 /end MEASUREMENT
/begin MEASUREMENT SvLp_lSootIdx_mp "Rußindex - Zwischen- und Summenwert des Rußkennfeldes" UWORD Length 1 100 0.00 65535.00 FORMAT "%8.2" ECU_ADDRESS 0x9FF934 /end MEASUREMENT
/begin MEASUREMENT SvLp_lSootLoad_mp "Russindexwert berechnet aus dem Russ- Eintragskennfeld[ m]" SWORD Length 1 100 -32768.00 32767.00 FORMAT "%8.2" ECU_ADDRESS 0x9FF936 /end MEASUREMENT
/begin MEASUREMENT SvLp_lWearIdx_mp "Verschleißindex - Zwischen- und Summenwert des Ölkennfeldes" UWORD Length 1 100 0.00 65535.00 FORMAT "%8.2" ECU_ADDRESS 0x9FF938 /end MEASUREMENT
/begin MEASUREMENT SvLp_stFillLvlPlaus_mp "Status Füllsatndsplausibilität nach jedem empfangen der TOG Botschaft" UBYTE OneToOne 1 100 0.00 255.0 FORMAT "%5.1" ECU_ADDRESS 0x9FFFB4 /end MEASUREMENT
/begin MEASUREMENT SvLp_stTogglefvfr "Status, der die neue Berechnung von Wear/Soot anzeigt" UBYTE OneToOne 1 100 0.00 255.0 FORMAT "%5.1" ECU_ADDRESS 0x7F9565 /end MEASUREMENT
/begin MEASUREMENT SvLp_stToggle_dCANzCAN "Toggle message, die bei jedem neuen Wert des Kurzzeitmittelwertes den Zustand ändert" UBYTE OneToOne 1 100 0.00 255.0 FORMAT "%5.1" ECU_ADDRESS 0x7F9564 /end MEASUREMENT
/begin MEASUREMENT SvLp_swtPresent "Schalterstellung, ob SI berechnet wird" UBYTE OneToOne 1 100 0.00 255.0 FORMAT "%5.1" ECU_ADDRESS 0x7F9566 /end MEASUREMENT
/begin MEASUREMENT SvLp_swtSotLdRgn_mp "Statuswort zur Umschaltung zwischen Russ- Eingangskennfeldern[]" UBYTE OneToOne 1 100 0.00 255.0 FORMAT "%5.1" ECU_ADDRESS 0x9FFFB5 /end MEASUREMENT
/begin MEASUREMENT SvLp_volMeanValPerTOSMsg_mp "Differenzensumme Mittelwerte" SWORD volFillLvl_ml 1 100 -32768.00 32767.00 FORMAT "%8.2" ECU_ADDRESS 0x9FF93A /end MEASUREMENT
/begin MEASUREMENT SvLp_volShTiMeanVal "Kurzzeitmittelwert" SWORD volFillLvl_ml 1 100 -32768.00 32767.00 FORMAT "%8.2" ECU_ADDRESS 0x7F9C8C /end MEASUREMENT
/begin MEASUREMENT SvLp_volShTiMeanVal_tmp_mp "Summe der einzelnen Füllstandsunterschiede des Komponententreibers" SLONG volFillLvl_ml 1 100 -2147483648.00 2147483647.00 FORMAT "%13.2" ECU_ADDRESS 0x9FE6F8 /end MEASUREMENT
/begin MEASUREMENT SWTmr_tiTmr16 "16-Bit Referenzzeit für Timer" UWORD Time_ms 1 100 0.00 655350.0 FORMAT "%8.1" ECU_ADDRESS 0x7F92AA /end MEASUREMENT
/begin MEASUREMENT SWTmr_tiTmr32 "32-Bit Referenzzeit für Timer" ULONG Time_ms 1 100 0.00 42949672950.0 FORMAT "%13.1" ECU_ADDRESS 0x7F92AC /end MEASUREMENT
/begin MEASUREMENT T15CD_stAnDebVal "Entprellter Wert der Klemme 15 aus Analogerfassung" UBYTE OneToOne 1 100 0.00 255.0 FORMAT "%5.1" ECU_ADDRESS 0x7F9567 /end MEASUREMENT
/begin MEASUREMENT T15CD_stAnRawVal "Status der Klemme 15 aus Analogerfassung" UBYTE OneToOne 1 100 0.00 255.0 FORMAT "%5.1" ECU_ADDRESS 0x7F9568 /end MEASUREMENT
/begin MEASUREMENT T15CD_stCutOff "Abschaltung der CAN/Suspend-Mode Überwachung" UBYTE OneToOne 1 100 0.00 255.0 FORMAT "%5.1" ECU_ADDRESS 0x7F9569 /end MEASUREMENT
/begin MEASUREMENT T15CD_stDebVal "entprellter Wert der Klemme 15" UBYTE OneToOne 1 100 0.00 255.0 FORMAT "%5.1" ECU_ADDRESS 0x7F956A /end MEASUREMENT
/begin MEASUREMENT T15CD_stRawVal "Rohwert der Klemme 15" UBYTE OneToOne 1 100 0.00 255.0 FORMAT "%5.1" ECU_ADDRESS 0x7F956B /end MEASUREMENT
/begin MEASUREMENT T15CD_uFltVal "Klemme 15 gefilterter Analogwert" SWORD Volt_Batt 1 100 -665674.1 665653.8 FORMAT "%8.1" ECU_ADDRESS 0x7F9C8E /end MEASUREMENT
/begin MEASUREMENT T15CD_uLinVal "Klemme 15 linearer Analogwert" SWORD Volt_Batt 1 100 -665674.1 665653.8 FORMAT "%8.1" ECU_ADDRESS 0x7F9C90 /end MEASUREMENT
/begin MEASUREMENT T15CD_uRawVal "Klemme 15 analoger Rohwert" SWORD Volt_Batt 1 100 -665674.1 665653.8 FORMAT "%8.1" ECU_ADDRESS 0x7F9C92 /end MEASUREMENT
/begin MEASUREMENT T15CD_uVal "Aktueller Wert der Klemme 15" SWORD Volt_Batt 1 100 -665674.1 665653.8 FORMAT "%8.1" ECU_ADDRESS 0x7F9C94 /end MEASUREMENT
/begin MEASUREMENT T50CD_stDebVal "entprellter Statuswert der Klemme 50" UBYTE OneToOne 1 100 0.00 255.0 FORMAT "%5.1" ECU_ADDRESS 0x7F956C /end MEASUREMENT
/begin MEASUREMENT T50CD_stDebValByp_mp "Bypass für T50CD_stDebVal" UBYTE OneToOne 1 100 0.00 255.0 FORMAT "%5.1" ECU_ADDRESS 0x9FFFB6 /end MEASUREMENT
/begin MEASUREMENT T50CD_stRawVal "unentprellter Wert des Eingangssignals für Klemme 50" UBYTE OneToOne 1 100 0.00 255.0 FORMAT "%5.1" ECU_ADDRESS 0x7F956D /end MEASUREMENT
/begin MEASUREMENT T50CD_stRxDebVal "Entprellter Statuswert der Anlasserrückmeldeleitung" UBYTE OneToOne 1 100 0.00 255.0 FORMAT "%5.1" ECU_ADDRESS 0x7F956E /end MEASUREMENT
/begin MEASUREMENT T50CD_stRxDebValByp_mp "Bypass für T50CD_stRxDebVal" UBYTE OneToOne 1 100 0.00 255.0 FORMAT "%5.1" ECU_ADDRESS 0x9FFFB7 /end MEASUREMENT
/begin MEASUREMENT T50CD_stRxRawVal "Anlasserrückmeldeleitung Rohwert" UBYTE OneToOne 1 100 0.00 255.0 FORMAT "%5.1" ECU_ADDRESS 0x7F956F /end MEASUREMENT
/begin MEASUREMENT T50CD_swtDigInPresentVal "Klemme 50 vorhanden" UBYTE OneToOne 1 100 0.00 255.0 FORMAT "%5.1" ECU_ADDRESS 0x7F9570 /end MEASUREMENT
/begin MEASUREMENT T50CD_swtRxDigInPVal "Anlasserrückmeldeleitung vorhanden" UBYTE OneToOne 1 100 0.00 255.0 FORMAT "%5.1" ECU_ADDRESS 0x7F9571 /end MEASUREMENT
/begin MEASUREMENT TAA_ctAngDvt_mp "Inkrementnummer für Winkelkorrekturwert TAA_phiAngDvt_mp" UBYTE OneToOne 1 100 0.00 255.0 FORMAT "%5.1" ECU_ADDRESS 0x9FFFC0 /end MEASUREMENT
/begin MEASUREMENT TAA_facDyn_mp "dynamische Änderung der Inkrementperiodendauer pro Geberrad-Umdrehung" SWORD Fact 1 100 -4.000000 3.999878 FORMAT "%8.6" ECU_ADDRESS 0x9FF952 /end MEASUREMENT
/begin MEASUREMENT TAA_facIpo_mp "Interpolationsfaktor für Inkrementwinkel-Korrekturwerte" SWORD Fact 1 100 -4.000000 3.999878 FORMAT "%8.6" ECU_ADDRESS 0x9FF954 /end MEASUREMENT
/begin MEASUREMENT TAA_nMinCalc_mp "minimale Drehzahl für Inkrementwinkel-Lernverfahren infolge interner Zahlendarstellung" UWORD EngN 1 100 0.00 65535.00 FORMAT "%8.2" ECU_ADDRESS 0x9FF956 /end MEASUREMENT
/begin MEASUREMENT TAA_numActv "Anzahl auszuwertender Inkremente je Rechenraster in Inkrementwinkel-Lernverfahren" UBYTE OneToOne 1 100 0.00 255.0 FORMAT "%5.1" ECU_ADDRESS 0x7F9572 /end MEASUREMENT
/begin MEASUREMENT TAA_numIncBefGap_mp "Nummer des Inkrements vor erster Lücke des Geberrads" UBYTE OneToOne 1 100 0.00 255.0 FORMAT "%5.1" ECU_ADDRESS 0x9FFFC1 /end MEASUREMENT
/begin MEASUREMENT TAA_numIncIR_mp "Inkrementzahl per drehzahlsynchronem Interrupt" UBYTE OneToOne 1 100 0.00 255.0 FORMAT "%5.1" ECU_ADDRESS 0x9FFFC2 /end MEASUREMENT
/begin MEASUREMENT TAA_phiAngDvt_mp "angle correction value for increment TAA_ctAngDvt_mp" SBYTE AngleCrS 1 100 -3.000 2.977 FORMAT "%5.3" ECU_ADDRESS 0x9FFFC3 /end MEASUREMENT
/begin MEASUREMENT TAA_stAdapt "auszuführender Teilalgorithmus im Inkrementwinkel-Lernverfahren" UWORD OneToOne 1 100 0.00 65535.00 FORMAT "%8.2" ECU_ADDRESS 0x7F9C96 /end MEASUREMENT
/begin MEASUREMENT TAA_stAdaptMode_mp "Adaptionsmodus für Inkrementwinkel-Lernverfahren (kein / in / ausserhalb Hauptdrehzahlbereich)" UBYTE OneToOne 1 100 0.00 255.0 FORMAT "%5.1" ECU_ADDRESS 0x9FFFBD /end MEASUREMENT
/begin MEASUREMENT TAA_stAdaptVal_mp "Einschwingzustand Inkrementwinkel-Lernverfahren" UBYTE OneToOne 1 100 0.00 255.0 FORMAT "%5.1" ECU_ADDRESS 0x9FFFBE /end MEASUREMENT
/begin MEASUREMENT TAA_stEnaCond_mp "Aktivierungsbedingung Inkrementwinkel-Lernverfahren (ohne Schubbedingung)" UBYTE OneToOne 1 100 0.00 255.0 FORMAT "%5.1" ECU_ADDRESS 0x9FFFC4 /end MEASUREMENT
/begin MEASUREMENT TAA_stErr_mp "Konfigurationsfehler bei Inkrementwinkel-Lernverfahren" UBYTE OneToOne 1 100 0.00 255.0 FORMAT "%5.1" ECU_ADDRESS 0x9FFFC5 /end MEASUREMENT
/begin MEASUREMENT TAA_stFin "zuletzt ausgeführter Teilalgorithmus Inkrementwinkel-Lernverfahren" UWORD OneToOne 1 100 0.00 65535.00 FORMAT "%8.2" ECU_ADDRESS 0x7F9C98 /end MEASUREMENT
/begin MEASUREMENT TAA_stIdxSync_mp "Inkrementwinkel-Lernverfahren ist synchron mit Winkelsystem" UBYTE OneToOne 1 100 0.00 255.0 FORMAT "%5.1" ECU_ADDRESS 0x9FFFC6 /end MEASUREMENT
/begin MEASUREMENT TAA_stIpoMode_mp "aktueller Interpolationsmodus für Inkrementwinkel-Korrekturwerte" UBYTE OneToOne 1 100 0.00 255.0 FORMAT "%5.1" ECU_ADDRESS 0x9FFFC7 /end MEASUREMENT
/begin MEASUREMENT TAA_stRev2Fin_mp "Triggersignal: zwei Geberradumdrehungen abgeschlossen" UBYTE OneToOne 1 100 0.00 255.0 FORMAT "%5.1" ECU_ADDRESS 0x9FFFC8 /end MEASUREMENT
/begin MEASUREMENT TAA_stRlsOvrRunCo_mp "Aktivierungsbedingung Inkrementwinkel-Lernverfahren" UBYTE OneToOne 1 100 0.00 255.0 FORMAT "%5.1" ECU_ADDRESS 0x9FFFC9 /end MEASUREMENT
/begin MEASUREMENT TAA_stSpdRngRdHigh_mp "oberer Drehzahlbereich für Interpolation Winkelkorrekturwerte" UBYTE OneToOne 1 100 0.00 255.0 FORMAT "%5.1" ECU_ADDRESS 0x9FFFCA /end MEASUREMENT
/begin MEASUREMENT TAA_stSpdRngRdLow_mp "unterer Drehzahlbereich für Interpolation Winkelkorrekturwerte" UBYTE OneToOne 1 100 0.00 255.0 FORMAT "%5.1" ECU_ADDRESS 0x9FFFCB /end MEASUREMENT
/begin MEASUREMENT TAA_stSpdRngWr_mp "aktueller Drehzahlbereich für Inkrementwinkel-Lernverfahren" UBYTE OneToOne 1 100 0.00 255.0 FORMAT "%5.1" ECU_ADDRESS 0x9FFFBF /end MEASUREMENT
/begin MEASUREMENT TAA_tiIncAvrg_mp "mittlere Inkrementperiodendauer aus zwei Geberrad-Umdrehungen" SLONG TimeTincHRes 1 100 -838860.800000 838860.799609 FORMAT "%13.6" ECU_ADDRESS 0x9FE6FC /end MEASUREMENT
/begin MEASUREMENT ThrVlv_ctRlsAttempts_mp "Aktuelle Anzahl der erfolglosen Losreißversuche" UBYTE OneToOne 1 100 0.00 255.0 FORMAT "%5.1" ECU_ADDRESS 0x9FFFCC /end MEASUREMENT
/begin MEASUREMENT ThrVlv_iEffFlt_mp "Modellierter Effektivstrom des thermischen Überlastschutzes" SWORD Curr_A 1 100 -327.6800 327.6700 FORMAT "%8.4" ECU_ADDRESS 0x9FF95C /end MEASUREMENT
/begin MEASUREMENT ThrVlv_rAbsTVA_mp "Absolutbetrag des Reglerausganges ThrVlv_rTVA" SWORD DtyCyc 1 100 -327.6800 327.6700 FORMAT "%8.4" ECU_ADDRESS 0x9FF95E /end MEASUREMENT
/begin MEASUREMENT ThrVlv_rDesTVA_mp "Korrigierter Sollwert für Regelklappensteller" SWORD DtyCyc 1 100 -327.6800 327.6700 FORMAT "%8.4" ECU_ADDRESS 0x9FF958 /end MEASUREMENT
/begin MEASUREMENT ThrVlv_rDesVal "Lagesollwert der Regelklappe" SWORD DtyCyc 1 100 -327.6800 327.6700 FORMAT "%8.4" ECU_ADDRESS 0x7F9CA2 /end MEASUREMENT
/begin MEASUREMENT ThrVlv_rDesValNrm "normierter Drosselklappen-Sollwert" SWORD DtyCyc 1 100 -327.6800 327.6700 FORMAT "%8.4" ECU_ADDRESS 0x7F9CA4 /end MEASUREMENT
/begin MEASUREMENT ThrVlv_rDesValSty_mp "Ersatzwert der Soll-Position im stationären Betriebszustand" SWORD DtyCyc 1 100 -327.6800 327.6700 FORMAT "%8.4" ECU_ADDRESS 0x9FF95A /end MEASUREMENT
/begin MEASUREMENT ThrVlv_rFrc_mp "Tastverhältnis zur Kompensation der Reibung" SWORD DtyCyc 1 100 -327.6800 327.6700 FORMAT "%8.4" ECU_ADDRESS 0x9FF960 /end MEASUREMENT
/begin MEASUREMENT ThrVlv_rGvnrDesVal "interner Sollwert für Lageregler" SWORD DtyCyc 1 100 -327.6800 327.6700 FORMAT "%8.4" ECU_ADDRESS 0x7F9CA6 /end MEASUREMENT
/begin MEASUREMENT ThrVlv_rGvnrDvt "Regelabweichung des Lagereglers" SWORD DtyCyc 1 100 -327.6800 327.6700 FORMAT "%8.4" ECU_ADDRESS 0x7F9CA8 /end MEASUREMENT
/begin MEASUREMENT ThrVlv_rGvnrMax_mp "Maximaler Reglerausgang, begrenzt durch den thermischen Überlastschutz" SWORD DtyCyc 1 100 -327.6800 327.6700 FORMAT "%8.4" ECU_ADDRESS 0x9FF962 /end MEASUREMENT
/begin MEASUREMENT ThrVlv_rGvnrMin_mp "Minimaler (max. negativer) Reglerausgang begrenzt durch den thermischen Überlastschutz" SWORD DtyCyc 1 100 -327.6800 327.6700 FORMAT "%8.4" ECU_ADDRESS 0x9FF964 /end MEASUREMENT
/begin MEASUREMENT ThrVlv_rGvnrThr "Stellgröße des Lagereglers" SWORD DtyCyc 1 100 -327.6800 327.6700 FORMAT "%8.4" ECU_ADDRESS 0x7F9CAA /end MEASUREMENT
/begin MEASUREMENT ThrVlv_rOutDRaw_mp "Rohwert des DT1-Elements des Lagereglers" SWORD DtyCyc 1 100 -327.6800 327.6700 FORMAT "%8.4" ECU_ADDRESS 0x9FF966 /end MEASUREMENT
/begin MEASUREMENT ThrVlv_rOutD_mp "Ausgang des D-Anteils des Reglers" SWORD DtyCyc 1 100 -327.6800 327.6700 FORMAT "%8.4" ECU_ADDRESS 0x9FF968 /end MEASUREMENT
/begin MEASUREMENT ThrVlv_rOutI_mp "Ausgang des I-Anteils des Reglers [%" SWORD DtyCyc 1 100 -327.6800 327.6700 FORMAT "%8.4" ECU_ADDRESS 0x9FF96A /end MEASUREMENT
/begin MEASUREMENT ThrVlv_rOutP_mp "Ausgang des P-Anteils des Reglers [%]" SWORD DtyCyc 1 100 -327.6800 327.6700 FORMAT "%8.4" ECU_ADDRESS 0x9FF96C /end MEASUREMENT
/begin MEASUREMENT ThrVlv_rRampDesVal_mp "Ausgang Rampenfunktion zum Erhöhen des Lagesollwerts" SWORD DtyCyc 1 100 -327.6800 327.6700 FORMAT "%8.4" ECU_ADDRESS 0x9FF96E /end MEASUREMENT
/begin MEASUREMENT ThrVlv_rRlsTVA "Stellgröße der Losreißfunktion" SWORD DtyCyc 1 100 -327.6800 327.6700 FORMAT "%8.4" ECU_ADDRESS 0x7F9CAC /end MEASUREMENT
/begin MEASUREMENT ThrVlv_rTVA "Stellgröße für Regelklappe (Stellerkoordinatorausgang)" SWORD DtyCyc 1 100 -327.6800 327.6700 FORMAT "%8.4" ECU_ADDRESS 0x7F9CAE /end MEASUREMENT
/begin MEASUREMENT ThrVlv_rTVAByp_mp "Bypass-Label, Kopie von ThrVlv_rTVA" SWORD Prc 1 100 -327.6800 327.6700 FORMAT "%8.4" ECU_ADDRESS 0x9FF970 /end MEASUREMENT
/begin MEASUREMENT ThrVlv_stMon "Status der Systemüberwachung" UWORD OneToOne 1 100 0.00 65535.00 FORMAT "%8.2" ECU_ADDRESS 0x7F9CB0 /end MEASUREMENT
/begin MEASUREMENT ThrVlv_stRelease_mp "Status der Losreißfunktion" UBYTE OneToOne 1 100 0.00 255.0 FORMAT "%5.1" ECU_ADDRESS 0x9FFFCD /end MEASUREMENT
/begin MEASUREMENT ThrVlv_stShutOff "Drosselklappe abschalten" UBYTE OneToOne 1 100 0.00 255.0 FORMAT "%5.1" ECU_ADDRESS 0x7F9579 /end MEASUREMENT
/begin MEASUREMENT TPUMon_ctUpDwnDeb_mp "Meßpunkt für den Entprellungszähler der TPUMon Zeitabweichung" UWORD OneToOne 1 100 0.00 65535.00 FORMAT "%8.2" ECU_ADDRESS 0x9FF972 /end MEASUREMENT
/begin MEASUREMENT TPUMon_tiDiffMax_mp "Meßpunkt der maximalen Differenzen aus Timervergleich in den letzten 100 ms" SLONG TimeUSResolution 1 100 -2147483648.00 2147483647.00 FORMAT "%13.2" ECU_ADDRESS 0x9FE70C /end MEASUREMENT
/begin MEASUREMENT TPUMon_tiDiffMin_mp "Meßpunkt der minimalen (negativer Wert) Differenzen aus Timervergleich in den letzten 100 ms" SLONG TimeUSResolution 1 100 -2147483648.00 2147483647.00 FORMAT "%13.2" ECU_ADDRESS 0x9FE710 /end MEASUREMENT
/begin MEASUREMENT TPUMon_tiDiffSum_mp "Meßpunkt der Summe aller Differenzen aus Timervergleich in den letzten 100 ms" SLONG TimeUSResolution 1 100 -2147483648.00 2147483647.00 FORMAT "%13.2" ECU_ADDRESS 0x9FE714 /end MEASUREMENT
/begin MEASUREMENT TstTog_ActRout_mp "Anzahl der Testroutinen die durchlaufen werden müssen" UBYTE OneToOne 1 100 0.00 255.0 FORMAT "%5.1" ECU_ADDRESS 0x9FFFCE /end MEASUREMENT
/begin MEASUREMENT TstTog_DNULL_mp "Dummy Meßpunkt für tsttog.kgs" UBYTE OneToOne 1 100 0.00 255.0 FORMAT "%5.1" ECU_ADDRESS 0x9FFFCF /end MEASUREMENT
/begin MEASUREMENT TstTog_lastRout_mp "letzte Testerroutine" UBYTE OneToOne 1 100 0.00 255.0 FORMAT "%5.1" ECU_ADDRESS 0x9FFFD0 /end MEASUREMENT
/begin MEASUREMENT TstTog_stActRout_mp "Status der durchgeführten Routine" UBYTE OneToOne 1 100 0.00 255.0 FORMAT "%5.1" ECU_ADDRESS 0x9FFFD1 /end MEASUREMENT
/begin MEASUREMENT TstTog_stRoutDem_mp "Status der Anforderung" UBYTE OneToOne 1 100 0.00 255.0 FORMAT "%5.1" ECU_ADDRESS 0x9FFFD2 /end MEASUREMENT
/begin MEASUREMENT TstTog_stTstEnd "Teststatus, der das Ende des aktuellen Tests kennzeichnet" UBYTE OneToOne 1 100 0.00 255.0 FORMAT "%5.1" ECU_ADDRESS 0x7F957A /end MEASUREMENT
/begin MEASUREMENT TstTog_st_mp "TstTog Togglestatus" UBYTE OneToOne 1 100 0.00 255.0 FORMAT "%5.1" ECU_ADDRESS 0x9FFFD3 /end MEASUREMENT
/begin MEASUREMENT TstTog_tiUserInput_mp "Zeit wann der Stellertest endet, wenn kein Eingriff durch den Benutzer erfolgt" UWORD Time_ms 1 100 0.00 655350.0 FORMAT "%8.1" ECU_ADDRESS 0x9FF974 /end MEASUREMENT
/begin MEASUREMENT Tst_Zyklflag_SB1 "Zyklusflagstatus für Bandende" UBYTE OneToOne 1 100 0.00 255.0 FORMAT "%5.1" ECU_ADDRESS 0x7F957B /end MEASUREMENT
/begin MEASUREMENT Tst_Zyklflag_SB2 "Zyklusflagstatus für Bandende" UBYTE OneToOne 1 100 0.00 255.0 FORMAT "%5.1" ECU_ADDRESS 0x7F957C /end MEASUREMENT
/begin MEASUREMENT Tst_Zyklflag_SB3 "Zyklusflagstatus für Bandende" UBYTE OneToOne 1 100 0.00 255.0 FORMAT "%5.1" ECU_ADDRESS 0x7F957D /end MEASUREMENT
/begin MEASUREMENT Tst_Zyklflag_SB4 "Zyklusflagstatus für Bandende" UBYTE OneToOne 1 100 0.00 255.0 FORMAT "%5.1" ECU_ADDRESS 0x7F957E /end MEASUREMENT
/begin MEASUREMENT Tst_Zyklflag_SB5 "Zyklusflagstatus für Bandende" UBYTE OneToOne 1 100 0.00 255.0 FORMAT "%5.1" ECU_ADDRESS 0x7F957F /end MEASUREMENT
/begin MEASUREMENT Tst_Zyklflag_SB6 "Zyklusflagstatus für Bandende" UBYTE OneToOne 1 100 0.00 255.0 FORMAT "%5.1" ECU_ADDRESS 0x7F9580 /end MEASUREMENT
/begin MEASUREMENT Tst_Zyklflag_SB7 "Zyklusflagstatus für Bandende" UBYTE OneToOne 1 100 0.00 255.0 FORMAT "%5.1" ECU_ADDRESS 0x7F9581 /end MEASUREMENT
/begin MEASUREMENT TVACD_facCorFlt_mp "PT1-gefilterter Ausgang des Batteriekorrekturfaktors" SWORD Fact 1 100 -4.000000 3.999878 FORMAT "%8.6" ECU_ADDRESS 0x9FF976 /end MEASUREMENT
/begin MEASUREMENT TVACD_rCnv_mp "Tastverhältnis basierend aus dem Ausgang des Abgasrückführreglers" SWORD DtyCyc 1 100 -327.6800 327.6700 FORMAT "%8.4" ECU_ADDRESS 0x9FF978 /end MEASUREMENT
/begin MEASUREMENT TVACD_rOut "Tastverhältnis zür Endstufenansteuerung" SWORD DtyCyc 1 100 -327.6800 327.6700 FORMAT "%8.4" ECU_ADDRESS 0x7F9C9A /end MEASUREMENT
/begin MEASUREMENT TVACD_stFlag_mp "CJ230 (SF)-Pinzustand" UBYTE OneToOne 1 100 0.00 255.0 FORMAT "%5.1" ECU_ADDRESS 0x9FFFD4 /end MEASUREMENT
/begin MEASUREMENT TVACD_stPwrStgOff "Abschaltstatus der Endstufe bei bestimmten Fahrzeugzuständen" UBYTE OneToOne 1 100 0.00 255.0 FORMAT "%5.1" ECU_ADDRESS 0x7F9573 /end MEASUREMENT
/begin MEASUREMENT TVACD_stSignOut "Vorzeichenbehaftete Bit-Information für Richtung" UBYTE OneToOne 1 100 0.00 255.0 FORMAT "%5.1" ECU_ADDRESS 0x7F9574 /end MEASUREMENT
/begin MEASUREMENT TVASCD_d_mp "d(Sensorkennlinie)  ->  y = kx + d" SWORD DtyCyc 1 100 -327.6800 327.6700 FORMAT "%8.4" ECU_ADDRESS 0x9FF97A /end MEASUREMENT
/begin MEASUREMENT TVASCD_k_mp "k(Sensorkennlinie)  ->  y = kx + d" SWORD K_Curve_DtyCyc_per_Volt 1 100 -0.06704333 0.06704128 FORMAT "%10.8" ECU_ADDRESS 0x9FF97C /end MEASUREMENT
/begin MEASUREMENT TVASCD_rDrftCls_mp "Offset drift in geschlossener Position in Prozent" SWORD DtyCyc 1 100 -327.6800 327.6700 FORMAT "%8.4" ECU_ADDRESS 0x7FDE34 /end MEASUREMENT
/begin MEASUREMENT TVASCD_rDrftOpn_mp "Offset drift in geöffneter Position in Prozent" SWORD DtyCyc 1 100 -327.6800 327.6700 FORMAT "%8.4" ECU_ADDRESS 0x7FDE36 /end MEASUREMENT
/begin MEASUREMENT TVASCD_rLinCURHi_mp "y-Sensorkennlinie(5200mV)" SWORD DtyCyc 1 100 -327.6800 327.6700 FORMAT "%8.4" ECU_ADDRESS 0x9FF97E /end MEASUREMENT
/begin MEASUREMENT TVASCD_rLinCURLo_mp "y-Sensorkennlinie(0mV)" SWORD DtyCyc 1 100 -327.6800 327.6700 FORMAT "%8.4" ECU_ADDRESS 0x9FF980 /end MEASUREMENT
/begin MEASUREMENT TVASCD_rNrm "Normalisierte Drosselklappenstellung" SWORD Prc 1 100 -327.6800 327.6700 FORMAT "%8.4" ECU_ADDRESS 0x7F9C9C /end MEASUREMENT
/begin MEASUREMENT TVASCD_rRelPos "Korrigiertes Signal des Lagesensors an der Drossel" SWORD DtyCyc 1 100 -327.6800 327.6700 FORMAT "%8.4" ECU_ADDRESS 0x7F9C9E /end MEASUREMENT
/begin MEASUREMENT TVASCD_st "Status der Drosselklappenüberwachung" UBYTE OneToOne 1 100 0.00 255.0 FORMAT "%5.1" ECU_ADDRESS 0x7F9575 /end MEASUREMENT
/begin MEASUREMENT TVASCD_stLine "Digitalwert der Statusleitung" UBYTE OneToOne 1 100 0.00 255.0 FORMAT "%5.1" ECU_ADDRESS 0x7F9576 /end MEASUREMENT
/begin MEASUREMENT TVASCD_stOfsLrnStMch "Aktueller Zustand des Zustandsautomaten" UBYTE OneToOne 1 100 0.00 255.0 FORMAT "%5.1" ECU_ADDRESS 0x7F9577 /end MEASUREMENT
/begin MEASUREMENT TVASCD_stSensType "Schalterstatus des Auswahlschalters zur Sensortypenselektion" UBYTE OneToOne 1 100 0.00 255.0 FORMAT "%5.1" ECU_ADDRESS 0x7F9578 /end MEASUREMENT
/begin MEASUREMENT TVASCD_uDrftCls_mp "Sensordrift UMS" SWORD Volt 1 100 -160156.4 160151.5 FORMAT "%8.1" ECU_ADDRESS 0x9FF982 /end MEASUREMENT
/begin MEASUREMENT TVASCD_uDrftOpn_mp "Sensordrift LMS" SWORD Volt 1 100 -160156.4 160151.5 FORMAT "%8.1" ECU_ADDRESS 0x9FF984 /end MEASUREMENT
/begin MEASUREMENT TVASCD_uRaw "Spannungsrohwert des Sensorsignals der Abgasrückführung" SWORD Volt 1 100 -160156.4 160151.5 FORMAT "%8.1" ECU_ADDRESS 0x7F9CA0 /end MEASUREMENT
/begin MEASUREMENT TVASCD_uRelPosClsd_mp "gelernte Spannung im geschlossenem Anschlag" SWORD Volt 1 100 -160156.4 160151.5 FORMAT "%8.1" ECU_ADDRESS 0x9FF986 /end MEASUREMENT
/begin MEASUREMENT TVASCD_uRelPosOpn_mp "gelernte Spannung im geöffneten Anschlag" SWORD Volt 1 100 -160156.4 160151.5 FORMAT "%8.1" ECU_ADDRESS 0x9FF988 /end MEASUREMENT
/begin MEASUREMENT UAcc_sigEnvDat "Enthält den freezeframe Zeit- und km Stand für DSM und signals" UBYTE OneToOne 1 100 0.00 255.0 FORMAT "%5.1" ARRAY_SIZE 7 ECU_ADDRESS 0x7F9F04 /end MEASUREMENT
/begin MEASUREMENT UAcc_stFuncCodePresent "Status der Funktionscodierung für verschiedene Funktionen" UWORD OneToOne 1 100 0.00 65535.00 FORMAT "%8.2" ECU_ADDRESS 0x7F9CB2 /end MEASUREMENT
/begin MEASUREMENT UAcc_swtFuncCodeAC "Funktionscode für Klimaanlage" UBYTE OneToOne 1 100 0.00 255.0 FORMAT "%5.1" ECU_ADDRESS 0x7F9582 /end MEASUREMENT
/begin MEASUREMENT UAcc_swtFuncCodeAIRBG1 "Funktionskodierung für Airbag" UBYTE OneToOne 1 100 0.00 255.0 FORMAT "%5.1" ECU_ADDRESS 0x7F9583 /end MEASUREMENT
/begin MEASUREMENT UAcc_swtFuncCodeAlt "Funktionscode für Generator" UBYTE OneToOne 1 100 0.00 255.0 FORMAT "%5.1" ECU_ADDRESS 0x7F9584 /end MEASUREMENT
/begin MEASUREMENT UAcc_swtFuncCodeESP "Funktionscode für EPS-Funktion" UBYTE OneToOne 1 100 0.00 255.0 FORMAT "%5.1" ECU_ADDRESS 0x7F9585 /end MEASUREMENT
/begin MEASUREMENT UAcc_swtFuncCodeFan "Funktionscode für Lüfter" UBYTE OneToOne 1 100 0.00 255.0 FORMAT "%5.1" ECU_ADDRESS 0x7F9587 /end MEASUREMENT
/begin MEASUREMENT UAcc_swtFuncCodeFQTSCD "Funktionskodierung für Kombiesensor FQTS" UBYTE OneToOne 1 100 0.00 255.0 FORMAT "%5.1" ECU_ADDRESS 0x7F9586 /end MEASUREMENT
/begin MEASUREMENT UAcc_swtFuncCodeOTS "Funktionskodierung für den Öltemperatursensor" UBYTE OneToOne 1 100 0.00 255.0 FORMAT "%5.1" ECU_ADDRESS 0x7F9588 /end MEASUREMENT
/begin MEASUREMENT UAcc_swtFuncCodeVehVel "Funktionscode für Fahrzeuggeschwindigkeit" UBYTE OneToOne 1 100 0.00 255.0 FORMAT "%5.1" ECU_ADDRESS 0x7F9589 /end MEASUREMENT
/begin MEASUREMENT UAcc_swtFuncCodeWIV "Funktionscode für WIV- und OTS-Funktion" UBYTE OneToOne 1 100 0.00 255.0 FORMAT "%5.1" ECU_ADDRESS 0x7F958A /end MEASUREMENT
/begin MEASUREMENT UKey_stNumCannel_mp "Meßpunkt der als Eingangsgrösse für UKey_stAdjChan_CA dient und bei der Initialisierung den jeweiligen Kanal anzeigt" UBYTE OneToOne 1 100 0.00 255.0 FORMAT "%5.1" ECU_ADDRESS 0x9FFFD9 /end MEASUREMENT
/begin MEASUREMENT UKey_stNumPassWD_mp "Meßpunkt der als Eingangsgrösse für UKey_stAdjChan_CA dient und bei der Initialisierung das jeweilige Passwort anzeigt" UBYTE OneToOne 1 100 0.00 255.0 FORMAT "%5.1" ECU_ADDRESS 0x9FFFDA /end MEASUREMENT
/begin MEASUREMENT USAp_dDatasetType "Message von USAp_dDatasetType_C für FrmMng" UBYTE OneToOne 1 100 0.00 255.0 FORMAT "%5.1" ECU_ADDRESS 0x7F958B /end MEASUREMENT
/begin MEASUREMENT USAp_numFuncCodeBits "Anzahl der Function Code Bits" UBYTE OneToOne 1 100 0.00 255.0 FORMAT "%5.1" ECU_ADDRESS 0x7F958C /end MEASUREMENT
/begin MEASUREMENT USAp_stFuncCode "Function Code für CAN" ULONG OneToOne 1 100 0.00 4294967295.00 FORMAT "%13.2" ECU_ADDRESS 0x7F9EC4 /end MEASUREMENT
/begin MEASUREMENT VehDa_AdjVal_lSum_mp "Zuletzt gespeicherter Wert der gefahrenen Strecke im EEPROM oder Wert über KWP2000 (32-Bit)" ULONG Length 1 100 0.00 4294967295.00 FORMAT "%13.2" ECU_ADDRESS 0x9FE718 /end MEASUREMENT
/begin MEASUREMENT VehDa_AdjVal_stSum_mp "uint8 - Meßpunkt von VehDa_stSum des EEPROM-Wertes" UBYTE OneToOne 1 100 0.00 255.0 FORMAT "%5.1" ECU_ADDRESS 0x9FFFDB /end MEASUREMENT
/begin MEASUREMENT VehDa_AdjVal_tiEngOn_mp "Zuletzt gespeicherter Wert der aktuellen Betriebszeit im EEPROM oder Wert über KWP2000 (32-Bit)" ULONG TimeEngOn 1 100 0.00 4294967295.00 FORMAT "%13.2" ECU_ADDRESS 0x9FE71C /end MEASUREMENT
/begin MEASUREMENT VehDa_lSum "Erfassung gefahrene Strecke" ULONG Length 1 100 0.00 4294967295.00 FORMAT "%13.2" ECU_ADDRESS 0x7F9ECC /end MEASUREMENT
/begin MEASUREMENT VehDa_nEngFilt_mp "vorgefilterte Motordrehzahl für v/n Verhältnis" SWORD EngN 1 100 -32768.00 32767.00 FORMAT "%8.2" ECU_ADDRESS 0x9FF994 /end MEASUREMENT
/begin MEASUREMENT VehDa_PerCntCarb_mp "Zähler der den Zeitwechsel bei VehDa_tiCarbEngOn schaltet" UWORD OneToOne 1 100 0.00 65535.00 FORMAT "%8.2" ECU_ADDRESS 0x9FF98E /end MEASUREMENT
/begin MEASUREMENT VehDa_PerCntFTS_mp "Zähler für Timer-increment VehDa_tiFTSEngOn" UWORD OneToOne 1 100 0.00 65535.00 FORMAT "%8.2" ECU_ADDRESS 0x9FF990 /end MEASUREMENT
/begin MEASUREMENT VehDa_PerCnt_mp "Zählerwert" UWORD OneToOne 1 100 0.00 65535.00 FORMAT "%8.2" ECU_ADDRESS 0x9FF992 /end MEASUREMENT
/begin MEASUREMENT VehDa_rVn "Verhältnis von Fahrgeschwindigkeit zur Motordrehzahl" SWORD VelToN 1 100 0.00 0.1000000 FORMAT "%9.7" ECU_ADDRESS 0x7F9CC6 /end MEASUREMENT
/begin MEASUREMENT VehDa_stSum "Status der gefahrenen Strecke" UBYTE OneToOne 1 100 0.00 255.0 FORMAT "%5.1" ECU_ADDRESS 0x7F9590 /end MEASUREMENT
/begin MEASUREMENT VehDa_stTrqDem "Status der aktuellen Momentenanforderungen" UWORD OneToOne 1 100 0.00 65535.00 FORMAT "%8.2" ECU_ADDRESS 0x7F9CC8 /end MEASUREMENT
/begin MEASUREMENT VehDa_tiCarbEngOn "Motor Laufzeit [sec] für Carb Mode 1 PID 1F" UWORD OneToOne 1 100 0.00 65535.00 FORMAT "%8.2" ECU_ADDRESS 0x7F9CCA /end MEASUREMENT
/begin MEASUREMENT VehDa_tiEngOn "Erfassung der aktuellen Betriebszeit" ULONG TimeEngOn 1 100 0.00 4294967295.00 FORMAT "%13.2" ECU_ADDRESS 0x7F9ED0 /end MEASUREMENT
/begin MEASUREMENT VehDa_tiFTSEngOn "Aktuelle Betriebszeit für FTS (uint32 - Variable)" ULONG TimeEngOn 1 100 0.00 4294967295.00 FORMAT "%13.2" ECU_ADDRESS 0x7F9ED4 /end MEASUREMENT
/begin MEASUREMENT VehDa_vSum_mp "aufsummierte Geschwindigkeit" SWORD Vel_SI 1 100 -91.02222 91.01944 FORMAT "%8.5" ECU_ADDRESS 0x9FF98A /end MEASUREMENT
/begin MEASUREMENT VehDa_vThres_mp "Schwellwert der aufsummierten Geschwindigkeit" SWORD Vel_SI 1 100 -91.02222 91.01944 FORMAT "%8.5" ECU_ADDRESS 0x9FF98C /end MEASUREMENT
/begin MEASUREMENT VehMot_nMax "Grenzdrehzahl für Fahrzeugbewegung" SWORD EngN 1 100 -32768.00 32767.00 FORMAT "%8.2" ECU_ADDRESS 0x7F9CCC /end MEASUREMENT
/begin MEASUREMENT VehMot_nMin "Leerlaufdrehzahl für Fahrzeugbewegung" SWORD EngN 1 100 -32768.00 32767.00 FORMAT "%8.2" ECU_ADDRESS 0x7F9CCE /end MEASUREMENT
/begin MEASUREMENT VehMot_pwrAcsDes "Gesamtbedarf Leistung der Nebenaggregate in der Fahrzeugbewegung" SWORD Pwr 1 100 -308831.1 308821.7 FORMAT "%8.1" ECU_ADDRESS 0x7F9CD0 /end MEASUREMENT
/begin MEASUREMENT VehMot_pwrAcsLead "Leistungsvorhalt der Nebenaggregate in der Fahrzeugbewegung" SWORD Pwr 1 100 -308831.1 308821.7 FORMAT "%8.1" ECU_ADDRESS 0x7F9CD2 /end MEASUREMENT
/begin MEASUREMENT VESGov_trq "Momentenanforderung Arbeitsdrehzahlregler" SWORD Trq 1 100 -3276.800 3276.700 FORMAT "%8.3" ECU_ADDRESS 0x7F9CB4 /end MEASUREMENT
/begin MEASUREMENT VSACD_rCnv_mp "Tastverhältnis basierend aus dem Ausgang der Drallniveausteuerung" SWORD DtyCyc 1 100 -327.6800 327.6700 FORMAT "%8.4" ECU_ADDRESS 0x9FF996 /end MEASUREMENT
/begin MEASUREMENT VSACD_rOut "Tastverhältnis zurAnsteuerung der Drosselklappe" SWORD DtyCyc 1 100 -327.6800 327.6700 FORMAT "%8.4" ECU_ADDRESS 0x7F9CB6 /end MEASUREMENT
/begin MEASUREMENT VSACD_rOutByp_mp "Meßpunkt für Bypass Freischnitt" SWORD DtyCyc 1 100 -327.6800 327.6700 FORMAT "%8.4" ECU_ADDRESS 0x9FF998 /end MEASUREMENT
/begin MEASUREMENT VSSCD_a "Fahrbeschleunigung" SWORD Acc 1 100 -20.00000 20.00000 FORMAT "%8.5" ECU_ADDRESS 0x7F9CB8 /end MEASUREMENT
/begin MEASUREMENT VSSCD_aFilt1 "Ausgang der PT1-Filter (erste Ebene)" SWORD Acc 1 100 -20.00000 20.00000 FORMAT "%8.5" ECU_ADDRESS 0x7F9CBA /end MEASUREMENT
/begin MEASUREMENT VSSCD_aRaw "Rohwert Fahrbeschleunigung" SWORD Acc 1 100 -20.00000 20.00000 FORMAT "%8.5" ECU_ADDRESS 0x7F9CBC /end MEASUREMENT
/begin MEASUREMENT VSSCD_aUnFlt_mp "Ungefilterter Fahrzeugbeschleunigung nach Umschaltung und Monitoring" SWORD Acc 1 100 -32.76800 32.76700 FORMAT "%8.5" ECU_ADDRESS 0x9FF99A /end MEASUREMENT
/begin MEASUREMENT VSSCD_ctImp "Impulszähler Fahrgeschwindigkeit Impulssignal" UWORD OneToOne 1 100 0.00 65535.00 FORMAT "%8.2" ECU_ADDRESS 0x7F9CBE /end MEASUREMENT
/begin MEASUREMENT VSSCD_stErrPwm "Error Status der PWM-In Funktion (HWE) des VSSCD" UBYTE OneToOne 1 100 0.00 255.0 FORMAT "%5.1" ECU_ADDRESS 0x7F958E /end MEASUREMENT
/begin MEASUREMENT VSSCD_swtSig "Signaleingangsschalter Fahrgeschwindigkeit" UBYTE OneToOne 1 100 0.00 255.0 FORMAT "%5.1" ECU_ADDRESS 0x7F958F /end MEASUREMENT
/begin MEASUREMENT VSSCD_tiPerAvrgFilt "Gefilterte Periodendauer des FGG's" SLONG Time_PwmHigh 1 100 -214748364.800 214748364.700 FORMAT "%13.3" ECU_ADDRESS 0x7F9EC8 /end MEASUREMENT
/begin MEASUREMENT VSSCD_v "Fahrzeuggeschwindigkeit" SWORD Vel 1 100 0.00 300.0000 FORMAT "%8.4" ECU_ADDRESS 0x7F9CC0 /end MEASUREMENT
/begin MEASUREMENT VSSCD_vCarb1 "Fahrzeuggeschwindigkeit für Carb Mode $1 ohne Ersatzwert" SWORD Vel 1 100 0.00 300.0000 FORMAT "%8.4" ECU_ADDRESS 0x7F9CC2 /end MEASUREMENT
/begin MEASUREMENT VSSCD_vRaw "Rohwert Fahrgeschwindigkeit" SWORD Vel 1 100 0.00 300.0000 FORMAT "%8.4" ECU_ADDRESS 0x7F9CC4 /end MEASUREMENT
/begin MEASUREMENT WDALCD_stOut_mp "Status des Ausgangs der Winterfahrprogrammlampe" UBYTE OneToOne 1 100 0.00 255.0 FORMAT "%5.1" ECU_ADDRESS 0x9FFFDC /end MEASUREMENT
/begin MEASUREMENT WDASCD_facWntrRmp "Wert der Rampenberechnung des Winterfahrprogramms" UWORD FactLow 1 100 0.00 63.99902 FORMAT "%8.5" ECU_ADDRESS 0x7F9CD4 /end MEASUREMENT
/begin MEASUREMENT WDASCD_stAftRunDelDem "Status der Nachlaufverlängerung-Anforderung des Winterfahrprogramm-Komponententreibers WDASCD" UBYTE OneToOne 1 100 0.00 255.0 FORMAT "%5.1" ECU_ADDRESS 0x7F9591 /end MEASUREMENT
/begin MEASUREMENT WDASCD_stLamp "Status des Winterfahrprogramm für die Lampenansteuerung" UBYTE OneToOne 1 100 0.00 255.0 FORMAT "%5.1" ECU_ADDRESS 0x7F9592 /end MEASUREMENT
/begin MEASUREMENT WDASCD_stWntr "aktueller Status des Winterfahrprogramm" UBYTE OneToOne 1 100 0.00 255.0 FORMAT "%5.1" ECU_ADDRESS 0x7F9593 /end MEASUREMENT
/begin MEASUREMENT WDASCD_stWntrCAN "Status des Winterfahrprogramm für den CAN" UBYTE OneToOne 1 100 0.00 255.0 FORMAT "%5.1" ECU_ADDRESS 0x7F9594 /end MEASUREMENT
/begin MEASUREMENT WDASCD_stWntrEna_mp "Status des Winterfahrprogramm Komponententreibers (WDASCD)" UBYTE OneToOne 1 100 0.00 255.0 FORMAT "%5.1" ECU_ADDRESS 0x9FFFDD /end MEASUREMENT
/begin MEASUREMENT WDASCD_stWntrLogVal_mp "Status des einegelesenen Schalterwertes" UBYTE OneToOne 1 100 0.00 255.0 FORMAT "%5.1" ECU_ADDRESS 0x7FDE38 /end MEASUREMENT
/begin MEASUREMENT WDASCD_stWntrSwtVal "Status des gewünschten Winterfahrprogrammmodus" UBYTE OneToOne 1 100 0.00 255.0 FORMAT "%5.1" ECU_ADDRESS 0x7F9595 /end MEASUREMENT
/begin MEASUREMENT WDCom_dChisteResponse_u32 "Antwortbeitrag des Befehlstests" UWORD OneToOne 1 100 0.00 65535.00 FORMAT "%8.2" ECU_ADDRESS 0x7FD4B4 /end MEASUREMENT
/begin MEASUREMENT WDCom_dErrorCountForCntler_u8 "Kopie des überwachungsmodul-internen Fehlerzählers für den Funktionsrechner" UBYTE OneToOne 1 100 0.00 255.0 FORMAT "%5.1" ECU_ADDRESS 0x7FD4FE /end MEASUREMENT
/begin MEASUREMENT WDCom_dErrorCountForWD_u8 "Fehlerzähler für das Überwachungsmodul" UBYTE OneToOne 1 100 0.00 255.0 FORMAT "%5.1" ECU_ADDRESS 0x7FA86D /end MEASUREMENT
/begin MEASUREMENT WDCom_dRequest_u32 "Aktuelle Frage des Überwachungsmoduls" UWORD OneToOne 1 100 0.00 65535.00 FORMAT "%8.2" ECU_ADDRESS 0x7FD4C4 /end MEASUREMENT
/begin MEASUREMENT WDCom_ErrorCntForSPI_u8 "Fehlerzähler für den SPI Handler" UBYTE OneToOne 1 100 0.00 255.0 FORMAT "%5.1" ECU_ADDRESS 0x9FE2D6 /end MEASUREMENT
/begin MEASUREMENT WDCom_ErrorCntForUC_u8 "Kopie des Fehlerzählers des externen Watch Dog" UBYTE OneToOne 1 100 0.00 255.0 FORMAT "%5.1" ECU_ADDRESS 0x9FE2D7 /end MEASUREMENT
/begin MEASUREMENT WDCom_ErrorCntForWD_u8 "Fehlerzähler für den externen Watch dog" UBYTE OneToOne 1 100 0.00 255.0 FORMAT "%5.1" ECU_ADDRESS 0x9FE2D8 /end MEASUREMENT
/begin MEASUREMENT Eng_bChgGearReq_VW "Change requested gear" UBYTE _CNV_S_2_RANGE______2_CM 1 0. 0. 1. ECU_ADDRESS 0x007FABF6 BIT_MASK 0x1 /end MEASUREMENT
/begin MEASUREMENT Eng_noGearReqLim_VW "Limited requested gear" UBYTE _CNV_R_R_RATIONALFU_3_CM 1 0. 0. 255. ECU_ADDRESS 0x007FAC0D FORMAT "%6.0" /end MEASUREMENT
/begin MEASUREMENT Can_noGearReqDisp_VW "Requested gear for CAN communication" UBYTE _CNV_R_R_RATIONALFU_3_CM 1 0. 0. 255. ECU_ADDRESS 0x007FABF1 FORMAT "%6.0" /end MEASUREMENT
/begin MEASUREMENT Eng_noGearReqLst_VW "Requested gear (last calculation step)" UBYTE _CNV_R_R_RATIONALFU_3_CM 1 0. 0. 255. ECU_ADDRESS 0x007FAC0E FORMAT "%6.0" /end MEASUREMENT
/begin MEASUREMENT Eng_noGearReqFb_VW "Requested gear (for feed back loop)" UBYTE _CNV_R_R_RATIONALFU_3_CM 1 0. 0. 255. ECU_ADDRESS 0x007FAC0C FORMAT "%6.0" /end MEASUREMENT
/begin MEASUREMENT Eng_noGearActHldRaw_VW "Raw value of actual gear from ratio revolution to speed, fixed for applicable time" UBYTE _CNV_R_R_RATIONALFU_3_CM 1 0. 0. 255. ECU_ADDRESS 0x007FAC09 FORMAT "%6.0" /end MEASUREMENT
/begin MEASUREMENT Eng_bSupRaw_VW "Shiftup requested gear raw" UBYTE _CNV_S_2_RANGE______2_CM 1 0. 0. 1. ECU_ADDRESS 0x007FABFF BIT_MASK 0x1 /end MEASUREMENT
/begin MEASUREMENT Eng_noGearReqRaw_VW "Raw value of requested gear" UBYTE _CNV_R_R_RATIONALFU_3_CM 1 0. 0. 255. ECU_ADDRESS 0x007FAC0F FORMAT "%6.0" /end MEASUREMENT
/begin MEASUREMENT Eng_bAcePedSdwnReq_VW "Acceleration Pedal above limit for shift down request" UBYTE _CNV_S_2_RANGE______2_CM 1 0. 0. 1. ECU_ADDRESS 0x007FABF4 BIT_MASK 0x1 /end MEASUREMENT
/begin MEASUREMENT Eng_bSdwnReq_VW "Shift down request" UBYTE _CNV_S_2_RANGE______2_CM 1 0. 0. 1. ECU_ADDRESS 0x007FABFE BIT_MASK 0x1 /end MEASUREMENT
/begin MEASUREMENT Eng_tqIdRed_VW "Reduction of maximum indicated torque due to influence of air density" UBYTE _CNV_R_R_RATIONALFU_8_CM 1 0. 0. 2550. ECU_ADDRESS 0x007FAC17 FORMAT "%6.0" /end MEASUREMENT
/begin MEASUREMENT Eng_bNotDispGear_VW "No gear is displayed" UBYTE _CNV_S_2_RANGE______2_CM 1 0. 0. 1. ECU_ADDRESS 0x007FABFA BIT_MASK 0x1 /end MEASUREMENT
/begin MEASUREMENT Eng_nMinSup_VW "Minimum engine speed for shift up advise" UBYTE _CNV_R_R_RATIONALFU_0_CM 1 0. 0. 10200. ECU_ADDRESS 0x007FAC04 FORMAT "%6.0" /end MEASUREMENT
/begin MEASUREMENT Eng_nMaxSdwn_VW "Maximum engine speed for shift down advise" UBYTE _CNV_R_R_RATIONALFU_0_CM 1 0. 0. 10200. ECU_ADDRESS 0x007FAC02 FORMAT "%6.0" /end MEASUREMENT
/begin MEASUREMENT Can_noGearActDisp_VW "Actual gear for CAN communication" UBYTE _CNV_R_R_RATIONALFU_3_CM 1 0. 0. 255. ECU_ADDRESS 0x007FABF0 FORMAT "%6.0" /end MEASUREMENT
/begin MEASUREMENT Eng_noGearActHld_VW "Actual Gear from ratio revolution to speed, fixed for applicable time" UBYTE _CNV_R_R_RATIONALFU_3_CM 1 0. 0. 255. ECU_ADDRESS 0x007FAC0A FORMAT "%6.0" /end MEASUREMENT
/begin MEASUREMENT Eng_noGearReq_VW "Requested gear" UBYTE _CNV_R_R_RATIONALFU_3_CM 1 0. 0. 255. ECU_ADDRESS 0x007FAC10 FORMAT "%6.0" /end MEASUREMENT
/begin MEASUREMENT Eng_densAir_VW "Air density" UBYTE _CNV_R_R_RATIONALFU_4_CM 1 0. 0. 1.9921875 ECU_ADDRESS 0x007FAC01 /end MEASUREMENT
/begin MEASUREMENT Eng_bTogGearAct_VW "Actual gear change between the last calculation steps" UBYTE _CNV_S_2_RANGE______2_CM 1 0. 0. 1. ECU_ADDRESS 0x007FAC00 BIT_MASK 0x1 /end MEASUREMENT
/begin MEASUREMENT Eng_noDeltaMaxGearReq_VW "Maximum of delta between raw value of requested gear and actually displayed gear" UBYTE _CNV_R_R_RATIONALFU_3_CM 1 0. 0. 255. ECU_ADDRESS 0x007FAC08 FORMAT "%6.0" /end MEASUREMENT
/begin MEASUREMENT Eng_nQuoSpdRev_VW "calculated virtual engine speed (ratio n/v)" UBYTE _CNV_R_R_RATIONALFU_0_CM 1 0. 0. 10200. ECU_ADDRESS 0x007FAC05 FORMAT "%6.0" /end MEASUREMENT
/begin MEASUREMENT Eng_noDeltaGearReqRaw_VW "Delta between raw value requested gear and actualy displayed gear" SBYTE _CNV_R_R_RATIONALFU_3_CM 1 0. -128. 127. ECU_ADDRESS 0x007FAC07 FORMAT "%6.0" /end MEASUREMENT
/begin MEASUREMENT Eng_bNotGearReq_VW "No gear advise (set requested gear equal actual gear)" UBYTE _CNV_S_2_RANGE______2_CM 1 0. 0. 1. ECU_ADDRESS 0x007FABFB BIT_MASK 0x1 /end MEASUREMENT
/begin MEASUREMENT Eng_agPwrStg_VW "Angle power steer" SWORD _CNV_R_R_RATIONALFU_10_CM 1 0. -1433.6 1433.55625 ECU_ADDRESS 0x007FABF2 /end MEASUREMENT
/begin MEASUREMENT Eng_bBrk_VW "Brake active" UBYTE _CNV_S_2_RANGE______2_CM 1 0. 0. 1. ECU_ADDRESS 0x007FABF5 BIT_MASK 0x1 /end MEASUREMENT
/begin MEASUREMENT Eng_bCluOp_VW "Clutch open" UBYTE _CNV_S_2_RANGE______2_CM 1 0. 0. 1. ECU_ADDRESS 0x007FABF7 BIT_MASK 0x1 /end MEASUREMENT
/begin MEASUREMENT Eng_bESP_VW "ESP/ ASR intervention active" UBYTE _CNV_S_2_RANGE______2_CM 1 0. 0. 1. ECU_ADDRESS 0x007FABF8 BIT_MASK 0x1 /end MEASUREMENT
/begin MEASUREMENT Eng_bGearRevs_VW "Reverse gear active" UBYTE _CNV_S_2_RANGE______2_CM 1 0. 0. 1. ECU_ADDRESS 0x007FABF9 BIT_MASK 0x1 /end MEASUREMENT
/begin MEASUREMENT Eng_bPu_VW "Condition fuel cut (with or without injection) fullfilled" UBYTE _CNV_S_2_RANGE______2_CM 1 0. 0. 1. ECU_ADDRESS 0x007FABFC BIT_MASK 0x1 /end MEASUREMENT
/begin MEASUREMENT Eng_bRegPmt_VW "PM-trap regeneration active" UBYTE _CNV_R_R_RATIONALFU_3_CM 1 0. 0. 1. ECU_ADDRESS 0x007FABFD BIT_MASK 0x1 /end MEASUREMENT
/begin MEASUREMENT Eng_nMinRegPmt_VW "Minimum recomended engine speed during PM-trap regeneration" UBYTE _CNV_R_R_RATIONALFU_0_CM 1 0. 0. 10200. ECU_ADDRESS 0x007FAC03 FORMAT "%6.0" /end MEASUREMENT
/begin MEASUREMENT Eng_n_VW "Engine speed" UBYTE _CNV_R_R_RATIONALFU_0_CM 1 0. 0. 10200. ECU_ADDRESS 0x007FAC06 FORMAT "%6.0" /end MEASUREMENT
/begin MEASUREMENT Eng_noGearAct_VW "Actual Gear" UBYTE _CNV_R_R_RATIONALFU_3_CM 1 0. 0. 255. ECU_ADDRESS 0x007FAC0B FORMAT "%6.0" /end MEASUREMENT
/begin MEASUREMENT Eng_pAmb_VW "Ambient pressure" UBYTE _CNV_R_R_RATIONALFU_11_CM 1 0. 0. 1275. ECU_ADDRESS 0x007FAC11 /end MEASUREMENT
/begin MEASUREMENT Eng_rAcePed_VW "Ratio acceleration pedal" UBYTE _CNV_R_R_RATIONALFU_7_CM 1 0. 0. 99.609375 ECU_ADDRESS 0x007FAC12 /end MEASUREMENT
/begin MEASUREMENT Eng_stAcc_VW "State of adaptive cruise control" UBYTE _CNV_R_R_RATIONALFU_3_CM 1 0. 0. 255. ECU_ADDRESS 0x007FAC13 FORMAT "%6.0" /end MEASUREMENT
/begin MEASUREMENT Eng_tAirIn_VW "Temperature of intake air" UBYTE _CNV_R_R_RATIONALFU_9_CM 1 0. -48. 143.25 ECU_ADDRESS 0x007FAC14 /end MEASUREMENT
/begin MEASUREMENT Eng_tCo_VW "Engine coolant temperature" UBYTE _CNV_R_R_RATIONALFU_9_CM 1 0. -48. 143.25 ECU_ADDRESS 0x007FAC15 /end MEASUREMENT
/begin MEASUREMENT Eng_tqFric_VW "Friction torque" UBYTE _CNV_R_R_RATIONALFU_1_CM 1 0. 0. 1275. ECU_ADDRESS 0x007FAC16 FORMAT "%6.0" /end MEASUREMENT
/begin MEASUREMENT Eng_tqId_VW "Indicated torque" UBYTE _CNV_R_R_RATIONALFU_1_CM 1 0. 0. 1275. ECU_ADDRESS 0x007FAC18 FORMAT "%6.0" /end MEASUREMENT
/begin MEASUREMENT Eng_v_VW "Vehicle speed" UWORD _CNV_R_R_RATIONALFU_12_CM 1 0. 0. 511.9921875 ECU_ADDRESS 0x007FAC1A /end MEASUREMENT
/begin COMPU_METHOD Acc "Fahrzeugbeschleunigung" RAT_FUNC "%6.5" "[m/s^2]" COEFFS 0 1000 0 0 0 1 /end COMPU_METHOD
/begin COMPU_METHOD AirMassPerCyl "Luftmasse pro Zylinder" RAT_FUNC "%6.3" "[mg/Hub Luft]" COEFFS 0 10 0 0 0 1 /end COMPU_METHOD
/begin COMPU_METHOD AngleCrS "Winkel Kurbelwelle" RAT_FUNC "%6.4" "[deg CrS]" COEFFS 0 42.6666666666667 0 0 0 1 /end COMPU_METHOD
/begin COMPU_METHOD _CNV_R_R_RATIONALFU_0_CM "The entity name was generated by DDS!" RAT_FUNC "%6.3" "U/min" COEFFS 0. 1. 0. 0. 0. 40. /end COMPU_METHOD
/begin COMPU_METHOD _CNV_R_R_RATIONALFU_1_CM "The entity name was generated by DDS!" RAT_FUNC "%6.3" "Nm" COEFFS 0. 1. 0. 0. 0. 5. /end COMPU_METHOD
/begin COMPU_METHOD _CNV_S_2_RANGE______2_CM "The entity name was generated by DDS!" TAB_VERB "%6.3" "-" COMPU_TAB_REF _CNV_S_2_RANGE______2 /end COMPU_METHOD
/begin COMPU_METHOD _CNV_R_R_RATIONALFU_3_CM "The entity name was generated by DDS!" RAT_FUNC "%6.3" "-" COEFFS 0. 1. 0. 0. 0. 1. /end COMPU_METHOD
/begin COMPU_METHOD _CNV_R_R_RATIONALFU_4_CM "The entity name was generated by DDS!" RAT_FUNC "%6.3" "kg/m3" COEFFS 0. 1. 0. 0. 0. 7.8125e-003 /end COMPU_METHOD
/begin COMPU_METHOD _CNV_R_R_RATIONALFU_7_CM "The entity name was generated by DDS!" RAT_FUNC "%6.3" "%" COEFFS 0. 1. 0. 0. 0. 0.390625 /end COMPU_METHOD
/begin COMPU_METHOD _CNV_R_R_RATIONALFU_8_CM "The entity name was generated by DDS!" RAT_FUNC "%6.3" "Nm" COEFFS 0. 1. 0. 0. 0. 10. /end COMPU_METHOD
/begin COMPU_METHOD _CNV_R_R_RATIONALFU_9_CM "The entity name was generated by DDS!" RAT_FUNC "%6.3" "°C" COEFFS 0. 1. 48. 0. 0. 0.75 /end COMPU_METHOD
/begin COMPU_METHOD _CNV_R_R_RATIONALFU_10_CM "The entity name was generated by DDS!" RAT_FUNC "%6.3" "°" COEFFS 0. 1. 0. 0. 0. 4.375e-002 /end COMPU_METHOD
/begin COMPU_METHOD _CNV_R_R_RATIONALFU_11_CM "The entity name was generated by DDS!" RAT_FUNC "%6.3" "hPa" COEFFS 0. 1. 0. 0. 0. 5. /end COMPU_METHOD
/begin COMPU_METHOD _CNV_R_R_RATIONALFU_12_CM "The entity name was generated by DDS!" RAT_FUNC "%6.3" "km/h" COEFFS 0. 1. 0. 0. 0. 7.8125e-003 /end COMPU_METHOD
/begin COMPU_VTAB _CNV_S_2_RANGE______2 "The entity name was generated by DDS!" TAB_VERB 2 0 "FALSE" 1 "TRUE" /end COMPU_VTAB
/begin COMPU_METHOD Curr_A "Umrechnung für Strom in Ampere" RAT_FUNC "%6.4" "A" COEFFS 0 100 0 0 0 1 /end COMPU_METHOD
/begin COMPU_METHOD DtyCyc "Tastverhaeltnis" RAT_FUNC "%6.4" "[%]" COEFFS 0 100 0 0 0 1 /end COMPU_METHOD
/begin COMPU_METHOD EngN "Motordrehzahl" RAT_FUNC "%6.2" "[rpm]" COEFFS 0 1 0 0 0 1 /end COMPU_METHOD
/begin COMPU_METHOD Fact "Faktor mit Auflösung 1 / 8192, hauptsächlich für einen Faktorenbereich 0...1 verwendet" RAT_FUNC "%6.5" "[-]" COEFFS 0 8192 0 0 0 1 /end COMPU_METHOD
/begin COMPU_METHOD FactLow "Faktor mit Auflösung 1/1024, hauptsächlich für einen Faktorenbereich 1...50 verwendet" RAT_FUNC "%6.5" "[-]" COEFFS 0 1024 0 0 0 1 /end COMPU_METHOD
/begin COMPU_METHOD Fact_WearSootIdx "Umrechnung für Ruß/Verschleißäquivalent" RAT_FUNC "%10.9" "[-]" COEFFS 0 50000000 0 0 0 1 /end COMPU_METHOD
/begin COMPU_METHOD K_Curve_DtyCyc_per_Volt "Kurvensteigung für |Steigungen| < 1.0 (mV/DtyCyc)" RAT_FUNC "%8.7" "[%/mV]" COEFFS 0 488758.553274682 0 0 0 1 /end COMPU_METHOD
/begin COMPU_METHOD Length "Länge in Meter" RAT_FUNC "%6.2" "[m]" COEFFS 0 1 0 0 0 1 /end COMPU_METHOD
/begin COMPU_METHOD Length1_mm "Umrechnungsformel für Länge in mm" RAT_FUNC "%6.4" "[mm]" COEFFS 0 250 0 0 0 1 /end COMPU_METHOD
/begin COMPU_METHOD OneToOne "eins zu eins (physikalischer Wert ist gleich dem internen Wert)" RAT_FUNC "%6.2" "[-]" COEFFS 0 1 0 0 0 1 /end COMPU_METHOD
/begin COMPU_METHOD Prc "Prozent, gleiche interne Auflösung wie Fact, aber Darstellung in Prozent (0...100%)" RAT_FUNC "%6.4" "[%]" COEFFS 0 100 0 0 0 1 /end COMPU_METHOD
/begin COMPU_METHOD Pres_hPa "Druck (angezeigt in [hPa])" RAT_FUNC "%6.2" "[hPa]" COEFFS 0 1 0 0 0 1 /end COMPU_METHOD
/begin COMPU_METHOD Pwr "Leistung" RAT_FUNC "%6.2" "[W]" COEFFS 0 0.10610329539459 0 0 0 1 /end COMPU_METHOD
/begin COMPU_METHOD RmpEngN_LIGov "Motordrehzahlgradient für Leerlaufreglerrampe" RAT_FUNC "%6.4" "[rpm/s]" COEFFS 0 458.752 0 0 0 1 /end COMPU_METHOD
/begin COMPU_METHOD RmpTrq "Rampengradient für Motormoment" RAT_FUNC "%6.4" "[Nm/s]" COEFFS 0 655.36 0 0 0 1 /end COMPU_METHOD
/begin COMPU_METHOD RtmoTicksToPercent "Rtmo_tiMaxLoad_u32 in Prozent konvertieren" RAT_FUNC "%6.2" "%" COEFFS 0 -34965 3496500 0 0 1 /end COMPU_METHOD
/begin COMPU_METHOD TimeEngOn "Motorbetriebszeit in Sekunden" RAT_FUNC "%6.2" "[s]" COEFFS 0 1 0 0 0 1 /end COMPU_METHOD
/begin COMPU_METHOD TimeSys_us "Zeit in [us] mit Systemzeit-Auflösung" RAT_FUNC "%6.3" "us" COEFFS 0 3.4965 0 0 0 1 /end COMPU_METHOD
/begin COMPU_METHOD TimeTincHRes "Umrechungsformel für Inkrementperiodendauern mit erhöhter Auflösung" RAT_FUNC "%6.5" "us" COEFFS 0 2560 0 0 0 1 /end COMPU_METHOD
/begin COMPU_METHOD TimeUSResolution "Zeit in Mikrosekunden für TPU Zeiten, Auflösung 1 us" RAT_FUNC "%6.2" "[us]" COEFFS 0 1 0 0 0 1 /end COMPU_METHOD
/begin COMPU_METHOD Time_ms "Zeit in ms für Fehlerentprellung (DSM) und SW-Timer" RAT_FUNC "%6.1" "[ms]" COEFFS 0 0.1 0 0 0 1 /end COMPU_METHOD
/begin COMPU_METHOD Time_ms_10ms "Zähler im 10ms Takt" RAT_FUNC "%6.1" "ms" COEFFS 0 0.1 0 0 0 1 /end COMPU_METHOD
/begin COMPU_METHOD Time_PwmHigh "Periodenzeit von der HWE (Tio_PwmGetAvrg)" RAT_FUNC "%6.3" "[us]" COEFFS 0 10 0 0 0 1 /end COMPU_METHOD
/begin COMPU_METHOD Time_RtmHighRes "Zeit mit hoher Auflösung für Laufzeitmessung" RAT_FUNC "%6.5" "[ms]" COEFFS 0 1000 0 0 0 1 /end COMPU_METHOD
/begin COMPU_METHOD TrnvrsAcc "Umrechnung für Querbeschleunigung" RAT_FUNC "%6.4" "[g]" COEFFS 0 100 0 0 0 1 /end COMPU_METHOD
/begin COMPU_METHOD Trq "Motormoment" RAT_FUNC "%6.3" "[Nm]" COEFFS 0 10 0 0 0 1 /end COMPU_METHOD
/begin COMPU_METHOD TrqPrpDT "zeitlich aufintegriertes Vortriebsmoment" RAT_FUNC "%6.2" "[Nm*s]" COEFFS 0 0.2 0 0 0 1 /end COMPU_METHOD
/begin COMPU_METHOD TrqPrpHigh "vortriebsmoment" RAT_FUNC "%6.3" "[Nm]" COEFFS 0 10 0 0 0 1 /end COMPU_METHOD
/begin COMPU_METHOD Vel "Fahrzeuggeschwindigkeit, gleiche interne Auflösung wie Vel_SI" RAT_FUNC "%6.4" "[km/h]" COEFFS 0 100 0 0 0 1 /end COMPU_METHOD
/begin COMPU_METHOD Vel2TrqPrp "Umwandlung von Fahrgeschwindigkeit zu Vortriebsmoment" RAT_FUNC "%6.4" "[Nm/(km/h)]" COEFFS 0 51.2 0 0 0 1 /end COMPU_METHOD
/begin COMPU_METHOD VelToN "Verhältnis Fahrzeuggeschwindigkeit zu Motordrehzahl v/n" RAT_FUNC "%8.7" "[(km/h)/rpm]" COEFFS 0 100000 0 0 0 1 /end COMPU_METHOD
/begin COMPU_METHOD Vel_SI "Fahrzeuggeschwindigkeit (in m/s)" RAT_FUNC "%6.4" "[m/s]" COEFFS 0 360 0 0 0 1 /end COMPU_METHOD
/begin COMPU_METHOD volAdd_ml2 "Umrechnung mit 1ml Auflösung für Additivmenge in AddPmp_AddMet" RAT_FUNC "%6.2" "ml" COEFFS 0 1 0 0 0 1 /end COMPU_METHOD
/begin COMPU_METHOD volFillLvl_ml "Umrechnungsformel für Volumen in ml" RAT_FUNC "%6.2" "[ml]" COEFFS 0 1 0 0 0 1 /end COMPU_METHOD
/begin COMPU_METHOD Volt "Spannung in V (von ADC)" RAT_FUNC "%6.2" "[mV]" COEFFS 0 0.2046 0 0 0 1 /end COMPU_METHOD
/begin COMPU_METHOD Volt_Batt "Batteriespannung" RAT_FUNC "%6.1" "[mV]" COEFFS 0 0.0492252911173131 0 0 0 1 /end COMPU_METHOD
/begin COMPU_METHOD Volt_Batt_PerSec_20ms "Batteriespannung (mit Aufweitungsfaktor) pro Sekunde (für 20ms Task) - [(du/dt) mV/s]" RAT_FUNC "%6.1" "[mV/s]" COEFFS 0 0.0984505822346261 0 0 0 1 /end COMPU_METHOD
/end MODULE
/end PROJECT
