ASAP2_VERSION 1 3
/begin PROJECT X447 "EDC16U34"
/begin HEADER "" VERSION "VAA1" PROJECT_NO X447 /end HEADER
/begin MODULE DIM ""
/begin MOD_COMMON "" BYTE_ORDER MSB_FIRST ALIGNMENT_BYTE 1 ALIGNMENT_WORD 2 ALIGNMENT_LONG 4 ALIGNMENT_FLOAT32_IEEE 4 /end MOD_COMMON
/begin CHARACTERISTIC Carb_stAppl_C "Applikationsschalter zwischen ISO9141(0) und KWP2000-4(1)" VALUE 0x1CC923 Kw_Wu8 1.000 OneToOne 0.00 1.000 FORMAT "%5.3" EXTENDED_LIMITS 0.00 255.0 /end CHARACTERISTIC
/begin CHARACTERISTIC DSM_CDCDfp_InjCrvT3DiaMax_C "CARB spezifischer Fehlercode fuer Fehlerpfad Dfp_InjCrvT3DiaMax" VAL_BLK 0x1CE2D4 Kwb_Wu16 65535.00 OneToOne 0.00 65535.00 FORMAT "%8.2" NUMBER 4 /end CHARACTERISTIC
/begin CHARACTERISTIC DSM_CDCDfp_InjCrvT3DiaMin_C "CARB spezifischer Fehlercode fuer Fehlerpfad Dfp_InjCrvT3DiaMin" VAL_BLK 0x1CE2DC Kwb_Wu16 65535.00 OneToOne 0.00 65535.00 FORMAT "%8.2" NUMBER 4 /end CHARACTERISTIC
/begin CHARACTERISTIC DSM_CDKDfp_InjCrvT3DiaMax_C "Kundenspezifischer Fehlercode fuer Fehlerpfad Dfp_InjCrvT3DiaMax" VAL_BLK 0x1CEED4 Kwb_Wu16 65535.00 OneToOne 0.00 65535.00 FORMAT "%8.2" NUMBER 4 /end CHARACTERISTIC
/begin CHARACTERISTIC DSM_CDKDfp_InjCrvT3DiaMin_C "Kundenspezifischer Fehlercode fuer Fehlerpfad Dfp_InjCrvT3DiaMin" VAL_BLK 0x1CEEDC Kwb_Wu16 65535.00 OneToOne 0.00 65535.00 FORMAT "%8.2" NUMBER 4 /end CHARACTERISTIC
/begin CHARACTERISTIC DSM_ClaDfp_InjCrvT3DiaMax_C "Fehlerklasse fuer Fehlerpfad Dfp_InjCrvT3DiaMax" VALUE 0x1CF3B1 Kw_Wu8 20.00 OneToOne 0.00 20.00 FORMAT "%5.2" EXTENDED_LIMITS 0.00 255.0 /end CHARACTERISTIC
/begin CHARACTERISTIC DSM_ClaDfp_InjCrvT3DiaMin_C "Fehlerklasse fuer Fehlerpfad Dfp_InjCrvT3DiaMin" VALUE 0x1CF3B2 Kw_Wu8 20.00 OneToOne 0.00 20.00 FORMAT "%5.2" EXTENDED_LIMITS 0.00 255.0 /end CHARACTERISTIC
/begin CHARACTERISTIC DSM_EnvDfp_InjCrvT3DiaMax_C "Fehlerpfad spezifische Umweltbedingungen fuer Fehlerpfad Dfp_InjCrvT3DiaMax" VAL_BLK 0x1D047C Kwb_Wu16 1152.00000000 SigName 0.00 1152.00000000 FORMAT "%13.8" NUMBER 8 /end CHARACTERISTIC
/begin CHARACTERISTIC DSM_EnvDfp_InjCrvT3DiaMin_C "Fehlerpfad spezifische Umweltbedingungen fuer Fehlerpfad Dfp_InjCrvT3DiaMin" VAL_BLK 0x1D048C Kwb_Wu16 1152.00000000 SigName 0.00 1152.00000000 FORMAT "%13.8" NUMBER 8 /end CHARACTERISTIC
/begin CHARACTERISTIC DSM_FMKDfp_InjCrvT3DiaMax_C "Ausblendbedingungen fuer Fehlerpfad Dfp_InjCrvT3DiaMax" VALUE 0x1CDA31 Kw_Wu8 255.0 OneToOne 0.00 255.0 FORMAT "%5.1" /end CHARACTERISTIC
/begin CHARACTERISTIC DSM_FMKDfp_InjCrvT3DiaMin_C "Ausblendbedingungen fuer Fehlerpfad Dfp_InjCrvT3DiaMin" VALUE 0x1CDA32 Kw_Wu8 255.0 OneToOne 0.00 255.0 FORMAT "%5.1" /end CHARACTERISTIC
/begin CHARACTERISTIC DSM_InhDfp_InjCrvT3DiaMax_C "Durch Fehlerpfad Dfp_InjCrvT3DiaMax verriegelte Funktionsidentifier" VAL_BLK 0x1D16E0 Kwb_Wu16 61901.0000000 FidName 0.00 61901.0000000 FORMAT "%13.7" NUMBER 3 /end CHARACTERISTIC
/begin CHARACTERISTIC DSM_InhDfp_InjCrvT3DiaMin_C "Durch Fehlerpfad Dfp_InjCrvT3DiaMin verriegelte Funktionsidentifier" VAL_BLK 0x1D16E6 Kwb_Wu16 61901.0000000 FidName 0.00 61901.0000000 FORMAT "%13.7" NUMBER 3 /end CHARACTERISTIC
/begin CHARACTERISTIC DSM_TypDfp_InjCrvT3DiaMax_C "Konvertierung der Fehlertypen auf der Diagnoseschnittstelle fuer Fehlerpfad Dfp_InjCrvT3DiaMax" VAL_BLK 0x1D231A Kwb_Wu8 255.0 OneToOne 0.00 255.0 FORMAT "%5.1" NUMBER 4 /end CHARACTERISTIC
/begin CHARACTERISTIC DSM_TypDfp_InjCrvT3DiaMin_C "Konvertierung der Fehlertypen auf der Diagnoseschnittstelle fuer Fehlerpfad Dfp_InjCrvT3DiaMin" VAL_BLK 0x1D231E Kwb_Wu8 255.0 OneToOne 0.00 255.0 FORMAT "%5.1" NUMBER 4 /end CHARACTERISTIC
/begin CHARACTERISTIC InjCrv_DebT3DiaMaxDef_C "Schwelle für Dfp_InjCrvT3Max_mp Defekterkennung" VALUE 0x1E389C Kw_Ws16 32767.00 OneToOne 0.00 32767.00 FORMAT "%8.2" EXTENDED_LIMITS -32768.00 32767.00 /end CHARACTERISTIC
/begin CHARACTERISTIC InjCrv_DebT3DiaMaxOk_C "Schwelle für Dfp_InjCrvT3Max_mp Heilungserkennung" VALUE 0x1E389E Kw_Ws16 32768.00 OneToOne -32768.00 0.00 FORMAT "%8.2" EXTENDED_LIMITS -32768.00 32767.00 /end CHARACTERISTIC
/begin CHARACTERISTIC InjCrv_DebT3DiaMaxStpDwn_C "Dekrementschrittweite des Dfp_InjCrvT3Max_mp zur Heilungserkennung" VALUE 0x1E38A0 Kw_Ws16 255.0000 OneToOne -255.0000 0.00 FORMAT "%8.4" EXTENDED_LIMITS -32768.00 32767.00 /end CHARACTERISTIC
/begin CHARACTERISTIC InjCrv_DebT3DiaMaxStpUp_C "Inkrementschrittweite des Dfp_InjCrvT3Max_mp Defekterkennung" VALUE 0x1E38A2 Kw_Wu8 255.0 OneToOne 0.00 255.0 FORMAT "%5.1" /end CHARACTERISTIC
/begin CHARACTERISTIC InjCrv_DebT3DiaMinDef_C "Schwelle für Dfp_InjCrvT3Min_mp Defekterkennung" VALUE 0x1E38A4 Kw_Ws16 32767.00 OneToOne 0.00 32767.00 FORMAT "%8.2" EXTENDED_LIMITS -32768.00 32767.00 /end CHARACTERISTIC
/begin CHARACTERISTIC InjCrv_DebT3DiaMinOk_C "Schwelle für Dfp_InjCrvT3Min_mp Heilungserkennung" VALUE 0x1E38A6 Kw_Ws16 32768.00 OneToOne -32768.00 0.00 FORMAT "%8.2" EXTENDED_LIMITS -32768.00 32767.00 /end CHARACTERISTIC
/begin CHARACTERISTIC InjCrv_DebT3DiaMinStpDwn_C "Dekrementschrittweite des Dfp_InjCrvT3Min_mp zur Heilungserkennung" VALUE 0x1E38A8 Kw_Ws16 255.0000 OneToOne -255.0000 0.00 FORMAT "%8.4" EXTENDED_LIMITS -32768.00 32767.00 /end CHARACTERISTIC
/begin CHARACTERISTIC InjCrv_DebT3DiaMinStpUp_C "Inkrementschrittweite des Dfp_InjCrvT3Min_mp Defekterkennung" VALUE 0x1E38AA Kw_Ws16 255.0000 OneToOne 0.00 255.0000 FORMAT "%8.4" EXTENDED_LIMITS -32768.00 32767.00 /end CHARACTERISTIC
/begin CHARACTERISTIC InjCrv_dfacPoI2LmbdKpSlp_C "Steigung der Einschaltrampe des Lambda-Reglers (PoI2)" VALUE 0x1E27B8 Kw_Wu16 50.00000 Rmp_GOV 0.00 50.00000 FORMAT "%8.5" EXTENDED_LIMITS 0.00 63.99902 /end CHARACTERISTIC
/begin CHARACTERISTIC InjCrv_dfacPoI2LmbdOutSlp_C "Steigung der Ausschaltrampe des Lambda-Reglers (PoI2)" VALUE 0x1E27BA Kw_Wu16 50.00000 Rmp_GOV 0.00 50.00000 FORMAT "%8.5" EXTENDED_LIMITS 0.00 63.99902 /end CHARACTERISTIC
/begin CHARACTERISTIC InjCrv_dfacPreTrbnKpSlp_C "Steigung der Einschaltrampe des T3-Reglers (PoI2)" VALUE 0x1E31D0 Kw_Wu16 50.00000 Rmp_GOV 0.00 50.00000 FORMAT "%8.5" EXTENDED_LIMITS 0.00 63.99902 /end CHARACTERISTIC
/begin CHARACTERISTIC InjCrv_drPoI2LmbdT3Slp_C "Steigung der Ausschaltrampe des T3-Reglers (PoI2)" VALUE 0x1E31D2 Kw_Wu16 50.00000 Rmp_GOV 0.00 50.00000 FORMAT "%8.5" EXTENDED_LIMITS 0.00 63.99902 /end CHARACTERISTIC
/begin CHARACTERISTIC InjCrv_facdlmbddtPreTrbn_MAP "Luftmassen- und Einspritzmengen-abhängiger Linearisierungsfaktor (T3-Regler)" MAP 0x1E31D4 Kf_Xs16_Ys16_Ws16 0.6400000 LmbdaTemp -0.3200000 0.3200000 FORMAT "%9.7" EXTENDED_LIMITS -0.3276800 0.3276700
 /begin AXIS_DESCR STD_AXIS InjCrv_qPoI2Tot InjMass 4 0.00 327.6700 FORMAT "%8.4" EXTENDED_LIMITS -327.6800 327.6700 DEPOSIT ABSOLUTE /end AXIS_DESCR
 /begin AXIS_DESCR STD_AXIS AirCtl_mDesVal AirMassPerCyl 4 0.00 100.0000 FORMAT "%8.4" EXTENDED_LIMITS -3276.800 3276.700 DEPOSIT ABSOLUTE /end AXIS_DESCR
/end CHARACTERISTIC
/begin CHARACTERISTIC InjCrv_facdqPoI2dlmbd_MAP "Statische Regelstreckenlinearisierung (Lambda-Regler)" MAP 0x1E27BC Kf_Xs16_Ys16_Ws16 200.0000 QLmbda -100.0000 100.0000 FORMAT "%8.4" EXTENDED_LIMITS -327.6800 327.6700
 /begin AXIS_DESCR STD_AXIS InjCrv_qPoI2Tot InjMass 4 0.00 327.6700 FORMAT "%8.4" EXTENDED_LIMITS -327.6800 327.6700 DEPOSIT ABSOLUTE /end AXIS_DESCR
 /begin AXIS_DESCR STD_AXIS AirCtl_mDesVal AirMassPerCyl 4 0.00 100.0000 FORMAT "%8.4" EXTENDED_LIMITS -3276.800 3276.700 DEPOSIT ABSOLUTE /end AXIS_DESCR
/end CHARACTERISTIC
/begin CHARACTERISTIC InjCrv_facPoI2LmbdKi_CUR "Integralfaktor für Lambda-Regelung Nacheinspritzung" CURVE 0x1E27F0 Kl_Xs16_Ws16 500.0000 Fact_GOVILMBD 0.00 500.0000 FORMAT "%8.4" EXTENDED_LIMITS -512.0000 511.9844
 /begin AXIS_DESCR STD_AXIS InjCrv_rPoI2LmbdDev_mp lambda 8 -3.000000 3.000000 FORMAT "%8.6" EXTENDED_LIMITS -32.76800 32.76700 DEPOSIT ABSOLUTE /end AXIS_DESCR
/end CHARACTERISTIC
/begin CHARACTERISTIC InjCrv_facPoI2LmbdKp_CUR "Proportionalfaktor für Lambda-Regelung Nacheinspritzung" CURVE 0x1E2812 Kl_Xs16_Ws16 100.0000 Fact_GOVPLMBD 0.00 100.0000 FORMAT "%8.4" EXTENDED_LIMITS -256.0000 255.9922
 /begin AXIS_DESCR STD_AXIS InjCrv_rPoI2LmbdDev_mp lambda 8 -3.000000 3.000000 FORMAT "%8.6" EXTENDED_LIMITS -32.76800 32.76700 DEPOSIT ABSOLUTE /end AXIS_DESCR
/end CHARACTERISTIC
/begin CHARACTERISTIC InjCrv_facPoI2LmbdStd_C "Standard-Verstärkungsfaktor des T3-Regler-Ausgangs bei Überbrückung des Lambda-Reglers (PoI2)" VALUE 0x1E2834 Kw_Ws16 400.0000 Fact_GOVPLMBD -200.0000 200.0000 FORMAT "%8.4" EXTENDED_LIMITS -256.0000 255.9922 /end CHARACTERISTIC
/begin CHARACTERISTIC InjCrv_facPoI2LmbdWgh_CUR "Kennlinie für Interpolation Lambda-Sollwert Nacheinspritzung" CURVE 0x1E2836 Kl_Xs16_Ws16 1.000000 Fact 0.00 1.000000 FORMAT "%8.6" EXTENDED_LIMITS -4.000000 3.999878
 /begin AXIS_DESCR STD_AXIS APSCD_pVal Pres_hPa 2 0.00 3500.000 FORMAT "%8.3" EXTENDED_LIMITS -32768.00 32767.00 DEPOSIT ABSOLUTE /end AXIS_DESCR
/end CHARACTERISTIC
/begin CHARACTERISTIC InjCrv_facPreTrbnKi_CUR "Kleinsignal-I-Faktor der T3-Regelung" CURVE 0x1E3208 Kl_Xs16_Ws16 9.994141 Fact_GOVIT3 0.005859375 10.00000 FORMAT "%8.5" EXTENDED_LIMITS -64.00000 63.99805
 /begin AXIS_DESCR STD_AXIS InjCrv_rPreTrbnDev_mp lambda 8 -3.000000 3.000000 FORMAT "%8.6" EXTENDED_LIMITS -32.76800 32.76700 DEPOSIT ABSOLUTE /end AXIS_DESCR
/end CHARACTERISTIC
/begin CHARACTERISTIC InjCrv_facPreTrbnKp_CUR "Kleinsignal-P-Faktor der T3-Regelung" CURVE 0x1E322A Kl_Xs16_Ws16 99.98828 Fact_GOVPT3 0.01171875 100.0000 FORMAT "%8.4" EXTENDED_LIMITS -128.0000 127.9961
 /begin AXIS_DESCR STD_AXIS InjCrv_rPreTrbnDev_mp lambda 8 -3.000000 3.000000 FORMAT "%8.6" EXTENDED_LIMITS -32.76800 32.76700 DEPOSIT ABSOLUTE /end AXIS_DESCR
/end CHARACTERISTIC
/begin CHARACTERISTIC InjCrv_facT3DiapEnvCorr_CUR "Korrekturfaktor zulässige Solltemperatur-Abweichung abhängig vom Atmosphärendruck" CURVE 0x1E38AC Kl_Xs16_Ws16 1.000000 Fact 0.00 1.000000 FORMAT "%8.6" EXTENDED_LIMITS -4.000000 3.999878
 /begin AXIS_DESCR STD_AXIS APSCD_pVal Pres_hPa 10 0.00 3500.000 FORMAT "%8.3" EXTENDED_LIMITS -32768.00 32767.00 DEPOSIT ABSOLUTE /end AXIS_DESCR
/end CHARACTERISTIC
/begin CHARACTERISTIC InjCrv_facT3DiaPreNomFltKp_C "Koeffizient für Filterung der Solltemperaturabweichung der T3-Diagnose" VALUE 0x1E38D6 Kw_Ws16 1.000000 Fact 0.00 1.000000 FORMAT "%8.6" EXTENDED_LIMITS -4.000000 3.999878 /end CHARACTERISTIC
/begin CHARACTERISTIC InjCrv_facT3DiatEnvCorr_CUR "Korrekturfaktor zulässige Solltemperatur-Abweichung = f ( t Air )" CURVE 0x1E38D8 Kl_Xs16_Ws16 1.000000 Fact 0.00 1.000000 FORMAT "%8.6" EXTENDED_LIMITS -4.000000 3.999878
 /begin AXIS_DESCR STD_AXIS InjCrv_tT3DiaAirSel_mp Temp_Cels 10 -50.14000 199.8600 FORMAT "%8.4" EXTENDED_LIMITS -3549.940 3003.560 DEPOSIT ABSOLUTE /end AXIS_DESCR
/end CHARACTERISTIC
/begin CHARACTERISTIC InjCrv_facTPstKp_CUR "P-Verstärkung des T4'-Reglers für Zugbetrieb" CURVE 0x1E4A24 Kl_Xs16_Ws16 256.0000 Fact_GOVPLMBD -1.000000 255.0000 FORMAT "%8.4" EXTENDED_LIMITS -256.0000 255.9922
 /begin AXIS_DESCR STD_AXIS InjCrv_tPstDelta_mp TempDiff_Kelv 5 -500.0000 500.0000 FORMAT "%8.4" EXTENDED_LIMITS -3276.800 3276.700 DEPOSIT ABSOLUTE /end AXIS_DESCR
/end CHARACTERISTIC
/begin CHARACTERISTIC InjCrv_qMI1Off_CUR "Ausschaltkennlinie für Überprüfung der Haupteinspritzmenge" CURVE 0x1DEDF4 Kl_Xs16_Ws16 10.00000 InjMass 0.00 10.00000 FORMAT "%8.5" EXTENDED_LIMITS -327.6800 327.6700
 /begin AXIS_DESCR STD_AXIS Eng_nAvrg EngN 10 0.00 6000.000 FORMAT "%8.3" EXTENDED_LIMITS -32768.00 32767.00 DEPOSIT ABSOLUTE /end AXIS_DESCR
/end CHARACTERISTIC
/begin CHARACTERISTIC InjCrv_qMI1On_CUR "Einschaltkennlinie für Überprüfung der Haupteinspritzmenge" CURVE 0x1DEE1E Kl_Xs16_Ws16 10.00000 InjMass 0.00 10.00000 FORMAT "%8.5" EXTENDED_LIMITS -327.6800 327.6700
 /begin AXIS_DESCR STD_AXIS Eng_nAvrg EngN 10 0.00 6000.000 FORMAT "%8.3" EXTENDED_LIMITS -32768.00 32767.00 DEPOSIT ABSOLUTE /end AXIS_DESCR
/end CHARACTERISTIC
/begin CHARACTERISTIC InjCrv_qOpOfsMax_MAP "Linearisierungskennfeld des T4'-Reglers für Zugbetrieb" MAP 0x1E4A3A Kf_Xs16_Ys16_Ws16 655.3500 InjMass -327.6800 327.6700 FORMAT "%8.4"
 /begin AXIS_DESCR STD_AXIS Eng_nAvrg EngN 14 0.00 6000.000 FORMAT "%8.3" EXTENDED_LIMITS -32768.00 32767.00 DEPOSIT ABSOLUTE /end AXIS_DESCR
 /begin AXIS_DESCR STD_AXIS InjCrv_qPoI2Op InjMass 14 0.00 327.6700 FORMAT "%8.4" EXTENDED_LIMITS -327.6800 327.6700 DEPOSIT ABSOLUTE /end AXIS_DESCR
/end CHARACTERISTIC
/begin CHARACTERISTIC InjCrv_qPiI1Off_CUR "Ausschaltkennlinie für Überprüfung der Voreinspritzmenge" CURVE 0x1DEE48 Kl_Xs16_Ws16 10.00000 InjMass 0.00 10.00000 FORMAT "%8.5" EXTENDED_LIMITS -327.6800 327.6700
 /begin AXIS_DESCR STD_AXIS Eng_nAvrg EngN 10 0.00 6000.000 FORMAT "%8.3" EXTENDED_LIMITS -32768.00 32767.00 DEPOSIT ABSOLUTE /end AXIS_DESCR
/end CHARACTERISTIC
/begin CHARACTERISTIC InjCrv_qPiI1On_CUR "Einschaltkennlinie für Überprüfung der Voreinspritzmenge" CURVE 0x1DEE72 Kl_Xs16_Ws16 10.00000 InjMass 0.00 10.00000 FORMAT "%8.5" EXTENDED_LIMITS -327.6800 327.6700
 /begin AXIS_DESCR STD_AXIS Eng_nAvrg EngN 10 0.00 6000.000 FORMAT "%8.3" EXTENDED_LIMITS -32768.00 32767.00 DEPOSIT ABSOLUTE /end AXIS_DESCR
/end CHARACTERISTIC
/begin CHARACTERISTIC InjCrv_qPoI2Eff_C "Fernsteuerung - Wert für  InjCrv_qPoI2Eff" VALUE 0x1D2582 Kw_Ws16 327.6700 InjMass 0.00 327.6700 FORMAT "%8.4" EXTENDED_LIMITS -327.6800 327.6700 /end CHARACTERISTIC
/begin CHARACTERISTIC InjCrv_qPoI2LmbdOfs_Vector "Vektor von BypTabStruct InjCrv_qPoI2LmbdOfs" VALUE 0x1C0AF4 Kw_Wu8 255.0 OneToOne 0.00 255.0 FORMAT "%5.1" /end CHARACTERISTIC
/begin CHARACTERISTIC InjCrv_qPoI2LmbdOfs_Channel "Channel von BypTabStruct InjCrv_qPoI2LmbdOfs" VALUE 0x1C0AF5 Kw_Wu8 255.0 OneToOne 0.00 255.0 FORMAT "%5.1" /end CHARACTERISTIC
/begin CHARACTERISTIC InjCrv_qPoI2LmbdRgn1Off_CUR "Ausschaltschwelle 1 für Lambda-Regelung Nacheinspritzung" CURVE 0x1E2840 Kl_Xs16_Ws16 327.6700 InjMass 0.00 327.6700 FORMAT "%8.4" EXTENDED_LIMITS -327.6800 327.6700
 /begin AXIS_DESCR STD_AXIS Eng_nAvrg EngN 10 0.00 6000.000 FORMAT "%8.3" EXTENDED_LIMITS -32768.00 32767.00 DEPOSIT ABSOLUTE /end AXIS_DESCR
/end CHARACTERISTIC
/begin CHARACTERISTIC InjCrv_qPoI2LmbdRgn1On_CUR "Einschaltschwelle 1 für Lambda-Regelung Nacheinspritzung" CURVE 0x1E286A Kl_Xs16_Ws16 327.6700 InjMass 0.00 327.6700 FORMAT "%8.4" EXTENDED_LIMITS -327.6800 327.6700
 /begin AXIS_DESCR STD_AXIS Eng_nAvrg EngN 10 0.00 6000.000 FORMAT "%8.3" EXTENDED_LIMITS -32768.00 32767.00 DEPOSIT ABSOLUTE /end AXIS_DESCR
/end CHARACTERISTIC
/begin CHARACTERISTIC InjCrv_qPoI2LmbdRgn2Off_CUR "Ausschaltschwelle 2 für Lambda-Regelung Nacheinspritzung" CURVE 0x1E2894 Kl_Xs16_Ws16 327.6700 InjMass 0.00 327.6700 FORMAT "%8.4" EXTENDED_LIMITS -327.6800 327.6700
 /begin AXIS_DESCR STD_AXIS Eng_nAvrg EngN 10 0.00 6000.000 FORMAT "%8.3" EXTENDED_LIMITS -32768.00 32767.00 DEPOSIT ABSOLUTE /end AXIS_DESCR
/end CHARACTERISTIC
/begin CHARACTERISTIC InjCrv_qPoI2LmbdRgn2On_CUR "Einschaltschwelle 2 für Lambda-Regelung Nacheinspritzung" CURVE 0x1E28BE Kl_Xs16_Ws16 327.6700 InjMass 0.00 327.6700 FORMAT "%8.4" EXTENDED_LIMITS -327.6800 327.6700
 /begin AXIS_DESCR STD_AXIS Eng_nAvrg EngN 10 0.00 6000.000 FORMAT "%8.3" EXTENDED_LIMITS -32768.00 32767.00 DEPOSIT ABSOLUTE /end AXIS_DESCR
/end CHARACTERISTIC
/begin CHARACTERISTIC InjCrv_qPoI2LmbdRgn3Off_CUR "Ausschaltschwelle 3 für Lambda-Regelung Nacheinspritzung" CURVE 0x1E28E8 Kl_Xs16_Ws16 327.6700 InjMass 0.00 327.6700 FORMAT "%8.4" EXTENDED_LIMITS -327.6800 327.6700
 /begin AXIS_DESCR STD_AXIS Eng_nAvrg EngN 10 0.00 6000.000 FORMAT "%8.3" EXTENDED_LIMITS -32768.00 32767.00 DEPOSIT ABSOLUTE /end AXIS_DESCR
/end CHARACTERISTIC
/begin CHARACTERISTIC InjCrv_qPoI2LmbdRgn3On_CUR "Einschaltschwelle 3 für Lambda-Regelung Nacheinspritzung" CURVE 0x1E2912 Kl_Xs16_Ws16 327.6700 InjMass 0.00 327.6700 FORMAT "%8.4" EXTENDED_LIMITS -327.6800 327.6700
 /begin AXIS_DESCR STD_AXIS Eng_nAvrg EngN 10 0.00 6000.000 FORMAT "%8.3" EXTENDED_LIMITS -32768.00 32767.00 DEPOSIT ABSOLUTE /end AXIS_DESCR
/end CHARACTERISTIC
/begin CHARACTERISTIC InjCrv_qPoI2LmbdRgn4Off_CUR "Ausschaltschwelle 4 für Lambda-Regelung Nacheinspritzung" CURVE 0x1E293C Kl_Xs16_Ws16 327.6700 InjMass 0.00 327.6700 FORMAT "%8.4" EXTENDED_LIMITS -327.6800 327.6700
 /begin AXIS_DESCR STD_AXIS Eng_nAvrg EngN 2 0.00 6000.000 FORMAT "%8.3" EXTENDED_LIMITS -32768.00 32767.00 DEPOSIT ABSOLUTE /end AXIS_DESCR
/end CHARACTERISTIC
/begin CHARACTERISTIC InjCrv_qPoI2LmbdRgn4On_CUR "Einschaltschwelle 4 für Lambda-Regelung Nacheinspritzung" CURVE 0x1E2946 Kl_Xs16_Ws16 327.6700 InjMass 0.00 327.6700 FORMAT "%8.4" EXTENDED_LIMITS -327.6800 327.6700
 /begin AXIS_DESCR STD_AXIS Eng_nAvrg EngN 2 0.00 6000.000 FORMAT "%8.3" EXTENDED_LIMITS -32768.00 32767.00 DEPOSIT ABSOLUTE /end AXIS_DESCR
/end CHARACTERISTIC
/begin CHARACTERISTIC InjCrv_qPoI2Off_CUR "Ausschaltkennlinie für Überprüfung der Nacheinspritzmenge" CURVE 0x1DEE9C Kl_Xs16_Ws16 10.00000 InjMass 0.00 10.00000 FORMAT "%8.5" EXTENDED_LIMITS -327.6800 327.6700
 /begin AXIS_DESCR STD_AXIS Eng_nAvrg EngN 10 0.00 6000.000 FORMAT "%8.3" EXTENDED_LIMITS -32768.00 32767.00 DEPOSIT ABSOLUTE /end AXIS_DESCR
/end CHARACTERISTIC
/begin CHARACTERISTIC InjCrv_qPoI2On_CUR "Einschaltkennlinie für Überprüfung der Nacheinspritzmenge" CURVE 0x1DEEC6 Kl_Xs16_Ws16 10.00000 InjMass 0.00 10.00000 FORMAT "%8.5" EXTENDED_LIMITS -327.6800 327.6700
 /begin AXIS_DESCR STD_AXIS Eng_nAvrg EngN 10 0.00 6000.000 FORMAT "%8.3" EXTENDED_LIMITS -32768.00 32767.00 DEPOSIT ABSOLUTE /end AXIS_DESCR
/end CHARACTERISTIC
/begin CHARACTERISTIC InjCrv_qTPreOfsOvR_MAP "Vorsteuerkennfeld des T4' Reglers für Schubbetrieb" MAP 0x1E4BFE Kf_Xs16_Ys16_Ws16 655.3500 InjMass -327.6800 327.6700 FORMAT "%8.4"
 /begin AXIS_DESCR STD_AXIS Eng_nAvrg EngN 6 0.00 6000.000 FORMAT "%8.3" EXTENDED_LIMITS -32768.00 32767.00 DEPOSIT ABSOLUTE /end AXIS_DESCR
 /begin AXIS_DESCR STD_AXIS PFlt_tOxiPre Temp_Cels 6 -50.04000 749.9600 FORMAT "%8.4" EXTENDED_LIMITS -3549.940 3003.560 DEPOSIT ABSOLUTE /end AXIS_DESCR
/end CHARACTERISTIC
/begin CHARACTERISTIC InjCrv_qTPstOfsOvR_MAP "P-Verstärkung des T4'-Reglers für Schubbetrieb" MAP 0x1E4C62 Kf_Xs16_Ys16_Ws16 655.3500 InjMass -327.6800 327.6700 FORMAT "%8.4"
 /begin AXIS_DESCR STD_AXIS Eng_nAvrg EngN 6 0.00 6000.000 FORMAT "%8.3" EXTENDED_LIMITS -32768.00 32767.00 DEPOSIT ABSOLUTE /end AXIS_DESCR
 /begin AXIS_DESCR STD_AXIS PFlt_tOxiPst Temp_Cels 6 -3549.940 3003.560 FORMAT "%8.3" DEPOSIT ABSOLUTE /end AXIS_DESCR
/end CHARACTERISTIC
/begin CHARACTERISTIC InjCrv_rPoI2LmbdGovMax_C "Maximalgrenze fuer Ausgangssignal Lambdaregler" VALUE 0x1E2950 Kw_Ws16 30.00000 lambda 0.00 30.00000 FORMAT "%8.5" EXTENDED_LIMITS -32.76800 32.76700 /end CHARACTERISTIC
/begin CHARACTERISTIC InjCrv_rPoI2LmbdGovMinStd_C "Standardwert für Minimalwertbegrenzung des Lambda-Reglers" VALUE 0x1E2952 Kw_Ws16 10.00000 lambda 0.00 10.00000 FORMAT "%8.5" EXTENDED_LIMITS -32.76800 32.76700 /end CHARACTERISTIC
/begin CHARACTERISTIC InjCrv_rPoI2LmbdGovMin_CUR "Verstaerkung dynamische Minimalwert-Begrenzung (Lambda-Regler)" CURVE 0x1E2954 Kl_Xs16_Ws16 60.00000 lambda -30.00000 30.00000 FORMAT "%8.5" EXTENDED_LIMITS -32.76800 32.76700
 /begin AXIS_DESCR STD_AXIS InjCrv_drPoI2LmbdMinDev_mp lambda 8 -3.000000 3.000000 FORMAT "%8.6" EXTENDED_LIMITS -32.76800 32.76700 DEPOSIT ABSOLUTE /end AXIS_DESCR
/end CHARACTERISTIC
/begin CHARACTERISTIC InjCrv_rPoI2LmbdMax_C "Maximalwert der Lambda-Sollwert.Limitierung" VALUE 0x1E2976 Kw_Ws16 30.00000 lambda 0.00 30.00000 FORMAT "%8.5" EXTENDED_LIMITS -32.76800 32.76700 /end CHARACTERISTIC
/begin CHARACTERISTIC InjCrv_rPoI2LmbdMin1_MAP "Kennfeld 1 Lambda-Sollwert-Limitierung" MAP 0x1E2978 Kf_Xs16_Ys16_Ws16 10.00000 lambda 0.00 10.00000 FORMAT "%8.5" EXTENDED_LIMITS -32.76800 32.76700
 /begin AXIS_DESCR STD_AXIS Eng_nAvrg EngN 8 0.00 6000.000 FORMAT "%8.3" EXTENDED_LIMITS -32768.00 32767.00 DEPOSIT ABSOLUTE /end AXIS_DESCR
 /begin AXIS_DESCR STD_AXIS InjCrv_qPoI2Op InjMass 8 0.00 327.6700 FORMAT "%8.4" EXTENDED_LIMITS -327.6800 327.6700 DEPOSIT ABSOLUTE /end AXIS_DESCR
/end CHARACTERISTIC
/begin CHARACTERISTIC InjCrv_rPoI2LmbdMin2_MAP "Kennfeld 2 Lambda-Sollwert-Limitierung" MAP 0x1E2A1C Kf_Xs16_Ys16_Ws16 10.00000 lambda 0.00 10.00000 FORMAT "%8.5" EXTENDED_LIMITS -32.76800 32.76700
 /begin AXIS_DESCR STD_AXIS Eng_nAvrg EngN 8 0.00 6000.000 FORMAT "%8.3" EXTENDED_LIMITS -32768.00 32767.00 DEPOSIT ABSOLUTE /end AXIS_DESCR
 /begin AXIS_DESCR STD_AXIS InjCrv_qPoI2Op InjMass 8 0.00 327.6700 FORMAT "%8.4" EXTENDED_LIMITS -327.6800 327.6700 DEPOSIT ABSOLUTE /end AXIS_DESCR
/end CHARACTERISTIC
/begin CHARACTERISTIC InjCrv_rPoI2LmbdMin3_MAP "Kennfeld 3 Lambda-Sollwert-Limitierung" MAP 0x1E2AC0 Kf_Xs16_Ys16_Ws16 10.00000 lambda 0.00 10.00000 FORMAT "%8.5" EXTENDED_LIMITS -32.76800 32.76700
 /begin AXIS_DESCR STD_AXIS Eng_nAvrg EngN 8 0.00 6000.000 FORMAT "%8.3" EXTENDED_LIMITS -32768.00 32767.00 DEPOSIT ABSOLUTE /end AXIS_DESCR
 /begin AXIS_DESCR STD_AXIS InjCrv_qPoI2Op InjMass 8 0.00 327.6700 FORMAT "%8.4" EXTENDED_LIMITS -327.6800 327.6700 DEPOSIT ABSOLUTE /end AXIS_DESCR
/end CHARACTERISTIC
/begin CHARACTERISTIC InjCrv_rPoI2LmbdMin4_MAP "Kennfeld 4 Lambda-Sollwert-Limitierung" MAP 0x1E2B64 Kf_Xs16_Ys16_Ws16 10.00000 lambda 0.00 10.00000 FORMAT "%8.5" EXTENDED_LIMITS -32.76800 32.76700
 /begin AXIS_DESCR STD_AXIS Eng_nAvrg EngN 2 0.00 6000.000 FORMAT "%8.3" EXTENDED_LIMITS -32768.00 32767.00 DEPOSIT ABSOLUTE /end AXIS_DESCR
 /begin AXIS_DESCR STD_AXIS InjCrv_qPoI2Op InjMass 2 0.00 327.6700 FORMAT "%8.4" EXTENDED_LIMITS -327.6800 327.6700 DEPOSIT ABSOLUTE /end AXIS_DESCR
/end CHARACTERISTIC
/begin CHARACTERISTIC InjCrv_rPoI2LmbdMinNom_MAP "Minimalgrenze fuer Ausgangssignal Lambdaregler" MAP 0x1E2B78 Kf_Xs16_Ys16_Ws16 2.000000 lambda 0.00 2.000000 FORMAT "%8.6" EXTENDED_LIMITS -32.76800 32.76700
 /begin AXIS_DESCR STD_AXIS Eng_nAvrg EngN 8 0.00 6000.000 FORMAT "%8.3" EXTENDED_LIMITS -32768.00 32767.00 DEPOSIT ABSOLUTE /end AXIS_DESCR
 /begin AXIS_DESCR STD_AXIS InjCrv_qPoI2Op InjMass 8 0.00 327.6700 FORMAT "%8.4" EXTENDED_LIMITS -327.6800 327.6700 DEPOSIT ABSOLUTE /end AXIS_DESCR
/end CHARACTERISTIC
/begin CHARACTERISTIC InjCrv_rPoI2LmbdNom_Vector "Bypass-Label fuer InjCrv_rPoI2LmbdNom (Nicht verstellen!)" VALUE 0x1C0AF6 Kw_Wu8 255.0 OneToOne 0.00 255.0 FORMAT "%5.1" /end CHARACTERISTIC
/begin CHARACTERISTIC InjCrv_rPoI2LmbdNom_Channel "Bypass-Label fuer InjCrv_rPoI2LmbdNom (Nicht verstellen!)" VALUE 0x1C0AF7 Kw_Wu8 255.0 OneToOne 0.00 255.0 FORMAT "%5.1" /end CHARACTERISTIC
/begin CHARACTERISTIC InjCrv_rPoI2LmbdRgn10_MAP "Kennfeldwert 10 Lambda-Sollwert Nacheinspritzung" MAP 0x1E2C1C Kf_Xs16_Ys16_Ws16 10.00000 lambda 0.00 10.00000 FORMAT "%8.5" EXTENDED_LIMITS -32.76800 32.76700
 /begin AXIS_DESCR STD_AXIS Eng_nAvrg EngN 14 0.00 6000.000 FORMAT "%8.3" EXTENDED_LIMITS -32768.00 32767.00 DEPOSIT ABSOLUTE /end AXIS_DESCR
 /begin AXIS_DESCR STD_AXIS InjCrv_qPoI2Op InjMass 14 0.00 327.6700 FORMAT "%8.4" EXTENDED_LIMITS -327.6800 327.6700 DEPOSIT ABSOLUTE /end AXIS_DESCR
/end CHARACTERISTIC
/begin CHARACTERISTIC InjCrv_rPoI2LmbdRgn11_MAP "Kennfeldwert 11 Lambda-Sollwert Nacheinspritzung" MAP 0x1E2DE0 Kf_Xs16_Ys16_Ws16 10.00000 lambda 0.00 10.00000 FORMAT "%8.5" EXTENDED_LIMITS -32.76800 32.76700
 /begin AXIS_DESCR STD_AXIS Eng_nAvrg EngN 2 0.00 6000.000 FORMAT "%8.3" EXTENDED_LIMITS -32768.00 32767.00 DEPOSIT ABSOLUTE /end AXIS_DESCR
 /begin AXIS_DESCR STD_AXIS InjCrv_qPoI2Op InjMass 2 0.00 327.6700 FORMAT "%8.4" EXTENDED_LIMITS -327.6800 327.6700 DEPOSIT ABSOLUTE /end AXIS_DESCR
/end CHARACTERISTIC
/begin CHARACTERISTIC InjCrv_rPoI2LmbdRgn20_MAP "Kennfeldwert 20 Lambda-Sollwert Nacheinspritzung" MAP 0x1E2DF4 Kf_Xs16_Ys16_Ws16 10.00000 lambda 0.00 10.00000 FORMAT "%8.5" EXTENDED_LIMITS -32.76800 32.76700
 /begin AXIS_DESCR STD_AXIS Eng_nAvrg EngN 14 0.00 6000.000 FORMAT "%8.3" EXTENDED_LIMITS -32768.00 32767.00 DEPOSIT ABSOLUTE /end AXIS_DESCR
 /begin AXIS_DESCR STD_AXIS InjCrv_qPoI2Op InjMass 14 0.00 327.6700 FORMAT "%8.4" EXTENDED_LIMITS -327.6800 327.6700 DEPOSIT ABSOLUTE /end AXIS_DESCR
/end CHARACTERISTIC
/begin CHARACTERISTIC InjCrv_rPoI2LmbdRgn21_MAP "Kennfeldwert 21 Lambda-Sollwert Nacheinspritzung" MAP 0x1E2FB8 Kf_Xs16_Ys16_Ws16 10.00000 lambda 0.00 10.00000 FORMAT "%8.5" EXTENDED_LIMITS -32.76800 32.76700
 /begin AXIS_DESCR STD_AXIS Eng_nAvrg EngN 2 0.00 6000.000 FORMAT "%8.3" EXTENDED_LIMITS -32768.00 32767.00 DEPOSIT ABSOLUTE /end AXIS_DESCR
 /begin AXIS_DESCR STD_AXIS InjCrv_qPoI2Op InjMass 2 0.00 327.6700 FORMAT "%8.4" EXTENDED_LIMITS -327.6800 327.6700 DEPOSIT ABSOLUTE /end AXIS_DESCR
/end CHARACTERISTIC
/begin CHARACTERISTIC InjCrv_rPoI2LmbdRgn30_MAP "Kennfeldwert 30 Lambda-Sollwert Nacheinspritzung" MAP 0x1E2FCC Kf_Xs16_Ys16_Ws16 10.00000 lambda 0.00 10.00000 FORMAT "%8.5" EXTENDED_LIMITS -32.76800 32.76700
 /begin AXIS_DESCR STD_AXIS Eng_nAvrg EngN 14 0.00 6000.000 FORMAT "%8.3" EXTENDED_LIMITS -32768.00 32767.00 DEPOSIT ABSOLUTE /end AXIS_DESCR
 /begin AXIS_DESCR STD_AXIS InjCrv_qPoI2Op InjMass 14 0.00 327.6700 FORMAT "%8.4" EXTENDED_LIMITS -327.6800 327.6700 DEPOSIT ABSOLUTE /end AXIS_DESCR
/end CHARACTERISTIC
/begin CHARACTERISTIC InjCrv_rPoI2LmbdRgn31_MAP "Kennfeldwert 31 Lambda-Sollwert Nacheinspritzung" MAP 0x1E3190 Kf_Xs16_Ys16_Ws16 10.00000 lambda 0.00 10.00000 FORMAT "%8.5" EXTENDED_LIMITS -32.76800 32.76700
 /begin AXIS_DESCR STD_AXIS Eng_nAvrg EngN 2 0.00 6000.000 FORMAT "%8.3" EXTENDED_LIMITS -32768.00 32767.00 DEPOSIT ABSOLUTE /end AXIS_DESCR
 /begin AXIS_DESCR STD_AXIS InjCrv_qPoI2Op InjMass 2 0.00 327.6700 FORMAT "%8.4" EXTENDED_LIMITS -327.6800 327.6700 DEPOSIT ABSOLUTE /end AXIS_DESCR
/end CHARACTERISTIC
/begin CHARACTERISTIC InjCrv_rPoI2LmbdRgn40_MAP "Kennfeldwert 40 Lambda-Sollwert Nacheinspritzung" MAP 0x1E31A4 Kf_Xs16_Ys16_Ws16 10.00000 lambda 0.00 10.00000 FORMAT "%8.5" EXTENDED_LIMITS -32.76800 32.76700
 /begin AXIS_DESCR STD_AXIS Eng_nAvrg EngN 2 0.00 6000.000 FORMAT "%8.3" EXTENDED_LIMITS -32768.00 32767.00 DEPOSIT ABSOLUTE /end AXIS_DESCR
 /begin AXIS_DESCR STD_AXIS InjCrv_qPoI2Op InjMass 2 0.00 327.6700 FORMAT "%8.4" EXTENDED_LIMITS -327.6800 327.6700 DEPOSIT ABSOLUTE /end AXIS_DESCR
/end CHARACTERISTIC
/begin CHARACTERISTIC InjCrv_rPoI2LmbdRgn41_MAP "Kennfeldwert 41 Lambda-Sollwert Nacheinspritzung" MAP 0x1E31B8 Kf_Xs16_Ys16_Ws16 10.00000 lambda 0.00 10.00000 FORMAT "%8.5" EXTENDED_LIMITS -32.76800 32.76700
 /begin AXIS_DESCR STD_AXIS Eng_nAvrg EngN 2 0.00 6000.000 FORMAT "%8.3" EXTENDED_LIMITS -32768.00 32767.00 DEPOSIT ABSOLUTE /end AXIS_DESCR
 /begin AXIS_DESCR STD_AXIS InjCrv_qPoI2Op InjMass 2 0.00 327.6700 FORMAT "%8.4" EXTENDED_LIMITS -327.6800 327.6700 DEPOSIT ABSOLUTE /end AXIS_DESCR
/end CHARACTERISTIC
/begin CHARACTERISTIC InjCrv_rPoI2LmbdT3Max_C "Minimalwert des T3-Reglers" VALUE 0x1E324C Kw_Ws16 30.00000 lambda 0.00 30.00000 FORMAT "%8.5" EXTENDED_LIMITS -32.76800 32.76700 /end CHARACTERISTIC
/begin CHARACTERISTIC InjCrv_rPoI2LmbdT3MinNom_MAP "Minimalgrenze fuer Ausgangssignal T3-Regler" MAP 0x1E324E Kf_Xs16_Ys16_Ws16 2.000000 lambda 0.00 2.000000 FORMAT "%8.6" EXTENDED_LIMITS -32.76800 32.76700
 /begin AXIS_DESCR STD_AXIS Eng_nAvrg EngN 8 0.00 6000.000 FORMAT "%8.3" EXTENDED_LIMITS -32768.00 32767.00 DEPOSIT ABSOLUTE /end AXIS_DESCR
 /begin AXIS_DESCR STD_AXIS InjCrv_qPoI2Op InjMass 8 0.00 327.6700 FORMAT "%8.4" EXTENDED_LIMITS -327.6800 327.6700 DEPOSIT ABSOLUTE /end AXIS_DESCR
/end CHARACTERISTIC
/begin CHARACTERISTIC InjCrv_rPoI2LmbdT3Min_CUR "Verstaerkung dynamische Minimalwert-Begrenzung (T3-Regler)" CURVE 0x1E32F2 Kl_Xs16_Ws16 60.00000 lambda -30.00000 30.00000 FORMAT "%8.5" EXTENDED_LIMITS -32.76800 32.76700
 /begin AXIS_DESCR STD_AXIS InjCrv_drLmbdT3MinDev_mp lambda 8 -3.000000 3.000000 FORMAT "%8.6" EXTENDED_LIMITS -32.76800 32.76700 DEPOSIT ABSOLUTE /end AXIS_DESCR
/end CHARACTERISTIC
/begin CHARACTERISTIC InjCrv_stfacPoI2T3Only_C "Umschalt-Maske zwischem geregeltem / gesteuertem Betrieb (Lambda-Regler PoI2)" VALUE 0x1E31CC Kw_Wu8 255.0 OneToOne 0.00 255.0 FORMAT "%5.1" /end CHARACTERISTIC
/begin CHARACTERISTIC InjCrv_stPoI2LmbdGovMinStd_C "Maske für Auswahl konstanter Lambda-Regler-Minimalwert-Begrenzung (anstatt dynamischer Begrenzung)" VALUE 0x1E31CD Kw_Wu8 255.0 OneToOne 0.00 255.0 FORMAT "%5.1" /end CHARACTERISTIC
/begin CHARACTERISTIC InjCrv_stPoI2LmbdLimM_C "Freigabe Auswahl berechneter Lambda-Wert fuer Min.-Begrenzung (Lambda-Regler)" VALUE 0x1E31CE Kw_Wu8 1.000 OneToOne 0.00 1.000 FORMAT "%5.3" EXTENDED_LIMITS 0.00 255.0 /end CHARACTERISTIC
/begin CHARACTERISTIC InjCrv_stPoI2LmbdSCDac_C "Maske um dynamische Ueberbrueckung des Lambda-Reglers freizugeben" VALUE 0x1E31CF Kw_Wu8 255.0 OneToOne 0.00 255.0 FORMAT "%5.1" /end CHARACTERISTIC
/begin CHARACTERISTIC InjCrv_stPoI2LmbdT3LimM1_C "Freigabe Auswahl berechneter Lambda-Wert fuer Min.-Begrenzung (T3-Regler)" VALUE 0x1E3314 Kw_Wu8 1.000 OneToOne 0.00 1.000 FORMAT "%5.3" EXTENDED_LIMITS 0.00 255.0 /end CHARACTERISTIC
/begin CHARACTERISTIC InjCrv_stPoI2LmbdT3LimM2_C "Freigabe Auswahl Lambdaregler-Sollwert fuer Min.-Begrenzung (T3-Regler)" VALUE 0x1E3315 Kw_Wu8 1.000 OneToOne 0.00 1.000 FORMAT "%5.3" EXTENDED_LIMITS 0.00 255.0 /end CHARACTERISTIC
/begin CHARACTERISTIC InjCrv_stPoI2Sel1_C "Maske für Regenerationsmodus 1" VALUE 0x1E275C Kw_Wu32 2147483647.00 OneToOne 0.00 2147483647.00 FORMAT "%13.2" EXTENDED_LIMITS 0.00 4294967295.00 /end CHARACTERISTIC
/begin CHARACTERISTIC InjCrv_stPoI2Sel2_C "Maske für Regenerationsmodus 2" VALUE 0x1E2760 Kw_Wu32 2147483647.00 OneToOne 0.00 2147483647.00 FORMAT "%13.2" EXTENDED_LIMITS 0.00 4294967295.00 /end CHARACTERISTIC
/begin CHARACTERISTIC InjCrv_stPoI2Sel3_C "Maske für Regenerationsmodus 3" VALUE 0x1E2764 Kw_Wu32 2147483647.00 OneToOne 0.00 2147483647.00 FORMAT "%13.2" EXTENDED_LIMITS 0.00 4294967295.00 /end CHARACTERISTIC
/begin CHARACTERISTIC InjCrv_stPoI2Sel4_C "Maske für Regenerationsmodus 4" VALUE 0x1E2768 Kw_Wu32 2147483647.00 OneToOne 0.00 2147483647.00 FORMAT "%13.2" EXTENDED_LIMITS 0.00 4294967295.00 /end CHARACTERISTIC
/begin CHARACTERISTIC InjCrv_stPreTrbnT3Dac_C "Maske für Deaktivierung des Abgastemperatur-Reglers" VALUE 0x1E3316 Kw_Wu8 255.0 OneToOne 0.00 255.0 FORMAT "%5.1" /end CHARACTERISTIC
/begin CHARACTERISTIC InjCrv_tPreTrbnPoI2T31Off_C "Ausschalt-Schwelle von EGPpCD_tPreTrbn für den T3-Regler (PoI2 Modus 1)" VALUE 0x1E3318 Kw_Ws16 1000.000 Temp_Cels -0.04000000 999.9600 FORMAT "%8.3" EXTENDED_LIMITS -3549.940 3003.560 /end CHARACTERISTIC
/begin CHARACTERISTIC InjCrv_tPreTrbnPoI2T31On_C "Einschalt-Schwelle von EGPpCD_tPreTrbn für den T3-Regler (PoI2 Modus 1)" VALUE 0x1E331A Kw_Ws16 1000.000 Temp_Cels -0.04000000 999.9600 FORMAT "%8.3" EXTENDED_LIMITS -3549.940 3003.560 /end CHARACTERISTIC
/begin CHARACTERISTIC InjCrv_stT3CtlNoAct1_C "Unterer T3-Hysterese-Ausgangswert (Regenerationsmodus 1)" VALUE 0x1E331C Kw_Ws16 65535.00 OneToOne -32768.00 32767.00 FORMAT "%8.2" READ_ONLY /end CHARACTERISTIC
/begin CHARACTERISTIC InjCrv_stT3CtlAct1_C "Oberer T3-Hysterese-Ausgangswert (Regenerationsmodus 1)" VALUE 0x1E331E Kw_Ws16 65535.00 OneToOne -32768.00 32767.00 FORMAT "%8.2" READ_ONLY /end CHARACTERISTIC
/begin CHARACTERISTIC InjCrv_tPreTrbnPoI2T32Off_C "Ausschalt-Schwelle von EGPpCD_tPreTrbn für den T3-Regler (PoI2 Modus 2)" VALUE 0x1E3320 Kw_Ws16 1000.000 Temp_Cels -0.04000000 999.9600 FORMAT "%8.3" EXTENDED_LIMITS -3549.940 3003.560 /end CHARACTERISTIC
/begin CHARACTERISTIC InjCrv_tPreTrbnPoI2T32On_C "Einschalt-Schwelle von EGPpCD_tPreTrbn für den T3-Regler (PoI2 Modus 2)" VALUE 0x1E3322 Kw_Ws16 1000.000 Temp_Cels -0.04000000 999.9600 FORMAT "%8.3" EXTENDED_LIMITS -3549.940 3003.560 /end CHARACTERISTIC
/begin CHARACTERISTIC InjCrv_stT3CtlNoAct2_C "Unterer T3-Hysterese-Ausgangswert (Regenerationsmodus 2)" VALUE 0x1E3324 Kw_Ws16 65535.00 OneToOne -32768.00 32767.00 FORMAT "%8.2" READ_ONLY /end CHARACTERISTIC
/begin CHARACTERISTIC InjCrv_stT3CtlAct2_C "Oberer T3-Hysterese-Ausgangswert (Regenerationsmodus 2)" VALUE 0x1E3326 Kw_Ws16 65535.00 OneToOne -32768.00 32767.00 FORMAT "%8.2" READ_ONLY /end CHARACTERISTIC
/begin CHARACTERISTIC InjCrv_tPreTrbnPoI2T33Off_C "Ausschalt-Schwelle von EGPpCD_tPreTrbn für den T3-Regler (PoI2 Modus 3)" VALUE 0x1E3328 Kw_Ws16 1000.000 Temp_Cels -0.04000000 999.9600 FORMAT "%8.3" EXTENDED_LIMITS -3549.940 3003.560 /end CHARACTERISTIC
/begin CHARACTERISTIC InjCrv_tPreTrbnPoI2T33On_C "Einschalt-Schwelle von EGPpCD_tPreTrbn für den T3-Regler (PoI2 Modus 3)" VALUE 0x1E332A Kw_Ws16 1000.000 Temp_Cels -0.04000000 999.9600 FORMAT "%8.3" EXTENDED_LIMITS -3549.940 3003.560 /end CHARACTERISTIC
/begin CHARACTERISTIC InjCrv_stT3CtlNoAct3_C "Unterer T3-Hysterese-Ausgangswert (Regenerationsmodus 3)" VALUE 0x1E332C Kw_Ws16 65535.00 OneToOne -32768.00 32767.00 FORMAT "%8.2" READ_ONLY /end CHARACTERISTIC
/begin CHARACTERISTIC InjCrv_stT3CtlAct3_C "Oberer T3-Hysterese-Ausgangswert (Regenerationsmodus 3)" VALUE 0x1E332E Kw_Ws16 65535.00 OneToOne -32768.00 32767.00 FORMAT "%8.2" READ_ONLY /end CHARACTERISTIC
/begin CHARACTERISTIC InjCrv_tPreTrbnPoI2T34Off_C "Ausschalt-Schwelle von EGPpCD_tPreTrbn für den T3-Regler (PoI2 Modus 4)" VALUE 0x1E3330 Kw_Ws16 1000.000 Temp_Cels -0.04000000 999.9600 FORMAT "%8.3" EXTENDED_LIMITS -3549.940 3003.560 /end CHARACTERISTIC
/begin CHARACTERISTIC InjCrv_tPreTrbnPoI2T34On_C "Einschalt-Schwelle von EGPpCD_tPreTrbn für den T3-Regler (PoI2 Modus 4)" VALUE 0x1E3332 Kw_Ws16 1000.000 Temp_Cels -0.04000000 999.9600 FORMAT "%8.3" EXTENDED_LIMITS -3549.940 3003.560 /end CHARACTERISTIC
/begin CHARACTERISTIC InjCrv_stT3CtlNoAct4_C "Unterer T3-Hysterese-Ausgangswert (Regenerationsmodus 4)" VALUE 0x1E3334 Kw_Ws16 65535.00 OneToOne -32768.00 32767.00 FORMAT "%8.2" READ_ONLY /end CHARACTERISTIC
/begin CHARACTERISTIC InjCrv_stT3CtlAct4_C "Oberer T3-Hysterese-Ausgangswert (Regenerationsmodus 4)" VALUE 0x1E3336 Kw_Ws16 65535.00 OneToOne -32768.00 32767.00 FORMAT "%8.2" READ_ONLY /end CHARACTERISTIC
/begin CHARACTERISTIC InjCrv_stT3DiaMskEna_C "Maske zur Freischaltung der T3-Diagnose in der akt. Regenerationsstufe" VALUE 0x1E3902 Kw_Wu8 255.0 OneToOne 0.00 255.0 FORMAT "%5.1" /end CHARACTERISTIC
/begin CHARACTERISTIC InjCrv_swtT3DiaAirSel_C "Auswahlschalter; EATSCD_tAir =0, IATSCD_tAir =1 für InjCrv_facT3DiatEnvCorr_CUR" VALUE 0x1E3903 Kw_Wu8 1.000 OneToOne 0.00 1.000 FORMAT "%5.3" EXTENDED_LIMITS 0.00 255.0 /end CHARACTERISTIC
/begin CHARACTERISTIC InjCrv_swtT3DiaEna_C "T3-Diagnose aktivieren =1; deaktivieren =0" VALUE 0x1E3904 Kw_Wu8 1.000 OneToOne 0.00 1.000 FORMAT "%5.3" EXTENDED_LIMITS 0.00 255.0 /end CHARACTERISTIC
/begin CHARACTERISTIC InjCrv_tiT3DiaCTDel_CUR "Verzögerungszeit Gesamtfreigabe über Kühlmitteltemperatur" CURVE 0x1E3906 Kl_Xs16_Ws16 255000.0 Time_ms 0.00 255000.0 FORMAT "%8.1" EXTENDED_LIMITS -327680.0 327670.0
 /begin AXIS_DESCR STD_AXIS CTSCD_tClnt Temp_Cels 10 -50.14000 149.8600 FORMAT "%8.4" EXTENDED_LIMITS -3549.940 3003.560 DEPOSIT ABSOLUTE /end AXIS_DESCR
/end CHARACTERISTIC
/begin CHARACTERISTIC InjCrv_tiT3DiaDel_C "Verzögerungszeit nach Eintritt in aktuelle Regenerationsstufe" VALUE 0x1E3930 Kw_Wu32 255000.000000 Time_ms 0.00 255000.000000 FORMAT "%13.6" EXTENDED_LIMITS 0.00 42949672950.0 /end CHARACTERISTIC
/begin CHARACTERISTIC InjCrv_tiT3DiaEGPDel_CUR "Verzögerungszeit der Gesamtfreigabe über Turboladertemperatur" CURVE 0x1E3934 Kl_Xs16_Ws16 255000.0 Time_ms 0.00 255000.0 FORMAT "%8.1" EXTENDED_LIMITS -327680.0 327670.0
 /begin AXIS_DESCR STD_AXIS EGPpCD_tPreTrbn Temp_Cels 13 -0.04000000 999.9600 FORMAT "%8.3" EXTENDED_LIMITS -3549.940 3003.560 DEPOSIT ABSOLUTE /end AXIS_DESCR
/end CHARACTERISTIC
/begin CHARACTERISTIC InjCrv_tiT3DiaShtrpDel_C "Verzögerungszeit der Gesamtfreigabe im Short-Trip Modus" VALUE 0x1E396C Kw_Wu32 255000.000000 Time_ms 0.00 255000.000000 FORMAT "%13.6" EXTENDED_LIMITS 0.00 42949672950.0 /end CHARACTERISTIC
/begin CHARACTERISTIC InjCrv_tOxiPstMax_C "tOxiPst Maximum für T4' Regler" VALUE 0x1E4CC6 Kw_Ws16 550.0000 Temp_Cels 199.9600 749.9600 FORMAT "%8.4" EXTENDED_LIMITS -3549.940 3003.560 /end CHARACTERISTIC
/begin CHARACTERISTIC InjCrv_tPreTrbn1_MAP "Kennfeld 1 für T3-Sollwert" MAP 0x1E333A Kf_Xs16_Ys16_Ws16 900.0000 Temp_Cels -0.04000000 899.9600 FORMAT "%8.4" EXTENDED_LIMITS -3549.940 3003.560
 /begin AXIS_DESCR STD_AXIS Eng_nAvrg EngN 14 0.00 6000.000 FORMAT "%8.3" EXTENDED_LIMITS -32768.00 32767.00 DEPOSIT ABSOLUTE /end AXIS_DESCR
 /begin AXIS_DESCR STD_AXIS InjCrv_qPoI2Op InjMass 14 0.00 327.6700 FORMAT "%8.4" EXTENDED_LIMITS -327.6800 327.6700 DEPOSIT ABSOLUTE /end AXIS_DESCR
/end CHARACTERISTIC
/begin CHARACTERISTIC InjCrv_tPreTrbn2_MAP "Kennfeld 2 für T3-Sollwert" MAP 0x1E34FE Kf_Xs16_Ys16_Ws16 900.0000 Temp_Cels -0.04000000 899.9600 FORMAT "%8.4" EXTENDED_LIMITS -3549.940 3003.560
 /begin AXIS_DESCR STD_AXIS Eng_nAvrg EngN 14 0.00 6000.000 FORMAT "%8.3" EXTENDED_LIMITS -32768.00 32767.00 DEPOSIT ABSOLUTE /end AXIS_DESCR
 /begin AXIS_DESCR STD_AXIS InjCrv_qPoI2Op InjMass 14 0.00 327.6700 FORMAT "%8.4" EXTENDED_LIMITS -327.6800 327.6700 DEPOSIT ABSOLUTE /end AXIS_DESCR
/end CHARACTERISTIC
/begin CHARACTERISTIC InjCrv_tPreTrbn3_MAP "Kennfeld 3 für T3-Sollwert" MAP 0x1E36C2 Kf_Xs16_Ys16_Ws16 900.0000 Temp_Cels -0.04000000 899.9600 FORMAT "%8.4" EXTENDED_LIMITS -3549.940 3003.560
 /begin AXIS_DESCR STD_AXIS Eng_nAvrg EngN 14 0.00 6000.000 FORMAT "%8.3" EXTENDED_LIMITS -32768.00 32767.00 DEPOSIT ABSOLUTE /end AXIS_DESCR
 /begin AXIS_DESCR STD_AXIS InjCrv_qPoI2Op InjMass 14 0.00 327.6700 FORMAT "%8.4" EXTENDED_LIMITS -327.6800 327.6700 DEPOSIT ABSOLUTE /end AXIS_DESCR
/end CHARACTERISTIC
/begin CHARACTERISTIC InjCrv_tPreTrbn4_MAP "Kennfeld 4 für T3-Sollwert" MAP 0x1E3886 Kf_Xs16_Ys16_Ws16 900.0000 Temp_Cels -0.04000000 899.9600 FORMAT "%8.4" EXTENDED_LIMITS -3549.940 3003.560
 /begin AXIS_DESCR STD_AXIS Eng_nAvrg EngN 2 0.00 6000.000 FORMAT "%8.3" EXTENDED_LIMITS -32768.00 32767.00 DEPOSIT ABSOLUTE /end AXIS_DESCR
 /begin AXIS_DESCR STD_AXIS InjCrv_qPoI2Op InjMass 2 0.00 327.6700 FORMAT "%8.4" EXTENDED_LIMITS -327.6800 327.6700 DEPOSIT ABSOLUTE /end AXIS_DESCR
/end CHARACTERISTIC
/begin CHARACTERISTIC InjCrv_tPreTrbnNom_Vector "Bypass-Label fuer InjCrv_tPreTrbnNom (Nicht verstellen!)" VALUE 0x1C0AF8 Kw_Wu8 255.0 OneToOne 0.00 255.0 FORMAT "%5.1" /end CHARACTERISTIC
/begin CHARACTERISTIC InjCrv_tPreTrbnNom_Channel "Bypass-Label fuer InjCrv_tPreTrbnNom (Nicht verstellen!)" VALUE 0x1C0AF9 Kw_Wu8 255.0 OneToOne 0.00 255.0 FORMAT "%5.1" /end CHARACTERISTIC
/begin CHARACTERISTIC InjCrv_tT3DiaDevMax_C "Schwelle zur Aktivierung der Überwachung auf Temp.überschreitung" VALUE 0x1E3970 Kw_Ws16 1023.000 TempDiff_Kelv 0.00 1023.000 FORMAT "%8.3" EXTENDED_LIMITS -3276.800 3276.700 /end CHARACTERISTIC
/begin CHARACTERISTIC InjCrv_tT3DiaDevMax_MAP "KF max. zulässigen Solltemperatur-Überschreitung" MAP 0x1E3972 Kf_Xs16_Ys16_Ws16 1023.000 TempDiff_Kelv 0.00 1023.000 FORMAT "%8.3" EXTENDED_LIMITS -3276.800 3276.700
 /begin AXIS_DESCR STD_AXIS Eng_nAvrg EngN 40 0.00 6000.000 FORMAT "%8.3" EXTENDED_LIMITS -32768.00 32767.00 DEPOSIT ABSOLUTE /end AXIS_DESCR
 /begin AXIS_DESCR STD_AXIS InjCtl_qCurr InjMass 25 0.00 327.6700 FORMAT "%8.4" EXTENDED_LIMITS -327.6800 327.6700 DEPOSIT ABSOLUTE /end AXIS_DESCR
/end CHARACTERISTIC
/begin CHARACTERISTIC InjCrv_tT3DiaDevMin_C "Schwelle zur Aktivierung der Überwachung auf Temp.unterschreitung" VALUE 0x1E41C8 Kw_Ws16 1023.000 TempDiff_Kelv -1023.000 0.00 FORMAT "%8.3" EXTENDED_LIMITS -3276.800 3276.700 /end CHARACTERISTIC
/begin CHARACTERISTIC InjCrv_tT3DiaDevMin_MAP "KF min. zulässigen Solltemperatur-Unterschreitung" MAP 0x1E41CA Kf_Xs16_Ys16_Ws16 1023.000 TempDiff_Kelv -1023.000 0.00 FORMAT "%8.3" EXTENDED_LIMITS -3276.800 3276.700
 /begin AXIS_DESCR STD_AXIS Eng_nAvrg EngN 40 0.00 6000.000 FORMAT "%8.3" EXTENDED_LIMITS -32768.00 32767.00 DEPOSIT ABSOLUTE /end AXIS_DESCR
 /begin AXIS_DESCR STD_AXIS InjCtl_qCurr InjMass 25 0.00 327.6700 FORMAT "%8.4" EXTENDED_LIMITS -327.6800 327.6700 DEPOSIT ABSOLUTE /end AXIS_DESCR
/end CHARACTERISTIC
/begin CHARACTERISTIC InjCrv_tT3DiaShtrpDevMax_C "max. Schwelle zur Aktivierung der Überwachung auf Temp.überschreitung im Short-Trip Modus" VALUE 0x1E4A20 Kw_Ws16 1023.000 TempDiff_Kelv 0.00 1023.000 FORMAT "%8.3" EXTENDED_LIMITS -3276.800 3276.700 /end CHARACTERISTIC
/begin CHARACTERISTIC InjCrv_tT3DiaShtrpDevMin_C "min. Schwelle zur Aktivierung der Überwachung auf Temp.Unterschreitung im Short-Trip Modus" VALUE 0x1E4A22 Kw_Ws16 1023.000 TempDiff_Kelv -1023.000 0.00 FORMAT "%8.3" EXTENDED_LIMITS -3276.800 3276.700 /end CHARACTERISTIC
/begin CHARACTERISTIC InjCtl_dqLimUp_C "Rampensteigung bei Wegfall des Systemfehlers" VALUE 0x1E4CCC Kw_Wu32 655359.499817 RmpInjMass 0.500030517578 655359.999847 FORMAT "%13.6" EXTENDED_LIMITS 0.00 655359.999847 /end CHARACTERISTIC
/begin CHARACTERISTIC InjCtl_dqLimDwn_C "Rampensteigung bei Auftreten eines Systemfehlers" VALUE 0x1E4CD0 Kw_Wu32 655359.499817 RmpInjMass 0.500030517578 655359.999847 FORMAT "%13.6" EXTENDED_LIMITS 0.00 655359.999847 /end CHARACTERISTIC
/begin CHARACTERISTIC InjCtl_qLimErr_CUR "Begrenzungsmeneg bei Systemfehler" CURVE 0x1E4CD4 Kl_Xs16_Ws16 327.6700 InjMass 0.00 327.6700 FORMAT "%8.4" EXTENDED_LIMITS -327.6800 327.6700
 /begin AXIS_DESCR STD_AXIS Eng_nAvrg EngN 25 0.00 6000.000 FORMAT "%8.3" EXTENDED_LIMITS -32768.00 32767.00 DEPOSIT ABSOLUTE /end AXIS_DESCR
/end CHARACTERISTIC
/begin CHARACTERISTIC InjCtl_swtFMACor_C "Schalter für FMA Korrektur (1: indirekte Korrektion ist aktiev, 0: inaktiev)" VALUE 0x1E4CC8 Kw_Wu8 1.000 OneToOne 0.00 1.000 FORMAT "%5.3" EXTENDED_LIMITS 0.00 255.0 /end CHARACTERISTIC
/begin CHARACTERISTIC InjUn_facqRedovn_CUR "Kennlinie für die drehzahlabhängige Reduzierung der Einspritzmenge im Notfahren" CURVE 0x1E4D3C Kl_Xs16_Ws16 1.000000 Fact 0.00 1.000000 FORMAT "%8.6" EXTENDED_LIMITS -4.000000 3.999878
 /begin AXIS_DESCR STD_AXIS Eng_nAvrg EngN 3 0.00 6000.000 FORMAT "%8.3" EXTENDED_LIMITS -32768.00 32767.00 DEPOSIT ABSOLUTE /end AXIS_DESCR
/end CHARACTERISTIC
/begin CHARACTERISTIC InjUn_QntyPerTemp_MAP "Mengen-Korrektur-Kennfeld (Menge pro Temperatureinheit)" MAP 0x1E4D4A Kf_Xs16_Ys16_Ws16 21.00098 Mass_FlTempCor -1.000977 20.00000 FORMAT "%8.5" EXTENDED_LIMITS -80.00000 79.99756
 /begin AXIS_DESCR STD_AXIS Eng_nAvrg EngN 9 0.00 6000.000 FORMAT "%8.3" EXTENDED_LIMITS -32768.00 32767.00 DEPOSIT ABSOLUTE /end AXIS_DESCR
 /begin AXIS_DESCR STD_AXIS InjUn_qTotIDes_mp InjMass 8 0.00 70.00000 FORMAT "%8.5" EXTENDED_LIMITS -327.6800 327.6700 DEPOSIT ABSOLUTE /end AXIS_DESCR
/end CHARACTERISTIC
/begin CHARACTERISTIC InjUn_swtTempSel_C "Schalter für die Mengenkorrektur im Startfall (0: Kraftstofftemperatur; 1:Wassertemperatur)" VALUE 0x1E4E00 Kw_Ws16 3.000000 OneToOne -1.000000 2.000000 FORMAT "%8.6" EXTENDED_LIMITS -32768.00 32767.00 /end CHARACTERISTIC
/begin CHARACTERISTIC InjUn_tFlDiffCor_CUR "Korrekturkennlinie der Kraftstofftemperaturabweichung" CURVE 0x1E4E02 Kl_Xs16_Ws16 220.0000 TempDiff_Kelv -110.0000 110.0000 FORMAT "%8.4" EXTENDED_LIMITS -3276.800 3276.700
 /begin AXIS_DESCR STD_AXIS InjUn_tFlDiff_mp TempDiff_Kelv 20 -110.0000 110.0000 FORMAT "%8.4" EXTENDED_LIMITS -3276.800 3276.700 DEPOSIT ABSOLUTE /end AXIS_DESCR
/end CHARACTERISTIC
/begin CHARACTERISTIC InjUn_tFlRef_MAP "Kraftstoffbezugstemperatur Kennfeld" MAP 0x1E4E54 Kf_Xs16_Ys16_Ws16 378.0000 Temp_Cels -273.1400 104.8600 FORMAT "%8.4" EXTENDED_LIMITS -3549.940 3003.560
 /begin AXIS_DESCR STD_AXIS Eng_nAvrg EngN 8 0.00 6000.000 FORMAT "%8.3" EXTENDED_LIMITS -32768.00 32767.00 DEPOSIT ABSOLUTE /end AXIS_DESCR
 /begin AXIS_DESCR STD_AXIS InjUn_qTotIDes_mp InjMass 8 0.00 60.00000 FORMAT "%8.5" EXTENDED_LIMITS -327.6800 327.6700 DEPOSIT ABSOLUTE /end AXIS_DESCR
/end CHARACTERISTIC
/begin CHARACTERISTIC InjVCD_iHold_C "SV-Haltestromniveau" VALUE 0x1E4F10 Kw_Ws16 2996.535 UI_Curr 8989.604 11986.14 FORMAT "%8.2" EXTENDED_LIMITS -1091005. 1090972. /end CHARACTERISTIC
/begin CHARACTERISTIC InjVCD_nShOffLoLim_C "Untere Drehzahlschwelle für Abschaltung der Einspritzung" VALUE 0x1E4F1C Kw_Ws16 6000.000 EngN 0.00 6000.000 FORMAT "%8.3" EXTENDED_LIMITS -32768.00 32767.00 /end CHARACTERISTIC
/begin CHARACTERISTIC InjVCD_nShOffUpLim_C "obere Drehzahlschwelle für Abschaltung der Einspritzung" VALUE 0x1E4F1E Kw_Ws16 6000.000 EngN 0.00 6000.000 FORMAT "%8.3" EXTENDED_LIMITS -32768.00 32767.00 /end CHARACTERISTIC
/begin CHARACTERISTIC InjVCD_numIncrAvrg_C "Anzahl der Inkremente, die für die Mittelwertbildung verwendet werden" VALUE 0x1E4EFC Kw_Wu8 3.000 OneToOne 0.00 3.000 FORMAT "%5.3" EXTENDED_LIMITS 0.00 255.0 /end CHARACTERISTIC
/begin CHARACTERISTIC InjVCD_nWUPOff_C "Ausschalthysteresewert für ""virtual dynamic WUP""" VALUE 0x1E4EFE Kw_Wu16 6000.000 EngN 0.00 6000.000 FORMAT "%8.3" EXTENDED_LIMITS 0.00 65535.00 /end CHARACTERISTIC
/begin CHARACTERISTIC InjVCD_nWUPOn_C "Einschalthysteresewert für ""virtual dynamic WUP" VALUE 0x1E4F00 Kw_Wu16 6000.000 EngN 0.00 6000.000 FORMAT "%8.3" EXTENDED_LIMITS 0.00 65535.00 /end CHARACTERISTIC
/begin CHARACTERISTIC InjVCD_phiAvrg_C "Winkelbereich, der für die Mittelwertbildung bei ITAC verwendet wird" VALUE 0x1E4F02 Kw_Ws16 238.9922 AngleCrS 1.007812 240.0000 FORMAT "%8.4" EXTENDED_LIMITS -768.0000 767.9766 /end CHARACTERISTIC
/begin CHARACTERISTIC InjVCD_phidiffIncrTDC_C "Winkel: Abstand der letzten Inkrementgrenze vor dem TDC und TDC (meistens 0)" VALUE 0x1E4F04 Kw_Ws16 6.000000 AngleCrS 0.00 6.000000 FORMAT "%8.6" EXTENDED_LIMITS -768.0000 767.9766 /end CHARACTERISTIC
/begin CHARACTERISTIC InjVCD_phiHys_C "Hysteresewinkel for ""virtual dynamic WUP""" VALUE 0x1E4F06 Kw_Ws16 6.000000 AngleCrS 0.00 6.000000 FORMAT "%8.6" EXTENDED_LIMITS -768.0000 767.9766 /end CHARACTERISTIC
/begin CHARACTERISTIC InjVCD_phiIntrWUP_C "Mindestabstand als Winkel zwischen Main Interrupt und virtuellem dynamischem WUP" VALUE 0x1E4F08 Kw_Ws16 767.9766 AngleCrS 0.00 767.9766 FORMAT "%8.4" EXTENDED_LIMITS -768.0000 767.9766 /end CHARACTERISTIC
/begin CHARACTERISTIC InjVCD_phiWUPTDC_C "Mindestabstand als Winkel zwischen virtuellem dynamischem WUP und TDC" VALUE 0x1E4F0A Kw_Ws16 120.0000 AngleCrS -70.00781 49.99219 FORMAT "%8.5" EXTENDED_LIMITS -768.0000 767.9766 /end CHARACTERISTIC
/begin CHARACTERISTIC InjVCD_swtMainIntr_C "Auswahlschalter für den verwendeten Main Interrupt beim DynWup-Modus" VALUE 0x1E4F0C Kw_Wu8 1.000 OneToOne 0.00 1.000 FORMAT "%5.3" EXTENDED_LIMITS 0.00 255.0 /end CHARACTERISTIC
/begin CHARACTERISTIC InjVCD_swtModus_C "Auswahlschalter für den Zumessmodus" VALUE 0x1E4F0D Kw_Wu8 3.000 OneToOne 0.00 3.000 FORMAT "%5.3" EXTENDED_LIMITS 0.00 255.0 /end CHARACTERISTIC
/begin CHARACTERISTIC InjVCD_tiEODOfs_C "Offset zur Berechnung von InjVCD_phiPoI2EODLatest_mp" VALUE 0x1E4F18 Kw_Ws16 65535.00 InjTime_us -32768.00 32767.00 FORMAT "%8.2" /end CHARACTERISTIC
/begin CHARACTERISTIC InjVCD_tiFastDecayMI1_C "Schnellloeschdauer der Haupteinspritzung" VALUE 0x1C0FBC Kw_Wu16 2000.000 InjTime_us 0.00 2000.000 FORMAT "%8.3" EXTENDED_LIMITS 0.00 65535.00 /end CHARACTERISTIC
/begin CHARACTERISTIC InjVCD_tiFastDecayPiI1_C "Schnellloeschdauer der Voreinspritzung" VALUE 0x1C0FBE Kw_Wu16 2000.000 InjTime_us 0.00 2000.000 FORMAT "%8.3" EXTENDED_LIMITS 0.00 65535.00 /end CHARACTERISTIC
/begin CHARACTERISTIC InjVCD_tiFastDecayPoI2_C "Schnellloeschdauer der Nacheinspritzung" VALUE 0x1C0FC0 Kw_Wu16 2000.000 InjTime_us 0.00 2000.000 FORMAT "%8.3" EXTENDED_LIMITS 0.00 65535.00 /end CHARACTERISTIC
/begin CHARACTERISTIC InjVCD_tiLead_C "Zeitpunkt des vituellen dynamischen WUPs bzgl. des Bestromungsbeginns" VALUE 0x1E4F0E Kw_Wu16 2000.000 InjTime_us 0.00 2000.000 FORMAT "%8.3" EXTENDED_LIMITS 0.00 65535.00 /end CHARACTERISTIC
/begin CHARACTERISTIC InjVlv_DebBnk1AMaxDef_C "Defektentprellung für Bankfehlerpfad A, KS nach Batterie" VALUE 0x1E6594 Kw_Wu16 65535.00 OneToOne 0.00 65535.00 FORMAT "%8.2" /end CHARACTERISTIC
/begin CHARACTERISTIC InjVlv_DebBnk1AMaxOk_C "Heilungsentprellung für Bankfehlerpfad A, KS nach Batterie" VALUE 0x1E6596 Kw_Wu16 65535.00 OneToOne 0.00 65535.00 FORMAT "%8.2" /end CHARACTERISTIC
/begin CHARACTERISTIC InjVlv_DebBnk1ASigDef_C "Defektentprellung für Bankfehlerpfad A, KS nach Masse" VALUE 0x1E6598 Kw_Wu16 65535.00 OneToOne 0.00 65535.00 FORMAT "%8.2" /end CHARACTERISTIC
/begin CHARACTERISTIC InjVlv_DebBnk1ASigOk_C "Heilungsentprellung für Bankfehlerpfad A, KS nach Masse" VALUE 0x1E659A Kw_Wu16 65535.00 OneToOne 0.00 65535.00 FORMAT "%8.2" /end CHARACTERISTIC
/begin CHARACTERISTIC InjVlv_DebBnk1AType_C "Entprellart und Schrittweite für Bankfehlerpfad A" VALUE 0x1E659C Kw_Wu8 241.0 OneToOne 0.00 241.0 FORMAT "%5.1" EXTENDED_LIMITS 0.00 255.0 /end CHARACTERISTIC
/begin CHARACTERISTIC InjVlv_DebCyl1ASigDef_C "Defektentprellung für Zylinderfehlerpfad A, Schnelllöschfehler / KS A_P_MVxy nach Masse" VALUE 0x1E659E Kw_Wu16 65535.00 OneToOne 0.00 65535.00 FORMAT "%8.2" /end CHARACTERISTIC
/begin CHARACTERISTIC InjVlv_DebCyl1ASigOk_C "Heilungsentprellung für Zylinderfehlerpfad A, Schnelllöschfehler / KS A_P_MVxy nach Masse" VALUE 0x1E65A0 Kw_Wu16 65535.00 OneToOne 0.00 65535.00 FORMAT "%8.2" /end CHARACTERISTIC
/begin CHARACTERISTIC InjVlv_DebCyl1AType_C "Entprellart und Schrittweite für Zylinderfehlerpfad A" VALUE 0x1E65A2 Kw_Wu8 241.0 OneToOne 0.00 241.0 FORMAT "%5.1" EXTENDED_LIMITS 0.00 255.0 /end CHARACTERISTIC
/begin CHARACTERISTIC InjVlv_numMI1_CUR "Kurve zur Auswahl der Foerderdauerkennfelder fuer Haupteinspritzung" CURVE 0x1E4F20 Kl_Xs16_Ws16 6.000000 Map_Select 0.00 6.000000 FORMAT "%8.6" EXTENDED_LIMITS -128.0000 127.9961
 /begin AXIS_DESCR STD_AXIS InjCrv_phiMI1Des AngleCrS 7 -60.00000 49.99219 FORMAT "%8.5" EXTENDED_LIMITS -768.0000 767.9766 DEPOSIT ABSOLUTE /end AXIS_DESCR
/end CHARACTERISTIC
/begin CHARACTERISTIC InjVlv_numPiI1_CUR "Pumpenkennfeldauswahlkennlinie Voreinspritzung" CURVE 0x1E5E20 Kl_Xs16_Ws16 1.000000 Map_Select 0.00 1.000000 FORMAT "%8.6" EXTENDED_LIMITS -128.0000 127.9961
 /begin AXIS_DESCR STD_AXIS InjCrv_phiPiI1Des AngleCrS 2 -60.00000 49.99219 FORMAT "%8.5" EXTENDED_LIMITS -768.0000 767.9766 DEPOSIT ABSOLUTE /end AXIS_DESCR
/end CHARACTERISTIC
/begin CHARACTERISTIC InjVlv_numPoI2_CUR "Kennfeld- Auswahlkennlinie für Nacheinspritzung" CURVE 0x1E6082 Kl_Xs16_Ws16 1.000000 Map_Select 0.00 1.000000 FORMAT "%8.6" EXTENDED_LIMITS -128.0000 127.9961
 /begin AXIS_DESCR STD_AXIS InjCrv_phiPoI2Des AngleCrS 2 -60.00000 49.99219 FORMAT "%8.5" EXTENDED_LIMITS -768.0000 767.9766 DEPOSIT ABSOLUTE /end AXIS_DESCR
/end CHARACTERISTIC
/begin CHARACTERISTIC InjVlv_numSegOfs1_C "Semgentoffset für die Bestimmung der zylinderselektiven Drehzahlen für Testmodus a" VALUE 0x1E6590 Kw_Wu8 11.00 OneToOne 0.00 11.00 FORMAT "%5.2" EXTENDED_LIMITS 0.00 255.0 /end CHARACTERISTIC
/begin CHARACTERISTIC InjVlv_numSegOfs2_C "Semgentoffset für die Bestimmung der zylinderselektiven Drehzahlen für Testmodus b und c" VALUE 0x1E6591 Kw_Wu8 11.00 OneToOne 0.00 11.00 FORMAT "%5.2" EXTENDED_LIMITS 0.00 255.0 /end CHARACTERISTIC
/begin CHARACTERISTIC InjVlv_phiInjMI1_MAP0 "Kennfeld zur Bestimmung der Förderdauer für Haupteinspritzung" MAP 0x1E4F3E Kf_Xs16_Ys16_Ws16 40.99219 AngleCrS -6.000000 34.99219 FORMAT "%8.5" EXTENDED_LIMITS -768.0000 767.9766
 /begin AXIS_DESCR STD_AXIS Eng_nAvrg EngN 10 0.00 6000.000 FORMAT "%8.3" EXTENDED_LIMITS -32768.00 32767.00 DEPOSIT ABSOLUTE /end AXIS_DESCR
 /begin AXIS_DESCR STD_AXIS InjUn_qMI1DesCorr InjMass 10 0.00 75.00000 FORMAT "%8.5" EXTENDED_LIMITS -327.6800 327.6700 DEPOSIT ABSOLUTE /end AXIS_DESCR
/end CHARACTERISTIC
/begin CHARACTERISTIC InjVlv_phiInjMI1_MAP1 "Kennfeld zur Bestimmung der Förderdauer für Haupteinspritzung" MAP 0x1E5032 Kf_Xs16_Ys16_Ws16 46.00781 AngleCrS -6.000000 40.00781 FORMAT "%8.5" EXTENDED_LIMITS -768.0000 767.9766
 /begin AXIS_DESCR STD_AXIS Eng_nAvrg EngN 19 0.00 6000.000 FORMAT "%8.3" EXTENDED_LIMITS -32768.00 32767.00 DEPOSIT ABSOLUTE /end AXIS_DESCR
 /begin AXIS_DESCR STD_AXIS InjUn_qMI1DesCorr InjMass 15 0.00 75.00000 FORMAT "%8.5" EXTENDED_LIMITS -327.6800 327.6700 DEPOSIT ABSOLUTE /end AXIS_DESCR
/end CHARACTERISTIC
/begin CHARACTERISTIC InjVlv_phiInjMI1_MAP2 "Kennfeld zur Bestimmung der Förderdauer für Haupteinspritzung" MAP 0x1E52B4 Kf_Xs16_Ys16_Ws16 36.00000 AngleCrS -6.000000 30.00000 FORMAT "%8.5" EXTENDED_LIMITS -768.0000 767.9766
 /begin AXIS_DESCR STD_AXIS Eng_nAvrg EngN 19 0.00 6000.000 FORMAT "%8.3" EXTENDED_LIMITS -32768.00 32767.00 DEPOSIT ABSOLUTE /end AXIS_DESCR
 /begin AXIS_DESCR STD_AXIS InjUn_qMI1DesCorr InjMass 15 0.00 75.00000 FORMAT "%8.5" EXTENDED_LIMITS -327.6800 327.6700 DEPOSIT ABSOLUTE /end AXIS_DESCR
/end CHARACTERISTIC
/begin CHARACTERISTIC InjVlv_phiInjMI1_MAP3 "Kennfeld zur Bestimmung der Förderdauer für Haupteinspritzung" MAP 0x1E5536 Kf_Xs16_Ys16_Ws16 36.00000 AngleCrS -6.000000 30.00000 FORMAT "%8.5" EXTENDED_LIMITS -768.0000 767.9766
 /begin AXIS_DESCR STD_AXIS Eng_nAvrg EngN 19 0.00 6000.000 FORMAT "%8.3" EXTENDED_LIMITS -32768.00 32767.00 DEPOSIT ABSOLUTE /end AXIS_DESCR
 /begin AXIS_DESCR STD_AXIS InjUn_qMI1DesCorr InjMass 15 0.00 75.00000 FORMAT "%8.5" EXTENDED_LIMITS -327.6800 327.6700 DEPOSIT ABSOLUTE /end AXIS_DESCR
/end CHARACTERISTIC
/begin CHARACTERISTIC InjVlv_phiInjMI1_MAP4 "Kennfeld zur Bestimmung der Förderdauer für Haupteinspritzung" MAP 0x1E57B8 Kf_Xs16_Ys16_Ws16 36.00000 AngleCrS -6.000000 30.00000 FORMAT "%8.5" EXTENDED_LIMITS -768.0000 767.9766
 /begin AXIS_DESCR STD_AXIS Eng_nAvrg EngN 19 0.00 6000.000 FORMAT "%8.3" EXTENDED_LIMITS -32768.00 32767.00 DEPOSIT ABSOLUTE /end AXIS_DESCR
 /begin AXIS_DESCR STD_AXIS InjUn_qMI1DesCorr InjMass 15 0.00 75.00000 FORMAT "%8.5" EXTENDED_LIMITS -327.6800 327.6700 DEPOSIT ABSOLUTE /end AXIS_DESCR
/end CHARACTERISTIC
/begin CHARACTERISTIC InjVlv_phiInjMI1_MAP5 "Kennfeld zur Bestimmung der Förderdauer für Haupteinspritzung" MAP 0x1E5A3A Kf_Xs16_Ys16_Ws16 36.00000 AngleCrS -6.000000 30.00000 FORMAT "%8.5" EXTENDED_LIMITS -768.0000 767.9766
 /begin AXIS_DESCR STD_AXIS Eng_nAvrg EngN 19 0.00 6000.000 FORMAT "%8.3" EXTENDED_LIMITS -32768.00 32767.00 DEPOSIT ABSOLUTE /end AXIS_DESCR
 /begin AXIS_DESCR STD_AXIS InjUn_qMI1DesCorr InjMass 15 0.00 75.00000 FORMAT "%8.5" EXTENDED_LIMITS -327.6800 327.6700 DEPOSIT ABSOLUTE /end AXIS_DESCR
/end CHARACTERISTIC
/begin CHARACTERISTIC InjVlv_phiInjMI1_MAP6 "Kennfeld zur Bestimmung der Förderdauer für Haupteinspritzung" MAP 0x1E5CBC Kf_Xs16_Ys16_Ws16 36.00000 AngleCrS -6.000000 30.00000 FORMAT "%8.5" EXTENDED_LIMITS -768.0000 767.9766
 /begin AXIS_DESCR STD_AXIS Eng_nAvrg EngN 10 0.00 6000.000 FORMAT "%8.3" EXTENDED_LIMITS -32768.00 32767.00 DEPOSIT ABSOLUTE /end AXIS_DESCR
 /begin AXIS_DESCR STD_AXIS InjUn_qMI1DesCorr InjMass 10 0.00 75.00000 FORMAT "%8.5" EXTENDED_LIMITS -327.6800 327.6700 DEPOSIT ABSOLUTE /end AXIS_DESCR
/end CHARACTERISTIC
/begin CHARACTERISTIC InjVlv_phiInjPiI1_MAP0 "Pumpenkennfeld 0 Voreinspritzung" MAP 0x1E5E2A Kf_Xs16_Ys16_Ws16 70.99219 AngleCrS -36.00000 34.99219 FORMAT "%8.5" EXTENDED_LIMITS -768.0000 767.9766
 /begin AXIS_DESCR STD_AXIS Eng_nAvrg EngN 10 40.00000 6000.000 FORMAT "%8.3" EXTENDED_LIMITS -32768.00 32767.00 DEPOSIT ABSOLUTE /end AXIS_DESCR
 /begin AXIS_DESCR STD_AXIS InjUn_qPiI1DesCorr InjMass 10 0.00 50.00000 FORMAT "%8.5" EXTENDED_LIMITS -327.6800 327.6700 DEPOSIT ABSOLUTE /end AXIS_DESCR
/end CHARACTERISTIC
/begin CHARACTERISTIC InjVlv_phiInjPiI1_MAP1 "Pumpenkennfeld 0 Voreinspritzung" MAP 0x1E5F1E Kf_Xs16_Ys16_Ws16 70.99219 AngleCrS -36.00000 34.99219 FORMAT "%8.5" EXTENDED_LIMITS -768.0000 767.9766
 /begin AXIS_DESCR STD_AXIS Eng_nAvrg EngN 10 40.00000 6000.000 FORMAT "%8.3" EXTENDED_LIMITS -32768.00 32767.00 DEPOSIT ABSOLUTE /end AXIS_DESCR
 /begin AXIS_DESCR STD_AXIS InjUn_qPiI1DesCorr InjMass 10 0.00 50.00000 FORMAT "%8.5" EXTENDED_LIMITS -327.6800 327.6700 DEPOSIT ABSOLUTE /end AXIS_DESCR
/end CHARACTERISTIC
/begin CHARACTERISTIC InjVlv_phiInjPoI2_MAP0 "Kennfeld zur Bestimmung der Förderdauer für Haupteinspritzung" MAP 0x1E608C Kf_Xs16_Ys16_Ws16 70.99219 AngleCrS -36.00000 34.99219 FORMAT "%8.5" EXTENDED_LIMITS -768.0000 767.9766
 /begin AXIS_DESCR STD_AXIS Eng_nAvrg EngN 19 0.00 6000.000 FORMAT "%8.3" EXTENDED_LIMITS -32768.00 32767.00 DEPOSIT ABSOLUTE /end AXIS_DESCR
 /begin AXIS_DESCR STD_AXIS InjUn_qPoI2DesCorr InjMass 15 0.00 50.00000 FORMAT "%8.5" EXTENDED_LIMITS -327.6800 327.6700 DEPOSIT ABSOLUTE /end AXIS_DESCR
/end CHARACTERISTIC
/begin CHARACTERISTIC InjVlv_phiInjPoI2_MAP1 "Kennfeld zur Bestimmung der Förderdauer für Nacheinspritzung" MAP 0x1E630E Kf_Xs16_Ys16_Ws16 70.99219 AngleCrS -36.00000 34.99219 FORMAT "%8.5" EXTENDED_LIMITS -768.0000 767.9766
 /begin AXIS_DESCR STD_AXIS Eng_nAvrg EngN 19 0.00 6000.000 FORMAT "%8.3" EXTENDED_LIMITS -32768.00 32767.00 DEPOSIT ABSOLUTE /end AXIS_DESCR
 /begin AXIS_DESCR STD_AXIS InjUn_qPoI2DesCorr InjMass 15 0.00 50.00000 FORMAT "%8.5" EXTENDED_LIMITS -327.6800 327.6700 DEPOSIT ABSOLUTE /end AXIS_DESCR
/end CHARACTERISTIC
/begin CHARACTERISTIC InjVlv_stErrDet_C "Status der Injektorfehlererkennung" VALUE 0x1E6592 Kw_Wu8 1.000 OneToOne 0.00 1.000 FORMAT "%5.3" EXTENDED_LIMITS 0.00 255.0 /end CHARACTERISTIC
/begin CHARACTERISTIC InjVlv_tiMI1BreMin_MAP "min. Ansteuerpause nach der Haupteinspritzung" MAP 0x1E5DB0 Kf_Xs16_Ys16_Ws16 5010.000 InjTime_us -10.00000 5000.000 FORMAT "%8.3" EXTENDED_LIMITS -32768.00 32767.00
 /begin AXIS_DESCR STD_AXIS Eng_nAvrg EngN 10 0.00 6000.000 FORMAT "%8.3" EXTENDED_LIMITS -32768.00 32767.00 DEPOSIT ABSOLUTE /end AXIS_DESCR
 /begin AXIS_DESCR STD_AXIS InjVlv_phiMI1Dur AngleCrS 4 0.00 49.99219 FORMAT "%8.5" EXTENDED_LIMITS -768.0000 767.9766 DEPOSIT ABSOLUTE /end AXIS_DESCR
/end CHARACTERISTIC
/begin CHARACTERISTIC InjVlv_tiPiI1BreMin_MAP "minimale Ansteuerpause nach Voreinspritzung" MAP 0x1E6012 Kf_Xs16_Ys16_Ws16 5010.000 InjTime_us -10.00000 5000.000 FORMAT "%8.3" EXTENDED_LIMITS -32768.00 32767.00
 /begin AXIS_DESCR STD_AXIS Eng_nAvrg EngN 10 0.00 6000.000 FORMAT "%8.3" EXTENDED_LIMITS -32768.00 32767.00 DEPOSIT ABSOLUTE /end AXIS_DESCR
 /begin AXIS_DESCR STD_AXIS InjVlv_phiPiI1Dur AngleCrS 4 0.00 49.99219 FORMAT "%8.5" EXTENDED_LIMITS -768.0000 767.9766 DEPOSIT ABSOLUTE /end AXIS_DESCR
/end CHARACTERISTIC
/begin CHARACTERISTIC InjVlv_tiSVMI1min_C "minimale Einspritzdauer Haupteinspritzung in Zeit" VALUE 0x1E65A6 Kw_Ws16 1600.000 InjTime_us -800.0000 800.0000 FORMAT "%8.4" EXTENDED_LIMITS -32768.00 32767.00 /end CHARACTERISTIC
/begin CHARACTERISTIC InjVlv_tiSVPiI1min_C "minimale Einspritzdauer Voreinspritzung" VALUE 0x1E65AA Kw_Ws16 1600.000 InjTime_us -800.0000 800.0000 FORMAT "%8.4" EXTENDED_LIMITS -32768.00 32767.00 /end CHARACTERISTIC
/begin CHARACTERISTIC InjVlv_tiSVPoI2min_C "minimale Einspritzdauer Nacheinspritzung in Zeit" VALUE 0x1E65A8 Kw_Ws16 1600.000 InjTime_us -800.0000 800.0000 FORMAT "%8.4" EXTENDED_LIMITS -32768.00 32767.00 /end CHARACTERISTIC
/begin CHARACTERISTIC K2RDI_SWPartNum_C "VW/Audi Softwareteilnummer" ASCII 0x1C144C Ktx 255.0 defaultAscii 0.00 255.0 NUMBER 7 /end CHARACTERISTIC
/begin CHARACTERISTIC K2rffd_FrzFrEnv_Idx_C "FreezeFrame-Index für Umweltbedingungen" VAL_BLK 0x1E65AC Kwb_Wu8 19.00 OneToOne 0.00 19.00 FORMAT "%5.2" EXTENDED_LIMITS 0.00 255.0 NUMBER 3 /end CHARACTERISTIC
/begin CHARACTERISTIC LASCD_tiPT1_C "Time constant for first level PT1 filter" VALUE 0x1E65B0 Kw_Wu32 4294.9673 TimeDelay_s 0.0000010000000 4294.9673 FORMAT "%9.4" /end CHARACTERISTIC
/begin CHARACTERISTIC LASCD_tiDebCANSigDef_C "Entprellzeit bei CAN-Signalfehler" VALUE 0x1E65B4 Kw_Wu16 655350.0 Time_ms 0.00 655350.0 FORMAT "%8.1" /end CHARACTERISTIC
/begin CHARACTERISTIC LASCD_tiDebCANSigOk_C "Heilungszeit bei CAN-Signalfehler" VALUE 0x1E65B6 Kw_Wu16 655350.0 Time_ms 0.00 655350.0 FORMAT "%8.1" /end CHARACTERISTIC
/begin CHARACTERISTIC LASCD_daLongRmpSlpUp_C "Aufwärtsrampensteigung zum Übergang auf Defektwert" VALUE 0x1E65B8 Kw_Wu32 5.00000000000 RmpAcc 0.00 5.00000000000 FORMAT "%13.11" EXTENDED_LIMITS 0.00 65535.9999847 /end CHARACTERISTIC
/begin CHARACTERISTIC LASCD_daLongRmpSlpDwn_C "Abwärtsrampensteigung zum Übergang auf Defektwert" VALUE 0x1E65BC Kw_Wu32 5.00000000000 RmpAcc 0.00 5.00000000000 FORMAT "%13.11" EXTENDED_LIMITS 0.00 65535.9999847 /end CHARACTERISTIC
/begin CHARACTERISTIC LASCD_swtAccSens_C "Schalter zur Aktivierung des LASCD-Moduls" VALUE 0x1E65C0 Kw_Wu8 1.000 OneToOne 0.00 1.000 FORMAT "%5.3" EXTENDED_LIMITS 0.00 255.0 /end CHARACTERISTIC
/begin CHARACTERISTIC LASCD_tiFlt_CUR "Kennlinie zur Ermittlung der Zeitkonstante des nicht-lineraen" CURVE 0x1E65C2 Kl_Xs16_Ws16 4000.000 Time_s 0.00 4000.000 FORMAT "%8.3" EXTENDED_LIMITS -327.6800 327.6700
 /begin AXIS_DESCR STD_AXIS LASCD_aLinPT1OP_mp Acc 5 -3.200000 3.200000 FORMAT "%8.6" EXTENDED_LIMITS -32.76800 32.76700 DEPOSIT ABSOLUTE /end AXIS_DESCR
/end CHARACTERISTIC
/begin CHARACTERISTIC LASCD_stSensIDWord_C "Variantenschalter bei defektivem Verhalten" VALUE 0x1E65D8 Kw_Wu16 5.000000 OneToOne 0.00 5.000000 FORMAT "%8.6" EXTENDED_LIMITS 0.00 65535.00 /end CHARACTERISTIC
/begin CHARACTERISTIC LASCD_aLongDfl_C "Ersatz im Fehlerfall" VALUE 0x1E65DA Kw_Ws16 65.53500 Acc -32.76800 32.76700 FORMAT "%8.5" /end CHARACTERISTIC
/begin CHARACTERISTIC LIGov_nRmpSlpUpBasAdj_C "Schrittweite der Rampe bei Erhöhung Solldrehzahl bei Grundeinstellungstest" VALUE 0x1E65DC Kw_Wu32 9362278.57317 RmpEngN_LIGov 7.13893345424 9362285.71211 FORMAT "%13.5" EXTENDED_LIMITS 0.00 9362285.71211 /end CHARACTERISTIC
/begin CHARACTERISTIC LIGov_nRmpSlpDwnBasAdj_C "Schrittweite der Rampe bei Senkung Solldrehzahl bei Grundeinstellungstest" VALUE 0x1E65E0 Kw_Wu32 9362278.57317 RmpEngN_LIGov 7.13893345424 9362285.71211 FORMAT "%13.5" EXTENDED_LIMITS 0.00 9362285.71211 /end CHARACTERISTIC
/begin CHARACTERISTIC LIGov_dnLimHighTrm_C "obere dn-Grenze für Abgleich" VALUE 0x1E65E4 Kw_Ws16 65535.00 EngN -32768.00 32767.00 FORMAT "%8.2" /end CHARACTERISTIC
/begin CHARACTERISTIC LIGov_dnLimLowTrm_C "untere dn-Grenze für Abgleich" VALUE 0x1E65E6 Kw_Ws16 65535.00 EngN -32768.00 32767.00 FORMAT "%8.2" /end CHARACTERISTIC
/begin CHARACTERISTIC LIGov_DriveOffDHypDenom_CUR "Parameter Denomiator für Driveoff" CURVE 0x1E65E8 Kl_Xs16_Ws16 32767.00 EngN 0.00 32767.00 FORMAT "%8.2" EXTENDED_LIMITS -32768.00 32767.00
 /begin AXIS_DESCR STD_AXIS LIGov_tEngHys Temp_Cels 15 -50.14000 199.8600 FORMAT "%8.4" EXTENDED_LIMITS -3549.940 3003.560 DEPOSIT ABSOLUTE /end AXIS_DESCR
/end CHARACTERISTIC
/begin CHARACTERISTIC LIGov_DriveOffDHypNum_CUR "Parameter Numinator für Driveoff" CURVE 0x1E6626 Kl_Xs16_Ws16 32767.00 EngN 0.00 32767.00 FORMAT "%8.2" EXTENDED_LIMITS -32768.00 32767.00
 /begin AXIS_DESCR STD_AXIS LIGov_tEngHys Temp_Cels 15 -50.14000 199.8600 FORMAT "%8.4" EXTENDED_LIMITS -3549.940 3003.560 DEPOSIT ABSOLUTE /end AXIS_DESCR
/end CHARACTERISTIC
/begin CHARACTERISTIC LIGov_DriveOffDKd_CUR "Parameter Kd für Driveoff" CURVE 0x1E6664 Kl_Xs16_Ws16 3.199951 KD_RPM2NM_3 -1.600000 1.599951 FORMAT "%8.6"
 /begin AXIS_DESCR STD_AXIS LIGov_tEngHys Temp_Cels 15 -50.14000 199.8600 FORMAT "%8.4" EXTENDED_LIMITS -3549.940 3003.560 DEPOSIT ABSOLUTE /end AXIS_DESCR
/end CHARACTERISTIC
/begin CHARACTERISTIC LIGov_DriveOffDT1_CUR "Parameter T1 für D-Glied für Driveoff" CURVE 0x1E66A2 Kl_Xs16_Ws16 250.0000 TimeDelay_s_Lin_16_3 0.00 250.0000 FORMAT "%8.4" EXTENDED_LIMITS -250.0076 250.0000
 /begin AXIS_DESCR STD_AXIS LIGov_tEngHys Temp_Cels 15 -50.14000 199.8600 FORMAT "%8.4" EXTENDED_LIMITS -3549.940 3003.560 DEPOSIT ABSOLUTE /end AXIS_DESCR
/end CHARACTERISTIC
/begin CHARACTERISTIC LIGov_DriveOffIKiNeg_CUR "Parameter KiNeg für Driveoff" CURVE 0x1E66E0 Kl_Xs16_Ws16 24.41369 KI_RPM2NM_2 -12.20703 12.20666 FORMAT "%8.5"
 /begin AXIS_DESCR STD_AXIS LIGov_tEngHys Temp_Cels 15 -50.14000 199.8600 FORMAT "%8.4" EXTENDED_LIMITS -3549.940 3003.560 DEPOSIT ABSOLUTE /end AXIS_DESCR
/end CHARACTERISTIC
/begin CHARACTERISTIC LIGov_DriveOffIKiPos_CUR "Parameter KiPos für Driveoff" CURVE 0x1E671E Kl_Xs16_Ws16 24.41369 KI_RPM2NM_2 -12.20703 12.20666 FORMAT "%8.5"
 /begin AXIS_DESCR STD_AXIS LIGov_tEngHys Temp_Cels 15 -50.14000 199.8600 FORMAT "%8.4" EXTENDED_LIMITS -3549.940 3003.560 DEPOSIT ABSOLUTE /end AXIS_DESCR
/end CHARACTERISTIC
/begin CHARACTERISTIC LIGov_DriveOffIKi_CUR "Parameter Ki für Driveoff" CURVE 0x1E675C Kl_Xs16_Ws16 24.41369 KI_RPM2NM_2 -12.20703 12.20666 FORMAT "%8.5"
 /begin AXIS_DESCR STD_AXIS LIGov_tEngHys Temp_Cels 15 -50.14000 199.8600 FORMAT "%8.4" EXTENDED_LIMITS -3549.940 3003.560 DEPOSIT ABSOLUTE /end AXIS_DESCR
/end CHARACTERISTIC
/begin CHARACTERISTIC LIGov_DriveOffIWinNeg_CUR "Parameter negatives Kleinsignalfenster I Parameter für Driveoff" CURVE 0x1E679A Kl_Xs16_Ws16 65535.00 EngN -32768.00 32767.00 FORMAT "%8.2"
 /begin AXIS_DESCR STD_AXIS LIGov_tEngHys Temp_Cels 15 -50.14000 199.8600 FORMAT "%8.4" EXTENDED_LIMITS -3549.940 3003.560 DEPOSIT ABSOLUTE /end AXIS_DESCR
/end CHARACTERISTIC
/begin CHARACTERISTIC LIGov_DriveOffIWinPos_CUR "Parameter positives Kleinsignalfenster I Parameter für Driveoff" CURVE 0x1E67D8 Kl_Xs16_Ws16 65535.00 EngN -32768.00 32767.00 FORMAT "%8.2"
 /begin AXIS_DESCR STD_AXIS LIGov_tEngHys Temp_Cels 15 -50.14000 199.8600 FORMAT "%8.4" EXTENDED_LIMITS -3549.940 3003.560 DEPOSIT ABSOLUTE /end AXIS_DESCR
/end CHARACTERISTIC
/begin CHARACTERISTIC LIGov_DriveOffPKpNeg_CUR "Parameter KpNeg für Driveoff" CURVE 0x1E6816 Kl_Xs16_Ws16 3.199951 KP_RPM2NM_2 -1.600000 1.599951 FORMAT "%8.6"
 /begin AXIS_DESCR STD_AXIS LIGov_tEngHys Temp_Cels 15 -50.14000 199.8600 FORMAT "%8.4" EXTENDED_LIMITS -3549.940 3003.560 DEPOSIT ABSOLUTE /end AXIS_DESCR
/end CHARACTERISTIC
/begin CHARACTERISTIC LIGov_DriveOffPKpPos_CUR "Parameter KpPos für Driveoff" CURVE 0x1E6854 Kl_Xs16_Ws16 3.199951 KP_RPM2NM_2 -1.600000 1.599951 FORMAT "%8.6"
 /begin AXIS_DESCR STD_AXIS LIGov_tEngHys Temp_Cels 15 -50.14000 199.8600 FORMAT "%8.4" EXTENDED_LIMITS -3549.940 3003.560 DEPOSIT ABSOLUTE /end AXIS_DESCR
/end CHARACTERISTIC
/begin CHARACTERISTIC LIGov_DriveOffPKp_CUR "Parameter Kp für Driveoff" CURVE 0x1E6892 Kl_Xs16_Ws16 3.199951 KP_RPM2NM_2 -1.600000 1.599951 FORMAT "%8.6"
 /begin AXIS_DESCR STD_AXIS LIGov_tEngHys Temp_Cels 15 -50.14000 199.8600 FORMAT "%8.4" EXTENDED_LIMITS -3549.940 3003.560 DEPOSIT ABSOLUTE /end AXIS_DESCR
/end CHARACTERISTIC
/begin CHARACTERISTIC LIGov_DriveOffPredef_CUR "Einschrittmoment für Driveoff" CURVE 0x1E68D0 Kl_Xs16_Ws16 6553.500 Trq -3276.800 3276.700 FORMAT "%8.3"
 /begin AXIS_DESCR STD_AXIS LIGov_tEngHys Temp_Cels 15 -50.14000 199.8600 FORMAT "%8.4" EXTENDED_LIMITS -3549.940 3003.560 DEPOSIT ABSOLUTE /end AXIS_DESCR
/end CHARACTERISTIC
/begin CHARACTERISTIC LIGov_DriveOffPWinNeg_CUR "Parameter negatives Kleinsignalfenster P Parameter für Driveoff" CURVE 0x1E690E Kl_Xs16_Ws16 65535.00 EngN -32768.00 32767.00 FORMAT "%8.2"
 /begin AXIS_DESCR STD_AXIS LIGov_tEngHys Temp_Cels 15 -50.14000 199.8600 FORMAT "%8.4" EXTENDED_LIMITS -3549.940 3003.560 DEPOSIT ABSOLUTE /end AXIS_DESCR
/end CHARACTERISTIC
/begin CHARACTERISTIC LIGov_DriveOffPWinPos_CUR "Parameterkurve positives Kleinsignalfenster P Parameter für Driveoff" CURVE 0x1E694C Kl_Xs16_Ws16 65535.00 EngN -32768.00 32767.00 FORMAT "%8.2"
 /begin AXIS_DESCR STD_AXIS LIGov_tEngHys Temp_Cels 15 -50.14000 199.8600 FORMAT "%8.4" EXTENDED_LIMITS -3549.940 3003.560 DEPOSIT ABSOLUTE /end AXIS_DESCR
/end CHARACTERISTIC
/begin CHARACTERISTIC LIGov_GearDHypDenom_MAP "Gangabhängiger D Parameter Denominator" MAP 0x1E698A Kf_Xs16_Ys16_Ws16 65535.00 EngN -32768.00 32767.00 FORMAT "%8.2"
 /begin AXIS_DESCR STD_AXIS LIGov_tEngHys Temp_Cels 15 -50.14000 199.8600 FORMAT "%8.4" EXTENDED_LIMITS -3549.940 3003.560 DEPOSIT ABSOLUTE /end AXIS_DESCR
 /begin AXIS_DESCR STD_AXIS LIGov_stGear OneToOne 10 -2.000 7.000 FORMAT "%5.3" EXTENDED_LIMITS -128.0 127.0 DEPOSIT ABSOLUTE /end AXIS_DESCR
/end CHARACTERISTIC
/begin CHARACTERISTIC LIGov_GearDHypNum_MAP "Gangabhängige Parameter Numerator für D Anteil" MAP 0x1E6AEC Kf_Xs16_Ys16_Ws16 65535.00 EngN -32768.00 32767.00 FORMAT "%8.2"
 /begin AXIS_DESCR STD_AXIS LIGov_tEngHys Temp_Cels 15 -50.14000 199.8600 FORMAT "%8.4" EXTENDED_LIMITS -3549.940 3003.560 DEPOSIT ABSOLUTE /end AXIS_DESCR
 /begin AXIS_DESCR STD_AXIS LIGov_stGear OneToOne 10 -2.000 7.000 FORMAT "%5.3" EXTENDED_LIMITS -128.0 127.0 DEPOSIT ABSOLUTE /end AXIS_DESCR
/end CHARACTERISTIC
/begin CHARACTERISTIC LIGov_GearDKd_MAP "Gangabhängige Parameter Kd für D Glied" MAP 0x1E6C4E Kf_Xs16_Ys16_Ws16 3.199951 KD_RPM2NM_3 -1.600000 1.599951 FORMAT "%8.6"
 /begin AXIS_DESCR STD_AXIS LIGov_tEngHys Temp_Cels 15 -50.14000 199.8600 FORMAT "%8.4" EXTENDED_LIMITS -3549.940 3003.560 DEPOSIT ABSOLUTE /end AXIS_DESCR
 /begin AXIS_DESCR STD_AXIS LIGov_stGear OneToOne 10 -2.000 7.000 FORMAT "%5.3" EXTENDED_LIMITS -128.0 127.0 DEPOSIT ABSOLUTE /end AXIS_DESCR
/end CHARACTERISTIC
/begin CHARACTERISTIC LIGov_GearDT1_MAP "Gangabhängiger Parameter T1 für D-Glied" MAP 0x1E6DB0 Kf_Xs16_Ys16_Ws16 250.0000 TimeDelay_s_Lin_16_3 0.00 250.0000 FORMAT "%8.4" EXTENDED_LIMITS -250.0076 250.0000
 /begin AXIS_DESCR STD_AXIS LIGov_tEngHys Temp_Cels 15 -50.14000 199.8600 FORMAT "%8.4" EXTENDED_LIMITS -3549.940 3003.560 DEPOSIT ABSOLUTE /end AXIS_DESCR
 /begin AXIS_DESCR STD_AXIS LIGov_stGear OneToOne 10 -2.000 7.000 FORMAT "%5.3" EXTENDED_LIMITS -128.0 127.0 DEPOSIT ABSOLUTE /end AXIS_DESCR
/end CHARACTERISTIC
/begin CHARACTERISTIC LIGov_GearIKiNeg_MAP "gangabhängiger Parameter KiNeg" MAP 0x1E6F12 Kf_Xs16_Ys16_Ws16 24.41369 KI_RPM2NM_2 -12.20703 12.20666 FORMAT "%8.5"
 /begin AXIS_DESCR STD_AXIS LIGov_tEngHys Temp_Cels 15 -50.14000 199.8600 FORMAT "%8.4" EXTENDED_LIMITS -3549.940 3003.560 DEPOSIT ABSOLUTE /end AXIS_DESCR
 /begin AXIS_DESCR STD_AXIS LIGov_stGear OneToOne 10 -2.000 7.000 FORMAT "%5.3" EXTENDED_LIMITS -128.0 127.0 DEPOSIT ABSOLUTE /end AXIS_DESCR
/end CHARACTERISTIC
/begin CHARACTERISTIC LIGov_GearIKiPos_MAP "gangabhängiger Parameter KiPos" MAP 0x1E7074 Kf_Xs16_Ys16_Ws16 24.41369 KI_RPM2NM_2 -12.20703 12.20666 FORMAT "%8.5"
 /begin AXIS_DESCR STD_AXIS LIGov_tEngHys Temp_Cels 15 -50.14000 199.8600 FORMAT "%8.4" EXTENDED_LIMITS -3549.940 3003.560 DEPOSIT ABSOLUTE /end AXIS_DESCR
 /begin AXIS_DESCR STD_AXIS LIGov_stGear OneToOne 10 -2.000 7.000 FORMAT "%5.3" EXTENDED_LIMITS -128.0 127.0 DEPOSIT ABSOLUTE /end AXIS_DESCR
/end CHARACTERISTIC
/begin CHARACTERISTIC LIGov_GearIKi_MAP "Parameter Ki, gangabhängig" MAP 0x1E71D6 Kf_Xs16_Ys16_Ws16 24.41369 KI_RPM2NM_2 -12.20703 12.20666 FORMAT "%8.5"
 /begin AXIS_DESCR STD_AXIS LIGov_tEngHys Temp_Cels 15 -50.14000 199.8600 FORMAT "%8.4" EXTENDED_LIMITS -3549.940 3003.560 DEPOSIT ABSOLUTE /end AXIS_DESCR
 /begin AXIS_DESCR STD_AXIS LIGov_stGear OneToOne 10 -2.000 7.000 FORMAT "%5.3" EXTENDED_LIMITS -128.0 127.0 DEPOSIT ABSOLUTE /end AXIS_DESCR
/end CHARACTERISTIC
/begin CHARACTERISTIC LIGov_GearIWinNeg_MAP "gangabhängiges negatives Kleinsignalfenster I Parameter" MAP 0x1E7338 Kf_Xs16_Ys16_Ws16 65535.00 EngN -32768.00 32767.00 FORMAT "%8.2"
 /begin AXIS_DESCR STD_AXIS LIGov_tEngHys Temp_Cels 15 -50.14000 199.8600 FORMAT "%8.4" EXTENDED_LIMITS -3549.940 3003.560 DEPOSIT ABSOLUTE /end AXIS_DESCR
 /begin AXIS_DESCR STD_AXIS LIGov_stGear OneToOne 10 -2.000 7.000 FORMAT "%5.3" EXTENDED_LIMITS -128.0 127.0 DEPOSIT ABSOLUTE /end AXIS_DESCR
/end CHARACTERISTIC
/begin CHARACTERISTIC LIGov_GearIWinPos_MAP "gangabhängiges positives Kleinsignalfenster I Parameter" MAP 0x1E749A Kf_Xs16_Ys16_Ws16 65535.00 EngN -32768.00 32767.00 FORMAT "%8.2"
 /begin AXIS_DESCR STD_AXIS LIGov_tEngHys Temp_Cels 15 -50.14000 199.8600 FORMAT "%8.4" EXTENDED_LIMITS -3549.940 3003.560 DEPOSIT ABSOLUTE /end AXIS_DESCR
 /begin AXIS_DESCR STD_AXIS LIGov_stGear OneToOne 10 -2.000 7.000 FORMAT "%5.3" EXTENDED_LIMITS -128.0 127.0 DEPOSIT ABSOLUTE /end AXIS_DESCR
/end CHARACTERISTIC
/begin CHARACTERISTIC LIGov_GearPKpNeg_MAP "gangabhängiger Parameter KpNeg" MAP 0x1E75FC Kf_Xs16_Ys16_Ws16 3.199951 KP_RPM2NM_2 -1.600000 1.599951 FORMAT "%8.6"
 /begin AXIS_DESCR STD_AXIS LIGov_tEngHys Temp_Cels 15 -50.14000 199.8600 FORMAT "%8.4" EXTENDED_LIMITS -3549.940 3003.560 DEPOSIT ABSOLUTE /end AXIS_DESCR
 /begin AXIS_DESCR STD_AXIS LIGov_stGear OneToOne 10 -2.000 7.000 FORMAT "%5.3" EXTENDED_LIMITS -128.0 127.0 DEPOSIT ABSOLUTE /end AXIS_DESCR
/end CHARACTERISTIC
/begin CHARACTERISTIC LIGov_GearPKpPos_MAP "Gangabhängiger Parameter KpPos" MAP 0x1E775E Kf_Xs16_Ys16_Ws16 3.199951 KP_RPM2NM_2 -1.600000 1.599951 FORMAT "%8.6"
 /begin AXIS_DESCR STD_AXIS LIGov_tEngHys Temp_Cels 15 -50.14000 199.8600 FORMAT "%8.4" EXTENDED_LIMITS -3549.940 3003.560 DEPOSIT ABSOLUTE /end AXIS_DESCR
 /begin AXIS_DESCR STD_AXIS LIGov_stGear OneToOne 10 -2.000 7.000 FORMAT "%5.3" EXTENDED_LIMITS -128.0 127.0 DEPOSIT ABSOLUTE /end AXIS_DESCR
/end CHARACTERISTIC
/begin CHARACTERISTIC LIGov_GearPKp_MAP "gangabhängiger Parameter Kp" MAP 0x1E78C0 Kf_Xs16_Ys16_Ws16 3.199951 KP_RPM2NM_2 -1.600000 1.599951 FORMAT "%8.6"
 /begin AXIS_DESCR STD_AXIS LIGov_tEngHys Temp_Cels 15 -50.14000 199.8600 FORMAT "%8.4" EXTENDED_LIMITS -3549.940 3003.560 DEPOSIT ABSOLUTE /end AXIS_DESCR
 /begin AXIS_DESCR STD_AXIS LIGov_stGear OneToOne 10 -2.000 7.000 FORMAT "%5.3" EXTENDED_LIMITS -128.0 127.0 DEPOSIT ABSOLUTE /end AXIS_DESCR
/end CHARACTERISTIC
/begin CHARACTERISTIC LIGov_GearPredef_MAP "Kennfeld für gangabhängiges Einschrittmoment" MAP 0x1E7A22 Kf_Xs16_Ys16_Ws16 6553.500 Trq -3276.800 3276.700 FORMAT "%8.3"
 /begin AXIS_DESCR STD_AXIS LIGov_tEngHys Temp_Cels 15 -50.14000 199.8600 FORMAT "%8.4" EXTENDED_LIMITS -3549.940 3003.560 DEPOSIT ABSOLUTE /end AXIS_DESCR
 /begin AXIS_DESCR STD_AXIS LIGov_stGear OneToOne 10 -2.000 7.000 FORMAT "%5.3" EXTENDED_LIMITS -128.0 127.0 DEPOSIT ABSOLUTE /end AXIS_DESCR
/end CHARACTERISTIC
/begin CHARACTERISTIC LIGov_GearPWinNeg_MAP "gangabhängiges negatives Kleinsignalfenster P parameter" MAP 0x1E7B84 Kf_Xs16_Ys16_Ws16 65535.00 EngN -32768.00 32767.00 FORMAT "%8.2"
 /begin AXIS_DESCR STD_AXIS LIGov_tEngHys Temp_Cels 15 -50.14000 199.8600 FORMAT "%8.4" EXTENDED_LIMITS -3549.940 3003.560 DEPOSIT ABSOLUTE /end AXIS_DESCR
 /begin AXIS_DESCR STD_AXIS LIGov_stGear OneToOne 10 -2.000 7.000 FORMAT "%5.3" EXTENDED_LIMITS -128.0 127.0 DEPOSIT ABSOLUTE /end AXIS_DESCR
/end CHARACTERISTIC
/begin CHARACTERISTIC LIGov_GearPWinPos_MAP "gangabhängiges positives Kleinsignalfenster P Parameter" MAP 0x1E7CE6 Kf_Xs16_Ys16_Ws16 65535.00 EngN -32768.00 32767.00 FORMAT "%8.2"
 /begin AXIS_DESCR STD_AXIS LIGov_tEngHys Temp_Cels 15 -50.14000 199.8600 FORMAT "%8.4" EXTENDED_LIMITS -3549.940 3003.560 DEPOSIT ABSOLUTE /end AXIS_DESCR
 /begin AXIS_DESCR STD_AXIS LIGov_stGear OneToOne 10 -2.000 7.000 FORMAT "%5.3" EXTENDED_LIMITS -128.0 127.0 DEPOSIT ABSOLUTE /end AXIS_DESCR
/end CHARACTERISTIC
/begin CHARACTERISTIC LIGov_nCltAirP_MAP "Wasser und Luftdruckabhängiger Leerlaufsollwert" MAP 0x1E839C Kf_Xs16_Ys16_Ws16 3000.000 EngN 0.00 3000.000 FORMAT "%8.3" EXTENDED_LIMITS -32768.00 32767.00
 /begin AXIS_DESCR STD_AXIS Eng_tEng Temp_Cels 9 -273.1400 149.8600 FORMAT "%8.4" EXTENDED_LIMITS -3549.940 3003.560 DEPOSIT ABSOLUTE /end AXIS_DESCR
 /begin AXIS_DESCR STD_AXIS APSCD_pVal Pres_hPa 4 0.00 2000.000 FORMAT "%8.3" EXTENDED_LIMITS -32768.00 32767.00 DEPOSIT ABSOLUTE /end AXIS_DESCR
/end CHARACTERISTIC
/begin CHARACTERISTIC LIGov_nEngOffset_C "Drehzahloffset für Übernahme der Solldrehzahlanforderung durch AccPed" VALUE 0x1E8402 Kw_Ws16 6000.000 EngN 0.00 6000.000 FORMAT "%8.3" EXTENDED_LIMITS -32768.00 32767.00 /end CHARACTERISTIC
/begin CHARACTERISTIC LIGov_nLimBasAdjHigh_C "Obere Drehzahlschwelle für Leerlaufregler bei aktiver Grundeinstellung" VALUE 0x1E7E48 Kw_Ws16 35768.00 EngN -32768.00 3000.000 FORMAT "%8.2" EXTENDED_LIMITS -32768.00 32767.00 /end CHARACTERISTIC
/begin CHARACTERISTIC LIGov_nLimHighOffs_C "Drehzahloffset der auf LIGov_nLIm hinzuaddiert wird zur LIGov-Daktivierung" VALUE 0x1E7E4C Kw_Ws16 100.0000 EngN 0.00 100.0000 FORMAT "%8.4" EXTENDED_LIMITS -32768.00 32767.00 /end CHARACTERISTIC
/begin CHARACTERISTIC LIGov_nLimHigh_C "obere Drehzahlgrenze für LLR" VALUE 0x1E7E4E Kw_Ws16 34968.00 EngN -32768.00 2200.000 FORMAT "%8.2" EXTENDED_LIMITS -32768.00 32767.00 /end CHARACTERISTIC
/begin CHARACTERISTIC LIGov_nLimLow_C "untere Drehzahlgrenze für LLR" VALUE 0x1E7E50 Kw_Ws16 65535.00 EngN -32768.00 32767.00 FORMAT "%8.2" /end CHARACTERISTIC
/begin CHARACTERISTIC LIGov_nLim_C "Maximale Drehzahl für Leerlaufanhebung mittels LIGov_nTemp2_CUR" VALUE 0x1E8404 Kw_Ws16 65535.00 EngN -32768.00 32767.00 FORMAT "%8.2" /end CHARACTERISTIC
/begin CHARACTERISTIC LIGov_nOffsetPreCtrltrqDem_C "Vorsteuerung aktiv n-Offset auf Basisdrehzahl und Momentenwunsch" VALUE 0x1E7E52 Kw_Ws16 65535.00 EngN -32768.00 32767.00 FORMAT "%8.2" /end CHARACTERISTIC
/begin CHARACTERISTIC LIGov_nOffsetPreCtrl_CUR "Kennfeld für Drehzahloffset der Vorsteuerung" CURVE 0x1E7E54 Kl_Xs16_Ws16 32767.00 EngN 0.00 32767.00 FORMAT "%8.2" EXTENDED_LIMITS -32768.00 32767.00
 /begin AXIS_DESCR STD_AXIS LIGov_tEngHys Temp_Cels 15 -50.14000 199.8600 FORMAT "%8.4" EXTENDED_LIMITS -3549.940 3003.560 DEPOSIT ABSOLUTE /end AXIS_DESCR
/end CHARACTERISTIC
/begin CHARACTERISTIC LIGov_nOffsetPredef_C "Einschrittmoment aktiv n-Offset auf Basisdrehzahl" VALUE 0x1E7E92 Kw_Ws16 65535.00 EngN -32768.00 32767.00 FORMAT "%8.2" /end CHARACTERISTIC
/begin CHARACTERISTIC LIGov_nOffsetUbr_C "Drehzahlschwelle für Erkennung für Leerlaufregler-Zustand Unterbremsen" VALUE 0x1E8406 Kw_Ws16 65535.00 EngN -32768.00 32767.00 FORMAT "%8.2" /end CHARACTERISTIC
/begin CHARACTERISTIC LIGov_nRev_CUR "Umdrehungen nach Start für Leerlaufanhebung mittels LIGov_nCltAirP_MAP" CURVE 0x1E8408 Kl_Xs16_Ws16 32000.00 OneToOne 0.00 32000.00 FORMAT "%8.2" EXTENDED_LIMITS -32768.00 32767.00
 /begin AXIS_DESCR STD_AXIS Eng_tEng Temp_Cels 25 -273.1400 149.8600 FORMAT "%8.4" EXTENDED_LIMITS -3549.940 3003.560 DEPOSIT ABSOLUTE /end AXIS_DESCR
/end CHARACTERISTIC
/begin CHARACTERISTIC LIGov_nRgnIdleOffset_C "Offset für LL-Solldrehzahl bei Regeneration." VALUE 0x1E7E94 Kw_Ws16 6000.000 EngN 0.00 6000.000 FORMAT "%8.3" EXTENDED_LIMITS -32768.00 32767.00 /end CHARACTERISTIC
/begin CHARACTERISTIC LIGov_nRmpInitOffSet_C "Offsetwert für LIGov-Solldrehzahl Rampen" VALUE 0x1E7E96 Kw_Ws16 6000.000 EngN 0.00 6000.000 FORMAT "%8.3" EXTENDED_LIMITS -32768.00 32767.00 /end CHARACTERISTIC
/begin CHARACTERISTIC LIGov_nSetpointDriveAway_CUR "LL-Solldrehzahl Fahrzeug fährt (V > 0) (Atmosphärendruck -abhängige)" CURVE 0x1E7E98 Kl_Xs16_Ws16 3000.000 EngN 0.00 3000.000 FORMAT "%8.3" EXTENDED_LIMITS -32768.00 32767.00
 /begin AXIS_DESCR STD_AXIS APSCD_pVal Pres_hPa 4 0.00 3500.000 FORMAT "%8.3" EXTENDED_LIMITS -32768.00 32767.00 DEPOSIT ABSOLUTE /end AXIS_DESCR
/end CHARACTERISTIC
/begin CHARACTERISTIC LIGov_nSetPointErr_C "Leerlaufsolldrehzahl für Notfahren auf der Nockenwelle" VALUE 0x1E7EAA Kw_Ws16 6000.000 EngN 0.00 6000.000 FORMAT "%8.3" EXTENDED_LIMITS -32768.00 32767.00 /end CHARACTERISTIC
/begin CHARACTERISTIC LIGov_nSetpointWarm_CUR "LL-Solldrehzahl Fahrzeug steht / warmer Motor (Atmosphärendruck -abhängige)" CURVE 0x1E846E Kl_Xs16_Ws16 3000.000 EngN 0.00 3000.000 FORMAT "%8.3" EXTENDED_LIMITS -32768.00 32767.00
 /begin AXIS_DESCR STD_AXIS APSCD_pVal Pres_hPa 4 0.00 3500.000 FORMAT "%8.3" EXTENDED_LIMITS -32768.00 32767.00 DEPOSIT ABSOLUTE /end AXIS_DESCR
/end CHARACTERISTIC
/begin CHARACTERISTIC LIGov_nTemp1_MAP "Kennfeld für Wassertemperatur und Atmosphärendruck - abhängige Leerlauferhöhung" MAP 0x1E8480 Kf_Xs16_Ys16_Ws16 6000.000 EngN 0.00 6000.000 FORMAT "%8.3" EXTENDED_LIMITS -32768.00 32767.00
 /begin AXIS_DESCR STD_AXIS Eng_tEng Temp_Cels 6 -50.14000 149.8600 FORMAT "%8.4" EXTENDED_LIMITS -3549.940 3003.560 DEPOSIT ABSOLUTE /end AXIS_DESCR
 /begin AXIS_DESCR STD_AXIS APSCD_pVal Pres_hPa 4 0.00 3500.000 FORMAT "%8.3" EXTENDED_LIMITS -32768.00 32767.00 DEPOSIT ABSOLUTE /end AXIS_DESCR
/end CHARACTERISTIC
/begin CHARACTERISTIC LIGov_nTemp2Rgn1_CUR "2.Kennlinie bei Regenerationsstufe 1 für Wassertemperaturabhängige Leerlauferhöhung" CURVE 0x1E84C8 Kl_Xs16_Ws16 3000.000 EngN 0.00 3000.000 FORMAT "%8.3" EXTENDED_LIMITS -32768.00 32767.00
 /begin AXIS_DESCR STD_AXIS Eng_tEng Temp_Cels 2 -0.04000000 422.9600 FORMAT "%8.4" EXTENDED_LIMITS -3549.940 3003.560 DEPOSIT ABSOLUTE /end AXIS_DESCR
/end CHARACTERISTIC
/begin CHARACTERISTIC LIGov_nTemp2Rgn2_CUR "2.Kennlinie bei Regenerationsstufe 2 für Wassertemperaturabhängige Leerlauferhöhung" CURVE 0x1E84D2 Kl_Xs16_Ws16 3000.000 EngN 0.00 3000.000 FORMAT "%8.3" EXTENDED_LIMITS -32768.00 32767.00
 /begin AXIS_DESCR STD_AXIS Eng_tEng Temp_Cels 2 -0.04000000 422.9600 FORMAT "%8.4" EXTENDED_LIMITS -3549.940 3003.560 DEPOSIT ABSOLUTE /end AXIS_DESCR
/end CHARACTERISTIC
/begin CHARACTERISTIC LIGov_nTemp2_CUR "2.Kennlinie für Wassertemperaturabhängige Leerlauferhöhung" CURVE 0x1E84DC Kl_Xs16_Ws16 3000.000 EngN 0.00 3000.000 FORMAT "%8.3" EXTENDED_LIMITS -32768.00 32767.00
 /begin AXIS_DESCR STD_AXIS Eng_tEng Temp_Cels 25 -273.1400 149.8600 FORMAT "%8.4" EXTENDED_LIMITS -3549.940 3003.560 DEPOSIT ABSOLUTE /end AXIS_DESCR
/end CHARACTERISTIC
/begin CHARACTERISTIC LIGov_rThresDriveoff_C "Prozentschwelle für PWG bei Status ""Anfahren""" VALUE 0x1E7EAC Kw_Ws16 100.0000 Prc 0.00 100.0000 FORMAT "%8.4" EXTENDED_LIMITS -327.6800 327.6700 /end CHARACTERISTIC
/begin CHARACTERISTIC LIGov_rThresTrqDem_C "Prozentschwelle für PWG bei Status ""Momentenanforderung""" VALUE 0x1E7EAE Kw_Ws16 100.0000 Prc 0.00 100.0000 FORMAT "%8.4" EXTENDED_LIMITS -327.6800 327.6700 /end CHARACTERISTIC
/begin CHARACTERISTIC LIGov_rTransSet_CUR "Kurve zur berechnung des nächsten Übersetzungsverhältnisses" CURVE 0x1E7EB0 Kl_Xs16_Ws16 3.000000 TransR 0.00 3.000000 FORMAT "%8.6" EXTENDED_LIMITS -327.6800 327.6700
 /begin AXIS_DESCR STD_AXIS LIGov_rTransFrzn_mp TransR 5 0.00 5.000000 FORMAT "%8.6" EXTENDED_LIMITS -327.6800 327.6700 DEPOSIT ABSOLUTE /end AXIS_DESCR
/end CHARACTERISTIC
/begin CHARACTERISTIC LIGov_nRmpCVTSlpUpSetPoint_C "Schrittweite der Rampe für CVT-Getriebe bei Erhöhung Solldrehzahl" VALUE 0x1E7EC8 Kw_Wu32 9362278.57317 RmpEngN_LIGov 7.13893345424 9362285.71211 FORMAT "%13.5" EXTENDED_LIMITS 0.00 9362285.71211 /end CHARACTERISTIC
/begin CHARACTERISTIC LIGov_nRmpCVTSlpDwnSetPoint_C "Schrittweite der Rampe für CVT-Getiebe bei Erniedrigung Solldrehzahl" VALUE 0x1E7ECC Kw_Wu32 9362278.57317 RmpEngN_LIGov 7.13893345424 9362285.71211 FORMAT "%13.5" EXTENDED_LIMITS 0.00 9362285.71211 /end CHARACTERISTIC
/begin CHARACTERISTIC LIGov_nRmpSlpUpSetPoint_C "Schrittweite der Rampe bei Erhöhung Solldrehzahl" VALUE 0x1E7ED0 Kw_Wu32 9362278.57317 RmpEngN_LIGov 7.13893345424 9362285.71211 FORMAT "%13.5" EXTENDED_LIMITS 0.00 9362285.71211 /end CHARACTERISTIC
/begin CHARACTERISTIC LIGov_nRmpSlpDwnSetPoint_C "Schrittweite der Rampe bei Erniedrigung Solldrehzahl" VALUE 0x1E7ED4 Kw_Wu32 9362278.57317 RmpEngN_LIGov 7.13893345424 9362285.71211 FORMAT "%13.5" EXTENDED_LIMITS 0.00 9362285.71211 /end CHARACTERISTIC
/begin CHARACTERISTIC LIGov_stCalcRgnMsk1_C "applizierbare Bitmaske für Regenerationsstufe 1" VALUE 0x1E8544 Kw_Wu32 4294967295.00 OneToOne 0.00 4294967295.00 FORMAT "%13.2" /end CHARACTERISTIC
/begin CHARACTERISTIC LIGov_stCalcRgnMsk2_C "applizierbare Bitmaske für Regenerationsstufe 2" VALUE 0x1E8548 Kw_Wu32 4294967295.00 OneToOne 0.00 4294967295.00 FORMAT "%13.2" /end CHARACTERISTIC
/begin CHARACTERISTIC LIGov_vThresPointLow_C "untere Schwelle der v-Hysterese" VALUE 0x1E854C Kw_Ws16 299.0000 Vel 1.000000 300.0000 FORMAT "%8.4" EXTENDED_LIMITS -327.6800 327.6700 /end CHARACTERISTIC
/begin CHARACTERISTIC LIGov_vThresPointHigh_C "obere Schwelle der v-Hysterese" VALUE 0x1E854E Kw_Ws16 299.0000 Vel 1.000000 300.0000 FORMAT "%8.4" EXTENDED_LIMITS -327.6800 327.6700 /end CHARACTERISTIC
/begin CHARACTERISTIC LIGov_YLow_C "LOW Ausgang der v-Hysterese" VALUE 0x1E8550 Kw_Ws16 0.00 OneToOne 0.00 0.00 FORMAT "%8.2" EXTENDED_LIMITS -32768.00 32767.00 READ_ONLY /end CHARACTERISTIC
/begin CHARACTERISTIC LIGov_YHigh_C "HIGH Ausgang der v-Hysterese" VALUE 0x1E8552 Kw_Ws16 0.00 OneToOne 1.000000 1.000000 FORMAT "%8.6" EXTENDED_LIMITS -32768.00 32767.00 READ_ONLY /end CHARACTERISTIC
/begin CHARACTERISTIC LIGov_swtGripDet_C "Schalter zum Auswählen der Kraftslusserkennung" VALUE 0x1E8554 Kw_Wu8 1.000 OneToOne 0.00 1.000 FORMAT "%5.3" EXTENDED_LIMITS 0.00 255.0 /end CHARACTERISTIC
/begin CHARACTERISTIC LIGov_swtParDriveoffVal_C "Auswahl der gewünschten Größe für Anfahren" VALUE 0x1E8555 Kw_Wu8 1.000 OneToOne 0.00 1.000 FORMAT "%5.3" EXTENDED_LIMITS 0.00 255.0 /end CHARACTERISTIC
/begin CHARACTERISTIC LIGov_swtParDriveoffType_C "Auswahl ob Wert des SW-Schalters vom Datensatz oder vom EEPROM für Anfahren gewaehlt wird" VALUE 0x1E8556 Kw_Wu8 2.000 OneToOne 0.00 2.000 FORMAT "%5.3" EXTENDED_LIMITS 0.00 255.0 /end CHARACTERISTIC
/begin CHARACTERISTIC LIGov_swtPrmChgInitDrv_C "Schalter zur Aktivierung der Neuinitialisierung des I Anteils nach Parameterwechsel bei Flanke Status DRIVEOFF" VALUE 0x1E7ED8 Kw_Wu8 1.000 OneToOne 0.00 1.000 FORMAT "%5.3" EXTENDED_LIMITS 0.00 255.0 /end CHARACTERISTIC
/begin CHARACTERISTIC LIGov_swtPrmChgInitUbr_C "Schalter zur Aktivierung der Neuinitialisierung des I Anteils nach Parameterwechsel bei Flanke Status UNDERBRAKING" VALUE 0x1E7ED9 Kw_Wu8 1.000 OneToOne 0.00 1.000 FORMAT "%5.3" EXTENDED_LIMITS 0.00 255.0 /end CHARACTERISTIC
/begin CHARACTERISTIC LIGov_swtPrmChgInit_C "Schalter zur Aktivierung der Neuinitialisierung des I Anteils nach Parameterwechsel im Status NO FREEZEI" VALUE 0x1E7EDA Kw_Wu8 1.000 OneToOne 0.00 1.000 FORMAT "%5.3" EXTENDED_LIMITS 0.00 255.0 /end CHARACTERISTIC
/begin CHARACTERISTIC LIGov_swtTempHys_C "Schalter zur Auswahl der Temperaturart aus dem Motortemperaturfeld" VALUE 0x1E7EDB Kw_Wu8 4.00000000000 EngTempFldSel 0.00 4.00000000000 FORMAT "%13.11" /end CHARACTERISTIC
/begin CHARACTERISTIC LIGov_swtTempTrqInit_C "Schalter der Temperaturwert des Arrays auswählt" VALUE 0x1E7EDC Kw_Wu8 4.00000000000 EngTempFldSel 0.00 4.00000000000 FORMAT "%13.11" /end CHARACTERISTIC
/begin CHARACTERISTIC LIGov_swtTIIInitOn_C "Schalter zur Initialisierung des I-Anteils bei TII Eingriff" VALUE 0x1E7EDD Kw_Wu8 1.000 OneToOne 0.00 1.000 FORMAT "%5.3" EXTENDED_LIMITS 0.00 255.0 /end CHARACTERISTIC
/begin CHARACTERISTIC LIGov_swtTransRec_C "Schalter zur Verwendung von DrvTrn_rTransDT anstatt Interpolation" VALUE 0x1E7EDE Kw_Wu8 1.000 OneToOne 0.00 1.000 FORMAT "%5.3" EXTENDED_LIMITS 0.00 255.0 /end CHARACTERISTIC
/begin CHARACTERISTIC LIGov_swtTrqDemDefrost_C "Schalter zum Auswählen der nach einer Zeit aufzutauenden Torque-Demands" VALUE 0x1E7EDF Kw_Wu8 255.0 OneToOne 0.00 255.0 FORMAT "%5.1" /end CHARACTERISTIC
/begin CHARACTERISTIC LIGov_tEngJit_C "Enttjitterungsschwelle für Motortemperatur" VALUE 0x1E7EE0 Kw_Ws16 3276.700 TempDiff_Kelv 0.00 3276.700 FORMAT "%8.3" EXTENDED_LIMITS -3276.800 3276.700 /end CHARACTERISTIC
/begin CHARACTERISTIC LIGov_tEngLim_C "Maximale Motortemperatur für die Leerlauferhöhung durch LIGov_nTemp1_CUR" VALUE 0x1E8558 Kw_Ws16 6553.500 Temp_Cels -3549.940 3003.560 FORMAT "%8.3" /end CHARACTERISTIC
/begin CHARACTERISTIC LIGov_tEngOilLim_C "Grenze für Öl Temperatur um noch LIGov_nTemp1_MAP zu benutzen" VALUE 0x1E7EE2 Kw_Ws16 6553.500 Temp_Cels -3549.940 3003.560 FORMAT "%8.3" /end CHARACTERISTIC
/begin CHARACTERISTIC LIGov_tiDemDefrostDelay_C "Wartezeit, nach der selektierter Troque-Demand aufgetaut wird." VALUE 0x1E7EE4 Kw_Wu16 655350.0 Time_ms 0.00 655350.0 FORMAT "%8.1" /end CHARACTERISTIC
/begin CHARACTERISTIC LIGov_tiPT1_CUR "Kennlinie der Zeitkonstanten für die PT1 Flterung über der Drehzahl" CURVE 0x1E7EE6 Kl_Xs16_Ws16 5.000000 TimeDelay_s_Lin_16 0.00 5.000000 FORMAT "%8.6" EXTENDED_LIMITS -5.000153 5.000000
 /begin AXIS_DESCR STD_AXIS LIGov_nDiff_mp EngN 25 -5000.000 1000.000 FORMAT "%8.3" EXTENDED_LIMITS -32768.00 32767.00 DEPOSIT ABSOLUTE /end AXIS_DESCR
/end CHARACTERISTIC
/begin CHARACTERISTIC LIGov_tiST_C "Zeit nach Start für LL-Solldrehzahlerhöhung nach Start" VALUE 0x1E855C Kw_Ws32 42949672.9500 Time_s -21474836.4800 21474836.4700 FORMAT "%13.4" /end CHARACTERISTIC
/begin CHARACTERISTIC LIGov_tiTW_C "Zeit nach Start für T_W-abh. LL-Solldrehzahl" VALUE 0x1E8560 Kw_Ws32 42949672.9500 Time_s -21474836.4800 21474836.4700 FORMAT "%13.4" /end CHARACTERISTIC
/begin CHARACTERISTIC LIGov_trqDMaxBasAdjCancel_C "Maximal zulässiger D-Anteil bei Abbruch des Grundeinstellungstests" VALUE 0x1E7F4C Kw_Ws16 6553.500 Trq -3276.800 3276.700 FORMAT "%8.3" /end CHARACTERISTIC
/begin CHARACTERISTIC LIGov_trqInitI_CUR "Kennlinie zur Initialisierung des Integrators" CURVE 0x1E7F4E Kl_Xs16_Ws16 400.0000 Trq 0.00 400.0000 FORMAT "%8.4" EXTENDED_LIMITS -3276.800 3276.700
 /begin AXIS_DESCR STD_AXIS LIGov_tEngTrqInit_mp Temp_Cels 25 -273.1400 149.8600 FORMAT "%8.4" EXTENDED_LIMITS -3549.940 3003.560 DEPOSIT ABSOLUTE /end AXIS_DESCR
/end CHARACTERISTIC
/begin CHARACTERISTIC LIGov_trqMaxTemp_CUR "Temperaturabhängige Kennlinie für maximales LLR Moment" CURVE 0x1E7FB4 Kl_Xs16_Ws16 3276.700 Trq 0.00 3276.700 FORMAT "%8.3" EXTENDED_LIMITS -3276.800 3276.700
 /begin AXIS_DESCR STD_AXIS LIGov_tEngHys Temp_Cels 15 -50.14000 199.8600 FORMAT "%8.4" EXTENDED_LIMITS -3549.940 3003.560 DEPOSIT ABSOLUTE /end AXIS_DESCR
/end CHARACTERISTIC
/begin CHARACTERISTIC LIGov_trqThresDefrostI_C "Mengenschwelle Integrator einfrieren/auftauen" VALUE 0x1E7FF2 Kw_Ws16 6553.500 Trq -3276.800 3276.700 FORMAT "%8.3" /end CHARACTERISTIC
/begin CHARACTERISTIC LIGov_UbrDHypDenom_CUR "Parameterkurve für Denominator für D Anteil bei Unterbremsen" CURVE 0x1E7FF4 Kl_Xs16_Ws16 32767.00 EngN 0.00 32767.00 FORMAT "%8.2" EXTENDED_LIMITS -32768.00 32767.00
 /begin AXIS_DESCR STD_AXIS LIGov_tEngHys Temp_Cels 15 -50.14000 199.8600 FORMAT "%8.4" EXTENDED_LIMITS -3549.940 3003.560 DEPOSIT ABSOLUTE /end AXIS_DESCR
/end CHARACTERISTIC
/begin CHARACTERISTIC LIGov_UbrDHypNum_CUR "Parameterkurve für Numinator des D Anteils für Unterbremsen" CURVE 0x1E8032 Kl_Xs16_Ws16 32767.00 EngN 0.00 32767.00 FORMAT "%8.2" EXTENDED_LIMITS -32768.00 32767.00
 /begin AXIS_DESCR STD_AXIS LIGov_tEngHys Temp_Cels 15 -50.14000 199.8600 FORMAT "%8.4" EXTENDED_LIMITS -3549.940 3003.560 DEPOSIT ABSOLUTE /end AXIS_DESCR
/end CHARACTERISTIC
/begin CHARACTERISTIC LIGov_UbrDKd_CUR "Parameterkurve Kd für unterbremsen" CURVE 0x1E8070 Kl_Xs16_Ws16 3.199951 KD_RPM2NM_3 -1.600000 1.599951 FORMAT "%8.6"
 /begin AXIS_DESCR STD_AXIS LIGov_tEngHys Temp_Cels 15 -50.14000 199.8600 FORMAT "%8.4" EXTENDED_LIMITS -3549.940 3003.560 DEPOSIT ABSOLUTE /end AXIS_DESCR
/end CHARACTERISTIC
/begin CHARACTERISTIC LIGov_UbrDT1_CUR "Parameterkurve Zeitkonstante für D Glied für Unterbremsen" CURVE 0x1E80AE Kl_Xs16_Ws16 250.0000 TimeDelay_s_Lin_16_3 0.00 250.0000 FORMAT "%8.4" EXTENDED_LIMITS -250.0076 250.0000
 /begin AXIS_DESCR STD_AXIS LIGov_tEngHys Temp_Cels 15 -50.14000 199.8600 FORMAT "%8.4" EXTENDED_LIMITS -3549.940 3003.560 DEPOSIT ABSOLUTE /end AXIS_DESCR
/end CHARACTERISTIC
/begin CHARACTERISTIC LIGov_UbrIKiNeg_CUR "Kennlinie für negative Großsignale KiNeg für Unterbremsen" CURVE 0x1E80EC Kl_Xs16_Ws16 24.41369 KI_RPM2NM_2 -12.20703 12.20666 FORMAT "%8.5"
 /begin AXIS_DESCR STD_AXIS LIGov_tEngHys Temp_Cels 15 -50.14000 199.8600 FORMAT "%8.4" EXTENDED_LIMITS -3549.940 3003.560 DEPOSIT ABSOLUTE /end AXIS_DESCR
/end CHARACTERISTIC
/begin CHARACTERISTIC LIGov_UbrIKiPos_CUR "Unterbremsen Parameter für positive Großsignale KiPos" CURVE 0x1E812A Kl_Xs16_Ws16 24.41369 KI_RPM2NM_2 -12.20703 12.20666 FORMAT "%8.5"
 /begin AXIS_DESCR STD_AXIS LIGov_tEngHys Temp_Cels 15 -50.14000 199.8600 FORMAT "%8.4" EXTENDED_LIMITS -3549.940 3003.560 DEPOSIT ABSOLUTE /end AXIS_DESCR
/end CHARACTERISTIC
/begin CHARACTERISTIC LIGov_UbrIKi_CUR "Parameterkurve Ki für unterbremsen" CURVE 0x1E8168 Kl_Xs16_Ws16 24.41369 KI_RPM2NM_2 -12.20703 12.20666 FORMAT "%8.5"
 /begin AXIS_DESCR STD_AXIS LIGov_tEngHys Temp_Cels 15 -50.14000 199.8600 FORMAT "%8.4" EXTENDED_LIMITS -3549.940 3003.560 DEPOSIT ABSOLUTE /end AXIS_DESCR
/end CHARACTERISTIC
/begin CHARACTERISTIC LIGov_UbrIWinNeg_CUR "Kennlinie für negatives Kleinsignalfenster I parameter für unterbremsen" CURVE 0x1E81A6 Kl_Xs16_Ws16 65535.00 EngN -32768.00 32767.00 FORMAT "%8.2"
 /begin AXIS_DESCR STD_AXIS LIGov_tEngHys Temp_Cels 15 -50.14000 199.8600 FORMAT "%8.4" EXTENDED_LIMITS -3549.940 3003.560 DEPOSIT ABSOLUTE /end AXIS_DESCR
/end CHARACTERISTIC
/begin CHARACTERISTIC LIGov_UbrIWinPos_CUR "Positives KleinsignalfensterI Parameter für Unterbremsen" CURVE 0x1E81E4 Kl_Xs16_Ws16 65535.00 EngN -32768.00 32767.00 FORMAT "%8.2"
 /begin AXIS_DESCR STD_AXIS LIGov_tEngHys Temp_Cels 15 -50.14000 199.8600 FORMAT "%8.4" EXTENDED_LIMITS -3549.940 3003.560 DEPOSIT ABSOLUTE /end AXIS_DESCR
/end CHARACTERISTIC
/begin CHARACTERISTIC LIGov_UbrPKpNeg_CUR "Kennlinie für P Parameter KpNeg negative Großsignale bei unterbremsen" CURVE 0x1E8222 Kl_Xs16_Ws16 3.199951 KP_RPM2NM_2 -1.600000 1.599951 FORMAT "%8.6"
 /begin AXIS_DESCR STD_AXIS LIGov_tEngHys Temp_Cels 15 -50.14000 199.8600 FORMAT "%8.4" EXTENDED_LIMITS -3549.940 3003.560 DEPOSIT ABSOLUTE /end AXIS_DESCR
/end CHARACTERISTIC
/begin CHARACTERISTIC LIGov_UbrPKpPos_CUR "Parameterkurve für negative Großsignale KpNeg für Unterbremsen" CURVE 0x1E8260 Kl_Xs16_Ws16 3.199951 KP_RPM2NM_2 -1.600000 1.599951 FORMAT "%8.6"
 /begin AXIS_DESCR STD_AXIS LIGov_tEngHys Temp_Cels 15 -50.14000 199.8600 FORMAT "%8.4" EXTENDED_LIMITS -3549.940 3003.560 DEPOSIT ABSOLUTE /end AXIS_DESCR
/end CHARACTERISTIC
/begin CHARACTERISTIC LIGov_UbrPKp_CUR "Parameterkennlinie für Kp bei Unterbremsen" CURVE 0x1E829E Kl_Xs16_Ws16 3.199951 KP_RPM2NM_2 -1.600000 1.599951 FORMAT "%8.6"
 /begin AXIS_DESCR STD_AXIS LIGov_tEngHys Temp_Cels 15 -50.14000 199.8600 FORMAT "%8.4" EXTENDED_LIMITS -3549.940 3003.560 DEPOSIT ABSOLUTE /end AXIS_DESCR
/end CHARACTERISTIC
/begin CHARACTERISTIC LIGov_UbrPredef_CUR "Einschrittmoment bei Unterbremsen" CURVE 0x1E82DC Kl_Xs16_Ws16 6553.500 Trq -3276.800 3276.700 FORMAT "%8.3"
 /begin AXIS_DESCR STD_AXIS LIGov_tEngHys Temp_Cels 15 -50.14000 199.8600 FORMAT "%8.4" EXTENDED_LIMITS -3549.940 3003.560 DEPOSIT ABSOLUTE /end AXIS_DESCR
/end CHARACTERISTIC
/begin CHARACTERISTIC LIGov_UbrPWinNeg_CUR "Parameterkurve für negatives Kleinsignalfenster P parameter für unterbremsen" CURVE 0x1E831A Kl_Xs16_Ws16 65535.00 EngN -32768.00 32767.00 FORMAT "%8.2"
 /begin AXIS_DESCR STD_AXIS LIGov_tEngHys Temp_Cels 15 -50.14000 199.8600 FORMAT "%8.4" EXTENDED_LIMITS -3549.940 3003.560 DEPOSIT ABSOLUTE /end AXIS_DESCR
/end CHARACTERISTIC
/begin CHARACTERISTIC LIGov_UbrPWinPos_CUR "Parameterkurve für positives Kleinsignalfenster P parameter für unterbremsen" CURVE 0x1E8358 Kl_Xs16_Ws16 65535.00 EngN -32768.00 32767.00 FORMAT "%8.2"
 /begin AXIS_DESCR STD_AXIS LIGov_tEngHys Temp_Cels 15 -50.14000 199.8600 FORMAT "%8.4" EXTENDED_LIMITS -3549.940 3003.560 DEPOSIT ABSOLUTE /end AXIS_DESCR
/end CHARACTERISTIC
/begin CHARACTERISTIC LIGov_vInitMin_C "Geschwindigkeitsschwelle zur Neu-Initialisierung des I-Anteils" VALUE 0x1E8396 Kw_Ws16 655.3500 Vel -327.6800 327.6700 FORMAT "%8.4" /end CHARACTERISTIC
/begin CHARACTERISTIC LIGov_vThreshUbr_C "Schwellgeschwindigkeit bei Unterbremsen" VALUE 0x1E8398 Kw_Ws16 655.3500 Vel -327.6800 327.6700 FORMAT "%8.4" /end CHARACTERISTIC
/begin COMPU_METHOD Acc "Fahrzeugbeschleunigung" RAT_FUNC "%6.5" "[m/s^2]" COEFFS 0 1000 0 0 0 1 /end COMPU_METHOD
/begin COMPU_METHOD AirMassPerCyl "Luftmasse pro Zylinder" RAT_FUNC "%6.3" "[mg/Hub Luft]" COEFFS 0 10 0 0 0 1 /end COMPU_METHOD
/begin COMPU_METHOD AngleCrS "Winkel Kurbelwelle" RAT_FUNC "%6.4" "[deg CrS]" COEFFS 0 42.6666666666667 0 0 0 1 /end COMPU_METHOD
/begin COMPU_METHOD EngN "Motordrehzahl" RAT_FUNC "%6.2" "[rpm]" COEFFS 0 1 0 0 0 1 /end COMPU_METHOD
/begin COMPU_METHOD EngTempFldSel "Verbale Umrechnung für Auswahl aus dem Motortemperatur-Feld Eng_tFld" TAB_VERB "%6.3" "" COMPU_TAB_REF EngTempFldSel /end COMPU_METHOD
/begin COMPU_VTAB EngTempFldSel "Verbale Umrechnung für Auswahl aus dem Motortemperatur-Feld Eng_tFld" TAB_VERB 5 0 "Coolant_Temperature" 1 "Oil_Temperature" 2 "Engine_Temperature" 3 "Fuel_Temperature" 4 "Coolant_Temperature_CAN" /end COMPU_VTAB
/begin COMPU_METHOD Fact "Faktor mit Auflösung 1 / 8192, hauptsächlich für einen Faktorenbereich 0...1 verwendet" RAT_FUNC "%6.5" "[-]" COEFFS 0 8192 0 0 0 1 /end COMPU_METHOD
/begin COMPU_METHOD Fact_GOVILMBD "Umrechnungsregel: Integralverstärkung des Lambdareglers" RAT_FUNC "%6.4" "[1/s]" COEFFS 0 64 0 0 0 1 /end COMPU_METHOD
/begin COMPU_METHOD Fact_GOVIT3 "Umrechnungsregel: Integralverstärkung des T3-Reglers" RAT_FUNC "%6.4" "[1/s]" COEFFS 0 512 0 0 0 1 /end COMPU_METHOD
/begin COMPU_METHOD Fact_GOVPLMBD "Umrechnungsregel: Proportionalverstärkung des Lambdareglers" RAT_FUNC "%6.4" "[-]" COEFFS 0 128 0 0 0 1 /end COMPU_METHOD
/begin COMPU_METHOD Fact_GOVPT3 "Umrechnungsregel: Proportional-Verstärkung des T3-Reglers" RAT_FUNC "%6.4" "[-]" COEFFS 0 256 0 0 0 1 /end COMPU_METHOD
/begin COMPU_METHOD FidName "Verbale Umrechnung für Fid-Namen" TAB_VERB "%6.3" "[-]" COMPU_TAB_REF FidName /end COMPU_METHOD
/begin COMPU_VTAB FidName "Verbale Umrechnung für Fid-Namen" TAB_VERB 2306 0 "Fid_unused" 4097 "Fid_AC1Can_MAX" 4098 "Fid_AC1PresCan_MAX" 4099 "Fid_AC1TrqCan_MAX" 4100 "Fid_ACCAccPed_MAX" 4101 "Fid_ACCAirbCDCrash_MAX" 4102 "Fid_ACCBrkErr_MAX" 4103 "Fid_ACCCDBrkIRev_MAX" 4104 "Fid_ACCCDCan_MAX" 4105 "Fid_ACCCDSens_MAX" 4106 "Fid_ACCCD_VehTrail_MAX" 4107 "Fid_ACCCD_frcRoad_MAX" 4108 "Fid_ACCECUIntErr_MAX" 4109 "Fid_ACCEngCodPlb_MAX" 4110 "Fid_ACCIRev_MAX" 4111 "Fid_ACCMsgErr_MAX" 4112 "Fid_ACCOffRev_MAX" 4113 "Fid_ACCPlCheck_MAX" 4114 "Fid_ACCtl_ACP_MAX" 4115 "Fid_ACCtl_EATSCD_MAX" 4116 "Fid_ACCtl_ESCUCan_MAX" 4117 "Fid_ACCtl_FanCtl1_MAX" 4118 "Fid_ACCtl_FanCtl2_MAX" 4119 "Fid_ACCtl_SysErr_MAX" 4120 "Fid_ACCtl_TSC1Can_MAX" 4121 "Fid_ACCtl_VehStand_MAX" 4122 "Fid_AFSCD_MAX" 4123 "Fid_AFSCD_AirPerTime_MAX" 4124 "Fid_AFSCD_PlOffsDrft_MAX" 4125 "Fid_AFSCD_PlSetyDrft_MAX" 4126 "Fid_AFSCD_SRCAirm_MAX" 4127 "Fid_AFVCtlSigErr_MAX" 4128 "Fid_AOHt_AC1Err_MAX" 4129 "Fid_AOHt_AltSRC_MAX" 4130 "Fid_AOHt_CDHt1_MAX" 4131 "Fid_AOHt_CDHt2_MAX" 4132 "Fid_AOHt_ESCUErr_MAX" 4133 "Fid_AOHt_ErrHt_MAX" 4134 "Fid_APP1_MAX" 4135 "Fid_APP1_FiltOffRampOn_MAX" 4136 "Fid_APP1_Sens_MAX" 4137 "Fid_APP2_MAX" 4138 "Fid_APP2_Sens_MAX" 4139 "Fid_APPCD_EEPROM_MAX" 4140 "Fid_APPCD_Prefill_MAX" 4141 "Fid_APPKickDown_VSS_MAX" 4142 "Fid_APPKickdown_MAX" 4143 "Fid_APSCD_MAX" 4144 "Fid_ASDdc_MAX" 4145 "Fid_ASDdcNGvnr_MAX" 4146 "Fid_ASDdcTrbnSpdCAN_MAX" 4147 "Fid_AccPed_MAX" 4148 "Fid_AccPedDO_MAX" 4149 "Fid_AccPedMstrShft_MAX" 4150 "Fid_AccPedVel_MAX" 4151 "Fid_AccPed_Brk_MAX" 4152 "Fid_AccPed_BrkCDBPTInvld_MAX" 4153 "Fid_AirCtl_MAX" 4154 "Fid_AirbCDCan_MAX" 4155 "Fid_AltCDLoad_MAX" 4156 "Fid_AltCD_CANrDFM_MAX" 4157 "Fid_Alt_PwrCan_MAX" 4158 "Fid_Alt_T15_MAX" 4159 "Fid_BIP_BattCD_MAX" 4160 "Fid_BIP_Control1_MAX" 4161 "Fid_BIP_Control10_MAX" 4162 "Fid_BIP_Control11_MAX" 4163 "Fid_BIP_Control12_MAX" 4164 "Fid_BIP_Control2_MAX" 4165 "Fid_BIP_Control3_MAX" 4166 "Fid_BIP_Control4_MAX" 4167 "Fid_BIP_Control5_MAX" 4168 "Fid_BIP_Control6_MAX" 4169 "Fid_BIP_Control7_MAX" 4170 "Fid_BIP_Control8_MAX" 4171 "Fid_BIP_Control9_MAX" 4172 "Fid_BIP_Err_MAX" 4173 "Fid_BIP_Set1_MAX" 4174 "Fid_BIP_Set10_MAX" 4175 "Fid_BIP_Set11_MAX" 4176 "Fid_BIP_Set12_MAX" 4177 "Fid_BIP_Set2_MAX" 4178 "Fid_BIP_Set3_MAX" 4179 "Fid_BIP_Set4_MAX" 4180 "Fid_BIP_Set5_MAX" 4181 "Fid_BIP_Set6_MAX" 4182 "Fid_BIP_Set7_MAX" 4183 "Fid_BIP_Set8_MAX" 4184 "Fid_BIP_Set9_MAX" 4185 "Fid_BPSErr_MAX" 4186 "Fid_BrkCDBPTInvld_MAX" 4187 "Fid_BrkCDCan_MAX" 4188 "Fid_BrkCDMnBrkCan_MAX" 4189 "Fid_CRCCDCan_MAX" 4190 "Fid_CRCCDTo_MAX" 4191 "Fid_CTSCDCan_MAX" 4192 "Fid_CTSCDCanInac_MAX" 4193 "Fid_CTSCDCanSig_MAX" 4194 "Fid_CTSCDOTSErr_MAX" 4195 "Fid_CTSCDPullup_MAX" 4196 "Fid_CTSErr_MAX" 4197 "Fid_CaSCD_SegCor_MAX" 4198 "Fid_ClgDynTst_MAX" 4199 "Fid_CmbChb_MAX" 4200 "Fid_CoDT_GripDeb_MAX" 4201 "Fid_CoEngAirbCDCrash_MAX" 4202 "Fid_CoEngGW1TO_MAX" 4203 "Fid_CoEng_ActrPrt_MAX" 4204 "Fid_CoEng_FrmMngAWD1_MAX" 4205 "Fid_CoEng_IRevSys_MAX" 4206 "Fid_CoEng_IRevSys2_MAX" 4207 "Fid_CoEng_IRevVeh_MAX" 4208 "Fid_CoEng_KickDown_MAX" 4209 "Fid_CoEng_PwrStgEnable_MAX" 4210 "Fid_CoEng_RevSys_MAX" 4211 "Fid_CoEng_RevSys2_MAX" 4212 "Fid_CoEng_RevVeh_MAX" 4213 "Fid_CoEng_T15CD_MAX" 4214 "Fid_CoEng_TMFWShOff_MAX" 4215 "Fid_CoEng_trqLimBiTurbo_MAX" 4216 "Fid_CoEng_trqLimErr_MAX" 4217 "Fid_CoVM_DCSErr_MAX" 4218 "Fid_CoVM_DCSh_MAX" 4219 "Fid_CoVM_DCSp_MAX" 4220 "Fid_CoVM_TCSErr_MAX" 4221 "Fid_CoVehPnlFunc_MAX" 4222 "Fid_CoVehtrqLimErr_MAX" 4223 "Fid_ConvCDCan_MAX" 4224 "Fid_ConvCDEPB_MAX" 4225 "Fid_Conv_ClthPrt_MAX" 4226 "Fid_CrCtlACCErr_MAX" 4227 "Fid_CrCtlAirbCDCrash_MAX" 4228 "Fid_CrCtlCanBrk1_MAX" 4229 "Fid_CrCtlMsgErrBRK8_MAX" 4230 "Fid_CrCtlPAAGNpl_MAX" 4231 "Fid_CrCtlPAAGTO_MAX" 4232 "Fid_CrCtlPAAGTlrDef_MAX" 4233 "Fid_CrCtlPBRK8Npl_MAX" 4234 "Fid_CrCtlPBRK8TO_MAX" 4235 "Fid_CrCtlPBRK8TempErr_MAX" 4236 "Fid_CrCtlPBRKDlyReg_MAX" 4237 "Fid_CrCtlPECDAAG_MAX" 4238 "Fid_CrCtlPECDILM_MAX" 4239 "Fid_CrCtlPGW1TO_MAX" 4240 "Fid_CrCtlPILMNpl_MAX" 4241 "Fid_CrCtlPILMTO_MAX" 4242 "Fid_CrCtlPMsgErrBRK8_MAX" 4243 "Fid_CrCtlPStopLDef_MAX" 4244 "Fid_CrCtlPstBLS_MAX" 4245 "Fid_CrCtlPstESP_MAX" 4246 "Fid_CrCtl_CAN_MAX" 4247 "Fid_CrCtl_Dspl_MAX" 4248 "Fid_CrCtl_DsplNotPlaus_MAX" 4249 "Fid_CrCtl_VDsplNotPlaus_MAX" 4250 "Fid_CrCtl_stBrk_MAX" 4251 "Fid_CrCtl_stCaSCrS_MAX" 4252 "Fid_CrCtl_stSpeedSensor_MAX" 4253 "Fid_CrCtl_stSystem_MAX" 4254 "Fid_CtTCtl_stStageErr_MAX" 4255 "Fid_CtTCtl_tClntDs1_Err_MAX" 4256 "Fid_CtTCtl_tClntDs2_Err_MAX" 4257 "Fid_CtTCtl_tClntDs3_Err_MAX" 4258 "Fid_CtTCtl_tClntDs4_Err_MAX" 4259 "Fid_CtT_SwtOff_MAX" 4260 "Fid_CtT_SwtOff_EAT_MAX" 4261 "Fid_CtT_SwtOff_EATMod_MAX" 4262 "Fid_DIUMPRDenom_MAX" 4263 "Fid_DIUMPRIgn_MAX" 4264 "Fid_DSM_Wuc_MAX" 4265 "Fid_DiffCANerr_MAX" 4266 "Fid_DrvTrn_TransConv_MAX" 4267 "Fid_EATSCDCan_MAX" 4268 "Fid_EATSCDCanInac_MAX" 4269 "Fid_EATSCDCanSig_MAX" 4270 "Fid_EGPpCDTempDfl_MAX" 4271 "Fid_EGRSCDMon_MAX" 4272 "Fid_EGRSCDOfsLrnInh_MAX" 4273 "Fid_EGRVlvGvnrOff_MAX" 4274 "Fid_EGSysCoLSU0_MAX" 4275 "Fid_EGSysCoNSC_MAX" 4276 "Fid_EGSysCoOxi_MAX" 4277 "Fid_EGSysCoOxiBrik_MAX" 4278 "Fid_EGSysCoTrbn0_MAX" 4279 "Fid_EGSysCoTrbn1_MAX" 4280 "Fid_EGSysCoTube0_MAX" 4281 "Fid_EGSysCoTube1_MAX" 4282 "Fid_EGSysCoTube2_MAX" 4283 "Fid_EGSysCoTube3_MAX" 4284 "Fid_EGSysHtgDel_MAX" 4285 "Fid_EGSysNSC_MAX" 4286 "Fid_EGSysOxiCat_MAX" 4287 "Fid_EGSysPresEnv_MAX" 4288 "Fid_EGSysStrt_MAX" 4289 "Fid_EGSysTemp_MAX" 4290 "Fid_EGSysTrbn_MAX" 4291 "Fid_EGSysTube_MAX" 4292 "Fid_EGSys_AP_MAX" 4293 "Fid_EcuBoot_MAX" 4294 "Fid_EcuInitTimestamp_MAX" 4295 "Fid_EngMBackUpTimer_MAX" 4296 "Fid_EngMCaS1_MAX" 4297 "Fid_EngMCaSBackUp_MAX" 4298 "Fid_EngMCrS1_MAX" 4299 "Fid_EngMCrSBackUp_MAX" 4300 "Fid_EngM_ChkStrtSpd_MAX" 4301 "Fid_EngM_nCoMa_MAX" 4302 "Fid_EngM_trqFrc_MAX" 4303 "Fid_EngMon_Actv_MAX" 4304 "Fid_EngOvrSpd_MAX" 4305 "Fid_EngPOpCalc1_MAX" 4306 "Fid_EngPOpCalc2_MAX" 4307 "Fid_EngPOpCalcSpeed_MAX" 4308 "Fid_EngPOpCalcVal_MAX" 4309 "Fid_EngPrtCaS_MAX" 4310 "Fid_EngPrtCrS_MAX" 4311 "Fid_EngPrtTrqLim_MAX" 4312 "Fid_EngPrt_nLimErr_MAX" 4313 "Fid_EngdtEng_MAX" 4314 "Fid_EngdtEngCOTSCD_MAX" 4315 "Fid_EngdtEngFTSCD_MAX" 4316 "Fid_EngdtEngIATSCD_MAX" 4317 "Fid_FBC_MAX" 4318 "Fid_FMASwtOff1_MAX" 4319 "Fid_FMASwtOff3_MAX" 4320 "Fid_FTSCDNpl_MAX" 4321 "Fid_FTSErr_MAX" 4322 "Fid_FanCDActrErr_MAX" 4323 "Fid_FanCtlCanAC1_MAX" 4324 "Fid_FanCtl_COTSErr_MAX" 4325 "Fid_FanCtl_tClntErr_MAX" 4326 "Fid_FanCtl_vCurrErr_MAX" 4327 "Fid_FlMngFullLdRglOff_MAX" 4328 "Fid_FlSCDCanDef_MAX" 4329 "Fid_FlSysCTSSens_MAX" 4330 "Fid_FlSysDens_MAX" 4331 "Fid_FlSysFTSSens_MAX" 4332 "Fid_FrmMngAC_MAX" 4333 "Fid_FrmMngAC1Npl_MAX" 4334 "Fid_FrmMngAC1TO_MAX" 4335 "Fid_FrmMngACCNpl_MAX" 4336 "Fid_FrmMngACCTO_MAX" 4337 "Fid_FrmMngACCWrongCoded_MAX" 4338 "Fid_FrmMngAIRBGNpl_MAX" 4339 "Fid_FrmMngAIRBGTO_MAX" 4340 "Fid_FrmMngALTCD_Load_MAX" 4341 "Fid_FrmMngAPP_MAX" 4342 "Fid_FrmMngAPPRAW_MAX" 4343 "Fid_FrmMngAPS_MAX" 4344 "Fid_FrmMngAWD1Npl_MAX" 4345 "Fid_FrmMngAWD1TO_MAX" 4346 "Fid_FrmMngBEM1Npl_MAX" 4347 "Fid_FrmMngBEM1TO_MAX" 4348 "Fid_FrmMngBPSCD_IntVal_MAX" 4349 "Fid_FrmMngBRK1Npl_MAX" 4350 "Fid_FrmMngBRK1TO_MAX" 4351 "Fid_FrmMngBRK2Npl_MAX" 4352 "Fid_FrmMngBRK2TO_MAX" 4353 "Fid_FrmMngBRK8Npl_MAX" 4354 "Fid_FrmMngBRK8TO_MAX" 4355 "Fid_FrmMngCCTLNpl_MAX" 4356 "Fid_FrmMngCCTLTO_MAX" 4357 "Fid_FrmMngCHRGR1Npl_MAX" 4358 "Fid_FrmMngCHRGR1TO_MAX" 4359 "Fid_FrmMngCHRGR2Npl_MAX" 4360 "Fid_FrmMngCHRGR2TO_MAX" 4361 "Fid_FrmMngCTSCD_MAX" 4362 "Fid_FrmMngCurInf_MAX" 4363 "Fid_FrmMngDIA1Npl_MAX" 4364 "Fid_FrmMngDIA1TO_MAX" 4365 "Fid_FrmMngDSP1Npl_MAX" 4366 "Fid_FrmMngDSP1TO_MAX" 4367 "Fid_FrmMngDSP2Npl_MAX" 4368 "Fid_FrmMngDSP2TO_MAX" 4369 "Fid_FrmMngDSP3Npl_MAX" 4370 "Fid_FrmMngDSP3TO_MAX" 4371 "Fid_FrmMngEPB1Npl_MAX" 4372 "Fid_FrmMngEPB1TO_MAX" 4373 "Fid_FrmMngESCUNpl_MAX" 4374 "Fid_FrmMngESCUTO_MAX" 4375 "Fid_FrmMngFlxTOSTO_MAX" 4376 "Fid_FrmMngGW1Npl_MAX" 4377 "Fid_FrmMngGW1TO_MAX" 4378 "Fid_FrmMngIATS_MAX" 4379 "Fid_FrmMngNIVEAU1Npl_MAX" 4380 "Fid_FrmMngNIVEAU1TO_MAX" 4381 "Fid_FrmMngPrcFan_MAX" 4382 "Fid_FrmMngSA1Npl_MAX" 4383 "Fid_FrmMngSA1TO_MAX" 4384 "Fid_FrmMngSTIGNNpl_MAX" 4385 "Fid_FrmMngSTIGNTO_MAX" 4386 "Fid_FrmMngSrvPmp_MAX" 4387 "Fid_FrmMngTCSTO_MAX" 4388 "Fid_FrmMngTOSNpl_MAX" 4389 "Fid_FrmMngTOSTO_MAX" 4390 "Fid_FrmMngTSC1Npl_MAX" 4391 "Fid_FrmMngTSC1TO_MAX" 4392 "Fid_FrmMngTSC2Npl_MAX" 4393 "Fid_FrmMngTSC2TO_MAX" 4394 "Fid_FrmMngTSC3Npl_MAX" 4395 "Fid_FrmMngTSC3TO_MAX" 4396 "Fid_FrmMngTSC6Npl_MAX" 4397 "Fid_FrmMngTSC6TO_MAX" 4398 "Fid_FrmMngVCurEng2_MAX" 4399 "Fid_FrmMng_AltPwrCan_MAX" 4400 "Fid_FrmMng_GlwCD_Actr_MAX" 4401 "Fid_FrmMng_GlwCtl_Rly_MAX" 4402 "Fid_FrmMng_KickDown_MAX" 4403 "Fid_GbSSCD_MAX" 4404 "Fid_GbSSCD_HW_MAX" 4405 "Fid_GearbxCanTSC2_MAX" 4406 "Fid_GearbxClthPlaus_MAX" 4407 "Fid_GearbxINCCup_MAX" 4408 "Fid_GearbxNMinDis_MAX" 4409 "Fid_GearbxTrbnSpdCAN_MAX" 4410 "Fid_Gearbx_CANerr_MAX" 4411 "Fid_Gearbx_Eng_MAX" 4412 "Fid_Gearbx_EngCTS_MAX" 4413 "Fid_Gearbx_EngFrc_MAX" 4414 "Fid_Gearbx_EngFrcVehSpeed_MAX" 4415 "Fid_Gearbx_EngOTS_MAX" 4416 "Fid_Gearbx_FrmMngAWD1_MAX" 4417 "Fid_Gearbx_GearDet_MAX" 4418 "Fid_Gearbx_TSC1Err_MAX" 4419 "Fid_Gearbx_TSC2Err_MAX" 4420 "Fid_Gearbx_TSC3Err_MAX" 4421 "Fid_Gearbx_TransConv_MAX" 4422 "Fid_GlwCDCan_MAX" 4423 "Fid_GlwCDCod_MAX" 4424 "Fid_GlwCtl1_MAX" 4425 "Fid_GlwCtl2_MAX" 4426 "Fid_GlwCtl3_MAX" 4427 "Fid_HDSCD_SSpMon1_MAX" 4428 "Fid_IATSErr_MAX" 4429 "Fid_IndSysMonIntMnf_MAX" 4430 "Fid_IndSys_MonVac_MAX" 4431 "Fid_IndSys_pAdj_MAX" 4432 "Fid_InjCrvCTS_MAX" 4433 "Fid_InjCrvDyn_MAX" 4434 "Fid_InjCrvFTS_MAX" 4435 "Fid_InjCrvT3Dia_MAX" 4436 "Fid_InjCrv_phiStartAddCor_MAX" 4437 "Fid_InjCrv_stPiI1_MAX" 4438 "Fid_InjCtl_qLimErr_MAX" 4439 "Fid_InjUnAlt_MAX" 4440 "Fid_InjUnIATS_MAX" 4441 "Fid_InjUnSpdErr_MAX" 4442 "Fid_InjUn_qRed_MAX" 4443 "Fid_InjVCD_InjVlv1_MAX" 4444 "Fid_InjVCD_InjVlv10_MAX" 4445 "Fid_InjVCD_InjVlv11_MAX" 4446 "Fid_InjVCD_InjVlv12_MAX" 4447 "Fid_InjVCD_InjVlv2_MAX" 4448 "Fid_InjVCD_InjVlv3_MAX" 4449 "Fid_InjVCD_InjVlv4_MAX" 4450 "Fid_InjVCD_InjVlv5_MAX" 4451 "Fid_InjVCD_InjVlv6_MAX" 4452 "Fid_InjVCD_InjVlv7_MAX" 4453 "Fid_InjVCD_InjVlv8_MAX" 4454 "Fid_InjVCD_InjVlv9_MAX" 4455 "Fid_InjVCD_PiIPoI_MAX" 4456 "Fid_InjVCD_WUP_MAX" 4457 "Fid_LASCD_MAX" 4458 "Fid_LASCDBRK8_MAX" 4459 "Fid_LIGovDriveAway_MAX" 4460 "Fid_LIGovUbr_MAX" 4461 "Fid_LIGovnSetPointErr_MAX" 4462 "Fid_LSUCDMon0_MAX" 4463 "Fid_LSUCDO20_MAX" 4464 "Fid_LSUCDRi0_MAX" 4465 "Fid_LSUCDactiv0_MAX" 4466 "Fid_LSUCDlsu0_MAX" 4467 "Fid_LSUClbSched_MAX" 4468 "Fid_LSUCtl0_MAX" 4469 "Fid_LSUMonAllChecks0_MAX" 4470 "Fid_LSUMonPlausChk0_MAX" 4471 "Fid_OTSCDCTSErr_MAX" 4472 "Fid_OTSCDCan_MAX" 4473 "Fid_OTSCDCanDSP2_MAX" 4474 "Fid_OTSCDCanInac_MAX" 4475 "Fid_OTSCDCanSig_MAX" 4476 "Fid_OTSCDDynTst_MAX" 4477 "Fid_OTSCDErr_MAX" 4478 "Fid_OvRMonACCTO_MAX" 4479 "Fid_OvRMonACCaFrmMng_MAX" 4480 "Fid_OvRMonBRK1TO_MAX" 4481 "Fid_OvRMonBRK8Err_MAX" 4482 "Fid_OvRMonBRK8MnBrkErr_MAX" 4483 "Fid_OvRMonCrCtlplusFin_MAX" 4484 "Fid_OvRMonShtrp_MAX" 4485 "Fid_OvRMonTSC1_MAX" 4486 "Fid_OvRMonTSC2_MAX" 4487 "Fid_OvRMonTSC3_MAX" 4488 "Fid_PCR_MAX" 4489 "Fid_PCRBalGvnr_MAX" 4490 "Fid_PCRNSShutOff_MAX" 4491 "Fid_PCRpLim_MAX" 4492 "Fid_PFltAirSysFail_MAX" 4493 "Fid_PFltChar_MAX" 4494 "Fid_PFltContPlausTemp_MAX" 4495 "Fid_PFltDynChk_MAX" 4496 "Fid_PFltHsLnChk_MAX" 4497 "Fid_PFltPlausPres_MAX" 4498 "Fid_PFltPlausTemp_MAX" 4499 "Fid_PFltPoI1Fail_MAX" 4500 "Fid_PFltPoI2Fail_MAX" 4501 "Fid_PFltPresSensDiff_MAX" 4502 "Fid_PFltPresSensFrz_MAX" 4503 "Fid_PFltPresSensHsLn_MAX" 4504 "Fid_PFltPresSensPre_MAX" 4505 "Fid_PFltRgnShOff_MAX" 4506 "Fid_PFltSRCPres_MAX" 4507 "Fid_PFltSRCTemp_MAX" 4508 "Fid_PFltSotSimPresElec_MAX" 4509 "Fid_PFltSotSimPresEnv_MAX" 4510 "Fid_PFltSotSimPresLrn_MAX" 4511 "Fid_PFltSotSimTemp_MAX" 4512 "Fid_PFltSysFail_MAX" 4513 "Fid_PFltTempModtPst_MAX" 4514 "Fid_PFltTempOxiPre_MAX" 4515 "Fid_PFltTempOxiSurf_MAX" 4516 "Fid_PFltTempPreOxiC_MAX" 4517 "Fid_PFltTempPrePFlt_MAX" 4518 "Fid_PFltTempPreTrbn_MAX" 4519 "Fid_PFltTempPstPFlt_MAX" 4520 "Fid_PFltTempSens_MAX" 4521 "Fid_PFltTempSensFrz_MAX" 4522 "Fid_PoI2HC_MAX" 4523 "Fid_PoI2HCSpd_MAX" 4524 "Fid_PoI2Lmbd_MAX" 4525 "Fid_PoI2LmbdT3_MAX" 4526 "Fid_PoI2OvR_MAX" 4527 "Fid_PrpCtl_AWD1_MAX" 4528 "Fid_PrpCtl_CANVerErr_MAX" 4529 "Fid_PrpCtl_NIVEAU1_MAX" 4530 "Fid_PrpCtl_VSSCD_MAX" 4531 "Fid_ShortTr_MAX" 4532 "Fid_ShortTrAct_MAX" 4533 "Fid_SignalsTstNLim_MAX" 4534 "Fid_SotSimEGROff_MAX" 4535 "Fid_SrvPmpStSA_MAX" 4536 "Fid_SrvPmpVSSCD_MAX" 4537 "Fid_StSysCtl_IlsPlaus_MAX" 4538 "Fid_StSysCtl_RlyErr_MAX" 4539 "Fid_StSysCtl_T50Err_MAX" 4540 "Fid_StSysCtl_VSSCD_MAX" 4541 "Fid_StSysCtltiThrsAddCr_MAX" 4542 "Fid_StSys_ESCUBSG3Err_MAX" 4543 "Fid_StSys_STIGNErr_MAX" 4544 "Fid_StSys_T50Err_MAX" 4545 "Fid_StSys_T50RErr_MAX" 4546 "Fid_StSystrqStrtAddCor_MAX" 4547 "Fid_SvLpBRK2TO_MAX" 4548 "Fid_SvLpCDTOSTO_MAX" 4549 "Fid_SvLpTOSTO_MAX" 4550 "Fid_T50CDCan_MAX" 4551 "Fid_TVASCDMon_MAX" 4552 "Fid_ThrVlvGvnrOn_MAX" 4553 "Fid_UAcc_EnvDat_MAX" 4554 "Fid_VSSCDBRK1Err_MAX" 4555 "Fid_VSSCDBRK8_MAX" 4556 "Fid_VSSCDDSP1Err_MAX" 4557 "Fid_WDASCD_MAX" 8193 "Fid_AC1Can_MIN" 8194 "Fid_AC1PresCan_MIN" 8195 "Fid_AC1TrqCan_MIN" 8196 "Fid_ACCAccPed_MIN" 8197 "Fid_ACCAirbCDCrash_MIN" 8198 "Fid_ACCBrkErr_MIN" 8199 "Fid_ACCCDBrkIRev_MIN" 8200 "Fid_ACCCDCan_MIN" 8201 "Fid_ACCCDSens_MIN" 8202 "Fid_ACCCD_VehTrail_MIN" 8203 "Fid_ACCCD_frcRoad_MIN" 8204 "Fid_ACCECUIntErr_MIN" 8205 "Fid_ACCEngCodPlb_MIN" 8206 "Fid_ACCIRev_MIN" 8207 "Fid_ACCMsgErr_MIN" 8208 "Fid_ACCOffRev_MIN" 8209 "Fid_ACCPlCheck_MIN" 8210 "Fid_ACCtl_ACP_MIN" 8211 "Fid_ACCtl_EATSCD_MIN" 8212 "Fid_ACCtl_ESCUCan_MIN" 8213 "Fid_ACCtl_FanCtl1_MIN" 8214 "Fid_ACCtl_FanCtl2_MIN" 8215 "Fid_ACCtl_SysErr_MIN" 8216 "Fid_ACCtl_TSC1Can_MIN" 8217 "Fid_ACCtl_VehStand_MIN" 8218 "Fid_AFSCD_MIN" 8219 "Fid_AFSCD_AirPerTime_MIN" 8220 "Fid_AFSCD_PlOffsDrft_MIN" 8221 "Fid_AFSCD_PlSetyDrft_MIN" 8222 "Fid_AFSCD_SRCAirm_MIN" 8223 "Fid_AFVCtlSigErr_MIN" 8224 "Fid_AOHt_AC1Err_MIN" 8225 "Fid_AOHt_AltSRC_MIN" 8226 "Fid_AOHt_CDHt1_MIN" 8227 "Fid_AOHt_CDHt2_MIN" 8228 "Fid_AOHt_ESCUErr_MIN" 8229 "Fid_AOHt_ErrHt_MIN" 8230 "Fid_APP1_MIN" 8231 "Fid_APP1_FiltOffRampOn_MIN" 8232 "Fid_APP1_Sens_MIN" 8233 "Fid_APP2_MIN" 8234 "Fid_APP2_Sens_MIN" 8235 "Fid_APPCD_EEPROM_MIN" 8236 "Fid_APPCD_Prefill_MIN" 8237 "Fid_APPKickDown_VSS_MIN" 8238 "Fid_APPKickdown_MIN" 8239 "Fid_APSCD_MIN" 8240 "Fid_ASDdc_MIN" 8241 "Fid_ASDdcNGvnr_MIN" 8242 "Fid_ASDdcTrbnSpdCAN_MIN" 8243 "Fid_AccPed_MIN" 8244 "Fid_AccPedDO_MIN" 8245 "Fid_AccPedMstrShft_MIN" 8246 "Fid_AccPedVel_MIN" 8247 "Fid_AccPed_Brk_MIN" 8248 "Fid_AccPed_BrkCDBPTInvld_MIN" 8249 "Fid_AirCtl_MIN" 8250 "Fid_AirbCDCan_MIN" 8251 "Fid_AltCDLoad_MIN" 8252 "Fid_AltCD_CANrDFM_MIN" 8253 "Fid_Alt_PwrCan_MIN" 8254 "Fid_Alt_T15_MIN" 8255 "Fid_BIP_BattCD_MIN" 8256 "Fid_BIP_Control1_MIN" 8257 "Fid_BIP_Control10_MIN" 8258 "Fid_BIP_Control11_MIN" 8259 "Fid_BIP_Control12_MIN" 8260 "Fid_BIP_Control2_MIN" 8261 "Fid_BIP_Control3_MIN" 8262 "Fid_BIP_Control4_MIN" 8263 "Fid_BIP_Control5_MIN" 8264 "Fid_BIP_Control6_MIN" 8265 "Fid_BIP_Control7_MIN" 8266 "Fid_BIP_Control8_MIN" 8267 "Fid_BIP_Control9_MIN" 8268 "Fid_BIP_Err_MIN" 8269 "Fid_BIP_Set1_MIN" 8270 "Fid_BIP_Set10_MIN" 8271 "Fid_BIP_Set11_MIN" 8272 "Fid_BIP_Set12_MIN" 8273 "Fid_BIP_Set2_MIN" 8274 "Fid_BIP_Set3_MIN" 8275 "Fid_BIP_Set4_MIN" 8276 "Fid_BIP_Set5_MIN" 8277 "Fid_BIP_Set6_MIN" 8278 "Fid_BIP_Set7_MIN" 8279 "Fid_BIP_Set8_MIN" 8280 "Fid_BIP_Set9_MIN" 8281 "Fid_BPSErr_MIN" 8282 "Fid_BrkCDBPTInvld_MIN" 8283 "Fid_BrkCDCan_MIN" 8284 "Fid_BrkCDMnBrkCan_MIN" 8285 "Fid_CRCCDCan_MIN" 8286 "Fid_CRCCDTo_MIN" 8287 "Fid_CTSCDCan_MIN" 8288 "Fid_CTSCDCanInac_MIN" 8289 "Fid_CTSCDCanSig_MIN" 8290 "Fid_CTSCDOTSErr_MIN" 8291 "Fid_CTSCDPullup_MIN" 8292 "Fid_CTSErr_MIN" 8293 "Fid_CaSCD_SegCor_MIN" 8294 "Fid_ClgDynTst_MIN" 8295 "Fid_CmbChb_MIN" 8296 "Fid_CoDT_GripDeb_MIN" 8297 "Fid_CoEngAirbCDCrash_MIN" 8298 "Fid_CoEngGW1TO_MIN" 8299 "Fid_CoEng_ActrPrt_MIN" 8300 "Fid_CoEng_FrmMngAWD1_MIN" 8301 "Fid_CoEng_IRevSys_MIN" 8302 "Fid_CoEng_IRevSys2_MIN" 8303 "Fid_CoEng_IRevVeh_MIN" 8304 "Fid_CoEng_KickDown_MIN" 8305 "Fid_CoEng_PwrStgEnable_MIN" 8306 "Fid_CoEng_RevSys_MIN" 8307 "Fid_CoEng_RevSys2_MIN" 8308 "Fid_CoEng_RevVeh_MIN" 8309 "Fid_CoEng_T15CD_MIN" 8310 "Fid_CoEng_TMFWShOff_MIN" 8311 "Fid_CoEng_trqLimBiTurbo_MIN" 8312 "Fid_CoEng_trqLimErr_MIN" 8313 "Fid_CoVM_DCSErr_MIN" 8314 "Fid_CoVM_DCSh_MIN" 8315 "Fid_CoVM_DCSp_MIN" 8316 "Fid_CoVM_TCSErr_MIN" 8317 "Fid_CoVehPnlFunc_MIN" 8318 "Fid_CoVehtrqLimErr_MIN" 8319 "Fid_ConvCDCan_MIN" 8320 "Fid_ConvCDEPB_MIN" 8321 "Fid_Conv_ClthPrt_MIN" 8322 "Fid_CrCtlACCErr_MIN" 8323 "Fid_CrCtlAirbCDCrash_MIN" 8324 "Fid_CrCtlCanBrk1_MIN" 8325 "Fid_CrCtlMsgErrBRK8_MIN" 8326 "Fid_CrCtlPAAGNpl_MIN" 8327 "Fid_CrCtlPAAGTO_MIN" 8328 "Fid_CrCtlPAAGTlrDef_MIN" 8329 "Fid_CrCtlPBRK8Npl_MIN" 8330 "Fid_CrCtlPBRK8TO_MIN" 8331 "Fid_CrCtlPBRK8TempErr_MIN" 8332 "Fid_CrCtlPBRKDlyReg_MIN" 8333 "Fid_CrCtlPECDAAG_MIN" 8334 "Fid_CrCtlPECDILM_MIN" 8335 "Fid_CrCtlPGW1TO_MIN" 8336 "Fid_CrCtlPILMNpl_MIN" 8337 "Fid_CrCtlPILMTO_MIN" 8338 "Fid_CrCtlPMsgErrBRK8_MIN" 8339 "Fid_CrCtlPStopLDef_MIN" 8340 "Fid_CrCtlPstBLS_MIN" 8341 "Fid_CrCtlPstESP_MIN" 8342 "Fid_CrCtl_CAN_MIN" 8343 "Fid_CrCtl_Dspl_MIN" 8344 "Fid_CrCtl_DsplNotPlaus_MIN" 8345 "Fid_CrCtl_VDsplNotPlaus_MIN" 8346 "Fid_CrCtl_stBrk_MIN" 8347 "Fid_CrCtl_stCaSCrS_MIN" 8348 "Fid_CrCtl_stSpeedSensor_MIN" 8349 "Fid_CrCtl_stSystem_MIN" 8350 "Fid_CtTCtl_stStageErr_MIN" 8351 "Fid_CtTCtl_tClntDs1_Err_MIN" 8352 "Fid_CtTCtl_tClntDs2_Err_MIN" 8353 "Fid_CtTCtl_tClntDs3_Err_MIN" 8354 "Fid_CtTCtl_tClntDs4_Err_MIN" 8355 "Fid_CtT_SwtOff_MIN" 8356 "Fid_CtT_SwtOff_EAT_MIN" 8357 "Fid_CtT_SwtOff_EATMod_MIN" 8358 "Fid_DIUMPRDenom_MIN" 8359 "Fid_DIUMPRIgn_MIN" 8360 "Fid_DSM_Wuc_MIN" 8361 "Fid_DiffCANerr_MIN" 8362 "Fid_DrvTrn_TransConv_MIN" 8363 "Fid_EATSCDCan_MIN" 8364 "Fid_EATSCDCanInac_MIN" 8365 "Fid_EATSCDCanSig_MIN" 8366 "Fid_EGPpCDTempDfl_MIN" 8367 "Fid_EGRSCDMon_MIN" 8368 "Fid_EGRSCDOfsLrnInh_MIN" 8369 "Fid_EGRVlvGvnrOff_MIN" 8370 "Fid_EGSysCoLSU0_MIN" 8371 "Fid_EGSysCoNSC_MIN" 8372 "Fid_EGSysCoOxi_MIN" 8373 "Fid_EGSysCoOxiBrik_MIN" 8374 "Fid_EGSysCoTrbn0_MIN" 8375 "Fid_EGSysCoTrbn1_MIN" 8376 "Fid_EGSysCoTube0_MIN" 8377 "Fid_EGSysCoTube1_MIN" 8378 "Fid_EGSysCoTube2_MIN" 8379 "Fid_EGSysCoTube3_MIN" 8380 "Fid_EGSysHtgDel_MIN" 8381 "Fid_EGSysNSC_MIN" 8382 "Fid_EGSysOxiCat_MIN" 8383 "Fid_EGSysPresEnv_MIN" 8384 "Fid_EGSysStrt_MIN" 8385 "Fid_EGSysTemp_MIN" 8386 "Fid_EGSysTrbn_MIN" 8387 "Fid_EGSysTube_MIN" 8388 "Fid_EGSys_AP_MIN" 8389 "Fid_EcuBoot_MIN" 8390 "Fid_EcuInitTimestamp_MIN" 8391 "Fid_EngMBackUpTimer_MIN" 8392 "Fid_EngMCaS1_MIN" 8393 "Fid_EngMCaSBackUp_MIN" 8394 "Fid_EngMCrS1_MIN" 8395 "Fid_EngMCrSBackUp_MIN" 8396 "Fid_EngM_ChkStrtSpd_MIN" 8397 "Fid_EngM_nCoMa_MIN" 8398 "Fid_EngM_trqFrc_MIN" 8399 "Fid_EngMon_Actv_MIN" 8400 "Fid_EngOvrSpd_MIN" 8401 "Fid_EngPOpCalc1_MIN" 8402 "Fid_EngPOpCalc2_MIN" 8403 "Fid_EngPOpCalcSpeed_MIN" 8404 "Fid_EngPOpCalcVal_MIN" 8405 "Fid_EngPrtCaS_MIN" 8406 "Fid_EngPrtCrS_MIN" 8407 "Fid_EngPrtTrqLim_MIN" 8408 "Fid_EngPrt_nLimErr_MIN" 8409 "Fid_EngdtEng_MIN" 8410 "Fid_EngdtEngCOTSCD_MIN" 8411 "Fid_EngdtEngFTSCD_MIN" 8412 "Fid_EngdtEngIATSCD_MIN" 8413 "Fid_FBC_MIN" 8414 "Fid_FMASwtOff1_MIN" 8415 "Fid_FMASwtOff3_MIN" 8416 "Fid_FTSCDNpl_MIN" 8417 "Fid_FTSErr_MIN" 8418 "Fid_FanCDActrErr_MIN" 8419 "Fid_FanCtlCanAC1_MIN" 8420 "Fid_FanCtl_COTSErr_MIN" 8421 "Fid_FanCtl_tClntErr_MIN" 8422 "Fid_FanCtl_vCurrErr_MIN" 8423 "Fid_FlMngFullLdRglOff_MIN" 8424 "Fid_FlSCDCanDef_MIN" 8425 "Fid_FlSysCTSSens_MIN" 8426 "Fid_FlSysDens_MIN" 8427 "Fid_FlSysFTSSens_MIN" 8428 "Fid_FrmMngAC_MIN" 8429 "Fid_FrmMngAC1Npl_MIN" 8430 "Fid_FrmMngAC1TO_MIN" 8431 "Fid_FrmMngACCNpl_MIN" 8432 "Fid_FrmMngACCTO_MIN" 8433 "Fid_FrmMngACCWrongCoded_MIN" 8434 "Fid_FrmMngAIRBGNpl_MIN" 8435 "Fid_FrmMngAIRBGTO_MIN" 8436 "Fid_FrmMngALTCD_Load_MIN" 8437 "Fid_FrmMngAPP_MIN" 8438 "Fid_FrmMngAPPRAW_MIN" 8439 "Fid_FrmMngAPS_MIN" 8440 "Fid_FrmMngAWD1Npl_MIN" 8441 "Fid_FrmMngAWD1TO_MIN" 8442 "Fid_FrmMngBEM1Npl_MIN" 8443 "Fid_FrmMngBEM1TO_MIN" 8444 "Fid_FrmMngBPSCD_IntVal_MIN" 8445 "Fid_FrmMngBRK1Npl_MIN" 8446 "Fid_FrmMngBRK1TO_MIN" 8447 "Fid_FrmMngBRK2Npl_MIN" 8448 "Fid_FrmMngBRK2TO_MIN" 8449 "Fid_FrmMngBRK8Npl_MIN" 8450 "Fid_FrmMngBRK8TO_MIN" 8451 "Fid_FrmMngCCTLNpl_MIN" 8452 "Fid_FrmMngCCTLTO_MIN" 8453 "Fid_FrmMngCHRGR1Npl_MIN" 8454 "Fid_FrmMngCHRGR1TO_MIN" 8455 "Fid_FrmMngCHRGR2Npl_MIN" 8456 "Fid_FrmMngCHRGR2TO_MIN" 8457 "Fid_FrmMngCTSCD_MIN" 8458 "Fid_FrmMngCurInf_MIN" 8459 "Fid_FrmMngDIA1Npl_MIN" 8460 "Fid_FrmMngDIA1TO_MIN" 8461 "Fid_FrmMngDSP1Npl_MIN" 8462 "Fid_FrmMngDSP1TO_MIN" 8463 "Fid_FrmMngDSP2Npl_MIN" 8464 "Fid_FrmMngDSP2TO_MIN" 8465 "Fid_FrmMngDSP3Npl_MIN" 8466 "Fid_FrmMngDSP3TO_MIN" 8467 "Fid_FrmMngEPB1Npl_MIN" 8468 "Fid_FrmMngEPB1TO_MIN" 8469 "Fid_FrmMngESCUNpl_MIN" 8470 "Fid_FrmMngESCUTO_MIN" 8471 "Fid_FrmMngFlxTOSTO_MIN" 8472 "Fid_FrmMngGW1Npl_MIN" 8473 "Fid_FrmMngGW1TO_MIN" 8474 "Fid_FrmMngIATS_MIN" 8475 "Fid_FrmMngNIVEAU1Npl_MIN" 8476 "Fid_FrmMngNIVEAU1TO_MIN" 8477 "Fid_FrmMngPrcFan_MIN" 8478 "Fid_FrmMngSA1Npl_MIN" 8479 "Fid_FrmMngSA1TO_MIN" 8480 "Fid_FrmMngSTIGNNpl_MIN" 8481 "Fid_FrmMngSTIGNTO_MIN" 8482 "Fid_FrmMngSrvPmp_MIN" 8483 "Fid_FrmMngTCSTO_MIN" 8484 "Fid_FrmMngTOSNpl_MIN" 8485 "Fid_FrmMngTOSTO_MIN" 8486 "Fid_FrmMngTSC1Npl_MIN" 8487 "Fid_FrmMngTSC1TO_MIN" 8488 "Fid_FrmMngTSC2Npl_MIN" 8489 "Fid_FrmMngTSC2TO_MIN" 8490 "Fid_FrmMngTSC3Npl_MIN" 8491 "Fid_FrmMngTSC3TO_MIN" 8492 "Fid_FrmMngTSC6Npl_MIN" 8493 "Fid_FrmMngTSC6TO_MIN" 8494 "Fid_FrmMngVCurEng2_MIN" 8495 "Fid_FrmMng_AltPwrCan_MIN" 8496 "Fid_FrmMng_GlwCD_Actr_MIN" 8497 "Fid_FrmMng_GlwCtl_Rly_MIN" 8498 "Fid_FrmMng_KickDown_MIN" 8499 "Fid_GbSSCD_MIN" 8500 "Fid_GbSSCD_HW_MIN" 8501 "Fid_GearbxCanTSC2_MIN" 8502 "Fid_GearbxClthPlaus_MIN" 8503 "Fid_GearbxINCCup_MIN" 8504 "Fid_GearbxNMinDis_MIN" 8505 "Fid_GearbxTrbnSpdCAN_MIN" 8506 "Fid_Gearbx_CANerr_MIN" 8507 "Fid_Gearbx_Eng_MIN" 8508 "Fid_Gearbx_EngCTS_MIN" 8509 "Fid_Gearbx_EngFrc_MIN" 8510 "Fid_Gearbx_EngFrcVehSpeed_MIN" 8511 "Fid_Gearbx_EngOTS_MIN" 8512 "Fid_Gearbx_FrmMngAWD1_MIN" 8513 "Fid_Gearbx_GearDet_MIN" 8514 "Fid_Gearbx_TSC1Err_MIN" 8515 "Fid_Gearbx_TSC2Err_MIN" 8516 "Fid_Gearbx_TSC3Err_MIN" 8517 "Fid_Gearbx_TransConv_MIN" 8518 "Fid_GlwCDCan_MIN" 8519 "Fid_GlwCDCod_MIN" 8520 "Fid_GlwCtl1_MIN" 8521 "Fid_GlwCtl2_MIN" 8522 "Fid_GlwCtl3_MIN" 8523 "Fid_HDSCD_SSpMon1_MIN" 8524 "Fid_IATSErr_MIN" 8525 "Fid_IndSysMonIntMnf_MIN" 8526 "Fid_IndSys_MonVac_MIN" 8527 "Fid_IndSys_pAdj_MIN" 8528 "Fid_InjCrvCTS_MIN" 8529 "Fid_InjCrvDyn_MIN" 8530 "Fid_InjCrvFTS_MIN" 8531 "Fid_InjCrvT3Dia_MIN" 8532 "Fid_InjCrv_phiStartAddCor_MIN" 8533 "Fid_InjCrv_stPiI1_MIN" 8534 "Fid_InjCtl_qLimErr_MIN" 8535 "Fid_InjUnAlt_MIN" 8536 "Fid_InjUnIATS_MIN" 8537 "Fid_InjUnSpdErr_MIN" 8538 "Fid_InjUn_qRed_MIN" 8539 "Fid_InjVCD_InjVlv1_MIN" 8540 "Fid_InjVCD_InjVlv10_MIN" 8541 "Fid_InjVCD_InjVlv11_MIN" 8542 "Fid_InjVCD_InjVlv12_MIN" 8543 "Fid_InjVCD_InjVlv2_MIN" 8544 "Fid_InjVCD_InjVlv3_MIN" 8545 "Fid_InjVCD_InjVlv4_MIN" 8546 "Fid_InjVCD_InjVlv5_MIN" 8547 "Fid_InjVCD_InjVlv6_MIN" 8548 "Fid_InjVCD_InjVlv7_MIN" 8549 "Fid_InjVCD_InjVlv8_MIN" 8550 "Fid_InjVCD_InjVlv9_MIN" 8551 "Fid_InjVCD_PiIPoI_MIN" 8552 "Fid_InjVCD_WUP_MIN" 8553 "Fid_LASCD_MIN" 8554 "Fid_LASCDBRK8_MIN" 8555 "Fid_LIGovDriveAway_MIN" 8556 "Fid_LIGovUbr_MIN" 8557 "Fid_LIGovnSetPointErr_MIN" 8558 "Fid_LSUCDMon0_MIN" 8559 "Fid_LSUCDO20_MIN" 8560 "Fid_LSUCDRi0_MIN" 8561 "Fid_LSUCDactiv0_MIN" 8562 "Fid_LSUCDlsu0_MIN" 8563 "Fid_LSUClbSched_MIN" 8564 "Fid_LSUCtl0_MIN" 8565 "Fid_LSUMonAllChecks0_MIN" 8566 "Fid_LSUMonPlausChk0_MIN" 8567 "Fid_OTSCDCTSErr_MIN" 8568 "Fid_OTSCDCan_MIN" 8569 "Fid_OTSCDCanDSP2_MIN" 8570 "Fid_OTSCDCanInac_MIN" 8571 "Fid_OTSCDCanSig_MIN" 8572 "Fid_OTSCDDynTst_MIN" 8573 "Fid_OTSCDErr_MIN" 8574 "Fid_OvRMonACCTO_MIN" 8575 "Fid_OvRMonACCaFrmMng_MIN" 8576 "Fid_OvRMonBRK1TO_MIN" 8577 "Fid_OvRMonBRK8Err_MIN" 8578 "Fid_OvRMonBRK8MnBrkErr_MIN" 8579 "Fid_OvRMonCrCtlplusFin_MIN" 8580 "Fid_OvRMonShtrp_MIN" 8581 "Fid_OvRMonTSC1_MIN" 8582 "Fid_OvRMonTSC2_MIN" 8583 "Fid_OvRMonTSC3_MIN" 8584 "Fid_PCR_MIN" 8585 "Fid_PCRBalGvnr_MIN" 8586 "Fid_PCRNSShutOff_MIN" 8587 "Fid_PCRpLim_MIN" 8588 "Fid_PFltAirSysFail_MIN" 8589 "Fid_PFltChar_MIN" 8590 "Fid_PFltContPlausTemp_MIN" 8591 "Fid_PFltDynChk_MIN" 8592 "Fid_PFltHsLnChk_MIN" 8593 "Fid_PFltPlausPres_MIN" 8594 "Fid_PFltPlausTemp_MIN" 8595 "Fid_PFltPoI1Fail_MIN" 8596 "Fid_PFltPoI2Fail_MIN" 8597 "Fid_PFltPresSensDiff_MIN" 8598 "Fid_PFltPresSensFrz_MIN" 8599 "Fid_PFltPresSensHsLn_MIN" 8600 "Fid_PFltPresSensPre_MIN" 8601 "Fid_PFltRgnShOff_MIN" 8602 "Fid_PFltSRCPres_MIN" 8603 "Fid_PFltSRCTemp_MIN" 8604 "Fid_PFltSotSimPresElec_MIN" 8605 "Fid_PFltSotSimPresEnv_MIN" 8606 "Fid_PFltSotSimPresLrn_MIN" 8607 "Fid_PFltSotSimTemp_MIN" 8608 "Fid_PFltSysFail_MIN" 8609 "Fid_PFltTempModtPst_MIN" 8610 "Fid_PFltTempOxiPre_MIN" 8611 "Fid_PFltTempOxiSurf_MIN" 8612 "Fid_PFltTempPreOxiC_MIN" 8613 "Fid_PFltTempPrePFlt_MIN" 8614 "Fid_PFltTempPreTrbn_MIN" 8615 "Fid_PFltTempPstPFlt_MIN" 8616 "Fid_PFltTempSens_MIN" 8617 "Fid_PFltTempSensFrz_MIN" 8618 "Fid_PoI2HC_MIN" 8619 "Fid_PoI2HCSpd_MIN" 8620 "Fid_PoI2Lmbd_MIN" 8621 "Fid_PoI2LmbdT3_MIN" 8622 "Fid_PoI2OvR_MIN" 8623 "Fid_PrpCtl_AWD1_MIN" 8624 "Fid_PrpCtl_CANVerErr_MIN" 8625 "Fid_PrpCtl_NIVEAU1_MIN" 8626 "Fid_PrpCtl_VSSCD_MIN" 8627 "Fid_ShortTr_MIN" 8628 "Fid_ShortTrAct_MIN" 8629 "Fid_SignalsTstNLim_MIN" 8630 "Fid_SotSimEGROff_MIN" 8631 "Fid_SrvPmpStSA_MIN" 8632 "Fid_SrvPmpVSSCD_MIN" 8633 "Fid_StSysCtl_IlsPlaus_MIN" 8634 "Fid_StSysCtl_RlyErr_MIN" 8635 "Fid_StSysCtl_T50Err_MIN" 8636 "Fid_StSysCtl_VSSCD_MIN" 8637 "Fid_StSysCtltiThrsAddCr_MIN" 8638 "Fid_StSys_ESCUBSG3Err_MIN" 8639 "Fid_StSys_STIGNErr_MIN" 8640 "Fid_StSys_T50Err_MIN" 8641 "Fid_StSys_T50RErr_MIN" 8642 "Fid_StSystrqStrtAddCor_MIN" 8643 "Fid_SvLpBRK2TO_MIN" 8644 "Fid_SvLpCDTOSTO_MIN" 8645 "Fid_SvLpTOSTO_MIN" 8646 "Fid_T50CDCan_MIN" 8647 "Fid_TVASCDMon_MIN" 8648 "Fid_ThrVlvGvnrOn_MIN" 8649 "Fid_UAcc_EnvDat_MIN" 8650 "Fid_VSSCDBRK1Err_MIN" 8651 "Fid_VSSCDBRK8_MIN" 8652 "Fid_VSSCDDSP1Err_MIN" 8653 "Fid_WDASCD_MIN" 16385 "Fid_AC1Can_SIG" 16386 "Fid_AC1PresCan_SIG" 16387 "Fid_AC1TrqCan_SIG" 16388 "Fid_ACCAccPed_SIG" 16389 "Fid_ACCAirbCDCrash_SIG" 16390 "Fid_ACCBrkErr_SIG" 16391 "Fid_ACCCDBrkIRev_SIG" 16392 "Fid_ACCCDCan_SIG" 16393 "Fid_ACCCDSens_SIG" 16394 "Fid_ACCCD_VehTrail_SIG" 16395 "Fid_ACCCD_frcRoad_SIG" 16396 "Fid_ACCECUIntErr_SIG" 16397 "Fid_ACCEngCodPlb_SIG" 16398 "Fid_ACCIRev_SIG" 16399 "Fid_ACCMsgErr_SIG" 16400 "Fid_ACCOffRev_SIG" 16401 "Fid_ACCPlCheck_SIG" 16402 "Fid_ACCtl_ACP_SIG" 16403 "Fid_ACCtl_EATSCD_SIG" 16404 "Fid_ACCtl_ESCUCan_SIG" 16405 "Fid_ACCtl_FanCtl1_SIG" 16406 "Fid_ACCtl_FanCtl2_SIG" 16407 "Fid_ACCtl_SysErr_SIG" 16408 "Fid_ACCtl_TSC1Can_SIG" 16409 "Fid_ACCtl_VehStand_SIG" 16410 "Fid_AFSCD_SIG" 16411 "Fid_AFSCD_AirPerTime_SIG" 16412 "Fid_AFSCD_PlOffsDrft_SIG" 16413 "Fid_AFSCD_PlSetyDrft_SIG" 16414 "Fid_AFSCD_SRCAirm_SIG" 16415 "Fid_AFVCtlSigErr_SIG" 16416 "Fid_AOHt_AC1Err_SIG" 16417 "Fid_AOHt_AltSRC_SIG" 16418 "Fid_AOHt_CDHt1_SIG" 16419 "Fid_AOHt_CDHt2_SIG" 16420 "Fid_AOHt_ESCUErr_SIG" 16421 "Fid_AOHt_ErrHt_SIG" 16422 "Fid_APP1_SIG" 16423 "Fid_APP1_FiltOffRampOn_SIG" 16424 "Fid_APP1_Sens_SIG" 16425 "Fid_APP2_SIG" 16426 "Fid_APP2_Sens_SIG" 16427 "Fid_APPCD_EEPROM_SIG" 16428 "Fid_APPCD_Prefill_SIG" 16429 "Fid_APPKickDown_VSS_SIG" 16430 "Fid_APPKickdown_SIG" 16431 "Fid_APSCD_SIG" 16432 "Fid_ASDdc_SIG" 16433 "Fid_ASDdcNGvnr_SIG" 16434 "Fid_ASDdcTrbnSpdCAN_SIG" 16435 "Fid_AccPed_SIG" 16436 "Fid_AccPedDO_SIG" 16437 "Fid_AccPedMstrShft_SIG" 16438 "Fid_AccPedVel_SIG" 16439 "Fid_AccPed_Brk_SIG" 16440 "Fid_AccPed_BrkCDBPTInvld_SIG" 16441 "Fid_AirCtl_SIG" 16442 "Fid_AirbCDCan_SIG" 16443 "Fid_AltCDLoad_SIG" 16444 "Fid_AltCD_CANrDFM_SIG" 16445 "Fid_Alt_PwrCan_SIG" 16446 "Fid_Alt_T15_SIG" 16447 "Fid_BIP_BattCD_SIG" 16448 "Fid_BIP_Control1_SIG" 16449 "Fid_BIP_Control10_SIG" 16450 "Fid_BIP_Control11_SIG" 16451 "Fid_BIP_Control12_SIG" 16452 "Fid_BIP_Control2_SIG" 16453 "Fid_BIP_Control3_SIG" 16454 "Fid_BIP_Control4_SIG" 16455 "Fid_BIP_Control5_SIG" 16456 "Fid_BIP_Control6_SIG" 16457 "Fid_BIP_Control7_SIG" 16458 "Fid_BIP_Control8_SIG" 16459 "Fid_BIP_Control9_SIG" 16460 "Fid_BIP_Err_SIG" 16461 "Fid_BIP_Set1_SIG" 16462 "Fid_BIP_Set10_SIG" 16463 "Fid_BIP_Set11_SIG" 16464 "Fid_BIP_Set12_SIG" 16465 "Fid_BIP_Set2_SIG" 16466 "Fid_BIP_Set3_SIG" 16467 "Fid_BIP_Set4_SIG" 16468 "Fid_BIP_Set5_SIG" 16469 "Fid_BIP_Set6_SIG" 16470 "Fid_BIP_Set7_SIG" 16471 "Fid_BIP_Set8_SIG" 16472 "Fid_BIP_Set9_SIG" 16473 "Fid_BPSErr_SIG" 16474 "Fid_BrkCDBPTInvld_SIG" 16475 "Fid_BrkCDCan_SIG" 16476 "Fid_BrkCDMnBrkCan_SIG" 16477 "Fid_CRCCDCan_SIG" 16478 "Fid_CRCCDTo_SIG" 16479 "Fid_CTSCDCan_SIG" 16480 "Fid_CTSCDCanInac_SIG" 16481 "Fid_CTSCDCanSig_SIG" 16482 "Fid_CTSCDOTSErr_SIG" 16483 "Fid_CTSCDPullup_SIG" 16484 "Fid_CTSErr_SIG" 16485 "Fid_CaSCD_SegCor_SIG" 16486 "Fid_ClgDynTst_SIG" 16487 "Fid_CmbChb_SIG" 16488 "Fid_CoDT_GripDeb_SIG" 16489 "Fid_CoEngAirbCDCrash_SIG" 16490 "Fid_CoEngGW1TO_SIG" 16491 "Fid_CoEng_ActrPrt_SIG" 16492 "Fid_CoEng_FrmMngAWD1_SIG" 16493 "Fid_CoEng_IRevSys_SIG" 16494 "Fid_CoEng_IRevSys2_SIG" 16495 "Fid_CoEng_IRevVeh_SIG" 16496 "Fid_CoEng_KickDown_SIG" 16497 "Fid_CoEng_PwrStgEnable_SIG" 16498 "Fid_CoEng_RevSys_SIG" 16499 "Fid_CoEng_RevSys2_SIG" 16500 "Fid_CoEng_RevVeh_SIG" 16501 "Fid_CoEng_T15CD_SIG" 16502 "Fid_CoEng_TMFWShOff_SIG" 16503 "Fid_CoEng_trqLimBiTurbo_SIG" 16504 "Fid_CoEng_trqLimErr_SIG" 16505 "Fid_CoVM_DCSErr_SIG" 16506 "Fid_CoVM_DCSh_SIG" 16507 "Fid_CoVM_DCSp_SIG" 16508 "Fid_CoVM_TCSErr_SIG" 16509 "Fid_CoVehPnlFunc_SIG" 16510 "Fid_CoVehtrqLimErr_SIG" 16511 "Fid_ConvCDCan_SIG" 16512 "Fid_ConvCDEPB_SIG" 16513 "Fid_Conv_ClthPrt_SIG" 16514 "Fid_CrCtlACCErr_SIG" 16515 "Fid_CrCtlAirbCDCrash_SIG" 16516 "Fid_CrCtlCanBrk1_SIG" 16517 "Fid_CrCtlMsgErrBRK8_SIG" 16518 "Fid_CrCtlPAAGNpl_SIG" 16519 "Fid_CrCtlPAAGTO_SIG" 16520 "Fid_CrCtlPAAGTlrDef_SIG" 16521 "Fid_CrCtlPBRK8Npl_SIG" 16522 "Fid_CrCtlPBRK8TO_SIG" 16523 "Fid_CrCtlPBRK8TempErr_SIG" 16524 "Fid_CrCtlPBRKDlyReg_SIG" 16525 "Fid_CrCtlPECDAAG_SIG" 16526 "Fid_CrCtlPECDILM_SIG" 16527 "Fid_CrCtlPGW1TO_SIG" 16528 "Fid_CrCtlPILMNpl_SIG" 16529 "Fid_CrCtlPILMTO_SIG" 16530 "Fid_CrCtlPMsgErrBRK8_SIG" 16531 "Fid_CrCtlPStopLDef_SIG" 16532 "Fid_CrCtlPstBLS_SIG" 16533 "Fid_CrCtlPstESP_SIG" 16534 "Fid_CrCtl_CAN_SIG" 16535 "Fid_CrCtl_Dspl_SIG" 16536 "Fid_CrCtl_DsplNotPlaus_SIG" 16537 "Fid_CrCtl_VDsplNotPlaus_SIG" 16538 "Fid_CrCtl_stBrk_SIG" 16539 "Fid_CrCtl_stCaSCrS_SIG" 16540 "Fid_CrCtl_stSpeedSensor_SIG" 16541 "Fid_CrCtl_stSystem_SIG" 16542 "Fid_CtTCtl_stStageErr_SIG" 16543 "Fid_CtTCtl_tClntDs1_Err_SIG" 16544 "Fid_CtTCtl_tClntDs2_Err_SIG" 16545 "Fid_CtTCtl_tClntDs3_Err_SIG" 16546 "Fid_CtTCtl_tClntDs4_Err_SIG" 16547 "Fid_CtT_SwtOff_SIG" 16548 "Fid_CtT_SwtOff_EAT_SIG" 16549 "Fid_CtT_SwtOff_EATMod_SIG" 16550 "Fid_DIUMPRDenom_SIG" 16551 "Fid_DIUMPRIgn_SIG" 16552 "Fid_DSM_Wuc_SIG" 16553 "Fid_DiffCANerr_SIG" 16554 "Fid_DrvTrn_TransConv_SIG" 16555 "Fid_EATSCDCan_SIG" 16556 "Fid_EATSCDCanInac_SIG" 16557 "Fid_EATSCDCanSig_SIG" 16558 "Fid_EGPpCDTempDfl_SIG" 16559 "Fid_EGRSCDMon_SIG" 16560 "Fid_EGRSCDOfsLrnInh_SIG" 16561 "Fid_EGRVlvGvnrOff_SIG" 16562 "Fid_EGSysCoLSU0_SIG" 16563 "Fid_EGSysCoNSC_SIG" 16564 "Fid_EGSysCoOxi_SIG" 16565 "Fid_EGSysCoOxiBrik_SIG" 16566 "Fid_EGSysCoTrbn0_SIG" 16567 "Fid_EGSysCoTrbn1_SIG" 16568 "Fid_EGSysCoTube0_SIG" 16569 "Fid_EGSysCoTube1_SIG" 16570 "Fid_EGSysCoTube2_SIG" 16571 "Fid_EGSysCoTube3_SIG" 16572 "Fid_EGSysHtgDel_SIG" 16573 "Fid_EGSysNSC_SIG" 16574 "Fid_EGSysOxiCat_SIG" 16575 "Fid_EGSysPresEnv_SIG" 16576 "Fid_EGSysStrt_SIG" 16577 "Fid_EGSysTemp_SIG" 16578 "Fid_EGSysTrbn_SIG" 16579 "Fid_EGSysTube_SIG" 16580 "Fid_EGSys_AP_SIG" 16581 "Fid_EcuBoot_SIG" 16582 "Fid_EcuInitTimestamp_SIG" 16583 "Fid_EngMBackUpTimer_SIG" 16584 "Fid_EngMCaS1_SIG" 16585 "Fid_EngMCaSBackUp_SIG" 16586 "Fid_EngMCrS1_SIG" 16587 "Fid_EngMCrSBackUp_SIG" 16588 "Fid_EngM_ChkStrtSpd_SIG" 16589 "Fid_EngM_nCoMa_SIG" 16590 "Fid_EngM_trqFrc_SIG" 16591 "Fid_EngMon_Actv_SIG" 16592 "Fid_EngOvrSpd_SIG" 16593 "Fid_EngPOpCalc1_SIG" 16594 "Fid_EngPOpCalc2_SIG" 16595 "Fid_EngPOpCalcSpeed_SIG" 16596 "Fid_EngPOpCalcVal_SIG" 16597 "Fid_EngPrtCaS_SIG" 16598 "Fid_EngPrtCrS_SIG" 16599 "Fid_EngPrtTrqLim_SIG" 16600 "Fid_EngPrt_nLimErr_SIG" 16601 "Fid_EngdtEng_SIG" 16602 "Fid_EngdtEngCOTSCD_SIG" 16603 "Fid_EngdtEngFTSCD_SIG" 16604 "Fid_EngdtEngIATSCD_SIG" 16605 "Fid_FBC_SIG" 16606 "Fid_FMASwtOff1_SIG" 16607 "Fid_FMASwtOff3_SIG" 16608 "Fid_FTSCDNpl_SIG" 16609 "Fid_FTSErr_SIG" 16610 "Fid_FanCDActrErr_SIG" 16611 "Fid_FanCtlCanAC1_SIG" 16612 "Fid_FanCtl_COTSErr_SIG" 16613 "Fid_FanCtl_tClntErr_SIG" 16614 "Fid_FanCtl_vCurrErr_SIG" 16615 "Fid_FlMngFullLdRglOff_SIG" 16616 "Fid_FlSCDCanDef_SIG" 16617 "Fid_FlSysCTSSens_SIG" 16618 "Fid_FlSysDens_SIG" 16619 "Fid_FlSysFTSSens_SIG" 16620 "Fid_FrmMngAC_SIG" 16621 "Fid_FrmMngAC1Npl_SIG" 16622 "Fid_FrmMngAC1TO_SIG" 16623 "Fid_FrmMngACCNpl_SIG" 16624 "Fid_FrmMngACCTO_SIG" 16625 "Fid_FrmMngACCWrongCoded_SIG" 16626 "Fid_FrmMngAIRBGNpl_SIG" 16627 "Fid_FrmMngAIRBGTO_SIG" 16628 "Fid_FrmMngALTCD_Load_SIG" 16629 "Fid_FrmMngAPP_SIG" 16630 "Fid_FrmMngAPPRAW_SIG" 16631 "Fid_FrmMngAPS_SIG" 16632 "Fid_FrmMngAWD1Npl_SIG" 16633 "Fid_FrmMngAWD1TO_SIG" 16634 "Fid_FrmMngBEM1Npl_SIG" 16635 "Fid_FrmMngBEM1TO_SIG" 16636 "Fid_FrmMngBPSCD_IntVal_SIG" 16637 "Fid_FrmMngBRK1Npl_SIG" 16638 "Fid_FrmMngBRK1TO_SIG" 16639 "Fid_FrmMngBRK2Npl_SIG" 16640 "Fid_FrmMngBRK2TO_SIG" 16641 "Fid_FrmMngBRK8Npl_SIG" 16642 "Fid_FrmMngBRK8TO_SIG" 16643 "Fid_FrmMngCCTLNpl_SIG" 16644 "Fid_FrmMngCCTLTO_SIG" 16645 "Fid_FrmMngCHRGR1Npl_SIG" 16646 "Fid_FrmMngCHRGR1TO_SIG" 16647 "Fid_FrmMngCHRGR2Npl_SIG" 16648 "Fid_FrmMngCHRGR2TO_SIG" 16649 "Fid_FrmMngCTSCD_SIG" 16650 "Fid_FrmMngCurInf_SIG" 16651 "Fid_FrmMngDIA1Npl_SIG" 16652 "Fid_FrmMngDIA1TO_SIG" 16653 "Fid_FrmMngDSP1Npl_SIG" 16654 "Fid_FrmMngDSP1TO_SIG" 16655 "Fid_FrmMngDSP2Npl_SIG" 16656 "Fid_FrmMngDSP2TO_SIG" 16657 "Fid_FrmMngDSP3Npl_SIG" 16658 "Fid_FrmMngDSP3TO_SIG" 16659 "Fid_FrmMngEPB1Npl_SIG" 16660 "Fid_FrmMngEPB1TO_SIG" 16661 "Fid_FrmMngESCUNpl_SIG" 16662 "Fid_FrmMngESCUTO_SIG" 16663 "Fid_FrmMngFlxTOSTO_SIG" 16664 "Fid_FrmMngGW1Npl_SIG" 16665 "Fid_FrmMngGW1TO_SIG" 16666 "Fid_FrmMngIATS_SIG" 16667 "Fid_FrmMngNIVEAU1Npl_SIG" 16668 "Fid_FrmMngNIVEAU1TO_SIG" 16669 "Fid_FrmMngPrcFan_SIG" 16670 "Fid_FrmMngSA1Npl_SIG" 16671 "Fid_FrmMngSA1TO_SIG" 16672 "Fid_FrmMngSTIGNNpl_SIG" 16673 "Fid_FrmMngSTIGNTO_SIG" 16674 "Fid_FrmMngSrvPmp_SIG" 16675 "Fid_FrmMngTCSTO_SIG" 16676 "Fid_FrmMngTOSNpl_SIG" 16677 "Fid_FrmMngTOSTO_SIG" 16678 "Fid_FrmMngTSC1Npl_SIG" 16679 "Fid_FrmMngTSC1TO_SIG" 16680 "Fid_FrmMngTSC2Npl_SIG" 16681 "Fid_FrmMngTSC2TO_SIG" 16682 "Fid_FrmMngTSC3Npl_SIG" 16683 "Fid_FrmMngTSC3TO_SIG" 16684 "Fid_FrmMngTSC6Npl_SIG" 16685 "Fid_FrmMngTSC6TO_SIG" 16686 "Fid_FrmMngVCurEng2_SIG" 16687 "Fid_FrmMng_AltPwrCan_SIG" 16688 "Fid_FrmMng_GlwCD_Actr_SIG" 16689 "Fid_FrmMng_GlwCtl_Rly_SIG" 16690 "Fid_FrmMng_KickDown_SIG" 16691 "Fid_GbSSCD_SIG" 16692 "Fid_GbSSCD_HW_SIG" 16693 "Fid_GearbxCanTSC2_SIG" 16694 "Fid_GearbxClthPlaus_SIG" 16695 "Fid_GearbxINCCup_SIG" 16696 "Fid_GearbxNMinDis_SIG" 16697 "Fid_GearbxTrbnSpdCAN_SIG" 16698 "Fid_Gearbx_CANerr_SIG" 16699 "Fid_Gearbx_Eng_SIG" 16700 "Fid_Gearbx_EngCTS_SIG" 16701 "Fid_Gearbx_EngFrc_SIG" 16702 "Fid_Gearbx_EngFrcVehSpeed_SIG" 16703 "Fid_Gearbx_EngOTS_SIG" 16704 "Fid_Gearbx_FrmMngAWD1_SIG" 16705 "Fid_Gearbx_GearDet_SIG" 16706 "Fid_Gearbx_TSC1Err_SIG" 16707 "Fid_Gearbx_TSC2Err_SIG" 16708 "Fid_Gearbx_TSC3Err_SIG" 16709 "Fid_Gearbx_TransConv_SIG" 16710 "Fid_GlwCDCan_SIG" 16711 "Fid_GlwCDCod_SIG" 16712 "Fid_GlwCtl1_SIG" 16713 "Fid_GlwCtl2_SIG" 16714 "Fid_GlwCtl3_SIG" 16715 "Fid_HDSCD_SSpMon1_SIG" 16716 "Fid_IATSErr_SIG" 16717 "Fid_IndSysMonIntMnf_SIG" 16718 "Fid_IndSys_MonVac_SIG" 16719 "Fid_IndSys_pAdj_SIG" 16720 "Fid_InjCrvCTS_SIG" 16721 "Fid_InjCrvDyn_SIG" 16722 "Fid_InjCrvFTS_SIG" 16723 "Fid_InjCrvT3Dia_SIG" 16724 "Fid_InjCrv_phiStartAddCor_SIG" 16725 "Fid_InjCrv_stPiI1_SIG" 16726 "Fid_InjCtl_qLimErr_SIG" 16727 "Fid_InjUnAlt_SIG" 16728 "Fid_InjUnIATS_SIG" 16729 "Fid_InjUnSpdErr_SIG" 16730 "Fid_InjUn_qRed_SIG" 16731 "Fid_InjVCD_InjVlv1_SIG" 16732 "Fid_InjVCD_InjVlv10_SIG" 16733 "Fid_InjVCD_InjVlv11_SIG" 16734 "Fid_InjVCD_InjVlv12_SIG" 16735 "Fid_InjVCD_InjVlv2_SIG" 16736 "Fid_InjVCD_InjVlv3_SIG" 16737 "Fid_InjVCD_InjVlv4_SIG" 16738 "Fid_InjVCD_InjVlv5_SIG" 16739 "Fid_InjVCD_InjVlv6_SIG" 16740 "Fid_InjVCD_InjVlv7_SIG" 16741 "Fid_InjVCD_InjVlv8_SIG" 16742 "Fid_InjVCD_InjVlv9_SIG" 16743 "Fid_InjVCD_PiIPoI_SIG" 16744 "Fid_InjVCD_WUP_SIG" 16745 "Fid_LASCD_SIG" 16746 "Fid_LASCDBRK8_SIG" 16747 "Fid_LIGovDriveAway_SIG" 16748 "Fid_LIGovUbr_SIG" 16749 "Fid_LIGovnSetPointErr_SIG" 16750 "Fid_LSUCDMon0_SIG" 16751 "Fid_LSUCDO20_SIG" 16752 "Fid_LSUCDRi0_SIG" 16753 "Fid_LSUCDactiv0_SIG" 16754 "Fid_LSUCDlsu0_SIG" 16755 "Fid_LSUClbSched_SIG" 16756 "Fid_LSUCtl0_SIG" 16757 "Fid_LSUMonAllChecks0_SIG" 16758 "Fid_LSUMonPlausChk0_SIG" 16759 "Fid_OTSCDCTSErr_SIG" 16760 "Fid_OTSCDCan_SIG" 16761 "Fid_OTSCDCanDSP2_SIG" 16762 "Fid_OTSCDCanInac_SIG" 16763 "Fid_OTSCDCanSig_SIG" 16764 "Fid_OTSCDDynTst_SIG" 16765 "Fid_OTSCDErr_SIG" 16766 "Fid_OvRMonACCTO_SIG" 16767 "Fid_OvRMonACCaFrmMng_SIG" 16768 "Fid_OvRMonBRK1TO_SIG" 16769 "Fid_OvRMonBRK8Err_SIG" 16770 "Fid_OvRMonBRK8MnBrkErr_SIG" 16771 "Fid_OvRMonCrCtlplusFin_SIG" 16772 "Fid_OvRMonShtrp_SIG" 16773 "Fid_OvRMonTSC1_SIG" 16774 "Fid_OvRMonTSC2_SIG" 16775 "Fid_OvRMonTSC3_SIG" 16776 "Fid_PCR_SIG" 16777 "Fid_PCRBalGvnr_SIG" 16778 "Fid_PCRNSShutOff_SIG" 16779 "Fid_PCRpLim_SIG" 16780 "Fid_PFltAirSysFail_SIG" 16781 "Fid_PFltChar_SIG" 16782 "Fid_PFltContPlausTemp_SIG" 16783 "Fid_PFltDynChk_SIG" 16784 "Fid_PFltHsLnChk_SIG" 16785 "Fid_PFltPlausPres_SIG" 16786 "Fid_PFltPlausTemp_SIG" 16787 "Fid_PFltPoI1Fail_SIG" 16788 "Fid_PFltPoI2Fail_SIG" 16789 "Fid_PFltPresSensDiff_SIG" 16790 "Fid_PFltPresSensFrz_SIG" 16791 "Fid_PFltPresSensHsLn_SIG" 16792 "Fid_PFltPresSensPre_SIG" 16793 "Fid_PFltRgnShOff_SIG" 16794 "Fid_PFltSRCPres_SIG" 16795 "Fid_PFltSRCTemp_SIG" 16796 "Fid_PFltSotSimPresElec_SIG" 16797 "Fid_PFltSotSimPresEnv_SIG" 16798 "Fid_PFltSotSimPresLrn_SIG" 16799 "Fid_PFltSotSimTemp_SIG" 16800 "Fid_PFltSysFail_SIG" 16801 "Fid_PFltTempModtPst_SIG" 16802 "Fid_PFltTempOxiPre_SIG" 16803 "Fid_PFltTempOxiSurf_SIG" 16804 "Fid_PFltTempPreOxiC_SIG" 16805 "Fid_PFltTempPrePFlt_SIG" 16806 "Fid_PFltTempPreTrbn_SIG" 16807 "Fid_PFltTempPstPFlt_SIG" 16808 "Fid_PFltTempSens_SIG" 16809 "Fid_PFltTempSensFrz_SIG" 16810 "Fid_PoI2HC_SIG" 16811 "Fid_PoI2HCSpd_SIG" 16812 "Fid_PoI2Lmbd_SIG" 16813 "Fid_PoI2LmbdT3_SIG" 16814 "Fid_PoI2OvR_SIG" 16815 "Fid_PrpCtl_AWD1_SIG" 16816 "Fid_PrpCtl_CANVerErr_SIG" 16817 "Fid_PrpCtl_NIVEAU1_SIG" 16818 "Fid_PrpCtl_VSSCD_SIG" 16819 "Fid_ShortTr_SIG" 16820 "Fid_ShortTrAct_SIG" 16821 "Fid_SignalsTstNLim_SIG" 16822 "Fid_SotSimEGROff_SIG" 16823 "Fid_SrvPmpStSA_SIG" 16824 "Fid_SrvPmpVSSCD_SIG" 16825 "Fid_StSysCtl_IlsPlaus_SIG" 16826 "Fid_StSysCtl_RlyErr_SIG" 16827 "Fid_StSysCtl_T50Err_SIG" 16828 "Fid_StSysCtl_VSSCD_SIG" 16829 "Fid_StSysCtltiThrsAddCr_SIG" 16830 "Fid_StSys_ESCUBSG3Err_SIG" 16831 "Fid_StSys_STIGNErr_SIG" 16832 "Fid_StSys_T50Err_SIG" 16833 "Fid_StSys_T50RErr_SIG" 16834 "Fid_StSystrqStrtAddCor_SIG" 16835 "Fid_SvLpBRK2TO_SIG" 16836 "Fid_SvLpCDTOSTO_SIG" 16837 "Fid_SvLpTOSTO_SIG" 16838 "Fid_T50CDCan_SIG" 16839 "Fid_TVASCDMon_SIG" 16840 "Fid_ThrVlvGvnrOn_SIG" 16841 "Fid_UAcc_EnvDat_SIG" 16842 "Fid_VSSCDBRK1Err_SIG" 16843 "Fid_VSSCDBRK8_SIG" 16844 "Fid_VSSCDDSP1Err_SIG" 16845 "Fid_WDASCD_SIG" 32769 "Fid_AC1Can_NPL" 32770 "Fid_AC1PresCan_NPL" 32771 "Fid_AC1TrqCan_NPL" 32772 "Fid_ACCAccPed_NPL" 32773 "Fid_ACCAirbCDCrash_NPL" 32774 "Fid_ACCBrkErr_NPL" 32775 "Fid_ACCCDBrkIRev_NPL" 32776 "Fid_ACCCDCan_NPL" 32777 "Fid_ACCCDSens_NPL" 32778 "Fid_ACCCD_VehTrail_NPL" 32779 "Fid_ACCCD_frcRoad_NPL" 32780 "Fid_ACCECUIntErr_NPL" 32781 "Fid_ACCEngCodPlb_NPL" 32782 "Fid_ACCIRev_NPL" 32783 "Fid_ACCMsgErr_NPL" 32784 "Fid_ACCOffRev_NPL" 32785 "Fid_ACCPlCheck_NPL" 32786 "Fid_ACCtl_ACP_NPL" 32787 "Fid_ACCtl_EATSCD_NPL" 32788 "Fid_ACCtl_ESCUCan_NPL" 32789 "Fid_ACCtl_FanCtl1_NPL" 32790 "Fid_ACCtl_FanCtl2_NPL" 32791 "Fid_ACCtl_SysErr_NPL" 32792 "Fid_ACCtl_TSC1Can_NPL" 32793 "Fid_ACCtl_VehStand_NPL" 32794 "Fid_AFSCD_NPL" 32795 "Fid_AFSCD_AirPerTime_NPL" 32796 "Fid_AFSCD_PlOffsDrft_NPL" 32797 "Fid_AFSCD_PlSetyDrft_NPL" 32798 "Fid_AFSCD_SRCAirm_NPL" 32799 "Fid_AFVCtlSigErr_NPL" 32800 "Fid_AOHt_AC1Err_NPL" 32801 "Fid_AOHt_AltSRC_NPL" 32802 "Fid_AOHt_CDHt1_NPL" 32803 "Fid_AOHt_CDHt2_NPL" 32804 "Fid_AOHt_ESCUErr_NPL" 32805 "Fid_AOHt_ErrHt_NPL" 32806 "Fid_APP1_NPL" 32807 "Fid_APP1_FiltOffRampOn_NPL" 32808 "Fid_APP1_Sens_NPL" 32809 "Fid_APP2_NPL" 32810 "Fid_APP2_Sens_NPL" 32811 "Fid_APPCD_EEPROM_NPL" 32812 "Fid_APPCD_Prefill_NPL" 32813 "Fid_APPKickDown_VSS_NPL" 32814 "Fid_APPKickdown_NPL" 32815 "Fid_APSCD_NPL" 32816 "Fid_ASDdc_NPL" 32817 "Fid_ASDdcNGvnr_NPL" 32818 "Fid_ASDdcTrbnSpdCAN_NPL" 32819 "Fid_AccPed_NPL" 32820 "Fid_AccPedDO_NPL" 32821 "Fid_AccPedMstrShft_NPL" 32822 "Fid_AccPedVel_NPL" 32823 "Fid_AccPed_Brk_NPL" 32824 "Fid_AccPed_BrkCDBPTInvld_NPL" 32825 "Fid_AirCtl_NPL" 32826 "Fid_AirbCDCan_NPL" 32827 "Fid_AltCDLoad_NPL" 32828 "Fid_AltCD_CANrDFM_NPL" 32829 "Fid_Alt_PwrCan_NPL" 32830 "Fid_Alt_T15_NPL" 32831 "Fid_BIP_BattCD_NPL" 32832 "Fid_BIP_Control1_NPL" 32833 "Fid_BIP_Control10_NPL" 32834 "Fid_BIP_Control11_NPL" 32835 "Fid_BIP_Control12_NPL" 32836 "Fid_BIP_Control2_NPL" 32837 "Fid_BIP_Control3_NPL" 32838 "Fid_BIP_Control4_NPL" 32839 "Fid_BIP_Control5_NPL" 32840 "Fid_BIP_Control6_NPL" 32841 "Fid_BIP_Control7_NPL" 32842 "Fid_BIP_Control8_NPL" 32843 "Fid_BIP_Control9_NPL" 32844 "Fid_BIP_Err_NPL" 32845 "Fid_BIP_Set1_NPL" 32846 "Fid_BIP_Set10_NPL" 32847 "Fid_BIP_Set11_NPL" 32848 "Fid_BIP_Set12_NPL" 32849 "Fid_BIP_Set2_NPL" 32850 "Fid_BIP_Set3_NPL" 32851 "Fid_BIP_Set4_NPL" 32852 "Fid_BIP_Set5_NPL" 32853 "Fid_BIP_Set6_NPL" 32854 "Fid_BIP_Set7_NPL" 32855 "Fid_BIP_Set8_NPL" 32856 "Fid_BIP_Set9_NPL" 32857 "Fid_BPSErr_NPL" 32858 "Fid_BrkCDBPTInvld_NPL" 32859 "Fid_BrkCDCan_NPL" 32860 "Fid_BrkCDMnBrkCan_NPL" 32861 "Fid_CRCCDCan_NPL" 32862 "Fid_CRCCDTo_NPL" 32863 "Fid_CTSCDCan_NPL" 32864 "Fid_CTSCDCanInac_NPL" 32865 "Fid_CTSCDCanSig_NPL" 32866 "Fid_CTSCDOTSErr_NPL" 32867 "Fid_CTSCDPullup_NPL" 32868 "Fid_CTSErr_NPL" 32869 "Fid_CaSCD_SegCor_NPL" 32870 "Fid_ClgDynTst_NPL" 32871 "Fid_CmbChb_NPL" 32872 "Fid_CoDT_GripDeb_NPL" 32873 "Fid_CoEngAirbCDCrash_NPL" 32874 "Fid_CoEngGW1TO_NPL" 32875 "Fid_CoEng_ActrPrt_NPL" 32876 "Fid_CoEng_FrmMngAWD1_NPL" 32877 "Fid_CoEng_IRevSys_NPL" 32878 "Fid_CoEng_IRevSys2_NPL" 32879 "Fid_CoEng_IRevVeh_NPL" 32880 "Fid_CoEng_KickDown_NPL" 32881 "Fid_CoEng_PwrStgEnable_NPL" 32882 "Fid_CoEng_RevSys_NPL" 32883 "Fid_CoEng_RevSys2_NPL" 32884 "Fid_CoEng_RevVeh_NPL" 32885 "Fid_CoEng_T15CD_NPL" 32886 "Fid_CoEng_TMFWShOff_NPL" 32887 "Fid_CoEng_trqLimBiTurbo_NPL" 32888 "Fid_CoEng_trqLimErr_NPL" 32889 "Fid_CoVM_DCSErr_NPL" 32890 "Fid_CoVM_DCSh_NPL" 32891 "Fid_CoVM_DCSp_NPL" 32892 "Fid_CoVM_TCSErr_NPL" 32893 "Fid_CoVehPnlFunc_NPL" 32894 "Fid_CoVehtrqLimErr_NPL" 32895 "Fid_ConvCDCan_NPL" 32896 "Fid_ConvCDEPB_NPL" 32897 "Fid_Conv_ClthPrt_NPL" 32898 "Fid_CrCtlACCErr_NPL" 32899 "Fid_CrCtlAirbCDCrash_NPL" 32900 "Fid_CrCtlCanBrk1_NPL" 32901 "Fid_CrCtlMsgErrBRK8_NPL" 32902 "Fid_CrCtlPAAGNpl_NPL" 32903 "Fid_CrCtlPAAGTO_NPL" 32904 "Fid_CrCtlPAAGTlrDef_NPL" 32905 "Fid_CrCtlPBRK8Npl_NPL" 32906 "Fid_CrCtlPBRK8TO_NPL" 32907 "Fid_CrCtlPBRK8TempErr_NPL" 32908 "Fid_CrCtlPBRKDlyReg_NPL" 32909 "Fid_CrCtlPECDAAG_NPL" 32910 "Fid_CrCtlPECDILM_NPL" 32911 "Fid_CrCtlPGW1TO_NPL" 32912 "Fid_CrCtlPILMNpl_NPL" 32913 "Fid_CrCtlPILMTO_NPL" 32914 "Fid_CrCtlPMsgErrBRK8_NPL" 32915 "Fid_CrCtlPStopLDef_NPL" 32916 "Fid_CrCtlPstBLS_NPL" 32917 "Fid_CrCtlPstESP_NPL" 32918 "Fid_CrCtl_CAN_NPL" 32919 "Fid_CrCtl_Dspl_NPL" 32920 "Fid_CrCtl_DsplNotPlaus_NPL" 32921 "Fid_CrCtl_VDsplNotPlaus_NPL" 32922 "Fid_CrCtl_stBrk_NPL" 32923 "Fid_CrCtl_stCaSCrS_NPL" 32924 "Fid_CrCtl_stSpeedSensor_NPL" 32925 "Fid_CrCtl_stSystem_NPL" 32926 "Fid_CtTCtl_stStageErr_NPL" 32927 "Fid_CtTCtl_tClntDs1_Err_NPL" 32928 "Fid_CtTCtl_tClntDs2_Err_NPL" 32929 "Fid_CtTCtl_tClntDs3_Err_NPL" 32930 "Fid_CtTCtl_tClntDs4_Err_NPL" 32931 "Fid_CtT_SwtOff_NPL" 32932 "Fid_CtT_SwtOff_EAT_NPL" 32933 "Fid_CtT_SwtOff_EATMod_NPL" 32934 "Fid_DIUMPRDenom_NPL" 32935 "Fid_DIUMPRIgn_NPL" 32936 "Fid_DSM_Wuc_NPL" 32937 "Fid_DiffCANerr_NPL" 32938 "Fid_DrvTrn_TransConv_NPL" 32939 "Fid_EATSCDCan_NPL" 32940 "Fid_EATSCDCanInac_NPL" 32941 "Fid_EATSCDCanSig_NPL" 32942 "Fid_EGPpCDTempDfl_NPL" 32943 "Fid_EGRSCDMon_NPL" 32944 "Fid_EGRSCDOfsLrnInh_NPL" 32945 "Fid_EGRVlvGvnrOff_NPL" 32946 "Fid_EGSysCoLSU0_NPL" 32947 "Fid_EGSysCoNSC_NPL" 32948 "Fid_EGSysCoOxi_NPL" 32949 "Fid_EGSysCoOxiBrik_NPL" 32950 "Fid_EGSysCoTrbn0_NPL" 32951 "Fid_EGSysCoTrbn1_NPL" 32952 "Fid_EGSysCoTube0_NPL" 32953 "Fid_EGSysCoTube1_NPL" 32954 "Fid_EGSysCoTube2_NPL" 32955 "Fid_EGSysCoTube3_NPL" 32956 "Fid_EGSysHtgDel_NPL" 32957 "Fid_EGSysNSC_NPL" 32958 "Fid_EGSysOxiCat_NPL" 32959 "Fid_EGSysPresEnv_NPL" 32960 "Fid_EGSysStrt_NPL" 32961 "Fid_EGSysTemp_NPL" 32962 "Fid_EGSysTrbn_NPL" 32963 "Fid_EGSysTube_NPL" 32964 "Fid_EGSys_AP_NPL" 32965 "Fid_EcuBoot_NPL" 32966 "Fid_EcuInitTimestamp_NPL" 32967 "Fid_EngMBackUpTimer_NPL" 32968 "Fid_EngMCaS1_NPL" 32969 "Fid_EngMCaSBackUp_NPL" 32970 "Fid_EngMCrS1_NPL" 32971 "Fid_EngMCrSBackUp_NPL" 32972 "Fid_EngM_ChkStrtSpd_NPL" 32973 "Fid_EngM_nCoMa_NPL" 32974 "Fid_EngM_trqFrc_NPL" 32975 "Fid_EngMon_Actv_NPL" 32976 "Fid_EngOvrSpd_NPL" 32977 "Fid_EngPOpCalc1_NPL" 32978 "Fid_EngPOpCalc2_NPL" 32979 "Fid_EngPOpCalcSpeed_NPL" 32980 "Fid_EngPOpCalcVal_NPL" 32981 "Fid_EngPrtCaS_NPL" 32982 "Fid_EngPrtCrS_NPL" 32983 "Fid_EngPrtTrqLim_NPL" 32984 "Fid_EngPrt_nLimErr_NPL" 32985 "Fid_EngdtEng_NPL" 32986 "Fid_EngdtEngCOTSCD_NPL" 32987 "Fid_EngdtEngFTSCD_NPL" 32988 "Fid_EngdtEngIATSCD_NPL" 32989 "Fid_FBC_NPL" 32990 "Fid_FMASwtOff1_NPL" 32991 "Fid_FMASwtOff3_NPL" 32992 "Fid_FTSCDNpl_NPL" 32993 "Fid_FTSErr_NPL" 32994 "Fid_FanCDActrErr_NPL" 32995 "Fid_FanCtlCanAC1_NPL" 32996 "Fid_FanCtl_COTSErr_NPL" 32997 "Fid_FanCtl_tClntErr_NPL" 32998 "Fid_FanCtl_vCurrErr_NPL" 32999 "Fid_FlMngFullLdRglOff_NPL" 33000 "Fid_FlSCDCanDef_NPL" 33001 "Fid_FlSysCTSSens_NPL" 33002 "Fid_FlSysDens_NPL" 33003 "Fid_FlSysFTSSens_NPL" 33004 "Fid_FrmMngAC_NPL" 33005 "Fid_FrmMngAC1Npl_NPL" 33006 "Fid_FrmMngAC1TO_NPL" 33007 "Fid_FrmMngACCNpl_NPL" 33008 "Fid_FrmMngACCTO_NPL" 33009 "Fid_FrmMngACCWrongCoded_NPL" 33010 "Fid_FrmMngAIRBGNpl_NPL" 33011 "Fid_FrmMngAIRBGTO_NPL" 33012 "Fid_FrmMngALTCD_Load_NPL" 33013 "Fid_FrmMngAPP_NPL" 33014 "Fid_FrmMngAPPRAW_NPL" 33015 "Fid_FrmMngAPS_NPL" 33016 "Fid_FrmMngAWD1Npl_NPL" 33017 "Fid_FrmMngAWD1TO_NPL" 33018 "Fid_FrmMngBEM1Npl_NPL" 33019 "Fid_FrmMngBEM1TO_NPL" 33020 "Fid_FrmMngBPSCD_IntVal_NPL" 33021 "Fid_FrmMngBRK1Npl_NPL" 33022 "Fid_FrmMngBRK1TO_NPL" 33023 "Fid_FrmMngBRK2Npl_NPL" 33024 "Fid_FrmMngBRK2TO_NPL" 33025 "Fid_FrmMngBRK8Npl_NPL" 33026 "Fid_FrmMngBRK8TO_NPL" 33027 "Fid_FrmMngCCTLNpl_NPL" 33028 "Fid_FrmMngCCTLTO_NPL" 33029 "Fid_FrmMngCHRGR1Npl_NPL" 33030 "Fid_FrmMngCHRGR1TO_NPL" 33031 "Fid_FrmMngCHRGR2Npl_NPL" 33032 "Fid_FrmMngCHRGR2TO_NPL" 33033 "Fid_FrmMngCTSCD_NPL" 33034 "Fid_FrmMngCurInf_NPL" 33035 "Fid_FrmMngDIA1Npl_NPL" 33036 "Fid_FrmMngDIA1TO_NPL" 33037 "Fid_FrmMngDSP1Npl_NPL" 33038 "Fid_FrmMngDSP1TO_NPL" 33039 "Fid_FrmMngDSP2Npl_NPL" 33040 "Fid_FrmMngDSP2TO_NPL" 33041 "Fid_FrmMngDSP3Npl_NPL" 33042 "Fid_FrmMngDSP3TO_NPL" 33043 "Fid_FrmMngEPB1Npl_NPL" 33044 "Fid_FrmMngEPB1TO_NPL" 33045 "Fid_FrmMngESCUNpl_NPL" 33046 "Fid_FrmMngESCUTO_NPL" 33047 "Fid_FrmMngFlxTOSTO_NPL" 33048 "Fid_FrmMngGW1Npl_NPL" 33049 "Fid_FrmMngGW1TO_NPL" 33050 "Fid_FrmMngIATS_NPL" 33051 "Fid_FrmMngNIVEAU1Npl_NPL" 33052 "Fid_FrmMngNIVEAU1TO_NPL" 33053 "Fid_FrmMngPrcFan_NPL" 33054 "Fid_FrmMngSA1Npl_NPL" 33055 "Fid_FrmMngSA1TO_NPL" 33056 "Fid_FrmMngSTIGNNpl_NPL" 33057 "Fid_FrmMngSTIGNTO_NPL" 33058 "Fid_FrmMngSrvPmp_NPL" 33059 "Fid_FrmMngTCSTO_NPL" 33060 "Fid_FrmMngTOSNpl_NPL" 33061 "Fid_FrmMngTOSTO_NPL" 33062 "Fid_FrmMngTSC1Npl_NPL" 33063 "Fid_FrmMngTSC1TO_NPL" 33064 "Fid_FrmMngTSC2Npl_NPL" 33065 "Fid_FrmMngTSC2TO_NPL" 33066 "Fid_FrmMngTSC3Npl_NPL" 33067 "Fid_FrmMngTSC3TO_NPL" 33068 "Fid_FrmMngTSC6Npl_NPL" 33069 "Fid_FrmMngTSC6TO_NPL" 33070 "Fid_FrmMngVCurEng2_NPL" 33071 "Fid_FrmMng_AltPwrCan_NPL" 33072 "Fid_FrmMng_GlwCD_Actr_NPL" 33073 "Fid_FrmMng_GlwCtl_Rly_NPL" 33074 "Fid_FrmMng_KickDown_NPL" 33075 "Fid_GbSSCD_NPL" 33076 "Fid_GbSSCD_HW_NPL" 33077 "Fid_GearbxCanTSC2_NPL" 33078 "Fid_GearbxClthPlaus_NPL" 33079 "Fid_GearbxINCCup_NPL" 33080 "Fid_GearbxNMinDis_NPL" 33081 "Fid_GearbxTrbnSpdCAN_NPL" 33082 "Fid_Gearbx_CANerr_NPL" 33083 "Fid_Gearbx_Eng_NPL" 33084 "Fid_Gearbx_EngCTS_NPL" 33085 "Fid_Gearbx_EngFrc_NPL" 33086 "Fid_Gearbx_EngFrcVehSpeed_NPL" 33087 "Fid_Gearbx_EngOTS_NPL" 33088 "Fid_Gearbx_FrmMngAWD1_NPL" 33089 "Fid_Gearbx_GearDet_NPL" 33090 "Fid_Gearbx_TSC1Err_NPL" 33091 "Fid_Gearbx_TSC2Err_NPL" 33092 "Fid_Gearbx_TSC3Err_NPL" 33093 "Fid_Gearbx_TransConv_NPL" 33094 "Fid_GlwCDCan_NPL" 33095 "Fid_GlwCDCod_NPL" 33096 "Fid_GlwCtl1_NPL" 33097 "Fid_GlwCtl2_NPL" 33098 "Fid_GlwCtl3_NPL" 33099 "Fid_HDSCD_SSpMon1_NPL" 33100 "Fid_IATSErr_NPL" 33101 "Fid_IndSysMonIntMnf_NPL" 33102 "Fid_IndSys_MonVac_NPL" 33103 "Fid_IndSys_pAdj_NPL" 33104 "Fid_InjCrvCTS_NPL" 33105 "Fid_InjCrvDyn_NPL" 33106 "Fid_InjCrvFTS_NPL" 33107 "Fid_InjCrvT3Dia_NPL" 33108 "Fid_InjCrv_phiStartAddCor_NPL" 33109 "Fid_InjCrv_stPiI1_NPL" 33110 "Fid_InjCtl_qLimErr_NPL" 33111 "Fid_InjUnAlt_NPL" 33112 "Fid_InjUnIATS_NPL" 33113 "Fid_InjUnSpdErr_NPL" 33114 "Fid_InjUn_qRed_NPL" 33115 "Fid_InjVCD_InjVlv1_NPL" 33116 "Fid_InjVCD_InjVlv10_NPL" 33117 "Fid_InjVCD_InjVlv11_NPL" 33118 "Fid_InjVCD_InjVlv12_NPL" 33119 "Fid_InjVCD_InjVlv2_NPL" 33120 "Fid_InjVCD_InjVlv3_NPL" 33121 "Fid_InjVCD_InjVlv4_NPL" 33122 "Fid_InjVCD_InjVlv5_NPL" 33123 "Fid_InjVCD_InjVlv6_NPL" 33124 "Fid_InjVCD_InjVlv7_NPL" 33125 "Fid_InjVCD_InjVlv8_NPL" 33126 "Fid_InjVCD_InjVlv9_NPL" 33127 "Fid_InjVCD_PiIPoI_NPL" 33128 "Fid_InjVCD_WUP_NPL" 33129 "Fid_LASCD_NPL" 33130 "Fid_LASCDBRK8_NPL" 33131 "Fid_LIGovDriveAway_NPL" 33132 "Fid_LIGovUbr_NPL" 33133 "Fid_LIGovnSetPointErr_NPL" 33134 "Fid_LSUCDMon0_NPL" 33135 "Fid_LSUCDO20_NPL" 33136 "Fid_LSUCDRi0_NPL" 33137 "Fid_LSUCDactiv0_NPL" 33138 "Fid_LSUCDlsu0_NPL" 33139 "Fid_LSUClbSched_NPL" 33140 "Fid_LSUCtl0_NPL" 33141 "Fid_LSUMonAllChecks0_NPL" 33142 "Fid_LSUMonPlausChk0_NPL" 33143 "Fid_OTSCDCTSErr_NPL" 33144 "Fid_OTSCDCan_NPL" 33145 "Fid_OTSCDCanDSP2_NPL" 33146 "Fid_OTSCDCanInac_NPL" 33147 "Fid_OTSCDCanSig_NPL" 33148 "Fid_OTSCDDynTst_NPL" 33149 "Fid_OTSCDErr_NPL" 33150 "Fid_OvRMonACCTO_NPL" 33151 "Fid_OvRMonACCaFrmMng_NPL" 33152 "Fid_OvRMonBRK1TO_NPL" 33153 "Fid_OvRMonBRK8Err_NPL" 33154 "Fid_OvRMonBRK8MnBrkErr_NPL" 33155 "Fid_OvRMonCrCtlplusFin_NPL" 33156 "Fid_OvRMonShtrp_NPL" 33157 "Fid_OvRMonTSC1_NPL" 33158 "Fid_OvRMonTSC2_NPL" 33159 "Fid_OvRMonTSC3_NPL" 33160 "Fid_PCR_NPL" 33161 "Fid_PCRBalGvnr_NPL" 33162 "Fid_PCRNSShutOff_NPL" 33163 "Fid_PCRpLim_NPL" 33164 "Fid_PFltAirSysFail_NPL" 33165 "Fid_PFltChar_NPL" 33166 "Fid_PFltContPlausTemp_NPL" 33167 "Fid_PFltDynChk_NPL" 33168 "Fid_PFltHsLnChk_NPL" 33169 "Fid_PFltPlausPres_NPL" 33170 "Fid_PFltPlausTemp_NPL" 33171 "Fid_PFltPoI1Fail_NPL" 33172 "Fid_PFltPoI2Fail_NPL" 33173 "Fid_PFltPresSensDiff_NPL" 33174 "Fid_PFltPresSensFrz_NPL" 33175 "Fid_PFltPresSensHsLn_NPL" 33176 "Fid_PFltPresSensPre_NPL" 33177 "Fid_PFltRgnShOff_NPL" 33178 "Fid_PFltSRCPres_NPL" 33179 "Fid_PFltSRCTemp_NPL" 33180 "Fid_PFltSotSimPresElec_NPL" 33181 "Fid_PFltSotSimPresEnv_NPL" 33182 "Fid_PFltSotSimPresLrn_NPL" 33183 "Fid_PFltSotSimTemp_NPL" 33184 "Fid_PFltSysFail_NPL" 33185 "Fid_PFltTempModtPst_NPL" 33186 "Fid_PFltTempOxiPre_NPL" 33187 "Fid_PFltTempOxiSurf_NPL" 33188 "Fid_PFltTempPreOxiC_NPL" 33189 "Fid_PFltTempPrePFlt_NPL" 33190 "Fid_PFltTempPreTrbn_NPL" 33191 "Fid_PFltTempPstPFlt_NPL" 33192 "Fid_PFltTempSens_NPL" 33193 "Fid_PFltTempSensFrz_NPL" 33194 "Fid_PoI2HC_NPL" 33195 "Fid_PoI2HCSpd_NPL" 33196 "Fid_PoI2Lmbd_NPL" 33197 "Fid_PoI2LmbdT3_NPL" 33198 "Fid_PoI2OvR_NPL" 33199 "Fid_PrpCtl_AWD1_NPL" 33200 "Fid_PrpCtl_CANVerErr_NPL" 33201 "Fid_PrpCtl_NIVEAU1_NPL" 33202 "Fid_PrpCtl_VSSCD_NPL" 33203 "Fid_ShortTr_NPL" 33204 "Fid_ShortTrAct_NPL" 33205 "Fid_SignalsTstNLim_NPL" 33206 "Fid_SotSimEGROff_NPL" 33207 "Fid_SrvPmpStSA_NPL" 33208 "Fid_SrvPmpVSSCD_NPL" 33209 "Fid_StSysCtl_IlsPlaus_NPL" 33210 "Fid_StSysCtl_RlyErr_NPL" 33211 "Fid_StSysCtl_T50Err_NPL" 33212 "Fid_StSysCtl_VSSCD_NPL" 33213 "Fid_StSysCtltiThrsAddCr_NPL" 33214 "Fid_StSys_ESCUBSG3Err_NPL" 33215 "Fid_StSys_STIGNErr_NPL" 33216 "Fid_StSys_T50Err_NPL" 33217 "Fid_StSys_T50RErr_NPL" 33218 "Fid_StSystrqStrtAddCor_NPL" 33219 "Fid_SvLpBRK2TO_NPL" 33220 "Fid_SvLpCDTOSTO_NPL" 33221 "Fid_SvLpTOSTO_NPL" 33222 "Fid_T50CDCan_NPL" 33223 "Fid_TVASCDMon_NPL" 33224 "Fid_ThrVlvGvnrOn_NPL" 33225 "Fid_UAcc_EnvDat_NPL" 33226 "Fid_VSSCDBRK1Err_NPL" 33227 "Fid_VSSCDBRK8_NPL" 33228 "Fid_VSSCDDSP1Err_NPL" 33229 "Fid_WDASCD_NPL" 61441 "Fid_AC1Can" 61442 "Fid_AC1PresCan" 61443 "Fid_AC1TrqCan" 61444 "Fid_ACCAccPed" 61445 "Fid_ACCAirbCDCrash" 61446 "Fid_ACCBrkErr" 61447 "Fid_ACCCDBrkIRev" 61448 "Fid_ACCCDCan" 61449 "Fid_ACCCDSens" 61450 "Fid_ACCCD_VehTrail" 61451 "Fid_ACCCD_frcRoad" 61452 "Fid_ACCECUIntErr" 61453 "Fid_ACCEngCodPlb" 61454 "Fid_ACCIRev" 61455 "Fid_ACCMsgErr" 61456 "Fid_ACCOffRev" 61457 "Fid_ACCPlCheck" 61458 "Fid_ACCtl_ACP" 61459 "Fid_ACCtl_EATSCD" 61460 "Fid_ACCtl_ESCUCan" 61461 "Fid_ACCtl_FanCtl1" 61462 "Fid_ACCtl_FanCtl2" 61463 "Fid_ACCtl_SysErr" 61464 "Fid_ACCtl_TSC1Can" 61465 "Fid_ACCtl_VehStand" 61466 "Fid_AFSCD" 61467 "Fid_AFSCD_AirPerTime" 61468 "Fid_AFSCD_PlOffsDrft" 61469 "Fid_AFSCD_PlSetyDrft" 61470 "Fid_AFSCD_SRCAirm" 61471 "Fid_AFVCtlSigErr" 61472 "Fid_AOHt_AC1Err" 61473 "Fid_AOHt_AltSRC" 61474 "Fid_AOHt_CDHt1" 61475 "Fid_AOHt_CDHt2" 61476 "Fid_AOHt_ESCUErr" 61477 "Fid_AOHt_ErrHt" 61478 "Fid_APP1" 61479 "Fid_APP1_FiltOffRampOn" 61480 "Fid_APP1_Sens" 61481 "Fid_APP2" 61482 "Fid_APP2_Sens" 61483 "Fid_APPCD_EEPROM" 61484 "Fid_APPCD_Prefill" 61485 "Fid_APPKickDown_VSS" 61486 "Fid_APPKickdown" 61487 "Fid_APSCD" 61488 "Fid_ASDdc" 61489 "Fid_ASDdcNGvnr" 61490 "Fid_ASDdcTrbnSpdCAN" 61491 "Fid_AccPed" 61492 "Fid_AccPedDO" 61493 "Fid_AccPedMstrShft" 61494 "Fid_AccPedVel" 61495 "Fid_AccPed_Brk" 61496 "Fid_AccPed_BrkCDBPTInvld" 61497 "Fid_AirCtl" 61498 "Fid_AirbCDCan" 61499 "Fid_AltCDLoad" 61500 "Fid_AltCD_CANrDFM" 61501 "Fid_Alt_PwrCan" 61502 "Fid_Alt_T15" 61503 "Fid_BIP_BattCD" 61504 "Fid_BIP_Control1" 61505 "Fid_BIP_Control10" 61506 "Fid_BIP_Control11" 61507 "Fid_BIP_Control12" 61508 "Fid_BIP_Control2" 61509 "Fid_BIP_Control3" 61510 "Fid_BIP_Control4" 61511 "Fid_BIP_Control5" 61512 "Fid_BIP_Control6" 61513 "Fid_BIP_Control7" 61514 "Fid_BIP_Control8" 61515 "Fid_BIP_Control9" 61516 "Fid_BIP_Err" 61517 "Fid_BIP_Set1" 61518 "Fid_BIP_Set10" 61519 "Fid_BIP_Set11" 61520 "Fid_BIP_Set12" 61521 "Fid_BIP_Set2" 61522 "Fid_BIP_Set3" 61523 "Fid_BIP_Set4" 61524 "Fid_BIP_Set5" 61525 "Fid_BIP_Set6" 61526 "Fid_BIP_Set7" 61527 "Fid_BIP_Set8" 61528 "Fid_BIP_Set9" 61529 "Fid_BPSErr" 61530 "Fid_BrkCDBPTInvld" 61531 "Fid_BrkCDCan" 61532 "Fid_BrkCDMnBrkCan" 61533 "Fid_CRCCDCan" 61534 "Fid_CRCCDTo" 61535 "Fid_CTSCDCan" 61536 "Fid_CTSCDCanInac" 61537 "Fid_CTSCDCanSig" 61538 "Fid_CTSCDOTSErr" 61539 "Fid_CTSCDPullup" 61540 "Fid_CTSErr" 61541 "Fid_CaSCD_SegCor" 61542 "Fid_ClgDynTst" 61543 "Fid_CmbChb" 61544 "Fid_CoDT_GripDeb" 61545 "Fid_CoEngAirbCDCrash" 61546 "Fid_CoEngGW1TO" 61547 "Fid_CoEng_ActrPrt" 61548 "Fid_CoEng_FrmMngAWD1" 61549 "Fid_CoEng_IRevSys" 61550 "Fid_CoEng_IRevSys2" 61551 "Fid_CoEng_IRevVeh" 61552 "Fid_CoEng_KickDown" 61553 "Fid_CoEng_PwrStgEnable" 61554 "Fid_CoEng_RevSys" 61555 "Fid_CoEng_RevSys2" 61556 "Fid_CoEng_RevVeh" 61557 "Fid_CoEng_T15CD" 61558 "Fid_CoEng_TMFWShOff" 61559 "Fid_CoEng_trqLimBiTurbo" 61560 "Fid_CoEng_trqLimErr" 61561 "Fid_CoVM_DCSErr" 61562 "Fid_CoVM_DCSh" 61563 "Fid_CoVM_DCSp" 61564 "Fid_CoVM_TCSErr" 61565 "Fid_CoVehPnlFunc" 61566 "Fid_CoVehtrqLimErr" 61567 "Fid_ConvCDCan" 61568 "Fid_ConvCDEPB" 61569 "Fid_Conv_ClthPrt" 61570 "Fid_CrCtlACCErr" 61571 "Fid_CrCtlAirbCDCrash" 61572 "Fid_CrCtlCanBrk1" 61573 "Fid_CrCtlMsgErrBRK8" 61574 "Fid_CrCtlPAAGNpl" 61575 "Fid_CrCtlPAAGTO" 61576 "Fid_CrCtlPAAGTlrDef" 61577 "Fid_CrCtlPBRK8Npl" 61578 "Fid_CrCtlPBRK8TO" 61579 "Fid_CrCtlPBRK8TempErr" 61580 "Fid_CrCtlPBRKDlyReg" 61581 "Fid_CrCtlPECDAAG" 61582 "Fid_CrCtlPECDILM" 61583 "Fid_CrCtlPGW1TO" 61584 "Fid_CrCtlPILMNpl" 61585 "Fid_CrCtlPILMTO" 61586 "Fid_CrCtlPMsgErrBRK8" 61587 "Fid_CrCtlPStopLDef" 61588 "Fid_CrCtlPstBLS" 61589 "Fid_CrCtlPstESP" 61590 "Fid_CrCtl_CAN" 61591 "Fid_CrCtl_Dspl" 61592 "Fid_CrCtl_DsplNotPlaus" 61593 "Fid_CrCtl_VDsplNotPlaus" 61594 "Fid_CrCtl_stBrk" 61595 "Fid_CrCtl_stCaSCrS" 61596 "Fid_CrCtl_stSpeedSensor" 61597 "Fid_CrCtl_stSystem" 61598 "Fid_CtTCtl_stStageErr" 61599 "Fid_CtTCtl_tClntDs1_Err" 61600 "Fid_CtTCtl_tClntDs2_Err" 61601 "Fid_CtTCtl_tClntDs3_Err" 61602 "Fid_CtTCtl_tClntDs4_Err" 61603 "Fid_CtT_SwtOff" 61604 "Fid_CtT_SwtOff_EAT" 61605 "Fid_CtT_SwtOff_EATMod" 61606 "Fid_DIUMPRDenom" 61607 "Fid_DIUMPRIgn" 61608 "Fid_DSM_Wuc" 61609 "Fid_DiffCANerr" 61610 "Fid_DrvTrn_TransConv" 61611 "Fid_EATSCDCan" 61612 "Fid_EATSCDCanInac" 61613 "Fid_EATSCDCanSig" 61614 "Fid_EGPpCDTempDfl" 61615 "Fid_EGRSCDMon" 61616 "Fid_EGRSCDOfsLrnInh" 61617 "Fid_EGRVlvGvnrOff" 61618 "Fid_EGSysCoLSU0" 61619 "Fid_EGSysCoNSC" 61620 "Fid_EGSysCoOxi" 61621 "Fid_EGSysCoOxiBrik" 61622 "Fid_EGSysCoTrbn0" 61623 "Fid_EGSysCoTrbn1" 61624 "Fid_EGSysCoTube0" 61625 "Fid_EGSysCoTube1" 61626 "Fid_EGSysCoTube2" 61627 "Fid_EGSysCoTube3" 61628 "Fid_EGSysHtgDel" 61629 "Fid_EGSysNSC" 61630 "Fid_EGSysOxiCat" 61631 "Fid_EGSysPresEnv" 61632 "Fid_EGSysStrt" 61633 "Fid_EGSysTemp" 61634 "Fid_EGSysTrbn" 61635 "Fid_EGSysTube" 61636 "Fid_EGSys_AP" 61637 "Fid_EcuBoot" 61638 "Fid_EcuInitTimestamp" 61639 "Fid_EngMBackUpTimer" 61640 "Fid_EngMCaS1" 61641 "Fid_EngMCaSBackUp" 61642 "Fid_EngMCrS1" 61643 "Fid_EngMCrSBackUp" 61644 "Fid_EngM_ChkStrtSpd" 61645 "Fid_EngM_nCoMa" 61646 "Fid_EngM_trqFrc" 61647 "Fid_EngMon_Actv" 61648 "Fid_EngOvrSpd" 61649 "Fid_EngPOpCalc1" 61650 "Fid_EngPOpCalc2" 61651 "Fid_EngPOpCalcSpeed" 61652 "Fid_EngPOpCalcVal" 61653 "Fid_EngPrtCaS" 61654 "Fid_EngPrtCrS" 61655 "Fid_EngPrtTrqLim" 61656 "Fid_EngPrt_nLimErr" 61657 "Fid_EngdtEng" 61658 "Fid_EngdtEngCOTSCD" 61659 "Fid_EngdtEngFTSCD" 61660 "Fid_EngdtEngIATSCD" 61661 "Fid_FBC" 61662 "Fid_FMASwtOff1" 61663 "Fid_FMASwtOff3" 61664 "Fid_FTSCDNpl" 61665 "Fid_FTSErr" 61666 "Fid_FanCDActrErr" 61667 "Fid_FanCtlCanAC1" 61668 "Fid_FanCtl_COTSErr" 61669 "Fid_FanCtl_tClntErr" 61670 "Fid_FanCtl_vCurrErr" 61671 "Fid_FlMngFullLdRglOff" 61672 "Fid_FlSCDCanDef" 61673 "Fid_FlSysCTSSens" 61674 "Fid_FlSysDens" 61675 "Fid_FlSysFTSSens" 61676 "Fid_FrmMngAC" 61677 "Fid_FrmMngAC1Npl" 61678 "Fid_FrmMngAC1TO" 61679 "Fid_FrmMngACCNpl" 61680 "Fid_FrmMngACCTO" 61681 "Fid_FrmMngACCWrongCoded" 61682 "Fid_FrmMngAIRBGNpl" 61683 "Fid_FrmMngAIRBGTO" 61684 "Fid_FrmMngALTCD_Load" 61685 "Fid_FrmMngAPP" 61686 "Fid_FrmMngAPPRAW" 61687 "Fid_FrmMngAPS" 61688 "Fid_FrmMngAWD1Npl" 61689 "Fid_FrmMngAWD1TO" 61690 "Fid_FrmMngBEM1Npl" 61691 "Fid_FrmMngBEM1TO" 61692 "Fid_FrmMngBPSCD_IntVal" 61693 "Fid_FrmMngBRK1Npl" 61694 "Fid_FrmMngBRK1TO" 61695 "Fid_FrmMngBRK2Npl" 61696 "Fid_FrmMngBRK2TO" 61697 "Fid_FrmMngBRK8Npl" 61698 "Fid_FrmMngBRK8TO" 61699 "Fid_FrmMngCCTLNpl" 61700 "Fid_FrmMngCCTLTO" 61701 "Fid_FrmMngCHRGR1Npl" 61702 "Fid_FrmMngCHRGR1TO" 61703 "Fid_FrmMngCHRGR2Npl" 61704 "Fid_FrmMngCHRGR2TO" 61705 "Fid_FrmMngCTSCD" 61706 "Fid_FrmMngCurInf" 61707 "Fid_FrmMngDIA1Npl" 61708 "Fid_FrmMngDIA1TO" 61709 "Fid_FrmMngDSP1Npl" 61710 "Fid_FrmMngDSP1TO" 61711 "Fid_FrmMngDSP2Npl" 61712 "Fid_FrmMngDSP2TO" 61713 "Fid_FrmMngDSP3Npl" 61714 "Fid_FrmMngDSP3TO" 61715 "Fid_FrmMngEPB1Npl" 61716 "Fid_FrmMngEPB1TO" 61717 "Fid_FrmMngESCUNpl" 61718 "Fid_FrmMngESCUTO" 61719 "Fid_FrmMngFlxTOSTO" 61720 "Fid_FrmMngGW1Npl" 61721 "Fid_FrmMngGW1TO" 61722 "Fid_FrmMngIATS" 61723 "Fid_FrmMngNIVEAU1Npl" 61724 "Fid_FrmMngNIVEAU1TO" 61725 "Fid_FrmMngPrcFan" 61726 "Fid_FrmMngSA1Npl" 61727 "Fid_FrmMngSA1TO" 61728 "Fid_FrmMngSTIGNNpl" 61729 "Fid_FrmMngSTIGNTO" 61730 "Fid_FrmMngSrvPmp" 61731 "Fid_FrmMngTCSTO" 61732 "Fid_FrmMngTOSNpl" 61733 "Fid_FrmMngTOSTO" 61734 "Fid_FrmMngTSC1Npl" 61735 "Fid_FrmMngTSC1TO" 61736 "Fid_FrmMngTSC2Npl" 61737 "Fid_FrmMngTSC2TO" 61738 "Fid_FrmMngTSC3Npl" 61739 "Fid_FrmMngTSC3TO" 61740 "Fid_FrmMngTSC6Npl" 61741 "Fid_FrmMngTSC6TO" 61742 "Fid_FrmMngVCurEng2" 61743 "Fid_FrmMng_AltPwrCan" 61744 "Fid_FrmMng_GlwCD_Actr" 61745 "Fid_FrmMng_GlwCtl_Rly" 61746 "Fid_FrmMng_KickDown" 61747 "Fid_GbSSCD" 61748 "Fid_GbSSCD_HW" 61749 "Fid_GearbxCanTSC2" 61750 "Fid_GearbxClthPlaus" 61751 "Fid_GearbxINCCup" 61752 "Fid_GearbxNMinDis" 61753 "Fid_GearbxTrbnSpdCAN" 61754 "Fid_Gearbx_CANerr" 61755 "Fid_Gearbx_Eng" 61756 "Fid_Gearbx_EngCTS" 61757 "Fid_Gearbx_EngFrc" 61758 "Fid_Gearbx_EngFrcVehSpeed" 61759 "Fid_Gearbx_EngOTS" 61760 "Fid_Gearbx_FrmMngAWD1" 61761 "Fid_Gearbx_GearDet" 61762 "Fid_Gearbx_TSC1Err" 61763 "Fid_Gearbx_TSC2Err" 61764 "Fid_Gearbx_TSC3Err" 61765 "Fid_Gearbx_TransConv" 61766 "Fid_GlwCDCan" 61767 "Fid_GlwCDCod" 61768 "Fid_GlwCtl1" 61769 "Fid_GlwCtl2" 61770 "Fid_GlwCtl3" 61771 "Fid_HDSCD_SSpMon1" 61772 "Fid_IATSErr" 61773 "Fid_IndSysMonIntMnf" 61774 "Fid_IndSys_MonVac" 61775 "Fid_IndSys_pAdj" 61776 "Fid_InjCrvCTS" 61777 "Fid_InjCrvDyn" 61778 "Fid_InjCrvFTS" 61779 "Fid_InjCrvT3Dia" 61780 "Fid_InjCrv_phiStartAddCor" 61781 "Fid_InjCrv_stPiI1" 61782 "Fid_InjCtl_qLimErr" 61783 "Fid_InjUnAlt" 61784 "Fid_InjUnIATS" 61785 "Fid_InjUnSpdErr" 61786 "Fid_InjUn_qRed" 61787 "Fid_InjVCD_InjVlv1" 61788 "Fid_InjVCD_InjVlv10" 61789 "Fid_InjVCD_InjVlv11" 61790 "Fid_InjVCD_InjVlv12" 61791 "Fid_InjVCD_InjVlv2" 61792 "Fid_InjVCD_InjVlv3" 61793 "Fid_InjVCD_InjVlv4" 61794 "Fid_InjVCD_InjVlv5" 61795 "Fid_InjVCD_InjVlv6" 61796 "Fid_InjVCD_InjVlv7" 61797 "Fid_InjVCD_InjVlv8" 61798 "Fid_InjVCD_InjVlv9" 61799 "Fid_InjVCD_PiIPoI" 61800 "Fid_InjVCD_WUP" 61801 "Fid_LASCD" 61802 "Fid_LASCDBRK8" 61803 "Fid_LIGovDriveAway" 61804 "Fid_LIGovUbr" 61805 "Fid_LIGovnSetPointErr" 61806 "Fid_LSUCDMon0" 61807 "Fid_LSUCDO20" 61808 "Fid_LSUCDRi0" 61809 "Fid_LSUCDactiv0" 61810 "Fid_LSUCDlsu0" 61811 "Fid_LSUClbSched" 61812 "Fid_LSUCtl0" 61813 "Fid_LSUMonAllChecks0" 61814 "Fid_LSUMonPlausChk0" 61815 "Fid_OTSCDCTSErr" 61816 "Fid_OTSCDCan" 61817 "Fid_OTSCDCanDSP2" 61818 "Fid_OTSCDCanInac" 61819 "Fid_OTSCDCanSig" 61820 "Fid_OTSCDDynTst" 61821 "Fid_OTSCDErr" 61822 "Fid_OvRMonACCTO" 61823 "Fid_OvRMonACCaFrmMng" 61824 "Fid_OvRMonBRK1TO" 61825 "Fid_OvRMonBRK8Err" 61826 "Fid_OvRMonBRK8MnBrkErr" 61827 "Fid_OvRMonCrCtlplusFin" 61828 "Fid_OvRMonShtrp" 61829 "Fid_OvRMonTSC1" 61830 "Fid_OvRMonTSC2" 61831 "Fid_OvRMonTSC3" 61832 "Fid_PCR" 61833 "Fid_PCRBalGvnr" 61834 "Fid_PCRNSShutOff" 61835 "Fid_PCRpLim" 61836 "Fid_PFltAirSysFail" 61837 "Fid_PFltChar" 61838 "Fid_PFltContPlausTemp" 61839 "Fid_PFltDynChk" 61840 "Fid_PFltHsLnChk" 61841 "Fid_PFltPlausPres" 61842 "Fid_PFltPlausTemp" 61843 "Fid_PFltPoI1Fail" 61844 "Fid_PFltPoI2Fail" 61845 "Fid_PFltPresSensDiff" 61846 "Fid_PFltPresSensFrz" 61847 "Fid_PFltPresSensHsLn" 61848 "Fid_PFltPresSensPre" 61849 "Fid_PFltRgnShOff" 61850 "Fid_PFltSRCPres" 61851 "Fid_PFltSRCTemp" 61852 "Fid_PFltSotSimPresElec" 61853 "Fid_PFltSotSimPresEnv" 61854 "Fid_PFltSotSimPresLrn" 61855 "Fid_PFltSotSimTemp" 61856 "Fid_PFltSysFail" 61857 "Fid_PFltTempModtPst" 61858 "Fid_PFltTempOxiPre" 61859 "Fid_PFltTempOxiSurf" 61860 "Fid_PFltTempPreOxiC" 61861 "Fid_PFltTempPrePFlt" 61862 "Fid_PFltTempPreTrbn" 61863 "Fid_PFltTempPstPFlt" 61864 "Fid_PFltTempSens" 61865 "Fid_PFltTempSensFrz" 61866 "Fid_PoI2HC" 61867 "Fid_PoI2HCSpd" 61868 "Fid_PoI2Lmbd" 61869 "Fid_PoI2LmbdT3" 61870 "Fid_PoI2OvR" 61871 "Fid_PrpCtl_AWD1" 61872 "Fid_PrpCtl_CANVerErr" 61873 "Fid_PrpCtl_NIVEAU1" 61874 "Fid_PrpCtl_VSSCD" 61875 "Fid_ShortTr" 61876 "Fid_ShortTrAct" 61877 "Fid_SignalsTstNLim" 61878 "Fid_SotSimEGROff" 61879 "Fid_SrvPmpStSA" 61880 "Fid_SrvPmpVSSCD" 61881 "Fid_StSysCtl_IlsPlaus" 61882 "Fid_StSysCtl_RlyErr" 61883 "Fid_StSysCtl_T50Err" 61884 "Fid_StSysCtl_VSSCD" 61885 "Fid_StSysCtltiThrsAddCr" 61886 "Fid_StSys_ESCUBSG3Err" 61887 "Fid_StSys_STIGNErr" 61888 "Fid_StSys_T50Err" 61889 "Fid_StSys_T50RErr" 61890 "Fid_StSystrqStrtAddCor" 61891 "Fid_SvLpBRK2TO" 61892 "Fid_SvLpCDTOSTO" 61893 "Fid_SvLpTOSTO" 61894 "Fid_T50CDCan" 61895 "Fid_TVASCDMon" 61896 "Fid_ThrVlvGvnrOn" 61897 "Fid_UAcc_EnvDat" 61898 "Fid_VSSCDBRK1Err" 61899 "Fid_VSSCDBRK8" 61900 "Fid_VSSCDDSP1Err" 61901 "Fid_WDASCD" /end COMPU_VTAB
/begin COMPU_METHOD InjMass "Einspritzmenge" RAT_FUNC "%6.4" "[mg/hub]" COEFFS 0 100 0 0 0 1 /end COMPU_METHOD
/begin COMPU_METHOD InjTime_us "Zeit in Microsekunden für das Einspritztiming" RAT_FUNC "%6.2" "[us]" COEFFS 0 1 0 0 0 1 /end COMPU_METHOD
/begin COMPU_METHOD KD_RPM2NM_3 "Verstärkungsfaktor zur Anpassung von 16 Bit an 32 Bit Werte (mit KD_RPM2NM_2_NRM+1 schieben)" RAT_FUNC "%7.6" "[Nm/(rpm*s)]" COEFFS 0 20480 0 0 0 1 /end COMPU_METHOD
/begin COMPU_METHOD KI_RPM2NM_2 "Verstärkungsfaktor zur Anpassung von 16 Bit an 32 Bit Werte (mit KI_RPM2NM_2_NRM schieben)" RAT_FUNC "%6.5" "[Nm/rpm]" COEFFS 0 2684.35456 0 0 0 1 /end COMPU_METHOD
/begin COMPU_METHOD KP_RPM2NM_2 "Verstärkungsfaktor zur Anpassung von 16 Bit an 32 Bit Werte (mit KP_RPM2NM_2_NRM schieben)" RAT_FUNC "%7.6" "[Nm/rpm]" COEFFS 0 20480 0 0 0 1 /end COMPU_METHOD
/begin COMPU_METHOD lambda "Lambda" RAT_FUNC "%6.5" "[-]" COEFFS 0 1000 0 0 0 1 /end COMPU_METHOD
/begin COMPU_METHOD LmbdaTemp "Umrechnungsregel: Verhältnis Lambda-Wert zu Temperatur" RAT_FUNC "%8.7" "[1/deg C]" COEFFS 0 100000 0 0 0 1 /end COMPU_METHOD
/begin COMPU_METHOD Map_Select "Umsetzungsfaktor von Kennfeldern fuer vierdimensionale Raeume" RAT_FUNC "%6.4" "[-]" COEFFS 0 256 0 0 0 1 /end COMPU_METHOD
/begin COMPU_METHOD Mass_FlTempCor "Einspritzmengenkorrektur pro 100K" RAT_FUNC "%6.4" "[(mg/Hub)/100°C]" COEFFS 0 409.6 0 0 0 1 /end COMPU_METHOD
/begin COMPU_METHOD OneToOne "eins zu eins (physikalischer Wert ist gleich dem internen Wert)" RAT_FUNC "%6.2" "[-]" COEFFS 0 1 0 0 0 1 /end COMPU_METHOD
/begin COMPU_METHOD Prc "Prozent, gleiche interne Auflösung wie Fact, aber Darstellung in Prozent (0...100%)" RAT_FUNC "%6.4" "[%]" COEFFS 0 100 0 0 0 1 /end COMPU_METHOD
/begin COMPU_METHOD Pres_hPa "Druck (angezeigt in [hPa])" RAT_FUNC "%6.2" "[hPa]" COEFFS 0 1 0 0 0 1 /end COMPU_METHOD
/begin COMPU_METHOD QLmbda "Umrechnungsregel: Verhältnis Einspritzmenge zu Lambda-Wert" RAT_FUNC "%6.4" "[mg/hub]" COEFFS 0 100 0 0 0 1 /end COMPU_METHOD
/begin COMPU_METHOD RmpAcc "Beschleunigungsrampe - Gradient" RAT_FUNC "%7.6" "[m/s^2/s]" COEFFS 0 65536 0 0 0 1 /end COMPU_METHOD
/begin COMPU_METHOD RmpEngN_LIGov "Motordrehzahlgradient für Leerlaufreglerrampe" RAT_FUNC "%6.4" "[rpm/s]" COEFFS 0 458.752 0 0 0 1 /end COMPU_METHOD
/begin COMPU_METHOD RmpInjMass "Rampengradient für Einspritzmenge" RAT_FUNC "%6.5" "[(mg/stroke)/s]" COEFFS 0 6553.6 0 0 0 1 /end COMPU_METHOD
/begin COMPU_METHOD Rmp_GOV "Umrechnungsregel: Rampensteigung" RAT_FUNC "%6.5" "[1/s]" COEFFS 0 1024 0 0 0 1 /end COMPU_METHOD
/begin COMPU_METHOD SigName "Verbale Umrechnung für Signal Referenz Nummern" TAB_VERB "%6.3" "[-]" COMPU_TAB_REF SigName /end COMPU_METHOD
/begin COMPU_VTAB SigName "Verbale Umrechnung für Signal Referenz Nummern" TAB_VERB 575 0 "Sig_unused" 4 "CoEng_rTrq__Carb_r_DLen1" 5 "CTSCD_tClntLin__Carb_t_DLen1" 11 "BPSCD_pLin__Carb_p_DLen1" 12 "Eng_nAvrg__Carb_n_DLen2" 13 "VSSCD_vCarb1__Carb_v_DLen1" 15 "IATSCD_tAirLin__Carb_t_DLen1" 16 "AFSCD_dmAirRawPerTime__Carb_mAirTim_DLen2" 17 "TVACD_rOut__Carb_r_DLen1" 28 "Signals_PID0x1C__OneToOne_DLen1" 29 "CARB_Mode1PID1D__OneToOne_DLen1" 31 "VehDa_tiCarbEngOn__OneToOne_DLen2" 33 "DSMDur_ctDfctDur1__Carb_l_DLen2" 44 "EGRCD_rOut__Carb_r_DLen1" 45 "EGRVlv_rGvnrDvtRel__Carb_rNeg_DLen1" 48 "DSM_ctWUC__OneToOne_DLen1" 49 "DSM_lDist__Carb_l_DLen2" 51 "APSCD_pSensorVal__Carb_p_DLen1" 60 "EGPpCD_tPreTrbn__Carb_tHighM1_DLen2" 62 "PFlt_tPre__Carb_tHighM1_DLen2" 65 "DSM_stPID41__LowByte_DLen4" 66 "BattCD_u__Carb_uBatt_DLen2" 69 "CARB_rRelThrVlvPos_PID45__Carb_r_DLen1" 70 "EATSCD_tAir__Carb_t_DLen1" 73 "CARB_rAPPCD_PID49__Carb_r_DLen1" 74 "CARB_rAPPCD_PID4A__Carb_r_DLen1" 76 "AirCtl_rTVA__Carb_r_DLen1" 79 "CARB_Mode1PID4F__LowByte_DLen4" 112 "CARB_LSU_rLmbd0__Carb_lr_DLen2" 113 "LSUCD_uO2Raw__Carb_u_DLen2" 114 "CARB_Mode1PID4FB__LowByte_DLen2" 115 "PFlt_tPst__Carb_tHighM1_DLen2" 116 "PFlt_tOxiPre__Carb_tHighM1_DLen2" 117 "PFlt_tOxiPst__Carb_tHighM1_DLen2" 118 "OxiCCD_tPre__Carb_tHighM1_DLen2" 119 "TVASCD_rNrm__Carb_r_DLen1" 120 "EGRVlv_rDesVal__Carb_r_DLen1" 122 "CARB_rNrmInvTVASCD__Carb_r_DLen1" 197 "Eng_nAvrg__n_DLen1" 198 "APPCD_stSwitchSig__OneToOne_DLen1" 199 "APPCD_uRawAPP1__u_DLen1" 200 "APPCD_uRawAPP2__u_DLen1" 201 "APPCD_rAPP1UnFlt__r_DLen1" 202 "BPSCD_uRawVal__u_DLen1" 203 "BPSCD_pOutVal__p_DLen1" 204 "APSCD_pVal__p_DLen1" 205 "APSCD_uRaw__u_DLen1" 206 "IATSCD_tAirLin__t_DLen1" 207 "IATSCD_uRaw__u_DLen1" 208 "FTSCD_tFuel__t_DLen1" 209 "CTSCD_uRaw__u_DLen1" 210 "CTSCD_tClnt__t_DLen1" 211 "OTSCD_tEngOil__t_DLen1" 212 "VSSCD_v__v_DLen1" 213 "AFSCD_dmAirRawPerTime__mAirTim_DLen1" 214 "AFSCD_uRaw__u_DLen1" 215 "AFSCD_dmAirPerTime__mAirTim_DLen1" 216 "BrkCD_stMnSwtRawVal__OneToOne_DLen1" 217 "BrkCD_stRedSwtRawVal__OneToOne_DLen1" 218 "ConvCD_stRawVal__OneToOne_DLen1" 219 "T15CD_stRawVal__OneToOne_DLen1" 220 "BattCD_uRaw__uBatt_DLen1" 221 "IndSys_rVSA__dcyc_DLen1" 222 "InjCtl_qCurr__q_DLen1" 223 "InjCtl_qSetUnBal__q_DLen1" 224 "BPACD_rOut__dcyc_DLen1" 225 "EGRCD_rOut__dcyc_DLen1" 226 "ACCtl_stLogicOut__OneToOne_DLen1" 227 "AOHt_stHt1Out__OneToOne_DLen1" 228 "GlwCtl_stLmpOut__OneToOne_DLen1" 229 "GlwCtl_stActrOut__OneToOne_DLen1" 230 "InjVlv_nCyl1__nCmpTst_DLen1" 231 "InjVlv_nCyl2__nCmpTst_DLen1" 232 "InjVlv_nCyl3__nCmpTst_DLen1" 233 "InjVlv_nCyl4__nCmpTst_DLen1" 234 "InjVlv_nCyl5__nCmpTst_DLen1" 235 "InjVlv_nCyl6__nCmpTst_DLen1" 236 "InjVlv_qFBCCyl1__q_DLen1" 237 "InjVlv_qFBCCyl2__q_DLen1" 238 "InjVlv_qFBCCyl3__q_DLen1" 239 "InjVlv_qFBCCyl4__q_DLen1" 240 "InjVlv_qFBCCyl5__q_DLen1" 241 "InjVlv_qFBCCyl6__q_DLen1" 242 "CaSCD_nPeriod__n_DLen1" 243 "FBC_qDvtCyl[0]__qdiff_DLen1" 244 "FBC_qDvtCyl[1]__qdiff_DLen1" 245 "FBC_qDvtCyl[2]__qdiff_DLen1" 246 "FBC_qDvtCyl[3]__qdiff_DLen1" 247 "FBC_qDvtCyl[4]__qdiff_DLen1" 248 "FBC_qDvtCyl[5]__qdiff_DLen1" 249 "FBC_qDvtCyl[6]__qdiff_DLen1" 250 "FBC_qDvtCyl[7]__qdiff_DLen1" 251 "FBC_qDvtCyl[8]__qdiff_DLen1" 252 "FBC_qDvtCyl[9]__qdiff_DLen1" 253 "InjCrv_phiMI1Des__phiHResol_DLen1" 254 "InjVlv_phiMI1DurCorr__phi_DLen1" 255 "PSP_stLogicOut__OneToOne_DLen1" 256 "ACCD_stMnSwtRawVal__OneToOne_DLen1" 257 "AOHt_stHt2Out__OneToOne_DLen1" 258 "AFSCD_mAirPerCyl__mAirCyl_DLen1" 259 "AFSCD_dmAirNorm__mAirTim_DLen1" 260 "AirCtl_mGovDev__mAirCylGov_DLen1" 261 "AirCtl_rEGR__r_DLen1" 262 "PCR_rBPACD__r_DLen1" 263 "Dfp_LSUCDCircNernst0_Low__OneToOne_DLen1" 264 "GlwCD_stRawVal__OneToOne_DLen1" 265 "APPCD_rFlt__r_DLen1" 266 "HWEMon_numRecovery__OneToOne_DLen1" 281 "DSM_stSysLamp__OneToOne_DLen1" 282 "DSM_stMIL__OneToOne_DLen1" 283 "BattCD_u__uBatt_DLen1" 284 "LIGov_nSetpoint__n_DLen1" 285 "VSSCD_a__a_DLen1" 286 "Tst_Zyklflag_SB5__OneToOne_DLen1" 287 "IATSCD_tAir__t_DLen1" 288 "AccPed_stPlaAPPBrk__OneToOne_DLen1" 289 "AccPed_trqDes__trqhigh_DLen1" 290 "COTSCD_tClnt__t_DLen1" 291 "AccPed_trqInrDesSig__trq_DLen1" 292 "Gearbx_stGear__OneToOne_DLen1" 293 "LSU_rLmbd[0]__rLmbd_DLen1" 294 "LSU_rLmbd[1]__rLmbd_DLen1" 295 "Tst_Zyklflag_SB1__OneToOne_DLen1" 296 "Tst_Zyklflag_SB2__OneToOne_DLen1" 297 "Tst_Zyklflag_SB3__OneToOne_DLen1" 298 "Tst_Zyklflag_SB4__OneToOne_DLen1" 299 "Tst_Zyklflag_SB6__OneToOne_DLen1" 300 "AirCtl_mDesVal__mAirCyl_DLen1" 301 "Tst_Zyklflag_SB7__OneToOne_DLen1" 302 "CtTCtl_tClntDes__t_DLen1" 303 "PCR_pBDes__p_DLen1" 304 "BPSCD_pFltVal__p_DLen1" 305 "FrmMng_lOil_mp__lLvl_DLen1" 306 "FlMng_stMon_mp__OneToOne_DLen1" 307 "FrmMng_stChrgr1Err1__OneToOne_DLen1" 308 "FrmMng_stChrgr1Err2__OneToOne_DLen1" 309 "FrmMng_stChrgr2Err1__OneToOne_DLen1" 310 "FrmMng_stChrgr2Err2__OneToOne_DLen1" 311 "FMTC_qStrt__q_DLen1" 312 "CrCtl_trqDes__trqhigh_DLen1" 313 "CoVM_trqInc__trqhigh_DLen1" 314 "CoEng_trqInrLim__trq_DLen1" 315 "FMTC_trqInrLimSmk__trq_DLen1" 316 "EngPrt_trqLim__trq_DLen1" 317 "CoVM_trqDec__trqhigh_DLen1" 318 "FlMng_qLimSmk__q_DLen1" 319 "CrCtl_vSetPointTrgt__v_DLen1" 320 "AltCD_rAltLoad__r_DLen1" 321 "CoEng_trqInrSet__trq_DLen1" 322 "CoEng_dvolFlConsum__Cnsmp_DLen1" 323 "AirCtl_stMonitor__OneToOne_DLen1" 324 "ACCtl_stLowByte_mp__OneToOne_DLen1" 325 "EngM_stSync__OneToOne_DLen1" 326 "NetMng_stCAN__LowByte_DLen1" 327 "LSUCD_resRiClb__res_DLen1" 328 "LSUCD_uO2Clb__u_DLen1" 329 "FrmMng_stTSC__LowByte_DLen1" 330 "FrmMng_stDCS__LowByte_DLen1" 331 "LSUCD_stAdpt__OneToOne_DLen1" 332 "LSUCD_uRiRaw__u_DLen1" 333 "LSUCD_mAirAftOvrrun__mAir_DLen1" 334 "GlwCtl_tiPst_mp__tiGlw_DLen1" 335 "PCR_stPCR_mp__LowByte_DLen1" 336 "AOHt_stShutOff_mp__LowByte_DLen1" 337 "FrmMng_stTCS__LowByte_DLen1" 338 "FrmMng_trqTSC__trq_DLen1" 339 "FrmMng_trqDCS__trqhigh_DLen1" 340 "CrCCD_stKeySig__OneToOne_DLen1" 341 "CrCtl_stKeyStateSig__OneToOne_DLen1" 342 "PrpCtl_vCurrTrack_mp__v_DLen1" 343 "CtApCD_rHWE_mp__dcyc_DLen1" 344 "Gearbx_trqDec__trq_DLen1" 345 "CrCtl_stShutOffrev__LowByte_DLen1" 346 "AirCtl_stAirCtl_mp__OneToOne_DLen1" 347 "DSM_stRdyAB__LowByte_DLen1" 348 "DSM_stRdyAB__HighByte_DLen1" 349 "DSM_stRdyCD__LowByte_DLen1" 350 "DSM_stRdyCD__HighByte_DLen1" 351 "PrpBrk_trqDes__trqhigh_DLen1" 352 "DSM_ctOBDPath__OneToOne_DLen1" 353 "DSM_ctRdyActCyc_mp__OneToOne_DLen1" 354 "GlwCtl_stLogic__LowByte_DLen1" 355 "GlwCtl_tiPre__tiGlw_DLen1" 356 "FMTC_trqInr__trq_DLen1" 357 "ACCtl_stBitStructure__HighByte_DLen1" 358 "AOHt_stShutOff_mp__HighByte_DLen1" 359 "FrmMng_stTSC__HighByte_DLen1" 360 "FrmMng_stDCS__HighByte_DLen1" 361 "FrmMng_stTCS__HighByte_DLen1" 362 "CrCtl_stSwitchSig__OneToOne_DLen1" 363 "EGSys_tEGLSU__tExhaust_DLen1" 364 "AOHt_NumRly_mp__OneToOne_DLen1" 365 "DSM_ctFcmEntry__OneToOne_DLen1" 368 "GlwCtl_stLogic__HighByte_DLen1" 369 "Dfp_HWEMonUMinSupply_Low__OneToOne_DLen1" 370 "Dfp_HWEMonUMaxSupply_Low__OneToOne_DLen1" 371 "PCR_rBalGvnrDiff__r_DLen1" 372 "Dfp_SOPTst_Low__OneToOne_DLen1" 373 "UAcc_SWPartNum_cs__OneToOne_DLen1" 374 "UAcc_ECUIdentEep_cs__OneToOne_DLen1" 375 "Gearbx_stTSC_mp__OneToOne_DLen1" 376 "CoVM_stActDem__OneToOne_DLen1" 377 "CrCCD_stKey__OneToOne_DLen1" 378 "CrCtl_stShutOff__OneToOne_DLen1" 379 "FanCtl_dcycFan1__dcyc_DLen1" 380 "FanCtl_dcycFan2__dcyc_DLen1" 381 "ACCD_p__pAC_DLen1" 382 "EngPrt_trqPrtLim__trq_DLen1" 383 "ImmCtl_tiLockCount__OneToOne_DLen1" 384 "UAcc_Vin_cs__OneToOne_DLen1" 385 "UAcc_dBGWVin_cs__OneToOne_DLen1" 386 "UAcc_SigBlk80_cs__OneToOne_DLen1" 387 "UAcc_SigBlk82_cs__OneToOne_DLen1" 388 "FlSys_stFlPp__OneToOne_DLen1" 389 "AOHtCD_volFlConsum__Cnsmp_DLen1" 390 "UAcc_MWB26sum_checksum_cs__OneToOne_DLen1" 391 "BPSCD_pLin__p_DLen1" 392 "CoEng_rTrq__r_DLen1" 393 "EngM_stEngMntCtl_MLS1__OneToOne_DLen1" 394 "EngM_stEngMntCtl_MLS2__OneToOne_DLen1" 395 "EngM_stEngMntCtl_GTL1__OneToOne_DLen1" 396 "EngM_stEngMntCtl_GTL2__OneToOne_DLen1" 397 "FanCD_rFan1HWE_mp__dcyc_DLen1" 398 "FanCD_rFan2HWE_mp__dcyc_DLen1" 399 "ACCD_trqCompr__trq_DLen1" 400 "TVACD_rOut__dcyc_DLen1" 401 "PFltCD_tPre__tExhaust_DLen1" 402 "PFltCD_pDiff__p_DLen1" 403 "EGPpCD_tPreTrbn__tExhaust_DLen1" 404 "AC_pwrDes__pwr_DLen1" 405 "Alt_pwrDes__pwr_DLen1" 406 "SrvPmp_pwrDes__pwr_DLen1" 407 "SvLp_dOilLoad__NoUnit_DLen1" 408 "SvLp_dSootLoad__NoUnit_DLen1" 409 "Dfp_LSUCDCircPumpCur0_Low__OneToOne_DLen1" 410 "Dfp_LSUCDCircVirtGnd0_Low__OneToOne_DLen1" 411 "Dfp_LSUCDHtCoup0_Low__OneToOne_DLen1" 412 "Dfp_LSUCDO20_Low__OneToOne_DLen1" 413 "Dfp_LSUCDHeater0_Low__OneToOne_DLen1" 414 "Dfp_LSUCDO2Clb0_Low__OneToOne_DLen1" 415 "Dfp_LSUCDRiClb0_Low__OneToOne_DLen1" 416 "Dfp_LSUCDSPI0_Low__OneToOne_DLen1" 417 "Dfp_LSUCDWireIP0_Low__OneToOne_DLen1" 418 "Dfp_LSUCtlRiExc0_Low__OneToOne_DLen1" 419 "Dfp_LSUMonFullLd_Low__LowByte_DLen1" 420 "Dfp_LSUMonPartLd_Low__LowByte_DLen1" 421 "Dfp_HWEMonEEPROM_Low__OneToOne_DLen1" 422 "Dfp_HWEMonCom_Low__OneToOne_DLen1" 423 "Ad_NumTyp_FreeApplic1_CSTR__FreeApplic1_DLen1" 424 "Ad_NumTyp_FreeApplic2_CSTR__FreeApplic2_DLen1" 425 "Ad_NumTyp_FreeApplic3_CSTR__FreeApplic3_DLen1" 426 "Ad_NumTyp_FreeApplic4_CSTR__FreeApplic4_DLen1" 427 "AFSCD_dmAirPerTimeB2__mAirTim_DLen1" 428 "AFSCD_mAirPerCylB1__mAirCyl_DLen1" 429 "AFSCD_mAirPerCylB2__mAirCyl_DLen1" 431 "BPACD_rOut2__dcyc_DLen1" 432 "AFSCD_dmAirPerTimeB1__mAirTim_DLen1" 468 "FrmMng_stNumTOOvrFlowECU[0]__OneToOne_DLen1" 469 "FrmMng_stNumTOOvrFlowECU[1]__OneToOne_DLen1" 470 "FrmMng_stNumTOOvrFlowECU[2]__OneToOne_DLen1" 471 "FrmMng_stNumTOOvrFlowECU[3]__OneToOne_DLen1" 472 "FrmMng_stNumTOOvrFlowECU[4]__OneToOne_DLen1" 473 "FrmMng_stNumTOOvrFlowECU[5]__OneToOne_DLen1" 474 "FrmMng_stNumTOOvrFlowECU[6]__OneToOne_DLen1" 475 "FrmMng_stNumTOOvrFlowECU[7]__OneToOne_DLen1" 476 "FrmMng_stNumTOOvrFlowECU[8]__OneToOne_DLen1" 477 "FrmMng_stNumTOOvrFlowECU[9]__OneToOne_DLen1" 478 "FrmMng_stNumTOOvrFlowECU[10]__OneToOne_DLen1" 479 "FrmMng_stNumTOOvrFlowECU[11]__OneToOne_DLen1" 480 "FrmMng_stNumTOOvrFlowECU[12]__OneToOne_DLen1" 481 "FrmMng_stNumTOOvrFlowECU[13]__OneToOne_DLen1" 482 "FrmMng_stNumTOOvrFlowECU[14]__OneToOne_DLen1" 483 "FrmMng_stNumTOOvrFlowECU[15]__OneToOne_DLen1" 484 "FrmMng_stNumTOOvrFlowECU[16]__OneToOne_DLen1" 485 "FrmMng_stNumTOOvrFlowECU[17]__OneToOne_DLen1" 486 "FrmMng_stNumTOOvrFlowECU[18]__OneToOne_DLen1" 487 "FrmMng_stNumTOOvrFlowECU[19]__OneToOne_DLen1" 488 "FrmMng_stNumTOOvrFlowECU[20]__OneToOne_DLen1" 489 "FrmMng_stNumTOOvrFlowECU[21]__OneToOne_DLen1" 490 "FrmMng_stNumTOOvrFlowECU[22]__OneToOne_DLen1" 491 "FrmMng_stNumTOOvrFlowECU[23]__OneToOne_DLen1" 492 "FrmMng_stNumTOOvrFlowECU[24]__OneToOne_DLen1" 493 "FrmMng_stNumTOOvrFlowECU[25]__OneToOne_DLen1" 494 "FrmMng_stNumTOOvrFlowECU[26]__OneToOne_DLen1" 495 "FrmMng_stNumTOOvrFlowECU[27]__OneToOne_DLen1" 496 "FrmMng_stNumTOOvrFlowECU[28]__OneToOne_DLen1" 497 "FrmMng_stNumTOOvrFlowECU[29]__OneToOne_DLen1" 498 "FrmMng_stNumTOOvrFlowECU[30]__OneToOne_DLen1" 499 "FrmMng_stNumTOOvrFlowECU[31]__OneToOne_DLen1" 526 "EGRVlv_rEGR__r_DLen1" 527 "EGRSCD_rRelPos__dcyc_DLen1" 532 "BPSCD_pIntVal__p_DLen1" 533 "EGRVlv_rDesVal__dcyc_DLen1" 535 "BPASCD_rRelPos__rNeg_DLen1" 536 "FMA_qRaw_mp__qNeg_DLen1" 538 "FMA_facSwtOff__Fact_DLen1" 601 "T50CD_stRxDebVal__OneToOne_DLen1" 602 "CoEng_stEng__OneToOne_DLen1" 603 "StSysCtl_stStrtCncl__LowByte_DLen1" 604 "PrpCtl_stSPTrack_mp__OneToOne_DLen1" 605 "ACCCD_stACC__OneToOne_DLen1" 606 "InjCrv_qLmbdCtl__q_DLen1" 607 "EGSys_stHtgLSU__OneToOne_DLen1" 608 "LSUCD_dcycHtCor__dcyc_DLen1" 609 "EGSys_pExhGas__p_DLen1" 610 "EGSys_dmEG__mAirTim_DLen1" 611 "LSUCD_drO2Adpt__O2diff_DLen1" 612 "LSUCD_stCircModeNewLow__OneToOne_DLen1" 613 "LSU_stPlausChk__OneToOne_DLen1" 614 "LSU_stO2Err__LowByte_DLen1" 615 "PFlt_pPre__p_DLen1" 616 "PFlt_pDiff__pPFlt_DLen1" 617 "PFlt_tPre__tExhaust_DLen1" 623 "PFlt_pDiffOfsValAct_mp__pPFlt_DLen1" 624 "PFlt_qFl_mp__q_DLen1" 625 "PFlt_tiSnceRgn_mp__ti_DLen1" 626 "PFlt_lSnceRgn_mp__l_DLen1" 627 "PFlt_stCntRes__OneToOne_DLen1" 628 "PFlt_numEngPOp_mp__OneToOne_DLen1" 629 "FMA_qIC__qdiff_DLen1" 630 "FMA_stSwtOff__LowByte_DLen1" 631 "EEPCD_stErrSet__OneToOne_DLen1" 632 "EEPCD_stOptErrCodSet__OneToOne_DLen1" 633 "CtTCtl_dcycThst__dcyc_DLen1" 634 "CtTCtl_stCtl__OneToOne_DLen1" 635 "EATSCD_tAir__t_DLen1" 636 "HDSCD_prcAir__r_DLen1" 638 "LSUCD_uO2Raw__u_DLen1" 639 "LSUCD_rO2Adpt__r_DLen1" 640 "PFlt_pDiffOfsValOld_mp__pPFlt_DLen1" 643 "ConvCD_stIlsDebVal__OneToOne_DLen1" 644 "StSysCtl_stT50CDOn__OneToOne_DLen1" 645 "StSysCtl_stT50CDOff__OneToOne_DLen1" 646 "T50CD_stDebVal__OneToOne_DLen1" 653 "AirCtl_mMaxDev_mp__mAirCylGov_DLen1" 654 "AirCtl_mMinDev_mp__mAirCylGov_DLen1" 655 "AirCtl_stDebDef__OneToOne_DLen1" 656 "AFSCD_stPlSetyDrft_mp__LowByte_DLen1" 657 "AFSCD_rAirNorm__Fact_DLen1" 658 "NetMng_stCAN__HighByte_DLen1" 659 "NetMng_stCAN__Byte2_DLen1" 660 "NetMng_stCAN__Byte3_DLen1" 661 "PCR_stPCR_mp__HighByte_DLen1" 662 "CrCtl_stShutOffrev__HighByte_DLen1" 663 "CrCtl_stShutOffrev__Byte2_DLen1" 664 "CrCtl_stShutOffrev__Byte3_DLen1" 665 "LSU_stO2Err__HighByte_DLen1" 666 "FMA_stSwtOff__HighByte_DLen1" 667 "AFSCD_stPlSetyDrft_mp__HighByte_DLen1" 671 "CARB_TstNotUsedMaxU__LowByte_DLen2" 672 "CARB_TstNotUsedMinU__LowByte_DLen2" 673 "CARB_TstNotUsedMaxS__LowByte_DLen2" 674 "CARB_TstNotUsedMinS__LowByte_DLen2" 675 "CARB_TstNotUsedTrue__LowByte_DLen2" 676 "CARB_TstNotUsedFalse__LowByte_DLen2" 681 "CoEng_dvolFlConsAllTot__Cnsmp_DLen1" 682 "EGT_st__Byte3_DLen1" 683 "EGT_st__Byte2_DLen1" 684 "EGT_st__HighByte_DLen1" 685 "EGT_st__LowByte_DLen1" 687 "LSUCD_stO2Valid__LowByte_DLen1" 688 "AirCtl_stEGRClgBypVlv__LowByte_DLen1" 689 "FQlSCD_rFlQlLin__ratio_DLen1" 690 "GlwCD_stLampOut__LowByte_DLen1" 691 "GlwCD_stOutHWE_mp__LowByte_DLen1" 692 "GlwCD_rGSK__dcyc_DLen1" 693 "FlPpCD_stFlPp__LowByte_DLen1" 694 "AFVCD_stActrOut__LowByte_DLen1" 695 "FrmMng_prcFan__dcyc_DLen1" 696 "EGPpCD_tLinPreTrbn__tExhaust_DLen1" 697 "EngPrt_facPrtLimCorr__Fact_DLen1" 698 "EngPrt_tPreTrbn__t_DLen1" 699 "FrmMng_trqFrcCan__trq_DLen1" 700 "CoVeh_trqAcs__trq_DLen1" 701 "CoEng_trqMin__trq_DLen1" 702 "BPSCD_pAvgDiff__pDiff_DLen1" 703 "IndSys_pAdj__pDiff_DLen1" 704 "BPSCD_ctAvg__OneToOne_DLen1" 705 "CtT_stCondMon__LowByte_DLen1" 706 "CtT_tAir__t_DLen1" 707 "SvLp_dOilLoadWIV2__NoUnitII_DLen1" 708 "SvLp_dSootLoadWIV2__NoUnitII_DLen1" 709 "CARB_stRdyCurrABCD__LowByte_DLen1" 710 "CARB_stRdyCurrABCD__HighByte_DLen1" 711 "CARB_stRdyCurrABCD__Byte2_DLen1" 712 "CARB_stRdyCurrABCD__Byte3_DLen1" 713 "CtT_stCondMon__HighByte_DLen1" 714 "CoEng_ctUnpla__OneToOne_DLen1" 716 "SvLpCD_ltmpMin2__lLvl2_DLen1" 717 "FanCtl_prcAddReq__r_DLen1" 718 "Dfp_LSUMonOvrRun_Low__LowByte_DLen1" 719 "Dfp_LSUMonDyn_Low__LowByte_DLen1" 720 "APPCD_rRawAPP1__r_DLen1" 721 "APPCD_rRawAPP2__r_DLen1" 722 "APPCD_rKDThres__r_DLen1" 727 "Shtrp_ctRemain__OneToOne_DLen1" 728 "Shtrp_numCurrTst__OneToOne_DLen1" 729 "CrCtl_stShutOffrevSig__LowByte_DLen1" 730 "CrCtl_stShutOffirevSig__LowByte_DLen1" 731 "ACCCD_trqDes__trqhigh_DLen1" 732 "ACC_trqDes__trqhigh_DLen1" 733 "ACC_trqBrk__trqhigh_DLen1" 734 "ACCCD_stACC__OneToOne_DLen1__2" 735 "ACCCD_stBrkErr_mp__OneToOne_DLen1" 736 "ACCCD_stSensErr_mp__OneToOne_DLen1" 737 "ACC_stState__OneToOne_DLen1" 738 "ACCCD_aDes__a_DLen1" 739 "ACCCD_phiRoad__phi2_DLen1" 740 "ACC_rBrkDes__r_DLen1" 748 "TVASCD_rRelPos__dcyc_DLen1" 750 "ThrVlv_rDesVal__dcyc_DLen1" 751 "ThrVlv_stMon__LowByte_DLen1" 752 "ThrVlv_stMon__HighByte_DLen1" 753 "ThrVlv_rTVA__dcyc_DLen1" 755 "StSysCtl_stStrtCncl_mp__LowByte_DLen1" 756 "StSysCtl_stStrtCncl_mp__HighByte_DLen1" 757 "FrmMng_rChrgr1Actr__dcyc_DLen1" 758 "FrmMng_tChrgr1ASIC__tExhaust_DLen1" 759 "FrmMng_rChrgr2Actr__dcyc_DLen1" 760 "FrmMng_tChrgr2ASIC__tExhaust_DLen1" 761 "Shtrp_ActFreeTstTog__OneToOne_DLen1" 762 "PFlt_tSimPstPFlt_mp__tExhaust_DLen1" 763 "FrmMng_volFuelFil__volLiter_DLen1" 764 "CtT_tClntMod__t_DLen1" 765 "InjCrv_stT3Dia_mp__LowByte_DLen1" 766 "InjCrv_stT3Dia_mp__HighByte_DLen1" 767 "InjCrv_ctT3DiaMin_mp__OneToOne_DLen1" 768 "InjCrv_tT3DiaMin_mp__tExhaust_DLen1" 769 "EGRCD_stCBVOutHWE_mp__LowByte_DLen1" 770 "FlClgCD_stFlClg__LowByte_DLen1" 771 "DIUMPR_ctIgn_mp__ct_DLen1" 772 "DIUMPR_ctGenDenom_mp__ct_DLen1" 773 "TVASCD_rDrftOpn_mp__dcycNeghighres_DLen1" 774 "TVASCD_rDrftCls_mp__dcycNeghighres_DLen1" 775 "WDASCD_stWntrSwtVal__LowByte_DLen1" 776 "WDASCD_stWntrLogVal_mp__LowByte_DLen1" 777 "PFlt_stRlsPlausTemp__OneToOne_DLen1" 778 "PFlt_stRlsPlausTempPrePFlt__OneToOne_DLen1" 779 "PFlt_stRlsPlausTempPreOxiC__OneToOne_DLen1" 780 "PFlt_stRlsPlausTempPreTrbn__OneToOne_DLen1" 781 "PFlt_stRlsPlausTempPstPFlt__OneToOne_DLen1" 1000 "BIP_tiDvtFltMI1[1]__tius_DLen1" 1001 "BIP_tiDvtFltMI1[2]__tius_DLen1" 1002 "BIP_tiDvtFltMI1[3]__tius_DLen1" 1003 "BIP_tiDvtFltMI1[4]__tius_DLen1" 1004 "BIP_tiDvtFltMI1[5]__tius_DLen1" 1005 "BIP_tiDvtFltMI1[6]__tius_DLen1" 1006 "BIP_tiDvtFltMI1[7]__tius_DLen1" 1007 "BIP_tiDvtFltMI1[8]__tius_DLen1" 1008 "BIP_tiDvtFltMI1[9]__tius_DLen1" 1009 "BIP_tiDvtFltMI1[10]__tius_DLen1" 1010 "BIPCD_stBIPDetMI1[1]__OneToOne_DLen1" 1011 "BIPCD_stBIPDetMI1[2]__OneToOne_DLen1" 1012 "BIPCD_stBIPDetMI1[3]__OneToOne_DLen1" 1013 "BIPCD_stBIPDetMI1[4]__OneToOne_DLen1" 1014 "BIPCD_stBIPDetMI1[5]__OneToOne_DLen1" 1015 "BIPCD_stBIPDetMI1[6]__OneToOne_DLen1" 1016 "BIPCD_stBIPDetMI1[7]__OneToOne_DLen1" 1017 "BIPCD_stBIPDetMI1[8]__OneToOne_DLen1" 1018 "BIPCD_stBIPDetMI1[9]__OneToOne_DLen1" 1019 "BIPCD_stBIPDetMI1[10]__OneToOne_DLen1" 1020 "EngM_phiCaSOfsCorr__phi_DLen1" 1021 "InjVCD_stInjVlv_mp__OneToOne_DLen1" 1022 "AFSCD_rAirThrHiPlHi_mp__Fact_DLen1" 1023 "AFSCD_rAirThrLoPlLo_mp__Fact_DLen1" 1024 "InjCrv_qPoI2Des__q_DLen1" 1025 "InjCrv_phiPoI2Des__phiHResol_DLen1" 1026 "InjVlv_phiPoI2Dur__phi_DLen1" 1027 "InjVlv_phiPiI1DurCorr__phi_DLen1" 1028 "InjCrv_qPiI1Des__q_DLen1" 1029 "InjCrv_phiPiI1Des__phiHResol_DLen1" 1030 "InjCrv_qPoI2LmbdOfs__q_DLen1" 1031 "PFlt_tiSumRgnMaxTmr__tisecond_DLen1" 1032 "PFlt_rAshLdLrn_mp__r_DLen1" 1033 "PFlt_rSotSimPres__r_DLen1" 1034 "PFlt_lSum_mp__l_DLen1" 1035 "PFlt_ctRgnLck__LowByte_DLen1" 1036 "PFlt_stCntRes__LowByte_DLen1" 1037 "PFlt_tiOp_mp__tiHour_DLen1" 1038 "IndSys_swtVacMonOn__OneToOne_DLen1" 1044 "BPASCD_rLinRelPos__r_DLen1" 1045 "VSACD_rOut__rNeg_DLen1" 1046 "BIPCD_stBIPDetPiI1[1]__OneToOne_DLen1" 1047 "BIPCD_stBIPDetPiI1[2]__OneToOne_DLen1" 1048 "BIPCD_stBIPDetPiI1[3]__OneToOne_DLen1" 1049 "BIPCD_stBIPDetPiI1[4]__OneToOne_DLen1" 1050 "BIPCD_stBIPDetPiI1[5]__OneToOne_DLen1" 1051 "BIPCD_stBIPDetPiI1[6]__OneToOne_DLen1" 1052 "BIPCD_stBIPDetPiI1[7]__OneToOne_DLen1" 1053 "BIPCD_stBIPDetPiI1[8]__OneToOne_DLen1" 1054 "BIPCD_stBIPDetPiI1[9]__OneToOne_DLen1" 1055 "BIPCD_stBIPDetPiI1[10]__OneToOne_DLen1" 1056 "BIPCD_stBIPDetPoI2[1]__OneToOne_DLen1" 1057 "BIPCD_stBIPDetPoI2[2]__OneToOne_DLen1" 1058 "BIPCD_stBIPDetPoI2[3]__OneToOne_DLen1" 1059 "BIPCD_stBIPDetPoI2[4]__OneToOne_DLen1" 1060 "BIPCD_stBIPDetPoI2[5]__OneToOne_DLen1" 1061 "BIPCD_stBIPDetPoI2[6]__OneToOne_DLen1" 1062 "BIPCD_stBIPDetPoI2[7]__OneToOne_DLen1" 1063 "BIPCD_stBIPDetPoI2[8]__OneToOne_DLen1" 1064 "BIPCD_stBIPDetPoI2[9]__OneToOne_DLen1" 1065 "BIPCD_stBIPDetPoI2[10]__OneToOne_DLen1" 1066 "BIP_tiDvtFltPiI1[1]__tius_DLen1" 1067 "BIP_tiDvtFltPiI1[2]__tius_DLen1" 1068 "BIP_tiDvtFltPiI1[3]__tius_DLen1" 1069 "BIP_tiDvtFltPiI1[4]__tius_DLen1" 1070 "BIP_tiDvtFltPiI1[5]__tius_DLen1" 1071 "BIP_tiDvtFltPiI1[6]__tius_DLen1" 1072 "BIP_tiDvtFltPiI1[7]__tius_DLen1" 1073 "BIP_tiDvtFltPiI1[8]__tius_DLen1" 1074 "BIP_tiDvtFltPiI1[9]__tius_DLen1" 1075 "BIP_tiDvtFltPiI1[10]__tius_DLen1" 1076 "BIP_tiDvtFltPoI2[1]__tius_DLen1" 1077 "BIP_tiDvtFltPoI2[2]__tius_DLen1" 1078 "BIP_tiDvtFltPoI2[3]__tius_DLen1" 1079 "BIP_tiDvtFltPoI2[4]__tius_DLen1" 1080 "BIP_tiDvtFltPoI2[5]__tius_DLen1" 1081 "BIP_tiDvtFltPoI2[6]__tius_DLen1" 1082 "BIP_tiDvtFltPoI2[7]__tius_DLen1" 1083 "BIP_tiDvtFltPoI2[8]__tius_DLen1" 1084 "BIP_tiDvtFltPoI2[9]__tius_DLen1" 1085 "BIP_tiDvtFltPoI2[10]__tius_DLen1" 1086 "PFlt_tFlt__tExhaust_DLen1" 1087 "PFlt_mAshTrmTot__mAsh_DLen1" 1089 "PFlt_rSotRatFlt_mp__r_DLen1" 1091 "PFlt_stCntRes__OneToOne_DLen1__2" 1092 "AddPCD_numStrkRem_mp__stroke_DLen1" 1093 "AddPmp_volAddTotDia_mp__vol_DLen1" 1094 "AddPmp_volAddDia_mp__volHigh_DLen1" 1095 "AddPmp_rAdd_mp__MLperL_DLen1" 1096 "EGRSCD_rOfsLrnLst__dcycNeg_DLen1" 1097 "EGRSCD_stAdapt__LowByte_DLen1" 1098 "BPASCD_rOfs__dcycNeg_DLen1" 1099 "BPASCD_stOfs__LowByte_DLen1" 1100 "FlSCD_volTotal__volLiter_DLen1" 1101 "UAcc_sigEnvDat[0]__LowByte_DLen1" 1102 "UAcc_sigEnvDat[1]__LowByte_DLen1" 1103 "UAcc_sigEnvDat[2]__LowByte_DLen1" 1104 "UAcc_sigEnvDat[3]__LowByte_DLen1" 1105 "UAcc_sigEnvDat[4]__LowByte_DLen1" 1106 "UAcc_sigEnvDat[5]__LowByte_DLen1" 1107 "UAcc_sigEnvDat[6]__LowByte_DLen1" 1108 "PFlt_tPst__tExhaust_DLen1" 1109 "GlwCD_rGSK__r_DLen1" 1110 "AddPCD_uTnkLvlRawVal__u_DLen1" 1111 "InjCrv_stPoI2LmbdT3Ctl__LowByte_DLen1" 1112 "PFlt_tSimPreTrbn_mp__tExhaust_DLen1" 1113 "PFlt_tSimPrePFlt_mp__tExhaust_DLen1" 1114 "DIUMPR_rMBGrp[0]__rDIUMPR_DLen1" 1115 "DIUMPR_rMBGrp[1]__rDIUMPR_DLen1" 1116 "DIUMPR_rMBGrp[2]__rDIUMPR_DLen1" 1117 "DIUMPR_rMBGrp[3]__rDIUMPR_DLen1" 1118 "DIUMPR_rMBGrp[4]__rDIUMPR_DLen1" 1119 "DIUMPR_rMBGrp[5]__rDIUMPR_DLen1" 1120 "DIUMPR_rMBGrp[6]__rDIUMPR_DLen1" 1121 "DIUMPR_rMBGrp[7]__rDIUMPR_DLen1" 1122 "DIUMPR_rMBGrp[8]__rDIUMPR_DLen1" 1123 "DIUMPR_rMBGrp[9]__rDIUMPR_DLen1" 1124 "DIUMPR_rMBGrp[10]__rDIUMPR_DLen1" 1125 "DIUMPR_rMBGrp[11]__rDIUMPR_DLen1" 1126 "DIUMPR_rMBGrp[12]__rDIUMPR_DLen1" 1127 "DIUMPR_rMBGrp[13]__rDIUMPR_DLen1" 1128 "DIUMPR_rMBGrp[14]__rDIUMPR_DLen1" 1129 "PFlt_dvol__dvol_DLen1" 1130 "PFlt_pDiffMinSty_mp__pPFlt_DLen1" 1131 "PFltCD_tPst__tExhaust_DLen1" 1132 "InjCrv_stPoI2LmbdT3Ctl__LowByte_DLen1__2" 1133 "InjCrv_tT3DiaPreNomFlt_mp__tExhaust_DLen1" 1134 "EGRSCD_rTmpOfs__dcycNeghighres_DLen1" 1147 "PFlt_rSotSimMax__r_DLen1" 1148 "EGSys_tOxiCatBrik[0]__tExhaust_DLen1" 1149 "EGSys_tOxiCatBrik[1]__tExhaust_DLen1" 1150 "PFlt_rSotSimTemp__r_DLen1" 1151 "PFlt_facArrhThm_mp__facArrh_DLen1" 1152 "PFlt_mSotSimTemp__mSot_DLen1" /end COMPU_VTAB
/begin COMPU_METHOD TempDiff_Kelv "Offsettemperatur dargestellt in [K]" RAT_FUNC "%6.3" "[ deg C ]" COEFFS 0 10 0 0 0 1 /end COMPU_METHOD
/begin COMPU_METHOD Temp_Cels "Temperatur dargestellt in °C (gleiche interne Darstellung wie Temp_Kelv)" RAT_FUNC "%6.1" "[deg C]" COEFFS 0 10 2731.4 0 0 1 /end COMPU_METHOD
/begin COMPU_METHOD TimeDelay_s "Zeitkonstante T1 (in s) für PT1, DT1, etc." RAT_FUNC "%9.3" "[s]" COEFFS 0 0 1 0 0.00023283064365387 0 /end COMPU_METHOD
/begin COMPU_METHOD TimeDelay_s_Lin_16 "Zeitkonstante T1 (in s) für PT1, DT1, etc. für SINT16, kein Kehrwert" RAT_FUNC "%6.5" "s" COEFFS 0 6553.4 0 0 0 1 /end COMPU_METHOD
/begin COMPU_METHOD TimeDelay_s_Lin_16_3 "Zeitkonstante T1 (in s) für PT1, DT1, etc. für SINT16, kein Kehrwert" RAT_FUNC "%6.4" "s" COEFFS 0 131.068 0 0 0 1 /end COMPU_METHOD
/begin COMPU_METHOD Time_ms "Zeit in ms für Fehlerentprellung (DSM) und SW-Timer" RAT_FUNC "%6.1" "[ms]" COEFFS 0 0.1 0 0 0 1 /end COMPU_METHOD
/begin COMPU_METHOD Time_s "Zeit in s für Fehlerentprellung (DSM) und SW-Timer" RAT_FUNC "%6.4" "[s]" COEFFS 0 100 0 0 0 1 /end COMPU_METHOD
/begin COMPU_METHOD TransR "Übersetzungsverhältnis (Getriebe etc.)" RAT_FUNC "%6.4" "[-]" COEFFS 0 100 0 0 0 1 /end COMPU_METHOD
/begin COMPU_METHOD Trq "Motormoment" RAT_FUNC "%6.3" "[Nm]" COEFFS 0 10 0 0 0 1 /end COMPU_METHOD
/begin COMPU_METHOD UI_Curr "Magnetventilstrom fuer Pumpe-Duese-Element" RAT_FUNC "%6.1" "[mA]" COEFFS 0 0.0300346940351333 0 0 0 1 /end COMPU_METHOD
/begin COMPU_METHOD Vel "Fahrzeuggeschwindigkeit, gleiche interne Auflösung wie Vel_SI" RAT_FUNC "%6.4" "[km/h]" COEFFS 0 100 0 0 0 1 /end COMPU_METHOD
/begin COMPU_METHOD defaultAscii "" RAT_FUNC "%6.2" "" COEFFS 0 1 0 0 0 1 /end COMPU_METHOD
/begin RECORD_LAYOUT Kf_Xs16_Ys16_Ws16 NO_AXIS_PTS_X 1 SWORD NO_AXIS_PTS_Y 2 SWORD AXIS_PTS_X 3 SWORD INDEX_INCR DIRECT AXIS_PTS_Y 4 SWORD INDEX_INCR DIRECT FNC_VALUES 5 SWORD COLUMN_DIR DIRECT /end RECORD_LAYOUT
/begin RECORD_LAYOUT Kl_Xs16_Ws16 NO_AXIS_PTS_X 1 SWORD AXIS_PTS_X 2 SWORD INDEX_INCR DIRECT FNC_VALUES 3 SWORD COLUMN_DIR DIRECT /end RECORD_LAYOUT
/begin RECORD_LAYOUT Ktx FNC_VALUES 1 UBYTE COLUMN_DIR DIRECT /end RECORD_LAYOUT
/begin RECORD_LAYOUT Kwb_Wu16 FNC_VALUES 1 UWORD COLUMN_DIR DIRECT /end RECORD_LAYOUT
/begin RECORD_LAYOUT Kwb_Wu8 FNC_VALUES 1 UBYTE COLUMN_DIR DIRECT /end RECORD_LAYOUT
/begin RECORD_LAYOUT Kw_Ws16 FNC_VALUES 1 SWORD COLUMN_DIR DIRECT /end RECORD_LAYOUT
/begin RECORD_LAYOUT Kw_Ws32 FNC_VALUES 1 SLONG COLUMN_DIR DIRECT /end RECORD_LAYOUT
/begin RECORD_LAYOUT Kw_Wu16 FNC_VALUES 1 UWORD COLUMN_DIR DIRECT /end RECORD_LAYOUT
/begin RECORD_LAYOUT Kw_Wu32 FNC_VALUES 1 ULONG COLUMN_DIR DIRECT /end RECORD_LAYOUT
/begin RECORD_LAYOUT Kw_Wu8 FNC_VALUES 1 UBYTE COLUMN_DIR DIRECT /end RECORD_LAYOUT
/begin FUNCTION InjCrv_PoI2Lmbd "Lambdaregelung der Nacheinspritzung während Regeneration"
 /begin DEF_CHARACTERISTIC InjCrv_dfacPoI2LmbdKpSlp_C InjCrv_dfacPoI2LmbdOutSlp_C InjCrv_dfacPreTrbnKpSlp_C InjCrv_drPoI2LmbdT3Slp_C InjCrv_facPoI2LmbdKi_CUR InjCrv_facPoI2LmbdKp_CUR InjCrv_facPoI2LmbdStd_C InjCrv_facPoI2LmbdWgh_CUR InjCrv_facPreTrbnKi_CUR InjCrv_facPreTrbnKp_CUR InjCrv_facdlmbddtPreTrbn_MAP InjCrv_facdqPoI2dlmbd_MAP InjCrv_qPoI2LmbdOfs_Channel InjCrv_qPoI2LmbdOfs_Vector InjCrv_qPoI2LmbdRgn1Off_CUR InjCrv_qPoI2LmbdRgn1On_CUR InjCrv_qPoI2LmbdRgn2Off_CUR InjCrv_qPoI2LmbdRgn2On_CUR InjCrv_qPoI2LmbdRgn3Off_CUR InjCrv_qPoI2LmbdRgn3On_CUR InjCrv_qPoI2LmbdRgn4Off_CUR InjCrv_qPoI2LmbdRgn4On_CUR InjCrv_rPoI2LmbdGovMax_C InjCrv_rPoI2LmbdGovMinStd_C InjCrv_rPoI2LmbdGovMin_CUR InjCrv_rPoI2LmbdMax_C InjCrv_rPoI2LmbdMin1_MAP InjCrv_rPoI2LmbdMin2_MAP InjCrv_rPoI2LmbdMin3_MAP InjCrv_rPoI2LmbdMin4_MAP InjCrv_rPoI2LmbdMinNom_MAP InjCrv_rPoI2LmbdNom_Channel InjCrv_rPoI2LmbdNom_Vector InjCrv_rPoI2LmbdRgn10_MAP InjCrv_rPoI2LmbdRgn11_MAP InjCrv_rPoI2LmbdRgn20_MAP InjCrv_rPoI2LmbdRgn21_MAP InjCrv_rPoI2LmbdRgn30_MAP InjCrv_rPoI2LmbdRgn31_MAP InjCrv_rPoI2LmbdRgn40_MAP InjCrv_rPoI2LmbdRgn41_MAP InjCrv_rPoI2LmbdT3Max_C InjCrv_rPoI2LmbdT3MinNom_MAP InjCrv_rPoI2LmbdT3Min_CUR InjCrv_stPoI2LmbdGovMinStd_C InjCrv_stPoI2LmbdLimM_C InjCrv_stPoI2LmbdSCDac_C InjCrv_stPoI2LmbdT3LimM1_C InjCrv_stPoI2LmbdT3LimM2_C InjCrv_stPoI2Sel1_C InjCrv_stPoI2Sel2_C InjCrv_stPoI2Sel3_C InjCrv_stPoI2Sel4_C InjCrv_stPreTrbnT3Dac_C InjCrv_stT3CtlAct1_C InjCrv_stT3CtlAct2_C InjCrv_stT3CtlAct3_C InjCrv_stT3CtlAct4_C InjCrv_stT3CtlNoAct1_C InjCrv_stT3CtlNoAct2_C InjCrv_stT3CtlNoAct3_C InjCrv_stT3CtlNoAct4_C InjCrv_stfacPoI2T3Only_C InjCrv_tPreTrbn1_MAP InjCrv_tPreTrbn2_MAP InjCrv_tPreTrbn3_MAP InjCrv_tPreTrbn4_MAP InjCrv_tPreTrbnNom_Channel InjCrv_tPreTrbnNom_Vector InjCrv_tPreTrbnPoI2T31Off_C InjCrv_tPreTrbnPoI2T31On_C InjCrv_tPreTrbnPoI2T32Off_C InjCrv_tPreTrbnPoI2T32On_C InjCrv_tPreTrbnPoI2T33Off_C InjCrv_tPreTrbnPoI2T33On_C InjCrv_tPreTrbnPoI2T34Off_C InjCrv_tPreTrbnPoI2T34On_C /end DEF_CHARACTERISTIC
/end FUNCTION
/begin FUNCTION InjCrv_PoI2LmbdT3Dia "Überwachung der Lambda/T3-Regelung der Nacheinspritzung"
 /begin DEF_CHARACTERISTIC DSM_CDCDfp_InjCrvT3DiaMax_C DSM_CDCDfp_InjCrvT3DiaMin_C DSM_CDKDfp_InjCrvT3DiaMax_C DSM_CDKDfp_InjCrvT3DiaMin_C DSM_ClaDfp_InjCrvT3DiaMax_C DSM_ClaDfp_InjCrvT3DiaMin_C DSM_EnvDfp_InjCrvT3DiaMax_C DSM_EnvDfp_InjCrvT3DiaMin_C DSM_FMKDfp_InjCrvT3DiaMax_C DSM_FMKDfp_InjCrvT3DiaMin_C DSM_InhDfp_InjCrvT3DiaMax_C DSM_InhDfp_InjCrvT3DiaMin_C DSM_TypDfp_InjCrvT3DiaMax_C DSM_TypDfp_InjCrvT3DiaMin_C InjCrv_DebT3DiaMaxDef_C InjCrv_DebT3DiaMaxOk_C InjCrv_DebT3DiaMaxStpDwn_C InjCrv_DebT3DiaMaxStpUp_C InjCrv_DebT3DiaMinDef_C InjCrv_DebT3DiaMinOk_C InjCrv_DebT3DiaMinStpDwn_C InjCrv_DebT3DiaMinStpUp_C InjCrv_facT3DiaPreNomFltKp_C InjCrv_facT3DiapEnvCorr_CUR InjCrv_facT3DiatEnvCorr_CUR InjCrv_stT3DiaMskEna_C InjCrv_swtT3DiaAirSel_C InjCrv_swtT3DiaEna_C InjCrv_tT3DiaDevMax_C InjCrv_tT3DiaDevMax_MAP InjCrv_tT3DiaDevMin_C InjCrv_tT3DiaDevMin_MAP InjCrv_tT3DiaShtrpDevMax_C InjCrv_tT3DiaShtrpDevMin_C InjCrv_tiT3DiaCTDel_CUR InjCrv_tiT3DiaDel_C InjCrv_tiT3DiaEGPDel_CUR InjCrv_tiT3DiaShtrpDel_C /end DEF_CHARACTERISTIC
/end FUNCTION
/begin FUNCTION InjCrv_PoI2Q "Nacheinspritzung 2, Mengenberechnung" /begin DEF_CHARACTERISTIC InjCrv_qPoI2Eff_C /end DEF_CHARACTERISTIC /end FUNCTION
/begin FUNCTION InjCrv_PoI2TPst "T4'-Regelung der Nacheinspritzung"
 /begin DEF_CHARACTERISTIC InjCrv_facTPstKp_CUR InjCrv_qOpOfsMax_MAP InjCrv_qTPreOfsOvR_MAP InjCrv_qTPstOfsOvR_MAP InjCrv_tOxiPstMax_C /end DEF_CHARACTERISTIC
/end FUNCTION
/begin FUNCTION InjCtl_qCo "Mengenkoordination" /begin DEF_CHARACTERISTIC InjCtl_swtFMACor_C /end DEF_CHARACTERISTIC /end FUNCTION
/begin FUNCTION InjCtl_qLimErrCalc "Begrenzungsmenge im Systemfehlerfall" /begin DEF_CHARACTERISTIC InjCtl_dqLimDwn_C InjCtl_dqLimUp_C InjCtl_qLimErr_CUR /end DEF_CHARACTERISTIC /end FUNCTION
/begin FUNCTION InjUn_FlTempCor "Kraftstofftemperaturkorrektur"
 /begin DEF_CHARACTERISTIC InjUn_QntyPerTemp_MAP InjUn_facqRedovn_CUR InjUn_swtTempSel_C InjUn_tFlDiffCor_CUR InjUn_tFlRef_MAP /end DEF_CHARACTERISTIC
/end FUNCTION
/begin FUNCTION InjUn_PSG16 "Einspritzsystem PSG16" /begin SUB_FUNCTION FQSVCD /end SUB_FUNCTION /end FUNCTION
/begin FUNCTION InjVCD_ProgMI "Programmierung der MI1, Initialisierung von Schnelllöschung und Haltestrom"
 /begin DEF_CHARACTERISTIC InjVCD_iHold_C InjVCD_numIncrAvrg_C InjVCD_phiHys_C InjVCD_tiFastDecayMI1_C InjVCD_tiLead_C /end DEF_CHARACTERISTIC
/end FUNCTION
/begin FUNCTION InjVCD_ProgPiI "Programmierung der Voreinspritzung" /begin DEF_CHARACTERISTIC InjVCD_tiFastDecayPiI1_C /end DEF_CHARACTERISTIC /end FUNCTION
/begin FUNCTION InjVCD_ProgPoI "Programmierung der Nacheinspritzung" /begin DEF_CHARACTERISTIC InjVCD_tiEODOfs_C InjVCD_tiFastDecayPoI2_C /end DEF_CHARACTERISTIC /end FUNCTION
/begin FUNCTION InjVCD_dynWUP "Ermittlung der Inkrementperiodendauer vor dem virtuellen dynamischen WUP"
 /begin DEF_CHARACTERISTIC InjVCD_nWUPOff_C InjVCD_nWUPOn_C InjVCD_phiAvrg_C InjVCD_phiIntrWUP_C InjVCD_phiWUPTDC_C InjVCD_phidiffIncrTDC_C InjVCD_swtMainIntr_C InjVCD_swtModus_C /end DEF_CHARACTERISTIC
/end FUNCTION
/begin FUNCTION InjVCD_stInj "allgemeine Abschaltbedingungen für Einspritzsequenz" /begin DEF_CHARACTERISTIC InjVCD_nShOffLoLim_C InjVCD_nShOffUpLim_C /end DEF_CHARACTERISTIC /end FUNCTION
/begin FUNCTION InjVlv_CalcInjDurMI1 "Förderdauerberechnung der Haupteinspritzung"
 /begin DEF_CHARACTERISTIC InjVlv_numMI1_CUR InjVlv_phiInjMI1_MAP0 InjVlv_phiInjMI1_MAP1 InjVlv_phiInjMI1_MAP2 InjVlv_phiInjMI1_MAP3 InjVlv_phiInjMI1_MAP4 InjVlv_phiInjMI1_MAP5 InjVlv_phiInjMI1_MAP6 /end DEF_CHARACTERISTIC
/end FUNCTION
/begin FUNCTION InjVlv_CalcInjDurPiI1 "Förderdauerberechnung Voreinspritzung"
 /begin DEF_CHARACTERISTIC InjVlv_numPiI1_CUR InjVlv_phiInjPiI1_MAP0 InjVlv_phiInjPiI1_MAP1 /end DEF_CHARACTERISTIC
/end FUNCTION
/begin FUNCTION InjVlv_CalcInjDurPoI2 "Förderdauerberechnung Nacheinspritzung"
 /begin DEF_CHARACTERISTIC InjVlv_numPoI2_CUR InjVlv_phiInjPoI2_MAP0 InjVlv_phiInjPoI2_MAP1 /end DEF_CHARACTERISTIC
/end FUNCTION
/begin FUNCTION InjVlv_ErrDet "Injektorfehlererkennung" /begin DEF_CHARACTERISTIC InjVlv_numSegOfs1_C InjVlv_numSegOfs2_C InjVlv_stErrDet_C /end DEF_CHARACTERISTIC /end FUNCTION
/begin FUNCTION InjVlv_MonShOff "Injektordiagnose - Abschaltung"
 /begin DEF_CHARACTERISTIC InjVlv_DebBnk1AMaxDef_C InjVlv_DebBnk1AMaxOk_C InjVlv_DebBnk1ASigDef_C InjVlv_DebBnk1ASigOk_C InjVlv_DebBnk1AType_C InjVlv_DebCyl1ASigDef_C InjVlv_DebCyl1ASigOk_C InjVlv_DebCyl1AType_C /end DEF_CHARACTERISTIC
/end FUNCTION
/begin FUNCTION InjVlv_qMin "Überwachung der minimalen Einspritzmenge"
 /begin DEF_CHARACTERISTIC InjCrv_qMI1Off_CUR InjCrv_qMI1On_CUR InjCrv_qPiI1Off_CUR InjCrv_qPiI1On_CUR InjCrv_qPoI2Off_CUR InjCrv_qPoI2On_CUR /end DEF_CHARACTERISTIC
/end FUNCTION
/begin FUNCTION InjVlv_tiMin "Minimale Ansteuerpause nach Haupteinspritzung"
 /begin DEF_CHARACTERISTIC InjVlv_tiMI1BreMin_MAP InjVlv_tiSVMI1min_C InjVlv_tiSVPoI2min_C /end DEF_CHARACTERISTIC
/end FUNCTION
/begin FUNCTION InjVlv_tiMinPiI1 "Ermittlung der minimale Ansteuerpause, -dauer Voreinspritzung" /begin DEF_CHARACTERISTIC InjVlv_tiPiI1BreMin_MAP InjVlv_tiSVPiI1min_C /end DEF_CHARACTERISTIC /end FUNCTION
/begin FUNCTION KWP2000 "Keyword Protokoll 2000 Implementierung" /begin DEF_CHARACTERISTIC Carb_stAppl_C K2RDI_SWPartNum_C K2rffd_FrzFrEnv_Idx_C /end DEF_CHARACTERISTIC /end FUNCTION
/begin FUNCTION LASCD "Komponententreiber für Längsbeschleunigungssensor"
 /begin DEF_CHARACTERISTIC LASCD_aLongDfl_C LASCD_daLongRmpSlpDwn_C LASCD_daLongRmpSlpUp_C LASCD_stSensIDWord_C LASCD_swtAccSens_C LASCD_tiDebCANSigDef_C LASCD_tiDebCANSigOk_C LASCD_tiFlt_CUR LASCD_tiPT1_C /end DEF_CHARACTERISTIC
/end FUNCTION
/begin FUNCTION LIGov "Leerlaufregler"
 /begin SUB_FUNCTION LIGov_CalcSetPoint LIGov_CalcState LIGov_Governor LIGov_SelectParameter /end SUB_FUNCTION
/end FUNCTION
/begin FUNCTION LIGov_CalcSetPoint "Solldrehzahlberechnung der Leerlaufregelung"
 /begin DEF_CHARACTERISTIC LIGov_YHigh_C LIGov_YLow_C LIGov_dnLimHighTrm_C LIGov_dnLimLowTrm_C LIGov_nCltAirP_MAP LIGov_nEngOffset_C LIGov_nLimBasAdjHigh_C LIGov_nLimHigh_C LIGov_nLim_C LIGov_nRev_CUR LIGov_nRgnIdleOffset_C LIGov_nRmpCVTSlpDwnSetPoint_C LIGov_nRmpCVTSlpUpSetPoint_C LIGov_nRmpInitOffSet_C LIGov_nRmpSlpDwnBasAdj_C LIGov_nRmpSlpDwnSetPoint_C LIGov_nRmpSlpUpBasAdj_C LIGov_nRmpSlpUpSetPoint_C LIGov_nSetPointErr_C LIGov_nSetpointDriveAway_CUR LIGov_nSetpointWarm_CUR LIGov_nTemp1_MAP LIGov_nTemp2Rgn1_CUR LIGov_nTemp2Rgn2_CUR LIGov_nTemp2_CUR LIGov_stCalcRgnMsk1_C LIGov_stCalcRgnMsk2_C LIGov_swtParDriveoffType_C LIGov_swtParDriveoffVal_C LIGov_swtTempTrqInit_C LIGov_tEngLim_C LIGov_tEngOilLim_C LIGov_tiST_C LIGov_tiTW_C LIGov_vThresPointHigh_C LIGov_vThresPointLow_C /end DEF_CHARACTERISTIC
/end FUNCTION
/begin FUNCTION LIGov_CalcState "Zustandsbestimmung des Leerlaufreglers"
 /begin DEF_CHARACTERISTIC LIGov_nLimHighOffs_C LIGov_nLimLow_C LIGov_nOffsetUbr_C LIGov_rThresDriveoff_C LIGov_rThresTrqDem_C LIGov_swtGripDet_C LIGov_swtTempHys_C LIGov_swtTrqDemDefrost_C LIGov_tEngJit_C LIGov_tiDemDefrostDelay_C LIGov_vThreshUbr_C /end DEF_CHARACTERISTIC
/end FUNCTION
/begin FUNCTION LIGov_Governor "Leerlaufregler"
 /begin DEF_CHARACTERISTIC LIGov_nOffsetPreCtrltrqDem_C LIGov_nOffsetPredef_C LIGov_rTransSet_CUR LIGov_swtPrmChgInitDrv_C LIGov_swtPrmChgInitUbr_C LIGov_swtPrmChgInit_C LIGov_swtTIIInitOn_C LIGov_swtTransRec_C LIGov_tiPT1_CUR LIGov_trqDMaxBasAdjCancel_C LIGov_trqInitI_CUR LIGov_trqMaxTemp_CUR LIGov_trqThresDefrostI_C LIGov_vInitMin_C /end DEF_CHARACTERISTIC
/end FUNCTION
/begin FUNCTION LIGov_SelectParameter "Parametersatzauswahl des Leerlaufreglers"
 /begin DEF_CHARACTERISTIC LIGov_DriveOffDHypDenom_CUR LIGov_DriveOffDHypNum_CUR LIGov_DriveOffDKd_CUR LIGov_DriveOffDT1_CUR LIGov_DriveOffIKiNeg_CUR LIGov_DriveOffIKiPos_CUR LIGov_DriveOffIKi_CUR LIGov_DriveOffIWinNeg_CUR LIGov_DriveOffIWinPos_CUR LIGov_DriveOffPKpNeg_CUR LIGov_DriveOffPKpPos_CUR LIGov_DriveOffPKp_CUR LIGov_DriveOffPWinNeg_CUR LIGov_DriveOffPWinPos_CUR LIGov_DriveOffPredef_CUR LIGov_GearDHypDenom_MAP LIGov_GearDHypNum_MAP LIGov_GearDKd_MAP LIGov_GearDT1_MAP LIGov_GearIKiNeg_MAP LIGov_GearIKiPos_MAP LIGov_GearIKi_MAP LIGov_GearIWinNeg_MAP LIGov_GearIWinPos_MAP LIGov_GearPKpNeg_MAP LIGov_GearPKpPos_MAP LIGov_GearPKp_MAP LIGov_GearPWinNeg_MAP LIGov_GearPWinPos_MAP LIGov_GearPredef_MAP LIGov_UbrDHypDenom_CUR LIGov_UbrDHypNum_CUR LIGov_UbrDKd_CUR LIGov_UbrDT1_CUR LIGov_UbrIKiNeg_CUR LIGov_UbrIKiPos_CUR LIGov_UbrIKi_CUR LIGov_UbrIWinNeg_CUR LIGov_UbrIWinPos_CUR LIGov_UbrPKpNeg_CUR LIGov_UbrPKpPos_CUR LIGov_UbrPKp_CUR LIGov_UbrPWinNeg_CUR LIGov_UbrPWinPos_CUR LIGov_UbrPredef_CUR LIGov_nOffsetPreCtrl_CUR /end DEF_CHARACTERISTIC
/end FUNCTION
/end MODULE
/end PROJECT
