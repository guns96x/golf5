ASAP2_VERSION 1 3
/begin PROJECT X447 "EDC16U34"
/begin HEADER "" VERSION "VAA1" PROJECT_NO X447 /end HEADER
/begin MODULE DIM ""
/begin MOD_COMMON "" BYTE_ORDER MSB_FIRST ALIGNMENT_BYTE 1 ALIGNMENT_WORD 2 ALIGNMENT_LONG 4 ALIGNMENT_FLOAT32_IEEE 4 /end MOD_COMMON
/begin MEASUREMENT Fid_EGSysTemp_mp "Meßpunkt für Abschaltung des Abgaskrümmer-Temperaturmodells bei fehlerhaften Eingangsgrößen" UBYTE OneToOne 1 100 0.00 255.0 FORMAT "%5.1" ECU_ADDRESS 0x9FFCE8 /end MEASUREMENT
/begin MEASUREMENT Fid_EGSysTrbn_mp "Meßpunkt für Abschaltung des Turbolader-Temperaturmodells bei fehlerhaften Eingangsgrößen" UBYTE OneToOne 1 100 0.00 255.0 FORMAT "%5.1" ECU_ADDRESS 0x9FFCE9 /end MEASUREMENT
/begin MEASUREMENT Fid_EGSysTube_mp "Meßpunkt für Abschaltung des Rohr-Temperaturmodells bei fehlerhaften Eingangsgrößen" UBYTE OneToOne 1 100 0.00 255.0 FORMAT "%5.1" ECU_ADDRESS 0x9FFCEA /end MEASUREMENT
/begin MEASUREMENT Fid_EGSys_AP_mp "Fehler des Atmosphärendruckfühlers" UBYTE OneToOne 1 100 0.00 255.0 FORMAT "%5.1" ECU_ADDRESS 0x9FFCEB /end MEASUREMENT
/begin MEASUREMENT Fid_EngdtEngCOTSCD_mp "Fid für einen Fehlerfall von COTSCD" UBYTE OneToOne 1 100 0.00 255.0 FORMAT "%5.1" ECU_ADDRESS 0x9FFCEC /end MEASUREMENT
/begin MEASUREMENT Fid_EngdtEngFTSCD_mp "Fid für den Fehlerfall von FTSCD" UBYTE OneToOne 1 100 0.00 255.0 FORMAT "%5.1" ECU_ADDRESS 0x9FFCED /end MEASUREMENT
/begin MEASUREMENT Fid_EngdtEngIATSCD_mp "Fid für den Fehlerfall von IATSCD" UBYTE OneToOne 1 100 0.00 255.0 FORMAT "%5.1" ECU_ADDRESS 0x9FFCEE /end MEASUREMENT
/begin MEASUREMENT Fid_EngdtEng_mp "Messpunkt fuer Funktions Identifier Fid_EngdtEng" UBYTE OneToOne 1 100 0.00 255.0 FORMAT "%5.1" ECU_ADDRESS 0x9FFCEF /end MEASUREMENT
/begin MEASUREMENT Fid_EngMBackUpTimer_mp "Fid wird für die Umschaltstrategie zwischen BackUp und SyncOk mode verwendet" UBYTE OneToOne 1 100 0.00 255.0 FORMAT "%5.1" ECU_ADDRESS 0x9FFCF0 /end MEASUREMENT
/begin MEASUREMENT Fid_EngMCaS1_mp "Fid-Definition zur Vermeidung der Nockenwellendiagnose beim Versorgungsfehler" UBYTE OneToOne 1 100 0.00 255.0 FORMAT "%5.1" ECU_ADDRESS 0x9FFCF1 /end MEASUREMENT
/begin MEASUREMENT Fid_EngMCaSBackUp_mp "Wechsel ins Notfahren erfolgt bei gültigem Nockenwellensignal" UBYTE OneToOne 1 100 0.00 255.0 FORMAT "%5.1" ECU_ADDRESS 0x9FFCF2 /end MEASUREMENT
/begin MEASUREMENT Fid_EngMCrS1_mp "Fid-Definition zur Vermeidung der Kurbelwellendiagnose beim Versorgungsfehler" UBYTE OneToOne 1 100 0.00 255.0 FORMAT "%5.1" ECU_ADDRESS 0x9FFCF3 /end MEASUREMENT
/begin MEASUREMENT Fid_EngMCrSBackUp_mp "Wenn EngM_stBackUpVar_C=1,dann nur,wenn der Dfp_EngMCrS1 einen Fehler meldet,wird(über diesen Fid)in den BackUp Modus gewechselt" UBYTE OneToOne 1 100 0.00 255.0 FORMAT "%5.1" ECU_ADDRESS 0x9FFCF4 /end MEASUREMENT
/begin MEASUREMENT Fid_EngMon_Actv_mp "Fid für Aktivierung der Verbrennungserkennung mit Lambda-Sonde" UBYTE OneToOne 1 100 0.00 255.0 FORMAT "%5.1" ECU_ADDRESS 0x9FFCF5 /end MEASUREMENT
/begin MEASUREMENT Fid_EngM_ChkStrtSpd_mp "Fid für Anfang nur mit Kurbelwellen-System" UBYTE OneToOne 1 100 0.00 255.0 FORMAT "%5.1" ECU_ADDRESS 0x9FFCF6 /end MEASUREMENT
/begin MEASUREMENT Fid_EngM_nCoMa_mp "Messpunkt des Function Identifiers für das drehzahlabhängige scheduling (andere Schaltschwelle im Notfahren)" UBYTE OneToOne 1 100 0.00 255.0 FORMAT "%5.1" ECU_ADDRESS 0x9FFCF7 /end MEASUREMENT
/begin MEASUREMENT Fid_EngM_trqFrc_mp "Temperaturfehler bei der Motor-Reibmomentberechnung" UBYTE OneToOne 1 100 0.00 255.0 FORMAT "%5.1" ECU_ADDRESS 0x9FFCF8 /end MEASUREMENT
/begin MEASUREMENT Fid_EngOvrSpd_mp "Messpunkt fuer Funktions Identifier Fid_EngOvrSpd" UBYTE OneToOne 1 100 0.00 255.0 FORMAT "%5.1" ECU_ADDRESS 0x9FFCF9 /end MEASUREMENT
/begin MEASUREMENT Fid_EngPOpCalc1_mp "Messpunkt fuer Funktions Identifier Fid_EngPOpCalc1" UBYTE OneToOne 1 100 0.00 255.0 FORMAT "%5.1" ECU_ADDRESS 0x9FFCFA /end MEASUREMENT
/begin MEASUREMENT Fid_EngPOpCalc2_mp "Messpunkt fuer Funktions Identifier Fid_EngPOpCalc2" UBYTE OneToOne 1 100 0.00 255.0 FORMAT "%5.1" ECU_ADDRESS 0x9FFCFB /end MEASUREMENT
/begin MEASUREMENT Fid_EngPOpCalcSpeed_mp "Funktionsidentifier für Fehlerpfad der Signalfehlermeldung der Fahrzeuggeschwindigkeit" UBYTE OneToOne 1 100 0.00 255.0 FORMAT "%5.1" ECU_ADDRESS 0x9FFCFC /end MEASUREMENT
/begin MEASUREMENT Fid_EngPOpCalcVal_mp "Funktionsidentifier für Fehlerpfad der Signalfehlermeldung der Fahrzeuggeschwindigkeit" UBYTE OneToOne 1 100 0.00 255.0 FORMAT "%5.1" ECU_ADDRESS 0x9FFCFD /end MEASUREMENT
/begin MEASUREMENT Fid_EngPrtCaS_mp "Messpunkt fuer Funktions Identifier Fid_EngPrtCaS" UBYTE OneToOne 1 100 0.00 255.0 FORMAT "%5.1" ECU_ADDRESS 0x9FFCFE /end MEASUREMENT
/begin MEASUREMENT Fid_EngPrtCrS_mp "Messpunkt fuer Funktions Identifier Fid_EngPrtCrS" UBYTE OneToOne 1 100 0.00 255.0 FORMAT "%5.1" ECU_ADDRESS 0x9FFCFF /end MEASUREMENT
/begin MEASUREMENT Fid_EngPrtTrqLim_mp "Functions Identifier des T3-Sensor Defekts" UBYTE OneToOne 1 100 0.00 255.0 FORMAT "%5.1" ECU_ADDRESS 0x9FFD00 /end MEASUREMENT
/begin MEASUREMENT Fid_EngPrt_nLimErr_mp "Fid für zusätzliche Motordrehzahlbegrenzung bei Systemfehler" UBYTE OneToOne 1 100 0.00 255.0 FORMAT "%5.1" ECU_ADDRESS 0x9FFD01 /end MEASUREMENT
/begin MEASUREMENT Fid_FanCDActrErr_mp "Fid für Fehlerpfad des Lüftersteuergeräteausgangs" UBYTE OneToOne 1 100 0.00 255.0 FORMAT "%5.1" ECU_ADDRESS 0x9FFD02 /end MEASUREMENT
/begin MEASUREMENT Fid_FanCtlCanAC1_mp "Messpunkt fuer Funktions Identifier Fid_FanCtlCanAC1" UBYTE OneToOne 1 100 0.00 255.0 FORMAT "%5.1" ECU_ADDRESS 0x9FFD03 /end MEASUREMENT
/begin MEASUREMENT Fid_FanCtl_COTSErr_mp "Messpunkt fuer Funktions Identifier Fid_FanCtl_COTSErr" UBYTE OneToOne 1 100 0.00 255.0 FORMAT "%5.1" ECU_ADDRESS 0x9FFD04 /end MEASUREMENT
/begin MEASUREMENT Fid_FanCtl_tClntErr_mp "Fid für Fehler bei der Kühlmittelsollwertermittlung" UBYTE OneToOne 1 100 0.00 255.0 FORMAT "%5.1" ECU_ADDRESS 0x9FFD05 /end MEASUREMENT
/begin MEASUREMENT Fid_FanCtl_vCurrErr_mp "Fid für Fehler der Komponente VSSCD" UBYTE OneToOne 1 100 0.00 255.0 FORMAT "%5.1" ECU_ADDRESS 0x9FFD06 /end MEASUREMENT
/begin MEASUREMENT Fid_FBC_mp "FID zur Aktivierung der Mengenausgleichsregelung" UBYTE OneToOne 1 100 0.00 255.0 FORMAT "%5.1" ECU_ADDRESS 0x9FFD07 /end MEASUREMENT
/begin MEASUREMENT Fid_FlMngFullLdRglOff_mp "Meßpunkt für Abschaltung des Lambda-Volllastreglers bei Systemfehlern" UBYTE OneToOne 1 100 0.00 255.0 FORMAT "%5.1" ECU_ADDRESS 0x9FFD08 /end MEASUREMENT
/begin MEASUREMENT Fid_FlSCDCanDef_mp "Fid Fehler des Tankstandsignals über CAN" UBYTE OneToOne 1 100 0.00 255.0 FORMAT "%5.1" ECU_ADDRESS 0x9FFD09 /end MEASUREMENT
/begin MEASUREMENT Fid_FlSysCTSSens_mp "Fid zur Deaktivierung der Verwendung der Wassertemperatur als Kraftstoffsystemtemperatur" UBYTE OneToOne 1 100 0.00 255.0 FORMAT "%5.1" ECU_ADDRESS 0x9FFD0A /end MEASUREMENT
/begin MEASUREMENT Fid_FlSysDens_mp "Fid zur Deaktivierung der Kraftstoffdichtenberechnung" UBYTE OneToOne 1 100 0.00 255.0 FORMAT "%5.1" ECU_ADDRESS 0x9FFD0B /end MEASUREMENT
/begin MEASUREMENT Fid_FlSysFTSSens_mp "Fid zur Deaktivierung der Verwendung der Kraftstofftemperatur als Kraftstoffsystemtemperatur" UBYTE OneToOne 1 100 0.00 255.0 FORMAT "%5.1" ECU_ADDRESS 0x9FFD0C /end MEASUREMENT
/begin MEASUREMENT Fid_FMASwtOff1_mp "Meßpunkt für FMA-Abschaltung bei leichten Systemfehlern (Abschaltmöglichkeit 1)" UBYTE OneToOne 1 100 0.00 255.0 FORMAT "%5.1" ECU_ADDRESS 0x9FFD0D /end MEASUREMENT
/begin MEASUREMENT Fid_FMASwtOff3_mp "Meßpunkt für FMA-Abschaltung bei schweren Systemfehlern (Abschaltmöglichkeit 3)" UBYTE OneToOne 1 100 0.00 255.0 FORMAT "%5.1" ECU_ADDRESS 0x9FFD0E /end MEASUREMENT
/begin MEASUREMENT Fid_FrmMngAC1Npl_mp "Messpunkt für Funktionsidentifier Fid_FrmMngAC1Npl" UBYTE OneToOne 1 100 0.00 255.0 FORMAT "%5.1" ECU_ADDRESS 0x9FFD0F /end MEASUREMENT
/begin MEASUREMENT Fid_FrmMngAC1TO_mp "Messpunkt für Funktionsidentifier Fid_FrmMngAC1TO" UBYTE OneToOne 1 100 0.00 255.0 FORMAT "%5.1" ECU_ADDRESS 0x9FFD10 /end MEASUREMENT
/begin MEASUREMENT Fid_FrmMngACCNpl_mp "Messpunkt für Funktions Identifier Fid_FrmMngACCNpl" UBYTE OneToOne 1 100 0.00 255.0 FORMAT "%5.1" ECU_ADDRESS 0x9FFD11 /end MEASUREMENT
/begin MEASUREMENT Fid_FrmMngACCTO_mp "Meßpunkt für Funktionsidentifier ACCTO (Timeout)" UBYTE OneToOne 1 100 0.00 255.0 FORMAT "%5.1" ECU_ADDRESS 0x9FFD12 /end MEASUREMENT
/begin MEASUREMENT Fid_FrmMngACCWrongCoded_mp "Meßpunkt für Funktionsidentifier Fid_FrmMngACCWrongCoded (Codierfehler der CrCtl oder ACC)" UBYTE OneToOne 1 100 0.00 255.0 FORMAT "%5.1" ECU_ADDRESS 0x9FFD13 /end MEASUREMENT
/begin MEASUREMENT Fid_FrmMngAC_mp "Messpunkt fuer Funktions Identifier Fid_FrmMngAC" UBYTE OneToOne 1 100 0.00 255.0 FORMAT "%5.1" ECU_ADDRESS 0x9FFD14 /end MEASUREMENT
/begin MEASUREMENT Fid_FrmMngAIRBGNpl_mp "Messpunkt für Funktions Identifier Fid_FrmMngAIRBGNpl" UBYTE OneToOne 1 100 0.00 255.0 FORMAT "%5.1" ECU_ADDRESS 0x9FFD15 /end MEASUREMENT
/begin MEASUREMENT Fid_FrmMngAIRBGTO_mp "Messpunkt fuer Funktions Identifier Fid_FrmMngAIRBGTO" UBYTE OneToOne 1 100 0.00 255.0 FORMAT "%5.1" ECU_ADDRESS 0x9FFD16 /end MEASUREMENT
/begin MEASUREMENT Fid_FrmMngALTCD_Load_mp "Messpunkt fuer Funktions Identifier Fid_FrmMngALTCD_Load" UBYTE OneToOne 1 100 0.00 255.0 FORMAT "%5.1" ECU_ADDRESS 0x9FFD17 /end MEASUREMENT
/begin MEASUREMENT Fid_FrmMngAPPRAW_mp "Meßpunkt für Funktions-identifier for Fid_FrmMngAPPRAW" UBYTE OneToOne 1 100 0.00 255.0 FORMAT "%5.1" ECU_ADDRESS 0x9FFD18 /end MEASUREMENT
/begin MEASUREMENT Fid_FrmMngAPP_mp "Messpunkt fuer Funktions Identifier Fid_FrmMngAPP" UBYTE OneToOne 1 100 0.00 255.0 FORMAT "%5.1" ECU_ADDRESS 0x9FFD19 /end MEASUREMENT
/begin MEASUREMENT Fid_FrmMngAPS_mp "Messpunkt fuer Funktions Identifier Fid_FrmMngAPS" UBYTE OneToOne 1 100 0.00 255.0 FORMAT "%5.1" ECU_ADDRESS 0x9FFD1A /end MEASUREMENT
/begin MEASUREMENT Fid_FrmMngAWD1Npl_mp "Messpunkt für Funktionsidentifier Fid_FrmMngAWD1Npl" UBYTE OneToOne 1 100 0.00 255.0 FORMAT "%5.1" ECU_ADDRESS 0x9FFD1B /end MEASUREMENT
/begin MEASUREMENT Fid_FrmMngAWD1TO_mp "Messpunkt fuer Funktions Identifier Fid_FrmMngAWD1TO" UBYTE OneToOne 1 100 0.00 255.0 FORMAT "%5.1" ECU_ADDRESS 0x9FFD1C /end MEASUREMENT
/begin MEASUREMENT Fid_FrmMngBEM1Npl_mp "Messpunkt für Funktionsidentifier Fid_FrmMngBEM1Npl" UBYTE OneToOne 1 100 0.00 255.0 FORMAT "%5.1" ECU_ADDRESS 0x9FFD1D /end MEASUREMENT
/begin MEASUREMENT Fid_FrmMngBEM1TO_mp "Meßpunkt für Funktionsidentifier BEM1TO (Timeout)" UBYTE OneToOne 1 100 0.00 255.0 FORMAT "%5.1" ECU_ADDRESS 0x9FFD1E /end MEASUREMENT
/begin MEASUREMENT Fid_FrmMngBPSCD_IntVal_mp "Meßpunkt für Funktions-identifier for Fid_FrmMngBPSCD_IntVal" UBYTE OneToOne 1 100 0.00 255.0 FORMAT "%5.1" ECU_ADDRESS 0x9FFD1F /end MEASUREMENT
/begin MEASUREMENT Fid_FrmMngBRK1Npl_mp "Meßpunkt für Funktionsidentifier Fid_FrmMngBRK1Npl" UBYTE OneToOne 1 100 0.00 255.0 FORMAT "%5.1" ECU_ADDRESS 0x9FFD20 /end MEASUREMENT
/begin MEASUREMENT Fid_FrmMngBRK1TO_mp "Messpunkt fuer Funktions Identifier Fid_FrmMngBRK1TO" UBYTE OneToOne 1 100 0.00 255.0 FORMAT "%5.1" ECU_ADDRESS 0x9FFD21 /end MEASUREMENT
/begin MEASUREMENT Fid_FrmMngBRK2Npl_mp "Messpunkt für Funktionsidentifier Fid_FrmMngBRK2Npl" UBYTE OneToOne 1 100 0.00 255.0 FORMAT "%5.1" ECU_ADDRESS 0x9FFD22 /end MEASUREMENT
/begin MEASUREMENT Fid_FrmMngBRK2TO_mp "Messpunkt für Funktionsidentifier Fid_FrmMngBRK2TO" UBYTE OneToOne 1 100 0.00 255.0 FORMAT "%5.1" ECU_ADDRESS 0x9FFD23 /end MEASUREMENT
/begin MEASUREMENT Fid_FrmMngBRK8Npl_mp "Meßpunkt für Funktionsidentifier Fid_FrmMngBRK8Npl" UBYTE OneToOne 1 100 0.00 255.0 FORMAT "%5.1" ECU_ADDRESS 0x9FFD24 /end MEASUREMENT
/begin MEASUREMENT Fid_FrmMngBRK8TO_mp "Meßpunkt für Funktionsidentifier BRK8TO (Timeout)" UBYTE OneToOne 1 100 0.00 255.0 FORMAT "%5.1" ECU_ADDRESS 0x9FFD25 /end MEASUREMENT
/begin MEASUREMENT Fid_FrmMngCCTLNpl_mp "Messpunkt für Funktions Identifier Fid_FrmMngCCTLNpl" UBYTE OneToOne 1 100 0.00 255.0 FORMAT "%5.1" ECU_ADDRESS 0x9FFD26 /end MEASUREMENT
/begin MEASUREMENT Fid_FrmMngCCTLTO_mp "Messpunkt fuer Funktions Identifier Fid_FrmMngCCTLTO" UBYTE OneToOne 1 100 0.00 255.0 FORMAT "%5.1" ECU_ADDRESS 0x9FFD27 /end MEASUREMENT
/begin MEASUREMENT Fid_FrmMngCHRGR1Npl_mp "Messpunkt für Funktionsidentifier Fid_FrmMngCHRGR1Npl" UBYTE OneToOne 1 100 0.00 255.0 FORMAT "%5.1" ECU_ADDRESS 0x9FFD28 /end MEASUREMENT
/begin MEASUREMENT Fid_FrmMngCHRGR1TO_mp "Messpunkt für Funktionsidentifier CHRGR1 (Timeout)" UBYTE OneToOne 1 100 0.00 255.0 FORMAT "%5.1" ECU_ADDRESS 0x9FFD29 /end MEASUREMENT
/begin MEASUREMENT Fid_FrmMngCHRGR2Npl_mp "Messpunkt für Funktionsidentifier Fid_FrmMngCHRGR2Npl" UBYTE OneToOne 1 100 0.00 255.0 FORMAT "%5.1" ECU_ADDRESS 0x9FFD2A /end MEASUREMENT
/begin MEASUREMENT Fid_FrmMngCHRGR2TO_mp "Messpunkt für Funktionsidentifier CHRGR2 (Timeout)" UBYTE OneToOne 1 100 0.00 255.0 FORMAT "%5.1" ECU_ADDRESS 0x9FFD2B /end MEASUREMENT
/begin MEASUREMENT Fid_FrmMngCTSCD_mp "Messpunkt für Funktionsidentifier Fid_FrmMngCTSCD" UBYTE OneToOne 1 100 0.00 255.0 FORMAT "%5.1" ECU_ADDRESS 0x9FFD2C /end MEASUREMENT
/begin MEASUREMENT Fid_FrmMngCurInf_mp "Messpunkt für Funktionsidentifier Fid_FrmMngCurInf (APSCD & IATSCD Fehler)" UBYTE OneToOne 1 100 0.00 255.0 FORMAT "%5.1" ECU_ADDRESS 0x9FFD2D /end MEASUREMENT
/begin MEASUREMENT Fid_FrmMngDIA1Npl_mp "Messpunkt für Funktionsidentifier Fid_FrmMngDIA1Npl" UBYTE OneToOne 1 100 0.00 255.0 FORMAT "%5.1" ECU_ADDRESS 0x9FFD2E /end MEASUREMENT
/begin MEASUREMENT Fid_FrmMngDIA1TO_mp "Messpunkt für Funktionsidentifier Fid_FrmMngDIA1TO" UBYTE OneToOne 1 100 0.00 255.0 FORMAT "%5.1" ECU_ADDRESS 0x9FFD2F /end MEASUREMENT
/begin MEASUREMENT Fid_FrmMngDSP1Npl_mp "Fid für Botschaftszähler der Can-Massage Kombi1" UBYTE OneToOne 1 100 0.00 255.0 FORMAT "%5.1" ECU_ADDRESS 0x9FFD30 /end MEASUREMENT
/begin MEASUREMENT Fid_FrmMngDSP1TO_mp "Fid für Time-out Fehler im Kombi1 botschaft" UBYTE OneToOne 1 100 0.00 255.0 FORMAT "%5.1" ECU_ADDRESS 0x9FFD31 /end MEASUREMENT
/begin MEASUREMENT Fid_FrmMngDSP2Npl_mp "Messpunkt für Funktionsidentifier Fid_FrmMngDSP2Npl" UBYTE OneToOne 1 100 0.00 255.0 FORMAT "%5.1" ECU_ADDRESS 0x9FFD32 /end MEASUREMENT
/begin MEASUREMENT Fid_FrmMngDSP2TO_mp "Messpunkt für Funktionsidentifier Fid_FrmMngDSP2TO" UBYTE OneToOne 1 100 0.00 255.0 FORMAT "%5.1" ECU_ADDRESS 0x9FFD33 /end MEASUREMENT
/begin MEASUREMENT Fid_FrmMngDSP3Npl_mp "Messpunkt fuer Funktions Identifier Fid_FrmMngDSP3Npl" UBYTE OneToOne 1 100 0.00 255.0 FORMAT "%5.1" ECU_ADDRESS 0x9FFD34 /end MEASUREMENT
/begin MEASUREMENT Fid_FrmMngDSP3TO_mp "Messpunkt fuer Funktions Identifier Fid_FrmMngDSP3TO" UBYTE OneToOne 1 100 0.00 255.0 FORMAT "%5.1" ECU_ADDRESS 0x9FFD35 /end MEASUREMENT
/begin MEASUREMENT Fid_FrmMngEPB1Npl_mp "Funktionsidentifier DLC-,Checksummen- und Botschaftszäh-lerfehlerder Botschaft EPB1" UBYTE OneToOne 1 100 0.00 255.0 FORMAT "%5.1" ECU_ADDRESS 0x9FFD36 /end MEASUREMENT
/begin MEASUREMENT Fid_FrmMngEPB1TO_mp "Funktionsidentifier Timeout-Fehler der Botschaft EPB1" UBYTE OneToOne 1 100 0.00 255.0 FORMAT "%5.1" ECU_ADDRESS 0x9FFD37 /end MEASUREMENT
/begin MEASUREMENT Fid_FrmMngESCUNpl_mp "Messpunkt für Funktionsidentifier Fid_FrmMngESCUNpl" UBYTE OneToOne 1 100 0.00 255.0 FORMAT "%5.1" ECU_ADDRESS 0x9FFD38 /end MEASUREMENT
/begin MEASUREMENT Fid_FrmMngESCUTO_mp "Messpunkt für Funktionsidentifier Fid_FrmMngESCUTO" UBYTE OneToOne 1 100 0.00 255.0 FORMAT "%5.1" ECU_ADDRESS 0x9FFD39 /end MEASUREMENT
/begin MEASUREMENT Fid_FrmMngFlxTOSTO_mp "Messpunkt für Funktions Identifier Fid_FrmMngFlxTOSTO_mp" UBYTE OneToOne 1 100 0.00 255.0 FORMAT "%5.1" ECU_ADDRESS 0x9FFD3A /end MEASUREMENT
/begin MEASUREMENT Fid_FrmMngGW1Npl_mp "Messpunkt für Funktionsidentifier Fid_FrmMngGW1Npl" UBYTE OneToOne 1 100 0.00 255.0 FORMAT "%5.1" ECU_ADDRESS 0x9FFD3B /end MEASUREMENT
/begin MEASUREMENT Fid_FrmMngGW1TO_mp "Messpunkt für Funktions Identifier Fid_FrmMngGW1TO_mp (GW1 - timeout)" UBYTE OneToOne 1 100 0.00 255.0 FORMAT "%5.1" ECU_ADDRESS 0x9FFD3C /end MEASUREMENT
/begin MEASUREMENT Fid_FrmMngIATS_mp "Messpunkt fuer Funktions Identifier Fid_FrmMngIATS" UBYTE OneToOne 1 100 0.00 255.0 FORMAT "%5.1" ECU_ADDRESS 0x9FFD3D /end MEASUREMENT
/begin MEASUREMENT Fid_FrmMngNIVEAU1Npl_mp "Messpunkt für Funktionsidentifier Fid_FrmMngNIVEAU1Npl" UBYTE OneToOne 1 100 0.00 255.0 FORMAT "%5.1" ECU_ADDRESS 0x9FFD3E /end MEASUREMENT
/begin MEASUREMENT Fid_FrmMngNIVEAU1TO_mp "Messpunkt fuer Funktions Identifier Fid_FrmMngNIVEAU1TO" UBYTE OneToOne 1 100 0.00 255.0 FORMAT "%5.1" ECU_ADDRESS 0x9FFD3F /end MEASUREMENT
/begin MEASUREMENT Fid_FrmMngPrcFan_mp "Messpunkt fuer Funktions Identifier Fid_FrmMngPrcFan" UBYTE OneToOne 1 100 0.00 255.0 FORMAT "%5.1" ECU_ADDRESS 0x9FFD40 /end MEASUREMENT
/begin MEASUREMENT Fid_FrmMngSA1Npl_mp "Messpunkt fuer Funktions Identifier Fid_FrmMngSA1Npl" UBYTE OneToOne 1 100 0.00 255.0 FORMAT "%5.1" ECU_ADDRESS 0x9FFD41 /end MEASUREMENT
/begin MEASUREMENT Fid_FrmMngSA1TO_mp "Messpunkt fuer Funktions Identifier Fid_FrmMngSA1TO" UBYTE OneToOne 1 100 0.00 255.0 FORMAT "%5.1" ECU_ADDRESS 0x9FFD42 /end MEASUREMENT
/begin MEASUREMENT Fid_FrmMngSrvPmp_mp "Esatzfunkltion für Servopumpenfehler bei Berechnung Momentenangabe ungenau" UBYTE OneToOne 1 100 0.00 255.0 FORMAT "%5.1" ECU_ADDRESS 0x9FFD43 /end MEASUREMENT
/begin MEASUREMENT Fid_FrmMngSTIGNNpl_mp "Messpunkt für Funktionsidentifier Fid_FrmMngSTIGNNpl" UBYTE OneToOne 1 100 0.00 255.0 FORMAT "%5.1" ECU_ADDRESS 0x9FFD44 /end MEASUREMENT
/begin MEASUREMENT Fid_FrmMngSTIGNTO_mp "Messpunkt für Funktionsidentifier Fid_FrmMngSTIGNTO" UBYTE OneToOne 1 100 0.00 255.0 FORMAT "%5.1" ECU_ADDRESS 0x9FFD45 /end MEASUREMENT
/begin MEASUREMENT Fid_FrmMngTCSTO_mp "Messpunkt fuer Funktions Identifier Fid_FrmMngASRTO" UBYTE OneToOne 1 100 0.00 255.0 FORMAT "%5.1" ECU_ADDRESS 0x9FFD46 /end MEASUREMENT
/begin MEASUREMENT Fid_FrmMngTOSNpl_mp "Messpunkt für Funktionsidentifier Fid_FrmMngTOSNpl" UBYTE OneToOne 1 100 0.00 255.0 FORMAT "%5.1" ECU_ADDRESS 0x9FFD47 /end MEASUREMENT
/begin MEASUREMENT Fid_FrmMngTOSTO_mp "Messpunkt für Funktions Identifier Fid_FrmMngTOSTO_mp" UBYTE OneToOne 1 100 0.00 255.0 FORMAT "%5.1" ECU_ADDRESS 0x9FFD48 /end MEASUREMENT
/begin MEASUREMENT Fid_FrmMngTSC1Npl_mp "Messpunkt für Funktionsidentifier Fid_FrmMngTSC1Npl" UBYTE OneToOne 1 100 0.00 255.0 FORMAT "%5.1" ECU_ADDRESS 0x9FFD49 /end MEASUREMENT
/begin MEASUREMENT Fid_FrmMngTSC1TO_mp "Messpunkt fuer Funktions Identifier Fid_FrmMngTSC1TO" UBYTE OneToOne 1 100 0.00 255.0 FORMAT "%5.1" ECU_ADDRESS 0x9FFD4A /end MEASUREMENT
/begin MEASUREMENT Fid_FrmMngTSC2Npl_mp "Messpunkt für Funktionsidentifier Fid_FrmMngTSC2Npl" UBYTE OneToOne 1 100 0.00 255.0 FORMAT "%5.1" ECU_ADDRESS 0x9FFD4B /end MEASUREMENT
/begin MEASUREMENT Fid_FrmMngTSC2TO_mp "Messpunkt fuer Funktions Identifier Fid_FrmMngTSC2TO" UBYTE OneToOne 1 100 0.00 255.0 FORMAT "%5.1" ECU_ADDRESS 0x9FFD4C /end MEASUREMENT
/begin MEASUREMENT Fid_FrmMngTSC3Npl_mp "Messpunkt für Funktionsidentifier Fid_FrmMngTSC3Npl" UBYTE OneToOne 1 100 0.00 255.0 FORMAT "%5.1" ECU_ADDRESS 0x9FFD4D /end MEASUREMENT
/begin MEASUREMENT Fid_FrmMngTSC3TO_mp "Messpunkt fuer Funktions Identifier Fid_FrmMngTSC3TO" UBYTE OneToOne 1 100 0.00 255.0 FORMAT "%5.1" ECU_ADDRESS 0x9FFD4E /end MEASUREMENT
/begin MEASUREMENT Fid_FrmMngTSC6Npl_mp "Messpunkt fuer Funktions Identifier Fid_FrmMngTSC6Npl" UBYTE OneToOne 1 100 0.00 255.0 FORMAT "%5.1" ECU_ADDRESS 0x9FFD4F /end MEASUREMENT
/begin MEASUREMENT Fid_FrmMngTSC6TO_mp "Messpunkt fuer Funktions Identifier Fid_FrmMngTSC6TO" UBYTE OneToOne 1 100 0.00 255.0 FORMAT "%5.1" ECU_ADDRESS 0x9FFD50 /end MEASUREMENT
/begin MEASUREMENT Fid_FrmMngVCurEng2_mp "Messpunkt fuer Funktions Identifier Fid_FrmMngVCurEng2 (Fahrzeugsgeschwindigkeitsfehler)" UBYTE OneToOne 1 100 0.00 255.0 FORMAT "%5.1" ECU_ADDRESS 0x9FFD51 /end MEASUREMENT
/begin MEASUREMENT Fid_FrmMng_AltPwrCan_mp "Messpunkt fuer Funktions Identifier Fid_FrmMng_AltPwrCan" UBYTE OneToOne 1 100 0.00 255.0 FORMAT "%5.1" ECU_ADDRESS 0x9FFD52 /end MEASUREMENT
/begin MEASUREMENT Fid_FrmMng_GlwCD_Actr_mp "Fid für GSK2-Glühkerzensteuerung" UBYTE OneToOne 1 100 0.00 255.0 FORMAT "%5.1" ECU_ADDRESS 0x9FFD53 /end MEASUREMENT
/begin MEASUREMENT Fid_FrmMng_GlwCtl_Rly_mp "Fid für GSK3-Glühkerzenssteuerung" UBYTE OneToOne 1 100 0.00 255.0 FORMAT "%5.1" ECU_ADDRESS 0x9FFD54 /end MEASUREMENT
/begin MEASUREMENT Fid_FrmMng_KickDown_mp "Meßpunkt für Funktionsidentifier Fid_FrmMng_KickDown_mp" UBYTE OneToOne 1 100 0.00 255.0 FORMAT "%5.1" ECU_ADDRESS 0x9FFD55 /end MEASUREMENT
/begin MEASUREMENT Fid_FTSCDNpl_mp "Messpunkt fuer Funktions Identifier Fid_FTSCDNpl" UBYTE OneToOne 1 100 0.00 255.0 FORMAT "%5.1" ECU_ADDRESS 0x9FFD56 /end MEASUREMENT
/begin MEASUREMENT Fid_FTSErr_mp "Messpunkt fuer Funktions Identifier Fid_FTSErr" UBYTE OneToOne 1 100 0.00 255.0 FORMAT "%5.1" ECU_ADDRESS 0x9FFD57 /end MEASUREMENT
/begin MEASUREMENT Fid_GbSSCD_HW_mp "Funktions Identifier für Hardwarefehler" UBYTE OneToOne 1 100 0.00 255.0 FORMAT "%5.1" ECU_ADDRESS 0x9FFD58 /end MEASUREMENT
/begin MEASUREMENT Fid_GbSSCD_mp "Funktions Identifier für Kupplungssignalfehler" UBYTE OneToOne 1 100 0.00 255.0 FORMAT "%5.1" ECU_ADDRESS 0x9FFD59 /end MEASUREMENT
/begin MEASUREMENT Fid_GearbxCanTSC2_mp "Messpunkt fuer Funktions Identifier Fid_GearbxCanTSC2" UBYTE OneToOne 1 100 0.00 255.0 FORMAT "%5.1" ECU_ADDRESS 0x9FFD5A /end MEASUREMENT
/begin MEASUREMENT Fid_GearbxClthPlaus_mp "Messpunkt fuer Funktions Identifier Fid_GearbxASTl" UBYTE OneToOne 1 100 0.00 255.0 FORMAT "%5.1" ECU_ADDRESS 0x9FFD5B /end MEASUREMENT
/begin MEASUREMENT Fid_GearbxINCCup_mp "Messpunkt fuer Funktions Identifier Fid_GearbxASTh" UBYTE OneToOne 1 100 0.00 255.0 FORMAT "%5.1" ECU_ADDRESS 0x9FFD5C /end MEASUREMENT
/begin MEASUREMENT Fid_GearbxNMinDis_mp "Fid für das Deaktivieren der Leerlaufdrehzahl Anhebung" UBYTE OneToOne 1 100 0.00 255.0 FORMAT "%5.1" ECU_ADDRESS 0x9FFD5D /end MEASUREMENT
/begin MEASUREMENT Fid_GearbxTrbnSpdCAN_mp "Fehlerverriegelung der Gangerkennung über Turbinendrehzahl" UBYTE OneToOne 1 100 0.00 255.0 FORMAT "%5.1" ECU_ADDRESS 0x9FFD5E /end MEASUREMENT
/begin MEASUREMENT Fid_Gearbx_CANerr_mp "Messpunkt fuer Funktions Identifier Fid_Gearbx_CANerr" UBYTE OneToOne 1 100 0.00 255.0 FORMAT "%5.1" ECU_ADDRESS 0x9FFD5F /end MEASUREMENT
/begin MEASUREMENT Fid_Gearbx_EngCTS_mp "Messpunkt fuer Funktions Identifier Fid_GearbxEngCTS_mp" UBYTE OneToOne 1 100 0.00 255.0 FORMAT "%5.1" ECU_ADDRESS 0x9FFD60 /end MEASUREMENT
/begin MEASUREMENT Fid_Gearbx_EngFrcVehSpeed_mp "Fid zur Erkenneung eines Fehlers in der Geschwindigkeitserfassung (Berechnung der Verluste für die Tasse Diesel Überwachung)" UBYTE OneToOne 1 100 0.00 255.0 FORMAT "%5.1" ECU_ADDRESS 0x9FFD61 /end MEASUREMENT
/begin MEASUREMENT Fid_Gearbx_EngFrc_mp "Temperaturfehler bei der Motor-Reibmomentberechnung" UBYTE OneToOne 1 100 0.00 255.0 FORMAT "%5.1" ECU_ADDRESS 0x9FFD62 /end MEASUREMENT
/begin MEASUREMENT Fid_Gearbx_EngOTS_mp "Messpunkt fuer Funktions Identifier Fid_Gearbx_EngOTS_mp" UBYTE OneToOne 1 100 0.00 255.0 FORMAT "%5.1" ECU_ADDRESS 0x9FFD63 /end MEASUREMENT
/begin MEASUREMENT Fid_Gearbx_Eng_mp "Messpunkt fuer Funktions Identifier Fid_Gearbx_Eng_mp" UBYTE OneToOne 1 100 0.00 255.0 FORMAT "%5.1" ECU_ADDRESS 0x9FFD64 /end MEASUREMENT
/begin MEASUREMENT Fid_Gearbx_FrmMngAWD1_mp "Meßpunkt für Funktions Identifier Fid_Gearbx_FrmMngAWD1 (AWD Message-Fehler)" UBYTE OneToOne 1 100 0.00 255.0 FORMAT "%5.1" ECU_ADDRESS 0x9FFD65 /end MEASUREMENT
/begin MEASUREMENT Fid_Gearbx_GearDet_mp "Fid für Gangerkennung" UBYTE OneToOne 1 100 0.00 255.0 FORMAT "%5.1" ECU_ADDRESS 0x9FFD66 /end MEASUREMENT
/begin MEASUREMENT Fid_Gearbx_TransConv_mp "Zeigt an ob die empfangene Triebsstrangübersetzung glaubwürdig ist" UBYTE OneToOne 1 100 0.00 255.0 FORMAT "%5.1" ECU_ADDRESS 0x9FFD67 /end MEASUREMENT
/begin MEASUREMENT Fid_Gearbx_TSC1Err_mp "Messpunkt fuer Funktions Identifier Fid_Gearbx_TSC1Err" UBYTE OneToOne 1 100 0.00 255.0 FORMAT "%5.1" ECU_ADDRESS 0x9FFD68 /end MEASUREMENT
/begin MEASUREMENT Fid_Gearbx_TSC2Err_mp "Messpunkt fuer Funktions Identifier Fid_Gearbx_TSC2Err" UBYTE OneToOne 1 100 0.00 255.0 FORMAT "%5.1" ECU_ADDRESS 0x9FFD69 /end MEASUREMENT
/begin MEASUREMENT Fid_Gearbx_TSC3Err_mp "Messpunkt fuer Funktions Identifier Fid_Gearbx_TSC3Err" UBYTE OneToOne 1 100 0.00 255.0 FORMAT "%5.1" ECU_ADDRESS 0x9FFD6A /end MEASUREMENT
/begin MEASUREMENT Fid_GlwCDCan_mp "Messpunkt fuer Funktions Identifier Fid_GlwCDCan" UBYTE OneToOne 1 100 0.00 255.0 FORMAT "%5.1" ECU_ADDRESS 0x9FFD6B /end MEASUREMENT
/begin MEASUREMENT Fid_GlwCDCod_mp "Fehlernummer fuer Codierung GZS" UBYTE OneToOne 1 100 0.00 255.0 FORMAT "%5.1" ECU_ADDRESS 0x9FFD6C /end MEASUREMENT
/begin MEASUREMENT Fid_GlwCtl1_mp "Verwendung der Ersatztemperatur anstelle der Motortemperatur zur Berechnung der Motortemperatur für das Glühen." UBYTE OneToOne 1 100 0.00 255.0 FORMAT "%5.1" ECU_ADDRESS 0x9FFD6D /end MEASUREMENT
/begin MEASUREMENT Fid_GlwCtl2_mp "Freigabe für den Übergang in den Glühsystemzustand ""Nachlauf aktiv""" UBYTE OneToOne 1 100 0.00 255.0 FORMAT "%5.1" ECU_ADDRESS 0x9FFD6E /end MEASUREMENT
/begin MEASUREMENT Fid_GlwCtl3_mp "Fid zur Verriegelung des Glühens" UBYTE OneToOne 1 100 0.00 255.0 FORMAT "%5.1" ECU_ADDRESS 0x9FFD6F /end MEASUREMENT
/begin MEASUREMENT Fid_HDSCD_SSpMon1_mp "FID für Fehler in SSpMon1" UBYTE OneToOne 1 100 0.00 255.0 FORMAT "%5.1" ECU_ADDRESS 0x9FFD70 /end MEASUREMENT
/begin MEASUREMENT Fid_IATSErr_mp "Messpunkt fuer Funktions Identifier Fid_IATSErr" UBYTE OneToOne 1 100 0.00 255.0 FORMAT "%5.1" ECU_ADDRESS 0x9FFD71 /end MEASUREMENT
/begin MEASUREMENT Fid_IndSysMonIntMnf_mp "Fid zur Deaktivierung von IndSys_MonIntMnf" UBYTE OneToOne 1 100 0.00 255.0 FORMAT "%5.1" ECU_ADDRESS 0x9FFD72 /end MEASUREMENT
/begin MEASUREMENT Fid_IndSys_MonVac_mp "Messpunkt fuer Funktions Identifier Fid_IndSys_MonVac" UBYTE OneToOne 1 100 0.00 255.0 FORMAT "%5.1" ECU_ADDRESS 0x9FFD73 /end MEASUREMENT
/begin MEASUREMENT Fid_IndSys_pAdj_mp "Messpunkt fuer Funktions Identifier Fid_IndSys_pAdj" UBYTE OneToOne 1 100 0.00 255.0 FORMAT "%5.1" ECU_ADDRESS 0x9FFD74 /end MEASUREMENT
/begin MEASUREMENT Fid_InjCrvCTS_mp "Fid zur Anzeige von defektem Wassertemperatursensor (führt zur Umschaltung auf Ersatzwert)" UBYTE OneToOne 1 100 0.00 255.0 FORMAT "%5.1" ECU_ADDRESS 0x9FFD75 /end MEASUREMENT
/begin MEASUREMENT Fid_InjCrvDyn_mp "Fid zur Deaktivierung der dynamischen Frühverstellung" UBYTE OneToOne 1 100 0.00 255.0 FORMAT "%5.1" ECU_ADDRESS 0x9FFD76 /end MEASUREMENT
/begin MEASUREMENT Fid_InjCrvFTS_mp "Fid für defekten Kraftstofftemperatursensor" UBYTE OneToOne 1 100 0.00 255.0 FORMAT "%5.1" ECU_ADDRESS 0x9FFD77 /end MEASUREMENT
/begin MEASUREMENT Fid_InjCrvT3Dia_mp "Funktions Identifier zur Deaktivierung der T3-Diagnose" UBYTE OneToOne 1 100 0.00 255.0 FORMAT "%5.1" ECU_ADDRESS 0x9FFD78 /end MEASUREMENT
/begin MEASUREMENT Fid_InjCrv_phiStartAddCor_mp "Messpunkt des Function Identifiers für Frühverschiebung Förderbeginn Haupteinspritzung im Notfahren" UBYTE OneToOne 1 100 0.00 255.0 FORMAT "%5.1" ECU_ADDRESS 0x9FFD79 /end MEASUREMENT
/begin MEASUREMENT Fid_InjCrv_stPiI1_mp "Messpunkt des Function Identifiers für die Freigabe der Voreinspritzung (nicht freigegeben im Notfahren)" UBYTE OneToOne 1 100 0.00 255.0 FORMAT "%5.1" ECU_ADDRESS 0x9FFD7A /end MEASUREMENT
/begin MEASUREMENT Fid_InjCtl_qLimErr_mp "Fid für Kraftstoffbegrenzung bei Systemfehler" UBYTE OneToOne 1 100 0.00 255.0 FORMAT "%5.1" ECU_ADDRESS 0x9FFD7B /end MEASUREMENT
/begin MEASUREMENT Fid_InjUnAlt_mp "Messpunkt fuer Funktions Identifier Fid_InjUnAlt" UBYTE OneToOne 1 100 0.00 255.0 FORMAT "%5.1" ECU_ADDRESS 0x9FFD7C /end MEASUREMENT
/begin MEASUREMENT Fid_InjUnIATS_mp "Messpunkt fuer Funktions Identifier Fid_InjUnIATS" UBYTE OneToOne 1 100 0.00 255.0 FORMAT "%5.1" ECU_ADDRESS 0x9FFD7D /end MEASUREMENT
/begin MEASUREMENT Fid_InjUnSpdErr_mp "FID für Kurbelwellenfehler in InjUn" UBYTE OneToOne 1 100 0.00 255.0 FORMAT "%5.1" ECU_ADDRESS 0x9FFD7E /end MEASUREMENT
/begin MEASUREMENT Fid_InjUn_qRed_mp "Messpunkt des Function Identifiers für die drehzahlabhängige Reduzierung der Einspritzmenge im Notfahren" UBYTE OneToOne 1 100 0.00 255.0 FORMAT "%5.1" ECU_ADDRESS 0x9FFD7F /end MEASUREMENT
/begin MEASUREMENT Fid_InjVCD_InjVlv10_mp "Abschaltung von Zylinder 10" UBYTE OneToOne 1 100 0.00 255.0 FORMAT "%5.1" ECU_ADDRESS 0x9FFD80 /end MEASUREMENT
/begin MEASUREMENT Fid_InjVCD_InjVlv11_mp "Abschaltung von Zylinder 11" UBYTE OneToOne 1 100 0.00 255.0 FORMAT "%5.1" ECU_ADDRESS 0x9FFD81 /end MEASUREMENT
/begin MEASUREMENT Fid_InjVCD_InjVlv12_mp "Abschaltung von Zylinder 12" UBYTE OneToOne 1 100 0.00 255.0 FORMAT "%5.1" ECU_ADDRESS 0x9FFD82 /end MEASUREMENT
/begin MEASUREMENT Fid_InjVCD_InjVlv1_mp "Abschaltung von Zylinder 1" UBYTE OneToOne 1 100 0.00 255.0 FORMAT "%5.1" ECU_ADDRESS 0x9FFD83 /end MEASUREMENT
/begin MEASUREMENT Fid_InjVCD_InjVlv2_mp "Abschaltung von Zylinder 2" UBYTE OneToOne 1 100 0.00 255.0 FORMAT "%5.1" ECU_ADDRESS 0x9FFD84 /end MEASUREMENT
/begin MEASUREMENT Fid_InjVCD_InjVlv3_mp "Abschaltung von Zylinder 3" UBYTE OneToOne 1 100 0.00 255.0 FORMAT "%5.1" ECU_ADDRESS 0x9FFD85 /end MEASUREMENT
/begin MEASUREMENT Fid_InjVCD_InjVlv4_mp "Abschaltung von Zylinder 4" UBYTE OneToOne 1 100 0.00 255.0 FORMAT "%5.1" ECU_ADDRESS 0x9FFD86 /end MEASUREMENT
/begin MEASUREMENT Fid_InjVCD_InjVlv5_mp "Abschaltung von Zylinder 5" UBYTE OneToOne 1 100 0.00 255.0 FORMAT "%5.1" ECU_ADDRESS 0x9FFD87 /end MEASUREMENT
/begin MEASUREMENT Fid_InjVCD_InjVlv6_mp "Abschaltung von Zylinder 6" UBYTE OneToOne 1 100 0.00 255.0 FORMAT "%5.1" ECU_ADDRESS 0x9FFD88 /end MEASUREMENT
/begin MEASUREMENT Fid_InjVCD_InjVlv7_mp "Abschaltung von Zylinder 7" UBYTE OneToOne 1 100 0.00 255.0 FORMAT "%5.1" ECU_ADDRESS 0x9FFD89 /end MEASUREMENT
/begin MEASUREMENT Fid_InjVCD_InjVlv8_mp "Abschaltung von Zylinder 8" UBYTE OneToOne 1 100 0.00 255.0 FORMAT "%5.1" ECU_ADDRESS 0x9FFD8A /end MEASUREMENT
/begin MEASUREMENT Fid_InjVCD_InjVlv9_mp "Abschaltung von Zylinder 9" UBYTE OneToOne 1 100 0.00 255.0 FORMAT "%5.1" ECU_ADDRESS 0x9FFD8B /end MEASUREMENT
/begin MEASUREMENT Fid_InjVCD_PiIPoI_mp "Messpunkt fuer Funktions Identifier Fid_InjVCD_PiIPoI" UBYTE OneToOne 1 100 0.00 255.0 FORMAT "%5.1" ECU_ADDRESS 0x9FFD8C /end MEASUREMENT
/begin MEASUREMENT Fid_InjVCD_WUP_mp "Sperrung des dynamischen  WUPs" UBYTE OneToOne 1 100 0.00 255.0 FORMAT "%5.1" ECU_ADDRESS 0x9FFD8D /end MEASUREMENT
/begin MEASUREMENT Fid_LASCDBRK8_mp "FID Bremse 8 - Botschaftszähler, Checksumme, Timeout-Fehler" UBYTE OneToOne 1 100 0.00 255.0 FORMAT "%5.1" ECU_ADDRESS 0x9FFD8E /end MEASUREMENT
/begin MEASUREMENT Fid_LASCD_mp "Meßgröße für Fid des Längsbeschleunigungssensors" UBYTE OneToOne 1 100 0.00 255.0 FORMAT "%5.1" ECU_ADDRESS 0x9FFD8F /end MEASUREMENT
/begin MEASUREMENT Fid_LIGovDriveAway_mp "Verriegelung der Ausgabe eines Sollwertes für fahrendes Fahrzeug" UBYTE OneToOne 1 100 0.00 255.0 FORMAT "%5.1" ECU_ADDRESS 0x9FFD90 /end MEASUREMENT
/begin MEASUREMENT Fid_LIGovnSetPointErr_mp "Funktion identifier für Fehler Notfahren auf der Nockenwelle" UBYTE OneToOne 1 100 0.00 255.0 FORMAT "%5.1" ECU_ADDRESS 0x9FFD91 /end MEASUREMENT
/begin MEASUREMENT Fid_LIGovUbr_mp "FID zur Deaktivierung der Funkionalität Unterbremsen" UBYTE OneToOne 1 100 0.00 255.0 FORMAT "%5.1" ECU_ADDRESS 0x9FFD92 /end MEASUREMENT
/begin MEASUREMENT Fid_LSUCDactiv0_mp "Messpunkt fuer Funktions Identifier Fid_LSUCDactiv0" UBYTE OneToOne 1 100 0.00 255.0 FORMAT "%5.1" ECU_ADDRESS 0x9FFD93 /end MEASUREMENT
/begin MEASUREMENT Fid_LSUCDlsu0_mp "Messpunkt fuer Funktions Identifier Fid_LSUCDlsu0" UBYTE OneToOne 1 100 0.00 255.0 FORMAT "%5.1" ECU_ADDRESS 0x9FFD94 /end MEASUREMENT
/begin MEASUREMENT Fid_LSUCDMon0_mp "Messpunkt fuer Funktions Identifier Fid_LSUCDMon0" UBYTE OneToOne 1 100 0.00 255.0 FORMAT "%5.1" ECU_ADDRESS 0x9FFD95 /end MEASUREMENT
/begin MEASUREMENT Fid_LSUCDO20_mp "Messpunkt fuer Funktions Identifier Fid_LSUCDO20" UBYTE OneToOne 1 100 0.00 255.0 FORMAT "%5.1" ECU_ADDRESS 0x9FFD96 /end MEASUREMENT
/begin MEASUREMENT Fid_LSUCDRi0_mp "Messpunkt fuer Funktions Identifier Fid_LSUCDRi0" UBYTE OneToOne 1 100 0.00 255.0 FORMAT "%5.1" ECU_ADDRESS 0x9FFD97 /end MEASUREMENT
/begin MEASUREMENT Fid_LSUClbSched_mp "Fid zur Unterdrückung der CJ125-Kalibrierung im Falle einer defekten Batterie" UBYTE OneToOne 1 100 0.00 255.0 FORMAT "%5.1" ECU_ADDRESS 0x9FFD98 /end MEASUREMENT
/begin MEASUREMENT Fid_LSUCtl0_mp "Messpunkt fuer Funktions Identifier Fid_LSUCtl0" UBYTE OneToOne 1 100 0.00 255.0 FORMAT "%5.1" ECU_ADDRESS 0x9FFD99 /end MEASUREMENT
/begin MEASUREMENT Fid_LSUMonAllChecks0_mp "Messpunkt fuer Funktions Identifier Fid_LSUMonAllChecks0" UBYTE OneToOne 1 100 0.00 255.0 FORMAT "%5.1" ECU_ADDRESS 0x9FFD9A /end MEASUREMENT
/begin MEASUREMENT Fid_LSUMonPlausChk0_mp "Messpunkt fuer Funktions Identifier Fid_LSUMonPlausChk0" UBYTE OneToOne 1 100 0.00 255.0 FORMAT "%5.1" ECU_ADDRESS 0x9FFD9B /end MEASUREMENT
/begin MEASUREMENT Fid_OTSCDCanDSP2_mp "Messpunkt fuer Funktions Identifier Fid_OTSCDCanDSP2_mp" UBYTE OneToOne 1 100 0.00 255.0 FORMAT "%5.1" ECU_ADDRESS 0x9FFD9C /end MEASUREMENT
/begin MEASUREMENT Fid_OTSCDCanInac_mp "Messpunkt fuer Funktions Identifier Fid_OTSCDCanInac" UBYTE OneToOne 1 100 0.00 255.0 FORMAT "%5.1" ECU_ADDRESS 0x9FFD9D /end MEASUREMENT
/begin MEASUREMENT Fid_OTSCDCanSig_mp "Messpunkt fuer Funktions Identifier Fid_OTSCDCanSig" UBYTE OneToOne 1 100 0.00 255.0 FORMAT "%5.1" ECU_ADDRESS 0x9FFD9E /end MEASUREMENT
/begin MEASUREMENT Fid_OTSCDCan_mp "Messpunkt fuer Funktions Identifier Fid_OTSCDCan" UBYTE OneToOne 1 100 0.00 255.0 FORMAT "%5.1" ECU_ADDRESS 0x9FFD9F /end MEASUREMENT
/begin MEASUREMENT Fid_OTSCDCTSErr_mp "Meßpunkt für Funktions Identifier Fid_ OTSCDCTSErr" UBYTE OneToOne 1 100 0.00 255.0 FORMAT "%5.1" ECU_ADDRESS 0x9FFDA0 /end MEASUREMENT
/begin MEASUREMENT Fid_OTSCDDynTst_mp "Messpunkt fuer Funktions Identifier Fid_OTSCDDynTst" UBYTE OneToOne 1 100 0.00 255.0 FORMAT "%5.1" ECU_ADDRESS 0x9FFDA1 /end MEASUREMENT
/begin MEASUREMENT Fid_OTSCDErr_mp "Meßpunkt für Funktions Identifier Fid_ OTSCDCTSErr" UBYTE OneToOne 1 100 0.00 255.0 FORMAT "%5.1" ECU_ADDRESS 0x9FFDA2 /end MEASUREMENT
/begin MEASUREMENT Fid_OvRMonACCaFrmMng_mp "Funktionsidentifier für entfültige ACCa-FrmMng Errors" UBYTE OneToOne 1 100 0.00 255.0 FORMAT "%5.1" ECU_ADDRESS 0x9FFDA3 /end MEASUREMENT
/begin MEASUREMENT Fid_OvRMonACCTO_mp "Fid für TimeOut - Fehler ACC - Botschaft" UBYTE OneToOne 1 100 0.00 255.0 FORMAT "%5.1" ECU_ADDRESS 0x9FFDA4 /end MEASUREMENT
/begin MEASUREMENT Fid_OvRMonBRK1TO_mp "Funktionsidentifier für entgültige BRK1-Fehler" UBYTE OneToOne 1 100 0.00 255.0 FORMAT "%5.1" ECU_ADDRESS 0x9FFDA5 /end MEASUREMENT
/begin MEASUREMENT Fid_OvRMonBRK8Err_mp "Meßpunkt des Fehlerpfades ""BRK8""" UBYTE OneToOne 1 100 0.00 255.0 FORMAT "%5.1" ECU_ADDRESS 0x9FFDA6 /end MEASUREMENT
/begin MEASUREMENT Fid_OvRMonBRK8MnBrkErr_mp "Fid für Überwachung der Bremse (CAN Botschaft BRK8) bei ""Bremse über CAN"" (type of brake == BRKCD_TYPE_CAN_MNBRK)" UBYTE OneToOne 1 100 0.00 255.0 FORMAT "%5.1" ECU_ADDRESS 0x9FFDA7 /end MEASUREMENT
/begin MEASUREMENT Fid_OvRMonCrCtlplusFin_mp "Funktionsidentifier für endgültige ACC-FrmMng--Fehler" UBYTE OneToOne 1 100 0.00 255.0 FORMAT "%5.1" ECU_ADDRESS 0x9FFDA8 /end MEASUREMENT
/begin MEASUREMENT Fid_OvRMonShtrp_mp "Fid für CAN, Bremsfühler, Pedalwertgeber bzw. Fahrge-schwindigkeitsgeber" UBYTE OneToOne 1 100 0.00 255.0 FORMAT "%5.1" ECU_ADDRESS 0x9FFDA9 /end MEASUREMENT
/begin MEASUREMENT Fid_OvRMonTSC1_mp "Messpunkt fuer Funktions Identifier Fid_OvRMonTSC1" UBYTE OneToOne 1 100 0.00 255.0 FORMAT "%5.1" ECU_ADDRESS 0x9FFDAA /end MEASUREMENT
/begin MEASUREMENT Fid_OvRMonTSC2_mp "Messpunkt fuer Funktions Identifier Fid_OvRMonTSC2" UBYTE OneToOne 1 100 0.00 255.0 FORMAT "%5.1" ECU_ADDRESS 0x9FFDAB /end MEASUREMENT
/begin MEASUREMENT Fid_OvRMonTSC3_mp "Messpunkt fuer Funktions Identifier Fid_OvRMonTSC3" UBYTE OneToOne 1 100 0.00 255.0 FORMAT "%5.1" ECU_ADDRESS 0x9FFDAC /end MEASUREMENT
/begin MEASUREMENT Fid_PCRBalGvnr_mp "Messpunkt fuer Funktions Identifier Fid_PCRBalGvnr" UBYTE OneToOne 1 100 0.00 255.0 FORMAT "%5.1" ECU_ADDRESS 0x9FFDAD /end MEASUREMENT
/begin MEASUREMENT Fid_PCRNSShutOff_mp "Sensorfehler Abschaltbedingung für die Anti-Kaudern-Maßnahme" UBYTE OneToOne 1 100 0.00 255.0 FORMAT "%5.1" ECU_ADDRESS 0x9FFDAE /end MEASUREMENT
/begin MEASUREMENT Fid_PCRpLim_mp "Funktion identifier für Fehler Notfahren auf der Nockenwelle" UBYTE OneToOne 1 100 0.00 255.0 FORMAT "%5.1" ECU_ADDRESS 0x9FFDAF /end MEASUREMENT
/begin MEASUREMENT Fid_PCR_mp "Systemfehler in PCR" UBYTE OneToOne 1 100 0.00 255.0 FORMAT "%5.1" ECU_ADDRESS 0x9FFDB0 /end MEASUREMENT
/begin MEASUREMENT Fid_PFltAirSysFail_mp "Luftsystemfehler" UBYTE OneToOne 1 100 0.00 255.0 FORMAT "%5.1" ECU_ADDRESS 0x9FFDB1 /end MEASUREMENT
/begin MEASUREMENT Fid_PFltChar_mp "Fid für Verhinderung Resflow-SRC" UBYTE OneToOne 1 100 0.00 255.0 FORMAT "%5.1" ECU_ADDRESS 0x9FFDB2 /end MEASUREMENT
/begin MEASUREMENT Fid_PFltContPlausTemp_mp "Messpunkt fuer Funktions Identifier Fid_PFltContPlausTemp" UBYTE OneToOne 1 100 0.00 255.0 FORMAT "%5.1" ECU_ADDRESS 0x9FFDB3 /end MEASUREMENT
/begin MEASUREMENT Fid_PFltDynChk_mp "FID zur Abschaltung dynamische Prüfung" UBYTE OneToOne 1 100 0.00 255.0 FORMAT "%5.1" ECU_ADDRESS 0x9FFDB4 /end MEASUREMENT
/begin MEASUREMENT Fid_PFltHsLnChk_mp "FID zur Abschaltung Schlauchüberwachung" UBYTE OneToOne 1 100 0.00 255.0 FORMAT "%5.1" ECU_ADDRESS 0x9FFDB5 /end MEASUREMENT
/begin MEASUREMENT Fid_PFltPlausPres_mp "FID für Drucküberwachung im Nachlauf" UBYTE OneToOne 1 100 0.00 255.0 FORMAT "%5.1" ECU_ADDRESS 0x9FFDB6 /end MEASUREMENT
/begin MEASUREMENT Fid_PFltPlausTemp_mp "Messpunkt fuer Funktions Identifier Fid_PFltPlausTemp" UBYTE OneToOne 1 100 0.00 255.0 FORMAT "%5.1" ECU_ADDRESS 0x9FFDB7 /end MEASUREMENT
/begin MEASUREMENT Fid_PFltPoI1Fail_mp "Fehler Nacheinspritzung PoI1" UBYTE OneToOne 1 100 0.00 255.0 FORMAT "%5.1" ECU_ADDRESS 0x9FFDB8 /end MEASUREMENT
/begin MEASUREMENT Fid_PFltPoI2Fail_mp "Fehler Nacheinspritzung PoI2" UBYTE OneToOne 1 100 0.00 255.0 FORMAT "%5.1" ECU_ADDRESS 0x9FFDB9 /end MEASUREMENT
/begin MEASUREMENT Fid_PFltPresSensDiff_mp "Messpunkt fuer Funktions Identifier Fid_PfltPresSensDiff" UBYTE OneToOne 1 100 0.00 255.0 FORMAT "%5.1" ECU_ADDRESS 0x9FFDBA /end MEASUREMENT
/begin MEASUREMENT Fid_PFltPresSensFrz_mp "FID für Drucküberprüfung Drucksensor" UBYTE OneToOne 1 100 0.00 255.0 FORMAT "%5.1" ECU_ADDRESS 0x9FFDBB /end MEASUREMENT
/begin MEASUREMENT Fid_PFltPresSensHsLn_mp "Fid für Verhinderung der Schlauchleitungsüberwachung der Drucksensoren" UBYTE OneToOne 1 100 0.00 255.0 FORMAT "%5.1" ECU_ADDRESS 0x9FFDBC /end MEASUREMENT
/begin MEASUREMENT Fid_PFltPresSensPre_mp "FID Druck vor Partikelfilter plausibel" UBYTE OneToOne 1 100 0.00 255.0 FORMAT "%5.1" ECU_ADDRESS 0x9FFDBD /end MEASUREMENT
/begin MEASUREMENT Fid_PFltRgnShOff_mp "Funktion identifier für Fehler Notfahren auf der Nockenwelle" UBYTE OneToOne 1 100 0.00 255.0 FORMAT "%5.1" ECU_ADDRESS 0x9FFDBE /end MEASUREMENT
/begin MEASUREMENT Fid_PFltSotSimPresElec_mp "FID für Partikelfilter-Sensorfehler wegen Strombedigungen." UBYTE OneToOne 1 100 0.00 255.0 FORMAT "%5.1" ECU_ADDRESS 0x9FFDBF /end MEASUREMENT
/begin MEASUREMENT Fid_PFltSotSimPresEnv_mp "FID für Partikelfilter-Sensorfehler wegen Umgebungsbedingungen." UBYTE OneToOne 1 100 0.00 255.0 FORMAT "%5.1" ECU_ADDRESS 0x9FFDC0 /end MEASUREMENT
/begin MEASUREMENT Fid_PFltSotSimPresLrn_mp "Verriegelung des Lernems der Ascheverteilung" UBYTE OneToOne 1 100 0.00 255.0 FORMAT "%5.1" ECU_ADDRESS 0x9FFDC1 /end MEASUREMENT
/begin MEASUREMENT Fid_PFltSotSimTemp_mp "Fid fuer Russmassen Beladungsmodell" UBYTE OneToOne 1 100 0.00 255.0 FORMAT "%5.1" ECU_ADDRESS 0x9FFDC2 /end MEASUREMENT
/begin MEASUREMENT Fid_PFltSRCPres_mp "FID zur Abschaltung SRC Drucksignal" UBYTE OneToOne 1 100 0.00 255.0 FORMAT "%5.1" ECU_ADDRESS 0x9FFDC3 /end MEASUREMENT
/begin MEASUREMENT Fid_PFltSRCTemp_mp "Fid für Verhinderung Temperatursensor-SRC" UBYTE OneToOne 1 100 0.00 255.0 FORMAT "%5.1" ECU_ADDRESS 0x9FFDC4 /end MEASUREMENT
/begin MEASUREMENT Fid_PFltSysFail_mp "Allgemeine  Systemfehler" UBYTE OneToOne 1 100 0.00 255.0 FORMAT "%5.1" ECU_ADDRESS 0x9FFDC5 /end MEASUREMENT
/begin MEASUREMENT Fid_PFltTempModtPst_mp "Funktion identifier für Fehler des Temperatur Sensors nach dem Partikel filter [ - ]" UBYTE OneToOne 1 100 0.00 255.0 FORMAT "%5.1" ECU_ADDRESS 0x9FFDC6 /end MEASUREMENT
/begin MEASUREMENT Fid_PFltTempOxiPre_mp "FID für Temperatur vor OxiCat" UBYTE OneToOne 1 100 0.00 255.0 FORMAT "%5.1" ECU_ADDRESS 0x9FFDC7 /end MEASUREMENT
/begin MEASUREMENT Fid_PFltTempOxiSurf_mp "Funktionsidentifier des Fehlerpfads zur Plausibilitätstest von" UBYTE OneToOne 1 100 0.00 255.0 FORMAT "%5.1" ECU_ADDRESS 0x9FFDC8 /end MEASUREMENT
/begin MEASUREMENT Fid_PFltTempPreOxiC_mp "Fid für DSM Freigabebedingung der Temperatur Sensorplausibilisierung" UBYTE OneToOne 1 100 0.00 255.0 FORMAT "%5.1" ECU_ADDRESS 0x9FFDC9 /end MEASUREMENT
/begin MEASUREMENT Fid_PFltTempPrePFlt_mp "Fid für DSM Freigabebedingung der Temperatur Sensorplausibilisierung" UBYTE OneToOne 1 100 0.00 255.0 FORMAT "%5.1" ECU_ADDRESS 0x9FFDCA /end MEASUREMENT
/begin MEASUREMENT Fid_PFltTempPreTrbn_mp "Fid für DSM Freigabebedingung der Temperatur Sensorplausibilisierung" UBYTE OneToOne 1 100 0.00 255.0 FORMAT "%5.1" ECU_ADDRESS 0x9FFDCB /end MEASUREMENT
/begin MEASUREMENT Fid_PFltTempPstPFlt_mp "Fid für DSM Freigabebedingung der Temperatur Sensorplausibilisierung" UBYTE OneToOne 1 100 0.00 255.0 FORMAT "%5.1" ECU_ADDRESS 0x9FFDCC /end MEASUREMENT
/begin MEASUREMENT Fid_PFltTempSensFrz_mp "FID für Drucksensorprüfung" UBYTE OneToOne 1 100 0.00 255.0 FORMAT "%5.1" ECU_ADDRESS 0x9FFDCD /end MEASUREMENT
/begin MEASUREMENT Fid_PFltTempSens_mp "FID für Plausitbilität Temperatur vor DPF" UBYTE OneToOne 1 100 0.00 255.0 FORMAT "%5.1" ECU_ADDRESS 0x9FFDCE /end MEASUREMENT
/begin MEASUREMENT Fid_PoI2HCSpd_mp "Freigabe der HC Nacheinspritzung bei ungültigem Geschwindigkeitssignal" UBYTE OneToOne 1 100 0.00 255.0 FORMAT "%5.1" ECU_ADDRESS 0x9FFDCF /end MEASUREMENT
/begin MEASUREMENT Fid_PoI2HC_mp "allgemeine Verriegelung der HC-Nacheinspritzung" UBYTE OneToOne 1 100 0.00 255.0 FORMAT "%5.1" ECU_ADDRESS 0x9FFDD0 /end MEASUREMENT
/begin MEASUREMENT Fid_PoI2LmbdT3_mp "Fid fuer Deaktivierung der T3-Regelung (PoI2)" UBYTE OneToOne 1 100 0.00 255.0 FORMAT "%5.1" ECU_ADDRESS 0x9FFDD1 /end MEASUREMENT
/begin MEASUREMENT Fid_PoI2Lmbd_mp "Fid für Deaktivierung der Lambdaregelung (PoI2)" UBYTE OneToOne 1 100 0.00 255.0 FORMAT "%5.1" ECU_ADDRESS 0x9FFDD2 /end MEASUREMENT
/begin MEASUREMENT Fid_PoI2OvR_mp "Freigabe der PoI2 im Schub" UBYTE OneToOne 1 100 0.00 255.0 FORMAT "%5.1" ECU_ADDRESS 0x9FFDD3 /end MEASUREMENT
/begin MEASUREMENT Fid_PrpCtl_AWD1_mp "Messpunkt fuer Funktions Identifier Fid_PrpCtl_AWD1" UBYTE OneToOne 1 100 0.00 255.0 FORMAT "%5.1" ECU_ADDRESS 0x9FFDD4 /end MEASUREMENT
/begin MEASUREMENT Fid_PrpCtl_CANVerErr_mp "Messpunkt für CAN-Version-Fehler" UBYTE OneToOne 1 100 0.00 255.0 FORMAT "%5.1" ECU_ADDRESS 0x9FFDD5 /end MEASUREMENT
/begin MEASUREMENT Fid_PrpCtl_NIVEAU1_mp "Messpunkt fuer Funktions Identifier Fid_PrpCtl_NIVEAU1" UBYTE OneToOne 1 100 0.00 255.0 FORMAT "%5.1" ECU_ADDRESS 0x9FFDD6 /end MEASUREMENT
/begin MEASUREMENT Fid_PrpCtl_VSSCD_mp "Messpunkt fuer Funktions Identifier Fid_PrpCtl_VSSCD" UBYTE OneToOne 1 100 0.00 255.0 FORMAT "%5.1" ECU_ADDRESS 0x9FFDD7 /end MEASUREMENT
/begin MEASUREMENT Fid_ShortTrAct_mp "Fid zur Aktivierung des ShTrp" UBYTE OneToOne 1 100 0.00 255.0 FORMAT "%5.1" ECU_ADDRESS 0x9FFDD8 /end MEASUREMENT
/begin MEASUREMENT Fid_ShortTr_mp "Fid für aktiven ShTrp" UBYTE OneToOne 1 100 0.00 255.0 FORMAT "%5.1" ECU_ADDRESS 0x9FFDD9 /end MEASUREMENT
/begin MEASUREMENT Fid_SignalsTstNLim_mp "Drehzahlbegrenzung beim Testerzugrift im Fall einen Defekt in Nockenwelle oder Kurbelwelle" UBYTE OneToOne 1 100 0.00 255.0 FORMAT "%5.1" ECU_ADDRESS 0x9FFDDA /end MEASUREMENT
/begin MEASUREMENT Fid_SotSimEGROff_mp "Fid für EGR Status-Berücksichtigung bei der Beladungssimulation" UBYTE OneToOne 1 100 0.00 255.0 FORMAT "%5.1" ECU_ADDRESS 0x9FFDDB /end MEASUREMENT
/begin MEASUREMENT Fid_SrvPmpStSA_mp "Messpunkt fuer Funktions Identifier Fid_SrvPmpStSA" UBYTE OneToOne 1 100 0.00 255.0 FORMAT "%5.1" ECU_ADDRESS 0x9FFDDC /end MEASUREMENT
/begin MEASUREMENT Fid_SrvPmpVSSCD_mp "Messpunkt fuer Funktions Identifier Fid_SrvPmpVSSCD" UBYTE OneToOne 1 100 0.00 255.0 FORMAT "%5.1" ECU_ADDRESS 0x9FFDDD /end MEASUREMENT
/begin MEASUREMENT Fid_StSysCtltiThrsAddCr_mp "Funktion identifier für Fehler Notfahren auf der Nockenwelle" UBYTE OneToOne 1 100 0.00 255.0 FORMAT "%5.1" ECU_ADDRESS 0x9FFDDE /end MEASUREMENT
/begin MEASUREMENT Fid_StSysCtl_IlsPlaus_mp "Function Identifier für Interlock nicht plausibel[-]" UBYTE OneToOne 1 100 0.00 255.0 FORMAT "%5.1" ECU_ADDRESS 0x9FFDDF /end MEASUREMENT
/begin MEASUREMENT Fid_StSysCtl_RlyErr_mp "Messpunkt fuer Funktions Identifier Fid_StSysCtl_RlyErr" UBYTE OneToOne 1 100 0.00 255.0 FORMAT "%5.1" ECU_ADDRESS 0x9FFDE0 /end MEASUREMENT
/begin MEASUREMENT Fid_StSysCtl_T50Err_mp "Messpunkt fuer Funktions Identifier Fid_StSysCtl_T50Err" UBYTE OneToOne 1 100 0.00 255.0 FORMAT "%5.1" ECU_ADDRESS 0x9FFDE1 /end MEASUREMENT
/begin MEASUREMENT Fid_StSysCtl_VSSCD_mp "Messpunkt fuer Funktions Identifier Fid_StSysCtl_VSSCD" UBYTE OneToOne 1 100 0.00 255.0 FORMAT "%5.1" ECU_ADDRESS 0x9FFDE2 /end MEASUREMENT
/begin MEASUREMENT Fid_StSystrqStrtAddCor_mp "Funktion identifier für Fehler Notfahren auf der Nockenwelle" UBYTE OneToOne 1 100 0.00 255.0 FORMAT "%5.1" ECU_ADDRESS 0x9FFDE3 /end MEASUREMENT
/begin MEASUREMENT Fid_StSys_ESCUBSG3Err_mp "Messpunkt fuer Funktions Identifier Fid_StSys_ESCUBSG3Err" UBYTE OneToOne 1 100 0.00 255.0 FORMAT "%5.1" ECU_ADDRESS 0x9FFDE4 /end MEASUREMENT
/begin MEASUREMENT Fid_StSys_STIGNErr_mp "Messpunkt fuer Funktions Identifier Fid_StSys_STIGNErr" UBYTE OneToOne 1 100 0.00 255.0 FORMAT "%5.1" ECU_ADDRESS 0x9FFDE5 /end MEASUREMENT
/begin MEASUREMENT Fid_StSys_T50Err_mp "Messpunkt fuer Funktions Identifier Fid_StSys_T50Err" UBYTE OneToOne 1 100 0.00 255.0 FORMAT "%5.1" ECU_ADDRESS 0x9FFDE6 /end MEASUREMENT
/begin MEASUREMENT Fid_StSys_T50RErr_mp "Messpunkt fuer Funktions Identifier Fid_StSys_T50RErr" UBYTE OneToOne 1 100 0.00 255.0 FORMAT "%5.1" ECU_ADDRESS 0x9FFDE7 /end MEASUREMENT
/begin MEASUREMENT Fid_SvLpBRK2TO_mp "Messpunkt fuer Funktions Identifier - Fid_SvLpBRK2TO_mp" UBYTE OneToOne 1 100 0.00 255.0 FORMAT "%5.1" ECU_ADDRESS 0x9FFDE8 /end MEASUREMENT
/begin MEASUREMENT Fid_SvLpCDTOSTO_mp "Messpunkt für Funktions Identifier Fid_SvLpCDTOSTO_mp" UBYTE OneToOne 1 100 0.00 255.0 FORMAT "%5.1" ECU_ADDRESS 0x9FFDE9 /end MEASUREMENT
/begin MEASUREMENT Fid_SvLpTOSTO_mp "Messpunkt fuer Funktions Identifier Fid_SvLpTOSTO_mp" UBYTE OneToOne 1 100 0.00 255.0 FORMAT "%5.1" ECU_ADDRESS 0x9FFDEA /end MEASUREMENT
/begin MEASUREMENT Fid_T50CDCan_mp "Messpunkt fuer Funktions Identifier Fid_T50CDCan" UBYTE OneToOne 1 100 0.00 255.0 FORMAT "%5.1" ECU_ADDRESS 0x9FFDEB /end MEASUREMENT
/begin MEASUREMENT Fid_ThrVlvGvnrOn_mp "Funktions Identifier zur Abschaltung des Lagereglers und der Überwachung bei Systemfehlern" UBYTE OneToOne 1 100 0.00 255.0 FORMAT "%5.1" ECU_ADDRESS 0x9FFDEC /end MEASUREMENT
/begin MEASUREMENT Fid_TVASCDMon_mp "Messpunkt fuer Funktions Identifier Fid_TVASCDMon" UBYTE OneToOne 1 100 0.00 255.0 FORMAT "%5.1" ECU_ADDRESS 0x9FFDED /end MEASUREMENT
/begin MEASUREMENT Fid_UAcc_EnvDat_mp "Dieser Fid zeigt an ob ein Fehler in der DIA1 message vorliegt" UBYTE OneToOne 1 100 0.00 255.0 FORMAT "%5.1" ECU_ADDRESS 0x9FFDEE /end MEASUREMENT
/begin MEASUREMENT Fid_VSSCDBRK1Err_mp "Messpunkt fuer Funktions Identifier Fid_VSSCDBRK1 (Geschwindigkeit über CAN-BRK1: verriegelt durch BRK1 spez. Fehler)" UBYTE OneToOne 1 100 0.00 255.0 FORMAT "%5.1" ECU_ADDRESS 0x9FFDEF /end MEASUREMENT
/begin MEASUREMENT Fid_VSSCDBRK8_mp "Fehler ID für Fehler in Botschaft Bremse 8" UBYTE OneToOne 1 100 0.00 255.0 FORMAT "%5.1" ECU_ADDRESS 0x9FFDF0 /end MEASUREMENT
/begin MEASUREMENT Fid_VSSCDDSP1Err_mp "Messpunkt fuer Funktions Identifier Fid_VSSCDDSP1 (Geschwindigkeit über CAN-DSP1: verriegelt durch DSP1 spez. Fehler)" UBYTE OneToOne 1 100 0.00 255.0 FORMAT "%5.1" ECU_ADDRESS 0x9FFDF1 /end MEASUREMENT
/begin MEASUREMENT Fid_WDASCD_mp "Messpunkt fuer Funktions Identifier Fid_WDASCD" UBYTE OneToOne 1 100 0.00 255.0 FORMAT "%5.1" ECU_ADDRESS 0x9FFDF2 /end MEASUREMENT
/begin MEASUREMENT FlClgCD_stFlClg "Status des Ventils für den Kühlmitteldurchfluß durch den Kraftstoffkühler" UBYTE OneToOne 1 100 0.00 255.0 FORMAT "%5.1" ECU_ADDRESS 0x7F93F1 /end MEASUREMENT
/begin MEASUREMENT FlMng_AirTemp_mp "Lufttemperatur für PWG abhängige Rauchbegrenzung" SWORD Temp_Cels 1 100 -3549.940 3003.560 FORMAT "%8.3" ECU_ADDRESS 0x9FF328 /end MEASUREMENT
/begin MEASUREMENT FlMng_facCor_mp "Lambda Grenzwert Korrektur Faktor für PWG abhängige Rauchbegrenzung" SWORD Fact 1 100 -4.000000 3.999878 FORMAT "%8.6" ECU_ADDRESS 0x9FF32A /end MEASUREMENT
/begin MEASUREMENT FlMng_facLmbdSmkSOE_mp "Korrekturfaktor aufgrund Saugrohrdruck" SWORD Fact 1 100 -4.000000 3.999878 FORMAT "%8.6" ECU_ADDRESS 0x9FF32C /end MEASUREMENT
/begin MEASUREMENT FlMng_mAirPerCylLim_mp "begrenzte Luftmasse" SWORD AirMassPerCyl 1 100 -3276.800 3276.700 FORMAT "%8.3" ECU_ADDRESS 0x9FF32E /end MEASUREMENT
/begin MEASUREMENT FlMng_mAirPerCyl_mp "Luftmasse pro Zylinder für Rauchbegrenzung" SWORD AirMassPerCyl 1 100 -3276.800 3276.700 FORMAT "%8.3" ECU_ADDRESS 0x9FF330 /end MEASUREMENT
/begin MEASUREMENT FlMng_pBPAPCorr_mp "Ausgang des Druckwahlschalters FlMng_swtBPAP_C" SWORD Pres_hPa 1 100 -32768.00 32767.00 FORMAT "%8.2" ECU_ADDRESS 0x9FF332 /end MEASUREMENT
/begin MEASUREMENT FlMng_pIATCorr_mp "Korrigierter Druck zur Rauchbegrenzung" SWORD Pres_hPa 1 100 -32768.00 32767.00 FORMAT "%8.2" ECU_ADDRESS 0x9FF334 /end MEASUREMENT
/begin MEASUREMENT FlMng_pValSel_mp "Gewählter Druck für Korrekturfaktor" SWORD Pres_hPa 1 100 -32768.00 32767.00 FORMAT "%8.2" ECU_ADDRESS 0x9FF336 /end MEASUREMENT
/begin MEASUREMENT FlMng_qDynSmkCor2_mp "Geschwindigkeits- und Ansauglufttemperaturkorrigierte Rauchmengenerhöhung" SWORD InjMass 1 100 -327.6800 327.6700 FORMAT "%8.4" ECU_ADDRESS 0x9FF338 /end MEASUREMENT
/begin MEASUREMENT FlMng_qDynSmkCor_mp "Geschwindigkeitskorrigierte Rauchmengenerhöhung" SWORD InjMass 1 100 -327.6800 327.6700 FORMAT "%8.4" ECU_ADDRESS 0x9FF33A /end MEASUREMENT
/begin MEASUREMENT FlMng_qDynSmk_mp "Dynamische Rauchmengenerhöhung" SWORD InjMass 1 100 -327.6800 327.6700 FORMAT "%8.4" ECU_ADDRESS 0x9FF33C /end MEASUREMENT
/begin MEASUREMENT FlMng_qDynSmoke_mp "Dynamische Rauchmengenerhöhung" SWORD InjMass 1 100 -327.6800 327.6700 FORMAT "%8.4" ECU_ADDRESS 0x9FF33E /end MEASUREMENT
/begin MEASUREMENT FlMng_qFullLdRglI_mp "I-Anteil der Vollastregelung" SLONG InjMass 1 100 -21474836.4800 21474836.4700 FORMAT "%13.4" ECU_ADDRESS 0x9FE5A8 /end MEASUREMENT
/begin MEASUREMENT FlMng_qFullLdRglP_mp "P-Anteil der Vollastregelung" SWORD InjMass 1 100 -327.6800 327.6700 FORMAT "%8.4" ECU_ADDRESS 0x9FF340 /end MEASUREMENT
/begin MEASUREMENT FlMng_qFullLdRgl_mp "Stellgröße der Vollastregelung" SWORD InjMass 1 100 -327.6800 327.6700 FORMAT "%8.4" ECU_ADDRESS 0x9FF342 /end MEASUREMENT
/begin MEASUREMENT FlMng_qLimSmk "Begrenzungsmenge zur Rauchbegrenzung" SWORD InjMass 1 100 -327.6800 327.6700 FORMAT "%8.4" ECU_ADDRESS 0x7F996C /end MEASUREMENT
/begin MEASUREMENT FlMng_qLimSmkAir_mp "Begrenzungsmenge nach Rauchbegrenzungsauswahlschalter FlMng_swtSmokeVariant_C" SWORD InjMass 1 100 -327.6800 327.6700 FORMAT "%8.4" ECU_ADDRESS 0x9FF344 /end MEASUREMENT
/begin MEASUREMENT FlMng_qLimSmkBas_mp "Basiswert der maximal zulässigen Kraftstoffmenge der Rauchbegrenzung" SWORD InjMass 1 100 -327.6800 327.6700 FORMAT "%8.4" ECU_ADDRESS 0x9FF346 /end MEASUREMENT
/begin MEASUREMENT FlMng_qLimSmkByp_mp "Bypass message für FlMng_qLimSmk" SWORD InjMass 1 100 -327.6800 327.6700 FORMAT "%8.4" ECU_ADDRESS 0x9FF348 /end MEASUREMENT
/begin MEASUREMENT FlMng_qLimSmkLQ_mp "statische Rauchbegrenzungsmenge" SWORD InjMass 1 100 -327.6800 327.6700 FORMAT "%8.4" ECU_ADDRESS 0x9FF34A /end MEASUREMENT
/begin MEASUREMENT FlMng_qLimSmkL_mp "Begrenzungsmenge aus Rauchbegrenzung über Lambda" SWORD InjMass 1 100 -327.6800 327.6700 FORMAT "%8.4" ECU_ADDRESS 0x9FF34C /end MEASUREMENT
/begin MEASUREMENT FlMng_qLimSmkQ_mp "Begrenzungsmenge aus Rauchbegrenzung über Luftmasse/Luftdruck" SWORD InjMass 1 100 -327.6800 327.6700 FORMAT "%8.4" ECU_ADDRESS 0x9FF34E /end MEASUREMENT
/begin MEASUREMENT FlMng_qTempFuelCorr_mp "Begrenzungsmenge gewichtet nach Kraftstofftemperatur" SWORD InjMass 1 100 -327.6800 327.6700 FORMAT "%8.4" ECU_ADDRESS 0x9FF350 /end MEASUREMENT
/begin MEASUREMENT FlMng_qTempFuel_mp "Begrenzungsmenge aus Wunschmenge über KF FlMng_qTempFuel" SWORD dQnt_dT1 1 100 -655.3600 655.3400 FORMAT "%8.4" ECU_ADDRESS 0x9FF352 /end MEASUREMENT
/begin MEASUREMENT FlMng_rLmbdPartLdCor_mp "PWG abhängige Rauchbegrenzung" SWORD lambda 1 100 -32.76800 32.76700 FORMAT "%8.5" ECU_ADDRESS 0x9FF354 /end MEASUREMENT
/begin MEASUREMENT FlMng_rLmbdRecDvt_mp "Kehrwert der Lambdaabweichung bei Volllastregelung" SWORD lambdaRec 1 100 -3.276800 3.276700 FORMAT "%8.6" ECU_ADDRESS 0x9FF356 /end MEASUREMENT
/begin MEASUREMENT FlMng_rLmbdSet_mp "minimal zulässiger Lambda Wert" SWORD lambda 1 100 -32.76800 32.76700 FORMAT "%8.5" ECU_ADDRESS 0x9FF358 /end MEASUREMENT
/begin MEASUREMENT FlMng_rLmbdSmkSOECorr_mp "Lambdawert der Rauchbegrenzung aufgrund Ansteuerbeginn" SWORD lambda 1 100 -32.76800 32.76700 FORMAT "%8.5" ECU_ADDRESS 0x9FF35A /end MEASUREMENT
/begin MEASUREMENT FlMng_rLmbdSmkSOE_mp "Lambdakorrekturwert durch Ansteuerbeginn - Frühverstellung" SWORD lambda 1 100 -32.76800 32.76700 FORMAT "%8.5" ECU_ADDRESS 0x9FF35C /end MEASUREMENT
/begin MEASUREMENT FlMng_rLmbdSmk_mp "Lambda-Wert der Rauchbegrenzung" SWORD lambda 1 100 -32.76800 32.76700 FORMAT "%8.5" ECU_ADDRESS 0x9FF35E /end MEASUREMENT
/begin MEASUREMENT FlMng_stMon_mp "Status der Einschaltlogik und Überwachung der VOllastregellung" UBYTE OneToOne 1 100 0.00 255.0 FORMAT "%5.1" ECU_ADDRESS 0x7FDDEE /end MEASUREMENT
/begin MEASUREMENT FlMng_stRmpLimSmkL_mp "Bitleiste zum Anzeigen der ausgewählten Rampeneingänge in der Rauchbegrenzung über Lambda" UBYTE OneToOne 1 100 0.00 255.0 FORMAT "%5.1" ECU_ADDRESS 0x9FFE52 /end MEASUREMENT
/begin MEASUREMENT FlPpCD_stFlPp "Hardwareansteuerung Kraftstoffumwaelzpumpe" UBYTE OneToOne 1 100 0.00 255.0 FORMAT "%5.1" ECU_ADDRESS 0x7F93F3 /end MEASUREMENT
/begin MEASUREMENT FlPpCD_swtFlPpAct "Schalter fuer die Kraftstoffumwaelzpumpe ( 0 - deaktiviert / 1 - aktiviert )" UBYTE OneToOne 1 100 0.00 255.0 FORMAT "%5.1" ECU_ADDRESS 0x7F93F4 /end MEASUREMENT
/begin MEASUREMENT FlSCD_stVld "Qualifizierungsmessage für den Tankstand" UBYTE OneToOne 1 100 0.00 255.0 FORMAT "%5.1" ECU_ADDRESS 0x7F93F5 /end MEASUREMENT
/begin MEASUREMENT FlSCD_uLvlRawT1 "Spannungsrohwert des Kraftstofflevelsensors 1" SWORD Volt 1 100 -160156.4 160151.5 FORMAT "%8.1" ECU_ADDRESS 0x7F996E /end MEASUREMENT
/begin MEASUREMENT FlSCD_volTotal "gefiltertes Gesamtvolumen des Tanks" SWORD Fl_Half_L 1 100 -16384.00 16383.50 FORMAT "%8.2" ECU_ADDRESS 0x7F9970 /end MEASUREMENT
/begin MEASUREMENT FlSCD_volTotalLin "Rohwert des Kraftstoffvolumens im Tank" SWORD Fl_Half_L 1 100 -16384.00 16383.50 FORMAT "%8.2" ECU_ADDRESS 0x7F9972 /end MEASUREMENT
/begin MEASUREMENT FlSys_rhoFl "Koeffizient Kraftstoffdichte" SWORD RhoFuel 1 100 -3276.800 3276.700 FORMAT "%8.3" ECU_ADDRESS 0x7F9974 /end MEASUREMENT
/begin MEASUREMENT FlSys_stFlClg "Status des Ventils für den Kühlmitteldurchfluß durch den Kraftstoffkühler" UBYTE OneToOne 1 100 0.00 255.0 FORMAT "%5.1" ECU_ADDRESS 0x7F93F7 /end MEASUREMENT
/begin MEASUREMENT FlSys_stFlPp "Statusmessage der Kraftstoffumwälzpumpenlogik" UBYTE OneToOne 1 100 0.00 255.0 FORMAT "%5.1" ECU_ADDRESS 0x7F93F8 /end MEASUREMENT
/begin MEASUREMENT FlSys_stLogicFlPp_mp "Meßpunkte für die Ansteuerungslogik der Kraftstoffumwälzpumpe" UBYTE OneToOne 1 100 0.00 255.0 FORMAT "%5.1" ECU_ADDRESS 0x9FFE54 /end MEASUREMENT
/begin MEASUREMENT FlSys_stTemp_mp "Statusbits zur Erfassung der Kraftstoffsystemtemperatur" UBYTE OneToOne 1 100 0.00 255.0 FORMAT "%5.1" ECU_ADDRESS 0x9FFE55 /end MEASUREMENT
/begin MEASUREMENT FlSys_swtTempSensCfg "Schalter, ob Kraftstofftemperaturfühler vorhanden" UBYTE OneToOne 1 100 0.00 255.0 FORMAT "%5.1" ECU_ADDRESS 0x7F93F9 /end MEASUREMENT
/begin MEASUREMENT FlSys_t "aktuelle Systemtemperatur" SWORD Temp_Cels 1 100 -3549.940 3003.560 FORMAT "%8.3" ECU_ADDRESS 0x7F9976 /end MEASUREMENT
/begin MEASUREMENT FMA_dqAbs_mp "Absolutwert der Einspritzmengenänderung für FMA" SWORD InjMassSec 1 100 -327.6800 327.6700 FORMAT "%8.4" ECU_ADDRESS 0x9FF3EE /end MEASUREMENT
/begin MEASUREMENT FMA_drLmbdAbs_mp "Absolutwert der Lambdaänderung für FMA" SWORD lambdaSec 1 100 -32.76800 32.76700 FORMAT "%8.5" ECU_ADDRESS 0x9FF3F0 /end MEASUREMENT
/begin MEASUREMENT FMA_facAirSwtOff_mp "Ansauglufttemperaturabhängiger Abschaltfaktor der FMA" SWORD Fact 1 100 -4.000000 3.999878 FORMAT "%8.6" ECU_ADDRESS 0x9FF3F2 /end MEASUREMENT
/begin MEASUREMENT FMA_facEngSwtOff_mp "Motortemperaturabhängiger Abschaltfaktor der FMA" SWORD Fact 1 100 -4.000000 3.999878 FORMAT "%8.6" ECU_ADDRESS 0x9FF3F4 /end MEASUREMENT
/begin MEASUREMENT FMA_facFaultSwtOff_mp "Faktor für langsame FMA-Abschaltung bei schweren Systemfehlern" SWORD Fact 1 100 -4.000000 3.999878 FORMAT "%8.6" ECU_ADDRESS 0x9FF3F6 /end MEASUREMENT
/begin MEASUREMENT FMA_facFlSwtOff_mp "Kraftstofftemperaturabhängiger Abschaltfaktor der FMA" SWORD Fact 1 100 -4.000000 3.999878 FORMAT "%8.6" ECU_ADDRESS 0x9FF3F8 /end MEASUREMENT
/begin MEASUREMENT FMA_facRgnSwtOff_mp "Regenerations-/ Applikationsabhängiger Abschaltfaktor der FMA" SWORD Fact 1 100 -4.000000 3.999878 FORMAT "%8.6" ECU_ADDRESS 0x9FF3FA /end MEASUREMENT
/begin MEASUREMENT FMA_facSlpSwtOff_mp "Abschaltfaktor der FMA, gebildet aus den 4 oberen Abschaltfaktoren" SWORD Fact 1 100 -4.000000 3.999878 FORMAT "%8.6" ECU_ADDRESS 0x9FF3FC /end MEASUREMENT
/begin MEASUREMENT FMA_facSwtOff "Abschaltfaktor zum langsamen Aus- und Einschalten der FMA" SWORD Fact 1 100 -4.000000 3.999878 FORMAT "%8.6" ECU_ADDRESS 0x7F991A /end MEASUREMENT
/begin MEASUREMENT FMA_numLim_mp "Anzahl der Kennfeldpunkte, die an den erlaubten Grenzwerten liegen" UWORD OneToOne 1 100 0.00 65535.00 FORMAT "%8.2" ECU_ADDRESS 0x9FF3E8 /end MEASUREMENT
/begin MEASUREMENT FMA_qAct_mp "Aus Lambda- und Luftmassenmessung ermittelte Einspritzmenge. ""Wirkliche"" Einspritzmenge der FMA" SWORD InjMass 1 100 -327.6800 327.6700 FORMAT "%8.4" ECU_ADDRESS 0x9FF360 /end MEASUREMENT
/begin MEASUREMENT FMA_qCtl_mp "Für Bestimmung des Mengenfehlers verwendetes Mengensignal" SWORD InjMass 1 100 -327.6800 327.6700 FORMAT "%8.4" ECU_ADDRESS 0x9FF364 /end MEASUREMENT
/begin MEASUREMENT FMA_qDC "Von FMA ermittelter Einspritzmengenfehler bzw. -korrekturwert für Betriebsart Direct Control (Modellfehler)" SWORD InjMass 1 100 -327.6800 327.6700 FORMAT "%8.4" ECU_ADDRESS 0x7F991C /end MEASUREMENT
/begin MEASUREMENT FMA_qDev_mp "Abweichung der ""wirklichen"" Einspritzmenge von der gewünschten Einspritzmenge in der FMA" SWORD InjMass 1 100 -327.6800 327.6700 FORMAT "%8.4" ECU_ADDRESS 0x9FF362 /end MEASUREMENT
/begin MEASUREMENT FMA_qIC "Von FMA ermittelter Einspritzmengenfehler bzw. -korrekturwert für Betriebsart Indirect Control (Modellfehler)" SWORD InjMass 1 100 -327.6800 327.6700 FORMAT "%8.4" ECU_ADDRESS 0x7F991E /end MEASUREMENT
/begin MEASUREMENT FMA_qMapRow0_mp "Kennfeldwerte für erste Mengenstützstelle (erste zeile von adaptive Kennfeld)" SWORD InjMassCorr 1 100 -32.76800 32.76700 FORMAT "%8.5" ARRAY_SIZE 8 ECU_ADDRESS 0x9FF368 /end MEASUREMENT
/begin MEASUREMENT FMA_qMapRow1_mp "Kennfeldwerte für zweite Mengenstützstelle (zweite zeile von adaptive Kennfeld)" SWORD InjMassCorr 1 100 -32.76800 32.76700 FORMAT "%8.5" ARRAY_SIZE 8 ECU_ADDRESS 0x9FF378 /end MEASUREMENT
/begin MEASUREMENT FMA_qMapRow2_mp "Kennfeldwerte für dritte Mengenstützstelle (dritte zeile von adaptive Kennfeld)" SWORD InjMassCorr 1 100 -32.76800 32.76700 FORMAT "%8.5" ARRAY_SIZE 8 ECU_ADDRESS 0x9FF388 /end MEASUREMENT
/begin MEASUREMENT FMA_qMapRow3_mp "Kennfeldwerte für vierte Mengenstützstelle (vierte zeile von adaptive Kennfeld)" SWORD InjMassCorr 1 100 -32.76800 32.76700 FORMAT "%8.5" ARRAY_SIZE 8 ECU_ADDRESS 0x9FF398 /end MEASUREMENT
/begin MEASUREMENT FMA_qMapRow4_mp "Kennfeldwerte für fünfte Mengenstützstelle (fünfte zeile von adaptive Kennfeld)" SWORD InjMassCorr 1 100 -32.76800 32.76700 FORMAT "%8.5" ARRAY_SIZE 8 ECU_ADDRESS 0x9FF3A8 /end MEASUREMENT
/begin MEASUREMENT FMA_qMapRow5_mp "Kennfeldwerte für sechste Mengenstützstelle (sechste zeile von adaptive Kennfeld)" SWORD InjMassCorr 1 100 -32.76800 32.76700 FORMAT "%8.5" ARRAY_SIZE 8 ECU_ADDRESS 0x9FF3B8 /end MEASUREMENT
/begin MEASUREMENT FMA_qMapRow6_mp "Kennfeldwerte für siebte Mengenstützstelle (siebte zeile von adaptive Kennfeld)" SWORD InjMassCorr 1 100 -32.76800 32.76700 FORMAT "%8.5" ARRAY_SIZE 8 ECU_ADDRESS 0x9FF3C8 /end MEASUREMENT
/begin MEASUREMENT FMA_qMapRow7_mp "Kennfeldwerte für achte Mengenstützstelle (achte zeile von adaptive Kennfeld)" SWORD InjMassCorr 1 100 -32.76800 32.76700 FORMAT "%8.5" ARRAY_SIZE 8 ECU_ADDRESS 0x9FF3D8 /end MEASUREMENT
/begin MEASUREMENT FMA_qRaw_mp "Aus Fehlermodell ermittelter unbegrenzter Rohwert des Einspritzmengenfehlers der FMA" SWORD InjMass 1 100 -327.6800 327.6700 FORMAT "%8.4" ECU_ADDRESS 0x7FDDF0 /end MEASUREMENT
/begin MEASUREMENT FMA_qReg_mp "Einspritzmengenfehler im aktuellen Lernbereich" SWORD InjMass 1 100 -327.6800 327.6700 FORMAT "%8.4" ECU_ADDRESS 0x9FF3EA /end MEASUREMENT
/begin MEASUREMENT FMA_qSetFil_mp "Initialisierungswert für Integrierer bzw. PT1-Filter" SWORD InjMassCorr 1 100 -32.76800 32.76700 FORMAT "%8.5" ECU_ADDRESS 0x9FF3EC /end MEASUREMENT
/begin MEASUREMENT FMA_q_mp "Mit abshaltfactor multiplizierter Mengenfehler des Fehlermodells" SWORD InjMass 1 100 -327.6800 327.6700 FORMAT "%8.4" ECU_ADDRESS 0x9FF366 /end MEASUREMENT
/begin MEASUREMENT FMA_stDynDlyd_mp "FMA-Status: Aktuell oder vor kurzem starke Änderung der Einspritzmenge (verzögerte Einspritzmengendynamik)" UBYTE OneToOne 1 100 0.00 255.0 FORMAT "%5.1" ECU_ADDRESS 0x9FFE57 /end MEASUREMENT
/begin MEASUREMENT FMA_stDynLmbd_mp "FMA- Status: Aktuell oder bis vor kurzem starke Lambdaänderung" UBYTE OneToOne 1 100 0.00 255.0 FORMAT "%5.1" ECU_ADDRESS 0x9FFE58 /end MEASUREMENT
/begin MEASUREMENT FMA_stNoAdapt_mp "Status: Adaption des FMA-Fehlermodells angehalten" UBYTE OneToOne 1 100 0.00 255.0 FORMAT "%5.1" ECU_ADDRESS 0x9FFE59 /end MEASUREMENT
/begin MEASUREMENT FMA_stOvrRunDlyd_mp "FMA-Status: Aktuell oder bis vor kurzem Schubbetrieb (verzögerter Schubbetrieb)" UBYTE OneToOne 1 100 0.00 255.0 FORMAT "%5.1" ECU_ADDRESS 0x9FFE5A /end MEASUREMENT
/begin MEASUREMENT FMA_stReset_mp "Status: FMA-Fehlermodell wird zurückgesetzt" UBYTE OneToOne 1 100 0.00 255.0 FORMAT "%5.1" ECU_ADDRESS 0x9FFE5B /end MEASUREMENT
/begin MEASUREMENT FMA_stRngLmbd_mp "FMA_ Status: Lambda aktuell oder bis vor kurzem außerhalb" UBYTE OneToOne 1 100 0.00 255.0 FORMAT "%5.1" ECU_ADDRESS 0x9FFE5C /end MEASUREMENT
/begin MEASUREMENT FMA_stSetMap_mp "Status: Setzen des aktuellen Kennfeldpunkts erlaubt" UBYTE OneToOne 1 100 0.00 255.0 FORMAT "%5.1" ECU_ADDRESS 0x9FFE56 /end MEASUREMENT
/begin MEASUREMENT FMA_stSwtOff "Abschaltzustand der FMA" UWORD OneToOne 1 100 0.00 65535.00 FORMAT "%8.2" ECU_ADDRESS 0x7F9920 /end MEASUREMENT
/begin MEASUREMENT FMTC_etaCurr "aktueller Wirkunggsgrad (korrigiert)" SWORD Eta 1 100 -256.0000 255.9922 FORMAT "%8.4" ECU_ADDRESS 0x7F9922 /end MEASUREMENT
/begin MEASUREMENT FMTC_etaCurrByp_mp "Meßpunkt für Bypass Freischnitt" SWORD Eta 1 100 -256.0000 255.9922 FORMAT "%8.4" ECU_ADDRESS 0x9FF3FE /end MEASUREMENT
/begin MEASUREMENT FMTC_etaCurrStd "aktueller Standard-Wirkungsgradfaktor (ohne Regenerationsmaßnahmen)" SWORD Eta 1 100 -256.0000 255.9922 FORMAT "%8.4" ECU_ADDRESS 0x7F9924 /end MEASUREMENT
/begin MEASUREMENT FMTC_facEtaCor "aktueller Wirkungsgradkorrekturwert" SWORD Fact 1 100 -4.000000 3.999878 FORMAT "%8.6" ECU_ADDRESS 0x7F9926 /end MEASUREMENT
/begin MEASUREMENT FMTC_qAct "Einspritzmenge Sollwert ohne Ruckeldämpfereingriff" SWORD InjMass 1 100 -327.6800 327.6700 FORMAT "%8.4" ECU_ADDRESS 0x7F9928 /end MEASUREMENT
/begin MEASUREMENT FMTC_qCurr "Einspritzmenge aktueller Wert" SWORD InjMass 1 100 -327.6800 327.6700 FORMAT "%8.4" ECU_ADDRESS 0x7F992A /end MEASUREMENT
/begin MEASUREMENT FMTC_qDes "Einspritzmenge Wunschwert" SWORD InjMass 1 100 -327.6800 327.6700 FORMAT "%8.4" ECU_ADDRESS 0x7F992C /end MEASUREMENT
/begin MEASUREMENT FMTC_qRaw "Einspritzmenge Rohwert (>Luftsystem)" SWORD InjMass 1 100 -327.6800 327.6700 FORMAT "%8.4" ECU_ADDRESS 0x7F992E /end MEASUREMENT
/begin MEASUREMENT FMTC_qSet "Einspritzmenge Sollwert (>Einspritzung)" SWORD InjMass 1 100 -327.6800 327.6700 FORMAT "%8.4" ECU_ADDRESS 0x7F9930 /end MEASUREMENT
/begin MEASUREMENT FMTC_qSetOptStd_mp "optimale Standardsollmenge ohne Korrekturen" SWORD InjMass 1 100 -327.6800 327.6700 FORMAT "%8.4" ECU_ADDRESS 0x9FF400 /end MEASUREMENT
/begin MEASUREMENT FMTC_qSetRgn1_mp "Regenerationseinspritzmenge Sollwert mit Berücksichtigung einer Regenerationsanforderung 1 der Abgasnachbehandlung" SWORD InjMass 1 100 -327.6800 327.6700 FORMAT "%8.4" ECU_ADDRESS 0x9FF402 /end MEASUREMENT
/begin MEASUREMENT FMTC_qSetRgn2_mp "Regenerationseinspritzmenge Sollwert mit Berücksichtigung einer Regenerationsanforderung 2 der Abgasnachbehandlung" SWORD InjMass 1 100 -327.6800 327.6700 FORMAT "%8.4" ECU_ADDRESS 0x9FF404 /end MEASUREMENT
/begin MEASUREMENT FMTC_qSetRgn3_mp "Regenerationseinspritzmenge Sollwert mit Berücksichtigung einer Regenerationsanforderung 3 der Abgasnachbehandlung" SWORD InjMass 1 100 -327.6800 327.6700 FORMAT "%8.4" ECU_ADDRESS 0x9FF406 /end MEASUREMENT
/begin MEASUREMENT FMTC_qSetRgn4_mp "Regenerationseinspritzmenge Sollwert mit Berücksichtigung einer Regenerationsanforderung 4 der Abgasnachbehandlung" SWORD InjMass 1 100 -327.6800 327.6700 FORMAT "%8.4" ECU_ADDRESS 0x9FF408 /end MEASUREMENT
/begin MEASUREMENT FMTC_qSetStd_mp "Standardeinspritzmenge Sollwert ohne Berücksichtigung der Regenerationsanforderung der Abgasnachbehandlung" SWORD InjMass 1 100 -327.6800 327.6700 FORMAT "%8.4" ECU_ADDRESS 0x9FF40A /end MEASUREMENT
/begin MEASUREMENT FMTC_qStrt "Einspritzmenge Startwert" SWORD InjMass 1 100 -327.6800 327.6700 FORMAT "%8.4" ECU_ADDRESS 0x7F9932 /end MEASUREMENT
/begin MEASUREMENT FMTC_qStrtByp_mp "Meßpunkt für Bypass Freischnitt" SWORD InjMass 1 100 -327.6800 327.6700 FORMAT "%8.4" ECU_ADDRESS 0x9FF40C /end MEASUREMENT
/begin MEASUREMENT FMTC_stRgn_mp "Interner Regenerationsstatus des FMTC" UWORD OneToOne 1 100 0.00 65535.00 FORMAT "%8.2" ECU_ADDRESS 0x9FF40E /end MEASUREMENT
/begin MEASUREMENT FMTC_trqInr "aktuelles rückgerechnetes inneres Motormoment" SWORD Trq 1 100 -3276.800 3276.700 FORMAT "%8.3" ECU_ADDRESS 0x7F9934 /end MEASUREMENT
/begin MEASUREMENT FMTC_trqInrLimSmk "Begrenzungsmoment Rauchgrenze" SWORD Trq 1 100 -3276.800 3276.700 FORMAT "%8.3" ECU_ADDRESS 0x7F9936 /end MEASUREMENT
/begin MEASUREMENT FMTC_trqInrLimSmkByp_mp "Meßpunkt für Bypass Freischnitt" SWORD Trq 1 100 -3276.800 3276.700 FORMAT "%8.3" ECU_ADDRESS 0x9FF410 /end MEASUREMENT
/begin MEASUREMENT FQlSCD_rFlQl "Momentaner RME Gehalt in Kraftstoff" SWORD Prc 1 100 -327.6800 327.6700 FORMAT "%8.4" ECU_ADDRESS 0x7F9944 /end MEASUREMENT
/begin MEASUREMENT FQlSCD_rFlQlLin "Lineralisierte Gehalt RME im Kraftstoff" SWORD Prc 1 100 -327.6800 327.6700 FORMAT "%8.4" ECU_ADDRESS 0x7F9946 /end MEASUREMENT
/begin MEASUREMENT FQlSCD_stRpOil "Kraftstoffart (RME oder Diesel)" SWORD OneToOne 1 100 -32768.00 32767.00 FORMAT "%8.2" ECU_ADDRESS 0x7F9948 /end MEASUREMENT
/begin MEASUREMENT FQlSCD_swtSig "RME Signalquelle" SWORD OneToOne 1 100 -32768.00 32767.00 FORMAT "%8.2" ECU_ADDRESS 0x7F93E9 /end MEASUREMENT
/begin MEASUREMENT FQlSCD_uRaw "RME Sensor Rohwert" SWORD Volt 1 100 -160156.4 160151.5 FORMAT "%8.1" ECU_ADDRESS 0x7F994A /end MEASUREMENT
/begin MEASUREMENT FQTSCD_rFlQl "Kraftstoffqualität" SWORD Prc 1 100 -327.6800 327.6700 FORMAT "%8.4" ECU_ADDRESS 0x7F9938 /end MEASUREMENT
/begin MEASUREMENT FQTSCD_rFlQlLin "Linearisierter Wert der Kraftstoffqualität" SWORD Prc 1 100 -327.6800 327.6700 FORMAT "%8.4" ECU_ADDRESS 0x7F993A /end MEASUREMENT
/begin MEASUREMENT FQTSCD_stMon "Status des Sensor-Zustandsautomaten" UBYTE OneToOne 1 100 0.00 255.0 FORMAT "%5.1" ECU_ADDRESS 0x7F93E6 /end MEASUREMENT
/begin MEASUREMENT FQTSCD_stRpOil "Status-Datenwort, das den verbrauchten Kraftstofftyp angibt : 0: Diesel, 1: RME." UBYTE OneToOne 1 100 0.00 255.0 FORMAT "%5.1" ECU_ADDRESS 0x7F93E7 /end MEASUREMENT
/begin MEASUREMENT FQTSCD_swtEna "Status-Botschaft zur Aktivierung bzw. Deaktivierung des Kombi-Sensors" UBYTE OneToOne 1 100 0.00 255.0 FORMAT "%5.1" ECU_ADDRESS 0x7F93E8 /end MEASUREMENT
/begin MEASUREMENT FQTSCD_tFuel "Kraftstofftemperatur" SWORD Temp_Cels 1 100 -3549.940 3003.560 FORMAT "%8.3" ECU_ADDRESS 0x7F993C /end MEASUREMENT
/begin MEASUREMENT FQTSCD_tFuelLin "Linearisierter Wert der Kraftstofftemperatur" SWORD Temp_Cels 1 100 -3549.940 3003.560 FORMAT "%8.3" ECU_ADDRESS 0x7F993E /end MEASUREMENT
/begin MEASUREMENT FQTSCD_uFlQlRaw "Spannungsrohwert der Kraftstoffqualität" SWORD Volt 1 100 -160156.4 160151.5 FORMAT "%8.1" ECU_ADDRESS 0x7F9940 /end MEASUREMENT
/begin MEASUREMENT FQTSCD_uFlTempRaw "Spannungsrohwert der Kraftstofftemperatur" SWORD Volt 1 100 -160156.4 160151.5 FORMAT "%8.1" ECU_ADDRESS 0x7F9942 /end MEASUREMENT
/begin MEASUREMENT FrmMng_aACCPtdCtlDvt "Zulässige regelabweichung" SWORD Acc 1 100 -32.76800 32.76700 FORMAT "%8.5" ECU_ADDRESS 0x7F9978 /end MEASUREMENT
/begin MEASUREMENT FrmMng_aACCSetpoint "Sollbeschleunigung" SWORD Acc 1 100 -32.76800 32.76700 FORMAT "%8.5" ECU_ADDRESS 0x7F997A /end MEASUREMENT
/begin MEASUREMENT FrmMng_aBRK2Trnvrs "Querbeschleunigung von BRK2" SWORD TrnvrsAcc 1 100 -327.6800 327.6700 FORMAT "%8.4" ECU_ADDRESS 0x7F997C /end MEASUREMENT
/begin MEASUREMENT FrmMng_aLong "Längsbeschleunigung" SWORD Acc 1 100 -32.76800 32.76700 FORMAT "%8.5" ECU_ADDRESS 0x7F997E /end MEASUREMENT
/begin MEASUREMENT FrmMng_aVeh "Fahrzeugbeschleunigung von CAN" SWORD Acc 1 100 -32.76800 32.76700 FORMAT "%8.5" ECU_ADDRESS 0x7F9980 /end MEASUREMENT
/begin MEASUREMENT FrmMng_ctAlvAAG_mp "Botschaftszähler der AAG Botschaft" UBYTE OneToOne 1 100 0.00 255.0 FORMAT "%5.1" ECU_ADDRESS 0x9FFE8A /end MEASUREMENT
/begin MEASUREMENT FrmMng_ctAlvACC_mp "Meßpunkt für Botschaftszähler für CAN Botschaft ACC-System" UBYTE OneToOne 1 100 0.00 255.0 FORMAT "%5.1" ECU_ADDRESS 0x9FFE8B /end MEASUREMENT
/begin MEASUREMENT FrmMng_ctAlvAirbag_mp "Botschaftszähler der Airbag Botschaft" UBYTE OneToOne 1 100 0.00 255.0 FORMAT "%5.1" ECU_ADDRESS 0x9FFE8C /end MEASUREMENT
/begin MEASUREMENT FrmMng_ctAlvAWD1_mp "Meßpunkt für Botschaftszähler für CAN Botschaft Allrad1" UBYTE OneToOne 1 100 0.00 255.0 FORMAT "%5.1" ECU_ADDRESS 0x9FFE8D /end MEASUREMENT
/begin MEASUREMENT FrmMng_ctAlvBEM1_mp "Botschaftszähler der Energiemanager 1 Botschaft" UBYTE OneToOne 1 100 0.00 255.0 FORMAT "%5.1" ECU_ADDRESS 0x9FFE8E /end MEASUREMENT
/begin MEASUREMENT FrmMng_ctAlvBRK1_mp "Meßpunkt für Botschaftszähler für CAN Botschaft Bremse1" UBYTE OneToOne 1 100 0.00 255.0 FORMAT "%5.1" ECU_ADDRESS 0x9FFE8F /end MEASUREMENT
/begin MEASUREMENT FrmMng_ctAlvBRK2_mp "Meßpunkt für Botschaftszähler für CAN Botschaft Bremse1" UBYTE OneToOne 1 100 0.00 255.0 FORMAT "%5.1" ECU_ADDRESS 0x9FFE90 /end MEASUREMENT
/begin MEASUREMENT FrmMng_ctAlvBRK8_mp "Meßpunkt für Botschaftszähler für CAN Botschaft Bremse8" UBYTE OneToOne 1 100 0.00 255.0 FORMAT "%5.1" ECU_ADDRESS 0x9FFE91 /end MEASUREMENT
/begin MEASUREMENT FrmMng_ctAlvCCTL_mp "Meßpunkt für Botschaftszähler für CAN Botschaft GRA" UBYTE OneToOne 1 100 0.00 255.0 FORMAT "%5.1" ECU_ADDRESS 0x9FFE92 /end MEASUREMENT
/begin MEASUREMENT FrmMng_ctAlvDSP1_mp "Meßpunkt für Botschaftszähler für CAN Botschaft Kombi1" UBYTE OneToOne 1 100 0.00 255.0 FORMAT "%5.1" ECU_ADDRESS 0x9FFE93 /end MEASUREMENT
/begin MEASUREMENT FrmMng_ctAlvEPB1_mp "Meßpunkt für Botschaftszähler der EPB1 Botschaft" UBYTE OneToOne 1 100 0.00 255.0 FORMAT "%5.1" ECU_ADDRESS 0x9FFE94 /end MEASUREMENT
/begin MEASUREMENT FrmMng_ctAlvILM_mp "Botschaftszähler der ILM Botschaft" UBYTE OneToOne 1 100 0.00 255.0 FORMAT "%5.1" ECU_ADDRESS 0x9FFE95 /end MEASUREMENT
/begin MEASUREMENT FrmMng_ctAlvNiveau1_mp "Botschaftszähler der Niveau1 Botschaft" UBYTE OneToOne 1 100 0.00 255.0 FORMAT "%5.1" ECU_ADDRESS 0x9FFE96 /end MEASUREMENT
/begin MEASUREMENT FrmMng_ctAlvSA1_mp "Aktueller Botschaftszähler der Botschaft SA1" UBYTE OneToOne 1 100 0.00 255.0 FORMAT "%5.1" ECU_ADDRESS 0x9FFE97 /end MEASUREMENT
/begin MEASUREMENT FrmMng_ctAlvTSC1_mp "Meßpunkt für Botschaftszähler für CAN Botschaft Getriebe1" UBYTE OneToOne 1 100 0.00 255.0 FORMAT "%5.1" ECU_ADDRESS 0x9FFE98 /end MEASUREMENT
/begin MEASUREMENT FrmMng_ctAlvTSC2_mp "Meßpunkt für Botschaftszähler für CAN Botschaft Getriebe2" UBYTE OneToOne 1 100 0.00 255.0 FORMAT "%5.1" ECU_ADDRESS 0x9FFE99 /end MEASUREMENT
/begin MEASUREMENT FrmMng_ctAlvTSC3_mp "Meßpunkt für Botschaftszähler für CAN Botschaft Getriebe3" UBYTE OneToOne 1 100 0.00 255.0 FORMAT "%5.1" ECU_ADDRESS 0x9FFE9A /end MEASUREMENT
/begin MEASUREMENT FrmMng_ctAlvTSC6_mp "Meßpunkt für Botschaftszähler für CAN Botschaft Getriebe6" UBYTE OneToOne 1 100 0.00 255.0 FORMAT "%5.1" ECU_ADDRESS 0x9FFE9B /end MEASUREMENT
/begin MEASUREMENT FrmMng_ctChrgr1_Off_mp "Messpunkt für Zähler der Abschaltanforderung Turbolader 1" UBYTE OneToOne 1 100 0.00 255.0 FORMAT "%5.1" ECU_ADDRESS 0x9FFE81 /end MEASUREMENT
/begin MEASUREMENT FrmMng_ctChrgr2_Off_mp "Messpunkt für Zähler der Abschaltanforderung Turbolader 2" UBYTE OneToOne 1 100 0.00 255.0 FORMAT "%5.1" ECU_ADDRESS 0x9FFE82 /end MEASUREMENT
/begin MEASUREMENT FrmMng_ctChrgr_Rst_mp "Messpunkt für den Zähler der Restartwerte" UBYTE OneToOne 1 100 0.00 255.0 FORMAT "%5.1" ECU_ADDRESS 0x9FFE83 /end MEASUREMENT
/begin MEASUREMENT FrmMng_daACCGradMax "Maximaler Anderungsgradient" SWORD RmpAccCan 1 100 -327.6800 327.6700 FORMAT "%8.4" ECU_ADDRESS 0x7F9982 /end MEASUREMENT
/begin MEASUREMENT FrmMng_dBPACDOut1_mp "CAN Wert des Tastverhältnisses für BPA 1" UWORD DtyCycCan 1 100 0.00 6553.500 FORMAT "%8.3" ECU_ADDRESS 0x9FF412 /end MEASUREMENT
/begin MEASUREMENT FrmMng_dBPACDOut2_mp "CAN Wert des Tastverhältnisses für BPA 2" UWORD DtyCycCan 1 100 0.00 6553.500 FORMAT "%8.3" ECU_ADDRESS 0x9FF414 /end MEASUREMENT
/begin MEASUREMENT FrmMng_drAPPPrefill_mp "PWG Gradient ueber CAN ENG3" SWORD Prc_D4ms_FrmMng 1 100 -819200.0 819175.0 FORMAT "%8.1" ECU_ADDRESS 0x9FF41A /end MEASUREMENT
/begin MEASUREMENT FrmMng_dSootLoadtmp_mp "Überschüssiger Rußbeladungswert" SWORD OneToOne 1 100 -32768.00 32767.00 FORMAT "%8.2" ECU_ADDRESS 0x9FF41C /end MEASUREMENT
/begin MEASUREMENT FrmMng_dSootLoadWIV2ItgrEEP_mp "Accumulated Soot load value from the EEPROM" ULONG OneToOne 1 100 0.00 4294967295.00 FORMAT "%13.2" ECU_ADDRESS 0x9FE5AC /end MEASUREMENT
/begin MEASUREMENT FrmMng_dSootLoadWIV2Itgr_mp "Akkumulierter Rußbeladungswert" ULONG OneToOne 1 100 0.00 4294967295.00 FORMAT "%13.2" ECU_ADDRESS 0x9FE5B0 /end MEASUREMENT
/begin MEASUREMENT FrmMng_dSumEngTrqErr_mp "Gewichtete Fehlersumme für Momentenangabe ungenau" UBYTE OneToOne 1 100 0.00 255.0 FORMAT "%5.1" ECU_ADDRESS 0x9FFE9C /end MEASUREMENT
/begin MEASUREMENT FrmMng_dTOSMsgCnt "TOS Botschaftszähler" UBYTE OneToOne 1 100 0.00 255.0 FORMAT "%5.1" ECU_ADDRESS 0x7F93FA /end MEASUREMENT
/begin MEASUREMENT FrmMng_dtrqFrcLimCan_mp "Meßpunkt für die beschränkte Reibmomentendifferenz des Can" SWORD Trq 1 100 -3276.800 3276.700 FORMAT "%8.3" ECU_ADDRESS 0x9FF41E /end MEASUREMENT
/begin MEASUREMENT FrmMng_dtrqFrcLim_mp "Meßpunkt für die beschränkte Reibmomentendifferenz" SWORD Trq 1 100 -3276.800 3276.700 FORMAT "%8.3" ECU_ADDRESS 0x9FF420 /end MEASUREMENT
/begin MEASUREMENT FrmMng_dtrqFrc_mp "Meßpunkt für die Reibmomentendifferenz" SWORD Trq 1 100 -3276.800 3276.700 FORMAT "%8.3" ECU_ADDRESS 0x9FF422 /end MEASUREMENT
/begin MEASUREMENT FrmMng_dtrqTSCLim "Momentengradientenbegrenzung vom EGS" SWORD TrqPerSec 1 100 -32768.00 32767.00 FORMAT "%8.2" ECU_ADDRESS 0x7F9984 /end MEASUREMENT
/begin MEASUREMENT FrmMng_lDIA1km "Kilometerzähler die Botschaft Diagnose1." ULONG Dist2_km 1 100 0.00 4294967295.00 FORMAT "%13.2" ECU_ADDRESS 0x7F9E38 /end MEASUREMENT
/begin MEASUREMENT FrmMng_lDSP3km "Kilometerstand der Kombi3-Botschaft" ULONG Dist2_km 1 100 0.00 4294967295.00 FORMAT "%13.2" ECU_ADDRESS 0x7F9E3C /end MEASUREMENT
/begin MEASUREMENT FrmMng_lOil_mp "Ölniveauschwelle" SWORD Length_mm 1 100 -256.0000 255.9922 FORMAT "%8.4" ECU_ADDRESS 0x7FDDF2 /end MEASUREMENT
/begin MEASUREMENT FrmMng_nDesAST "Synchronisationswunschdrehzahl" SWORD EngN 1 100 -32768.00 32767.00 FORMAT "%8.2" ECU_ADDRESS 0x7F9986 /end MEASUREMENT
/begin MEASUREMENT FrmMng_nDesRgn "Gewünschte Motordrehzahl für Regeneration" UWORD EngN 1 100 0.00 65535.00 FORMAT "%8.2" ECU_ADDRESS 0x7F9988 /end MEASUREMENT
/begin MEASUREMENT FrmMng_nDes_mp "Motorwunschdrehzahl" UWORD EngN 1 100 0.00 65535.00 FORMAT "%8.2" ECU_ADDRESS 0x9FF424 /end MEASUREMENT
/begin MEASUREMENT FrmMng_nMin "Leerlaufsolldrehzahl der Getriebe2 Botschaft" SWORD EngN 1 100 -32768.00 32767.00 FORMAT "%8.2" ECU_ADDRESS 0x7F998A /end MEASUREMENT
/begin MEASUREMENT FrmMng_nSetpoint "Leerlaufsolldrehzahl empfangen vom Slave über CAN" SWORD EngN 1 100 -32768.00 32767.00 FORMAT "%8.2" ECU_ADDRESS 0x7F998C /end MEASUREMENT
/begin MEASUREMENT FrmMng_nTrbnASD "Turbinendrehzahl" SWORD EngN 1 100 -32768.00 32767.00 FORMAT "%8.2" ECU_ADDRESS 0x7F998E /end MEASUREMENT
/begin MEASUREMENT FrmMng_pAC "Kaeltemitteldruck, empfangen von externem Steuergeraet" SWORD PresAC_hPa 1 100 -65536.00 65534.00 FORMAT "%8.2" ECU_ADDRESS 0x7F9990 /end MEASUREMENT
/begin MEASUREMENT FrmMng_pAir "Atmosphärendruck über CAN" SWORD OneToOne 1 100 -32768.00 32767.00 FORMAT "%8.2" ECU_ADDRESS 0x7F9992 /end MEASUREMENT
/begin MEASUREMENT FrmMng_pBoost "Ladedruck über CAN" SWORD OneToOne 1 100 -32768.00 32767.00 FORMAT "%8.2" ECU_ADDRESS 0x7F9994 /end MEASUREMENT
/begin MEASUREMENT FrmMng_pDiffPFlt "Differenzdruck über Partikelfilter" SWORD OneToOne 1 100 -32768.00 32767.00 FORMAT "%8.2" ECU_ADDRESS 0x7F9996 /end MEASUREMENT
/begin MEASUREMENT FrmMng_phiSteer "Aktueller Lenkwinkel" SWORD PhiSteer 1 100 -3276.800 3276.700 FORMAT "%8.3" ECU_ADDRESS 0x7F9998 /end MEASUREMENT
/begin MEASUREMENT FrmMng_prcFan "Prozent Kühlleistunganforderung vom CAN für den Kühlerlüfter" SWORD Prc 1 100 -327.6800 327.6700 FORMAT "%8.4" ECU_ADDRESS 0x7F999A /end MEASUREMENT
/begin MEASUREMENT FrmMng_pwrBEMAlt "Generatorleistung über CAN" SWORD Pwr 1 100 -308831.1 308821.7 FORMAT "%8.1" ECU_ADDRESS 0x7F999C /end MEASUREMENT
/begin MEASUREMENT FrmMng_rAPPPrefill_mp "PWG Wert ueber CAN ENG3" SWORD Prc_FrmMng 1 100 -13107.20 13106.80 FORMAT "%8.2" ECU_ADDRESS 0x9FF426 /end MEASUREMENT
/begin MEASUREMENT FrmMng_rBPACDIn1 "Positionsistwert des Ladedruckstellers 1 über CAN" SWORD DtyCyc 1 100 -327.6800 327.6700 FORMAT "%8.4" ECU_ADDRESS 0x7F999E /end MEASUREMENT
/begin MEASUREMENT FrmMng_rBPACDIn2 "Positionsistwert des Ladedruckstellers 1 über CAN" SWORD DtyCyc 1 100 -327.6800 327.6700 FORMAT "%8.4" ECU_ADDRESS 0x7F99A0 /end MEASUREMENT
/begin MEASUREMENT FrmMng_rBPACDOut1_mp "Tastverhältnis für BPA 1" UWORD DtyCycCan 1 100 0.00 6553.500 FORMAT "%8.3" ECU_ADDRESS 0x9FF416 /end MEASUREMENT
/begin MEASUREMENT FrmMng_rBPACDOut2_mp "Tastverhältnis für BPA 2" UWORD DtyCycCan 1 100 0.00 6553.500 FORMAT "%8.3" ECU_ADDRESS 0x9FF418 /end MEASUREMENT
/begin MEASUREMENT FrmMng_rChrgr1Actr "Ansteuerungs - TV fuer REA- DC - Motor  (Turboloader 1)" SWORD DtyCyc 1 100 -327.6800 327.6700 FORMAT "%8.4" ECU_ADDRESS 0x7F99A2 /end MEASUREMENT
/begin MEASUREMENT FrmMng_rChrgr2Actr "Ansteuerungs - TV fuer REA- DC - Motor  (Turboloader 2)" SWORD DtyCyc 1 100 -327.6800 327.6700 FORMAT "%8.4" ECU_ADDRESS 0x7F99A4 /end MEASUREMENT
/begin MEASUREMENT FrmMng_rCurInf "aktuelle Motordrehzahlbeeinflussung welche über CAN versandt wird" SWORD Prc 1 100 -327.6800 327.6700 FORMAT "%8.4" ECU_ADDRESS 0x7F99A6 /end MEASUREMENT
/begin MEASUREMENT FrmMng_rCurInf_mp "Messpunkt für Ausgang von FrmMng_rCurInf_MAP" SWORD Prc 1 100 -327.6800 327.6700 FORMAT "%8.4" ECU_ADDRESS 0x9FF428 /end MEASUREMENT
/begin MEASUREMENT FrmMng_rDFM "Klemme DFM signal" SWORD Prc 1 100 -327.6800 327.6700 FORMAT "%8.4" ECU_ADDRESS 0x7F99A8 /end MEASUREMENT
/begin MEASUREMENT FrmMng_rFlQl "Kraftsstoffart für CAN" SWORD Prc 1 100 -327.6800 327.6700 FORMAT "%8.4" ECU_ADDRESS 0x7F99AA /end MEASUREMENT
/begin MEASUREMENT FrmMng_rLmbd_mp "Meßpunkt für invertierten Wert von ASMod_rLmbdRecEG" SWORD lambda 1 100 -32.76800 32.76700 FORMAT "%8.5" ECU_ADDRESS 0x9FF42A /end MEASUREMENT
/begin MEASUREMENT FrmMng_rRelPosBPAS "Positionsistwert des Ladedruckstellers  über CAN" SWORD OneToOne 1 100 -32768.00 32767.00 FORMAT "%8.2" ECU_ADDRESS 0x7F99AC /end MEASUREMENT
/begin MEASUREMENT FrmMng_rSlpRes "Fahrwiderstandsindex" SWORD PrcHigh 1 100 -32.76800 32.76700 FORMAT "%8.5" ECU_ADDRESS 0x7F99AE /end MEASUREMENT
/begin MEASUREMENT FrmMng_rTransConv "Übertragungsfunktion" SWORD TransR 1 100 -327.6800 327.6700 FORMAT "%8.4" ECU_ADDRESS 0x7F99B0 /end MEASUREMENT
/begin MEASUREMENT FrmMng_rtrqACCDes "gewünschtes Moment in %  des Maximalmoments" SWORD rTrqCAN 1 100 -12850.20 12849.81 FORMAT "%8.2" ECU_ADDRESS 0x7F99B2 /end MEASUREMENT
/begin MEASUREMENT FrmMng_rtrqConvLoss_mp "Meßpunkt für Verhältnis Wandlerverlustmoment / Maximalmoment" SWORD rTrqCAN 1 100 -12850.20 12849.81 FORMAT "%8.2" ECU_ADDRESS 0x9FF42C /end MEASUREMENT
/begin MEASUREMENT FrmMng_rtrqDCS_mp "Meßpunkt für Verhältnis MSR-Anforderungsmoment / Maximalmoment" SWORD rTrqCAN 1 100 -12850.20 12849.81 FORMAT "%8.2" ECU_ADDRESS 0x9FF42E /end MEASUREMENT
/begin MEASUREMENT FrmMng_rtrqFrcCan_mp "Meßpunkt des Reibmomntenverhältnisses der CAN Botschaft Motor 1" SWORD rTrqCAN 1 100 -12850.20 12849.81 FORMAT "%8.2" ECU_ADDRESS 0x9FF430 /end MEASUREMENT
/begin MEASUREMENT FrmMng_rtrqGearbxCur_mp "Meßpunkt fuer Getriebe-Istmoment (CAN-Wert)" SWORD rTrqCAN 1 100 -12850.20 12849.81 FORMAT "%8.2" ECU_ADDRESS 0x9FF432 /end MEASUREMENT
/begin MEASUREMENT FrmMng_rtrqGearbxDes_mp "Meßpunkt fuer Getriebe-Sollmoment (CAN-Wert)" SWORD rTrqCAN 1 100 -12850.20 12849.81 FORMAT "%8.2" ECU_ADDRESS 0x9FF434 /end MEASUREMENT
/begin MEASUREMENT FrmMng_rtrqInrAvrg "relatives gemitteltes Master/Slave Motormoment für CAN" SWORD rTrqCAN 1 100 -12850.20 12849.81 FORMAT "%8.2" ECU_ADDRESS 0x7F99B4 /end MEASUREMENT
/begin MEASUREMENT FrmMng_rtrqInrEngNoExtDem_mp "Meßpunkt für Verhältnis inneres Motormoment ohne externe Momente / Maximalmoment" SWORD rTrqCAN 1 100 -12850.20 12849.81 FORMAT "%8.2" ECU_ADDRESS 0x9FF436 /end MEASUREMENT
/begin MEASUREMENT FrmMng_rtrqInrEng_mp "Meßpunkt für Verhältnis inneres Motormoment / Maximalmoment" SWORD rTrqCAN 1 100 -12850.20 12849.81 FORMAT "%8.2" ECU_ADDRESS 0x9FF438 /end MEASUREMENT
/begin MEASUREMENT FrmMng_rtrqLimAWD_mp "Rohwert des Begrenzungsmoment des AWD Steuergerätes" SWORD rTrqCAN 1 100 -12850.20 12849.81 FORMAT "%8.2" ECU_ADDRESS 0x9FF43A /end MEASUREMENT
/begin MEASUREMENT FrmMng_rtrqLim_mp "Meßpunkt für Verhältnis Begrenzungsmoment / Maximalmoment" SWORD rTrqCAN 1 100 -12850.20 12849.81 FORMAT "%8.2" ECU_ADDRESS 0x9FF43C /end MEASUREMENT
/begin MEASUREMENT FrmMng_rtrqRelDrvDem_mp "Meßpunkt für Verhältnis relatives Fahrerwunschmoment / Maximalmoment" SWORD rTrqCAN 1 100 -12850.20 12849.81 FORMAT "%8.2" ECU_ADDRESS 0x9FF43E /end MEASUREMENT
/begin MEASUREMENT FrmMng_rtrqRmpACC_mp "Rampenwert für Moment bei ShortTOError(AUDI-ACCRX)" ULONG rRmpTrq 1 100 0.00 25700401.1460 FORMAT "%13.4" ECU_ADDRESS 0x9FE5B4 /end MEASUREMENT
/begin MEASUREMENT FrmMng_rtrqTCS_mp "Meßpunkt für Verhältnis ASR-Anforderungsmoment / Maximalmoment" SWORD rTrqCAN 1 100 -12850.20 12849.81 FORMAT "%8.2" ECU_ADDRESS 0x9FF440 /end MEASUREMENT
/begin MEASUREMENT FrmMng_rtrqTSC_mp "Meßpunkt für Verhältnis EGS-Anforderungsmoment / Maximalmoment" SWORD rTrqCAN 1 100 -12850.20 12849.81 FORMAT "%8.2" ECU_ADDRESS 0x9FF442 /end MEASUREMENT
/begin MEASUREMENT FrmMng_rtrqWheel_mp "Meßpunkt für Verhältnis Radmoment / Maximalmoment" SLONG rTrqCAN 1 100 -842150744.949 842150744.557 FORMAT "%13.3" ECU_ADDRESS 0x9FE5B8 /end MEASUREMENT
/begin MEASUREMENT FrmMng_rvLimAWD_mp "Rohwert der Höchstgeschwindigkeit" UBYTE OneToOne 1 100 0.00 255.0 FORMAT "%5.1" ECU_ADDRESS 0x9FFE9D /end MEASUREMENT
/begin MEASUREMENT FrmMng_stAC "Klimaanlagenzustand über CAN" UWORD OneToOne 1 100 0.00 65535.00 FORMAT "%8.2" ECU_ADDRESS 0x7F99B6 /end MEASUREMENT
/begin MEASUREMENT FrmMng_stACC "empfangener Zustand des ACC-SG" UBYTE OneToOne 1 100 0.00 255.0 FORMAT "%5.1" ECU_ADDRESS 0x7F93FC /end MEASUREMENT
/begin MEASUREMENT FrmMng_stACC1Ena_mp "Aktivierungsstatus der ACC1 Sendebotschaft" UBYTE OneToOne 1 100 0.00 255.0 FORMAT "%5.1" ECU_ADDRESS 0x9FFE9E /end MEASUREMENT
/begin MEASUREMENT FrmMng_stACCaccel "Status ACC-Gearshift" UBYTE OneToOne 1 100 0.00 255.0 FORMAT "%5.1" ECU_ADDRESS 0x7F9400 /end MEASUREMENT
/begin MEASUREMENT FrmMng_stACCBrk "empfangener Zustand des Bremsboosters" UBYTE OneToOne 1 100 0.00 255.0 FORMAT "%5.1" ECU_ADDRESS 0x7F93FD /end MEASUREMENT
/begin MEASUREMENT FrmMng_stACCInvalid "Status ob die CAN message ""ACC-System"" einmal korrekt empfangen wurde" UBYTE OneToOne 1 100 0.00 255.0 FORMAT "%5.1" ECU_ADDRESS 0x7F93FE /end MEASUREMENT
/begin MEASUREMENT FrmMng_stACCSndSel "Auswahl der in der ACC1 zu Versendenden Signale" UBYTE OneToOne 1 100 0.00 255.0 FORMAT "%5.1" ECU_ADDRESS 0x7F93FF /end MEASUREMENT
/begin MEASUREMENT FrmMng_stACCTrqbhvr_mp "Status des ACC Momenten - Verhaltens" UBYTE OneToOne 1 100 0.00 255.0 FORMAT "%5.1" ECU_ADDRESS 0x9FFE9F /end MEASUREMENT
/begin MEASUREMENT FrmMng_stAIRBG "Status von AIRBG" UWORD OneToOne 1 100 0.00 65535.00 FORMAT "%8.2" ECU_ADDRESS 0x7F99B8 /end MEASUREMENT
/begin MEASUREMENT FrmMng_stAIRBGTst "Status Airbagsteuergerät im Stellgliedtest" UBYTE OneToOne 1 100 0.00 255.0 FORMAT "%5.1" ECU_ADDRESS 0x7F9401 /end MEASUREMENT
/begin MEASUREMENT FrmMng_stAPPErr "Status von Fahrpedalwert ungenau" UBYTE OneToOne 1 100 0.00 255.0 FORMAT "%5.1" ECU_ADDRESS 0x7F9402 /end MEASUREMENT
/begin MEASUREMENT FrmMng_stAST "Status ASG-Eingriff" UWORD OneToOne 1 100 0.00 65535.00 FORMAT "%8.2" ECU_ADDRESS 0x7F99BA /end MEASUREMENT
/begin MEASUREMENT FrmMng_stAWD1 "Zustand des  Allrad" UBYTE OneToOne 1 100 0.00 255.0 FORMAT "%5.1" ECU_ADDRESS 0x7F9403 /end MEASUREMENT
/begin MEASUREMENT FrmMng_stBEMAOHt "Zustand der Zusatzheizung" UBYTE OneToOne 1 100 0.00 255.0 FORMAT "%5.1" ECU_ADDRESS 0x7F9404 /end MEASUREMENT
/begin MEASUREMENT FrmMng_stBEMB1_mp "Meßpunkt für Byte 1 in BEM" UBYTE OneToOne 1 100 0.00 255.0 FORMAT "%5.1" ECU_ADDRESS 0x9FFEA0 /end MEASUREMENT
/begin MEASUREMENT FrmMng_stBEMB2_mp "Meßpunkt für Byte 2 in BEM" UBYTE OneToOne 1 100 0.00 255.0 FORMAT "%5.1" ECU_ADDRESS 0x9FFEA1 /end MEASUREMENT
/begin MEASUREMENT FrmMng_stBEMB3_mp "Meßpunkt für Byte 3 in BEM" UBYTE OneToOne 1 100 0.00 255.0 FORMAT "%5.1" ECU_ADDRESS 0x9FFEA2 /end MEASUREMENT
/begin MEASUREMENT FrmMng_stBEMB4_mp "Meßpunkt für Byte 4 in BEM" UBYTE OneToOne 1 100 0.00 255.0 FORMAT "%5.1" ECU_ADDRESS 0x9FFEA3 /end MEASUREMENT
/begin MEASUREMENT FrmMng_stBEMB5_mp "Meßpunkt für Byte5 in BEM" UBYTE OneToOne 1 100 0.00 255.0 FORMAT "%5.1" ECU_ADDRESS 0x9FFEA4 /end MEASUREMENT
/begin MEASUREMENT FrmMng_stBEMB6_mp "Meßpunkt für Byte 6 in BEM" UBYTE OneToOne 1 100 0.00 255.0 FORMAT "%5.1" ECU_ADDRESS 0x9FFEA5 /end MEASUREMENT
/begin MEASUREMENT FrmMng_stBEMB7_mp "Meßpunkt für Byte 7 in BEM" UBYTE OneToOne 1 100 0.00 255.0 FORMAT "%5.1" ECU_ADDRESS 0x9FFEA6 /end MEASUREMENT
/begin MEASUREMENT FrmMng_stBEMB8_mp "Meßpunkt für Byte 8 in BEM" UBYTE OneToOne 1 100 0.00 255.0 FORMAT "%5.1" ECU_ADDRESS 0x9FFEA7 /end MEASUREMENT
/begin MEASUREMENT FrmMng_stBEMLIDem "Status der Leerlaufanhebung" UBYTE OneToOne 1 100 0.00 255.0 FORMAT "%5.1" ECU_ADDRESS 0x7F9405 /end MEASUREMENT
/begin MEASUREMENT FrmMng_stBrk "Bremsschalterinformation über CAN" UBYTE OneToOne 1 100 0.00 255.0 FORMAT "%5.1" ECU_ADDRESS 0x7F940A /end MEASUREMENT
/begin MEASUREMENT FrmMng_stBRK2Trnvrs "Querbeschleunigung gültig" UBYTE OneToOne 1 100 0.00 255.0 FORMAT "%5.1" ECU_ADDRESS 0x7F9406 /end MEASUREMENT
/begin MEASUREMENT FrmMng_stBRK8 "Bremsinformation von BRK8" UBYTE OneToOne 1 100 0.00 255.0 FORMAT "%5.1" ECU_ADDRESS 0x7F9407 /end MEASUREMENT
/begin MEASUREMENT FrmMng_stBRK8ACCMsg "Fehler bei CAN-Botschaft BRK8" UBYTE OneToOne 1 100 0.00 255.0 FORMAT "%5.1" ECU_ADDRESS 0x7F9408 /end MEASUREMENT
/begin MEASUREMENT FrmMng_stBrkAct "Status BAB,- FDR- und EDS - Eingriff" UBYTE OneToOne 1 100 0.00 255.0 FORMAT "%5.1" ECU_ADDRESS 0x7F940B /end MEASUREMENT
/begin MEASUREMENT FrmMng_stBSG3Err "TO Fehlerstatus für BSG" UBYTE OneToOne 1 100 0.00 255.0 FORMAT "%5.1" ECU_ADDRESS 0x7F9409 /end MEASUREMENT
/begin MEASUREMENT FrmMng_stCANVer "Versionsnummer des CAN- Layouts" UBYTE OneToOne 1 100 0.00 255.0 FORMAT "%5.1" ECU_ADDRESS 0x7F940C /end MEASUREMENT
/begin MEASUREMENT FrmMng_stCANVerCCtl "Versionnumber des CAN-Layouts für die CrCtl" UBYTE OneToOne 1 100 0.00 255.0 FORMAT "%5.1" ECU_ADDRESS 0x7F940D /end MEASUREMENT
/begin MEASUREMENT FrmMng_stChrgr1A_mp "Status des Fehlerflags vom Fehlerpfad Chrgr1A" UBYTE OneToOne 1 100 0.00 255.0 FORMAT "%5.1" ECU_ADDRESS 0x9FFE84 /end MEASUREMENT
/begin MEASUREMENT FrmMng_stChrgr1Err1 "Fehlerstatus 1 des Laders 1" UBYTE OneToOne 1 100 0.00 255.0 FORMAT "%5.1" ECU_ADDRESS 0x7F940E /end MEASUREMENT
/begin MEASUREMENT FrmMng_stChrgr1Err2 "Fehlerstatus 2 des Laders 1" UBYTE OneToOne 1 100 0.00 255.0 FORMAT "%5.1" ECU_ADDRESS 0x7F940F /end MEASUREMENT
/begin MEASUREMENT FrmMng_stChrgr1ExTemp1_mp "Anzeige für Fehlerbehandlung chrgr 1 Zustand 1 ist erfüllt" UBYTE OneToOne 1 100 0.00 255.0 FORMAT "%5.1" ECU_ADDRESS 0x9FFE79 /end MEASUREMENT
/begin MEASUREMENT FrmMng_stChrgr1ExTemp2_mp "Anzeige für Fehlerbehandlung chrgr 1 Zustand 2 ist erfüllt" UBYTE OneToOne 1 100 0.00 255.0 FORMAT "%5.1" ECU_ADDRESS 0x9FFE7A /end MEASUREMENT
/begin MEASUREMENT FrmMng_stChrgr1Strt_mp "Fehlerbehandlung Lader 1 nach Kaltstart ist erlaubt" UBYTE OneToOne 1 100 0.00 255.0 FORMAT "%5.1" ECU_ADDRESS 0x9FFE7B /end MEASUREMENT
/begin MEASUREMENT FrmMng_stChrgr1_Off_mp "Senden des Abschaltwertes für Lader 1 ist erlaubt" UBYTE OneToOne 1 100 0.00 255.0 FORMAT "%5.1" ECU_ADDRESS 0x9FFE85 /end MEASUREMENT
/begin MEASUREMENT FrmMng_stChrgr2A_mp "Status des Fehlerflags vom Fehlerpfad Chrgr2A" UBYTE OneToOne 1 100 0.00 255.0 FORMAT "%5.1" ECU_ADDRESS 0x9FFE86 /end MEASUREMENT
/begin MEASUREMENT FrmMng_stChrgr2Err1 "Fehlerstatus 1 des Laders 2" UBYTE OneToOne 1 100 0.00 255.0 FORMAT "%5.1" ECU_ADDRESS 0x7F9410 /end MEASUREMENT
/begin MEASUREMENT FrmMng_stChrgr2Err2 "Fehlerstatus 2 des Laders 2" UBYTE OneToOne 1 100 0.00 255.0 FORMAT "%5.1" ECU_ADDRESS 0x7F9411 /end MEASUREMENT
/begin MEASUREMENT FrmMng_stChrgr2ExTemp1_mp "Anzeige für Fehlerbehandlung chrgr 2 Zustand 1 ist erfüllt" UBYTE OneToOne 1 100 0.00 255.0 FORMAT "%5.1" ECU_ADDRESS 0x9FFE7C /end MEASUREMENT
/begin MEASUREMENT FrmMng_stChrgr2ExTemp2_mp "Anzeige für Fehlerbehandlung chrgr 2 Zustand 2 ist erfüllt" UBYTE OneToOne 1 100 0.00 255.0 FORMAT "%5.1" ECU_ADDRESS 0x9FFE7D /end MEASUREMENT
/begin MEASUREMENT FrmMng_stChrgr2Strt_mp "Fehlerbehandlung Lader 2 nach Kaltstart ist erlaubt" UBYTE OneToOne 1 100 0.00 255.0 FORMAT "%5.1" ECU_ADDRESS 0x9FFE7E /end MEASUREMENT
/begin MEASUREMENT FrmMng_stChrgr2_Off_mp "Senden des Abschaltwertes für Lader 2 ist erlaubt" UBYTE OneToOne 1 100 0.00 255.0 FORMAT "%5.1" ECU_ADDRESS 0x9FFE87 /end MEASUREMENT
/begin MEASUREMENT FrmMng_stChrgrPCRGovDevOff "Status für die Abschaltung der Erkennung auf Regelabweichung im PCR" UBYTE OneToOne 1 100 0.00 255.0 FORMAT "%5.1" ECU_ADDRESS 0x7F9412 /end MEASUREMENT
/begin MEASUREMENT FrmMng_stClgGearbx "Gestufte Kühlleistungsanhebung" UBYTE OneToOne 1 100 0.00 255.0 FORMAT "%5.1" ECU_ADDRESS 0x7F9413 /end MEASUREMENT
/begin MEASUREMENT FrmMng_stClg_mp "Meßpunkt des Status Kennfeldkühlung" UBYTE OneToOne 1 100 0.00 255.0 FORMAT "%5.1" ECU_ADDRESS 0x9FFEA8 /end MEASUREMENT
/begin MEASUREMENT FrmMng_stClthEPB "Clutch status" UBYTE OneToOne 1 100 0.00 255.0 FORMAT "%5.1" ECU_ADDRESS 0x7F9414 /end MEASUREMENT
/begin MEASUREMENT FrmMng_stConv "Kupplungszustand über CAN" UBYTE OneToOne 1 100 0.00 255.0 FORMAT "%5.1" ECU_ADDRESS 0x7F9415 /end MEASUREMENT
/begin MEASUREMENT FrmMng_stConvErr "Kupplungsfehlerzustand über CAN" UBYTE OneToOne 1 100 0.00 255.0 FORMAT "%5.1" ECU_ADDRESS 0x7F9416 /end MEASUREMENT
/begin MEASUREMENT FrmMng_stCrErr "GRA Fehlerzustand über CAN" UBYTE OneToOne 1 100 0.00 255.0 FORMAT "%5.1" ECU_ADDRESS 0x7F9417 /end MEASUREMENT
/begin MEASUREMENT FrmMng_stCrPan "GRA Bedienteilzustand über CAN" UWORD OneToOne 1 100 0.00 65535.00 FORMAT "%8.2" ECU_ADDRESS 0x7F99BC /end MEASUREMENT
/begin MEASUREMENT FrmMng_stCrshCrCtlDet "Status der Abbruch-Aufdeckung für FGR" UBYTE OneToOne 1 100 0.00 255.0 FORMAT "%5.1" ECU_ADDRESS 0x7F9418 /end MEASUREMENT
/begin MEASUREMENT FrmMng_stCrshDet "Status Airbagsteuergerät" UBYTE OneToOne 1 100 0.00 255.0 FORMAT "%5.1" ECU_ADDRESS 0x7F9419 /end MEASUREMENT
/begin MEASUREMENT FrmMng_stCrshSus "Status Airbagsteuergerät" UBYTE OneToOne 1 100 0.00 255.0 FORMAT "%5.1" ECU_ADDRESS 0x7F941A /end MEASUREMENT
/begin MEASUREMENT FrmMng_stCurInf "Status der aktuellen Motordrehzahlbeeinflussung" UBYTE OneToOne 1 100 0.00 255.0 FORMAT "%5.1" ECU_ADDRESS 0x7F941B /end MEASUREMENT
/begin MEASUREMENT FrmMng_stDCS "Status des MSR Momenteneingriffs" UWORD OneToOne 1 100 0.00 65535.00 FORMAT "%8.2" ECU_ADDRESS 0x7F99BE /end MEASUREMENT
/begin MEASUREMENT FrmMng_stDIA1Invalid "Zustand der Botschaft Diagnose1 (ob gültig oder nicht)" UBYTE OneToOne 1 100 0.00 255.0 FORMAT "%5.1" ECU_ADDRESS 0x7F941C /end MEASUREMENT
/begin MEASUREMENT FrmMng_stDIA1kmOld "Kilometerzustand (d.h. aktuell oder alt) der Diagnose1-Botschaf" UBYTE OneToOne 1 100 0.00 255.0 FORMAT "%5.1" ECU_ADDRESS 0x7F941E /end MEASUREMENT
/begin MEASUREMENT FrmMng_stDIA1TimeOld "Zeitzustand (d.h. aktuell oder alt) der Diagnose1-Botschaft" UBYTE OneToOne 1 100 0.00 255.0 FORMAT "%5.1" ECU_ADDRESS 0x7F941D /end MEASUREMENT
/begin MEASUREMENT FrmMng_stDSP3Invalid "Gültigkeit der Kombi3-Botschaft" UBYTE OneToOne 1 100 0.00 255.0 FORMAT "%5.1" ECU_ADDRESS 0x7F941F /end MEASUREMENT
/begin MEASUREMENT FrmMng_stDsplAccNpl "Status ACC Botschaft nicht konsistent" UBYTE OneToOne 1 100 0.00 255.0 FORMAT "%5.1" ECU_ADDRESS 0x7F9420 /end MEASUREMENT
/begin MEASUREMENT FrmMng_stDsplHighLine "Status High Line Kombi" UBYTE OneToOne 1 100 0.00 255.0 FORMAT "%5.1" ECU_ADDRESS 0x7F9421 /end MEASUREMENT
/begin MEASUREMENT FrmMng_stEGT "Regenerationsstatus für Getriebebotschaft" UBYTE OneToOne 1 100 0.00 255.0 FORMAT "%5.1" ECU_ADDRESS 0x7F9422 /end MEASUREMENT
/begin MEASUREMENT FrmMng_stEngActr_Ena_mp "Messpunkt Botschaft ENGACTR1 (Motor_Steller1) ist eingeschaltet" UBYTE OneToOne 1 100 0.00 255.0 FORMAT "%5.1" ECU_ADDRESS 0x9FFE88 /end MEASUREMENT
/begin MEASUREMENT FrmMng_stEngActr_Rst_mp "Messpunkt Senden des Restart-Wertes ist freigeschalten" UBYTE OneToOne 1 100 0.00 255.0 FORMAT "%5.1" ECU_ADDRESS 0x9FFE89 /end MEASUREMENT
/begin MEASUREMENT FrmMng_stEngBrkDem "Status der Bremsanforderung vom MSG" UBYTE OneToOne 1 100 0.00 255.0 FORMAT "%5.1" ECU_ADDRESS 0x7F9429 /end MEASUREMENT
/begin MEASUREMENT FrmMng_stEngFlxSync "Variable zum Synchronisieren der Motor Flexia" UBYTE OneToOne 1 100 0.00 255.0 FORMAT "%5.1" ECU_ADDRESS 0x7F942A /end MEASUREMENT
/begin MEASUREMENT FrmMng_stEngOff "Anforderung Motor aus" UBYTE OneToOne 1 100 0.00 255.0 FORMAT "%5.1" ECU_ADDRESS 0x7F942B /end MEASUREMENT
/begin MEASUREMENT FrmMng_stEngTrqErr "Statusbits von Momentenangabe ungenau" UBYTE OneToOne 1 100 0.00 255.0 FORMAT "%5.1" ECU_ADDRESS 0x7F942C /end MEASUREMENT
/begin MEASUREMENT FrmMng_stEPB "Schalter Info Parkbremse" UBYTE OneToOne 1 100 0.00 255.0 FORMAT "%5.1" ECU_ADDRESS 0x7F9423 /end MEASUREMENT
/begin MEASUREMENT FrmMng_stEPBAct "signal EPB zustend" UBYTE OneToOne 1 100 0.00 255.0 FORMAT "%5.1" ECU_ADDRESS 0x7F9424 /end MEASUREMENT
/begin MEASUREMENT FrmMng_stEPBActBRK8 "EPB signal from BRK8 frame" UBYTE OneToOne 1 100 0.00 255.0 FORMAT "%5.1" ECU_ADDRESS 0x7F9425 /end MEASUREMENT
/begin MEASUREMENT FrmMng_stEPBActEPB1 "EPB signal from EPB1 frame" UBYTE OneToOne 1 100 0.00 255.0 FORMAT "%5.1" ECU_ADDRESS 0x7F9426 /end MEASUREMENT
/begin MEASUREMENT FrmMng_stEPB_Err_mp "Fehlerstatus der Parkbremsen in der Botschaft EPB1" UBYTE OneToOne 1 100 0.00 255.0 FORMAT "%5.1" ECU_ADDRESS 0x9FFEA9 /end MEASUREMENT
/begin MEASUREMENT FrmMng_stESCU "Status Bordnetzspannungsteuergerät über CAN" SWORD OneToOne 1 100 -32768.00 32767.00 FORMAT "%8.2" ECU_ADDRESS 0x7F99C0 /end MEASUREMENT
/begin MEASUREMENT FrmMng_stESPDeActv "Status ESP deaktiviert" UBYTE OneToOne 1 100 0.00 255.0 FORMAT "%5.1" ECU_ADDRESS 0x7F9427 /end MEASUREMENT
/begin MEASUREMENT FrmMng_stESPSysErr "ESP Systemstatusfehler" UBYTE OneToOne 1 100 0.00 255.0 FORMAT "%5.1" ECU_ADDRESS 0x7F9428 /end MEASUREMENT
/begin MEASUREMENT FrmMng_stFanOn "Anforderung Kühlerlüfter einschalten" UBYTE OneToOne 1 100 0.00 255.0 FORMAT "%5.1" ECU_ADDRESS 0x7F942D /end MEASUREMENT
/begin MEASUREMENT FrmMng_stForceConv "Status der CAN Umrechnungsoptimierung" UBYTE OneToOne 1 100 0.00 255.0 FORMAT "%5.1" ECU_ADDRESS 0x7F942E /end MEASUREMENT
/begin MEASUREMENT FrmMng_stGapChngDspl_mp "Status des Kalibrierungszeit nach der SG-Initialisierung" UBYTE OneToOne 1 100 0.00 255.0 FORMAT "%5.1" ECU_ADDRESS 0x9FFEAA /end MEASUREMENT
/begin MEASUREMENT FrmMng_stGblCANErrAC1_mp "Zustand der CAN-Botschaft AC und Fehlerzustand vom CAN global." UBYTE OneToOne 1 100 0.00 255.0 FORMAT "%5.1" ECU_ADDRESS 0x9FFEAB /end MEASUREMENT
/begin MEASUREMENT FrmMng_stGblCANErrACC_mp "Zustand der CAN-Botschaft ACC und Fehlerzustand vom CAN global." UBYTE OneToOne 1 100 0.00 255.0 FORMAT "%5.1" ECU_ADDRESS 0x9FFEAC /end MEASUREMENT
/begin MEASUREMENT FrmMng_stGblCANErrAIRBG1_mp "Zustand der CAN-Botschaft AIRBG und Fehlerzustand vom CAN global." UBYTE OneToOne 1 100 0.00 255.0 FORMAT "%5.1" ECU_ADDRESS 0x9FFEAD /end MEASUREMENT
/begin MEASUREMENT FrmMng_stGblCANErrAWD1_mp "Zustand der CAN-Botschaft AWD und Fehlerzustand vom CAN global." UBYTE OneToOne 1 100 0.00 255.0 FORMAT "%5.1" ECU_ADDRESS 0x9FFEAE /end MEASUREMENT
/begin MEASUREMENT FrmMng_stGblCANErrBEM1_mp "Zustand der CAN-Botschaft BEM und Fehlerzustand vom CAN global." UBYTE OneToOne 1 100 0.00 255.0 FORMAT "%5.1" ECU_ADDRESS 0x9FFEAF /end MEASUREMENT
/begin MEASUREMENT FrmMng_stGblCANErrBRK1_mp "Zustand der CAN-Botschaft BRK1 und Fehlerzustand vom CAN global." UBYTE OneToOne 1 100 0.00 255.0 FORMAT "%5.1" ECU_ADDRESS 0x9FFEB0 /end MEASUREMENT
/begin MEASUREMENT FrmMng_stGblCANErrBRK2_mp "Zustand der CAN-Botschaft BRK2 und Fehlerzustand vom CAN global." UBYTE OneToOne 1 100 0.00 255.0 FORMAT "%5.1" ECU_ADDRESS 0x9FFEB1 /end MEASUREMENT
/begin MEASUREMENT FrmMng_stGblCANErrBRK8_mp "Zustand der CAN-Botschaft BRK8 und Fehlerzustand vom CAN global." UBYTE OneToOne 1 100 0.00 255.0 FORMAT "%5.1" ECU_ADDRESS 0x9FFEB2 /end MEASUREMENT
/begin MEASUREMENT FrmMng_stGblCANErrCCTL_mp "Zustand der CAN-Botschaft CCTL und Fehlerzustand vom CAN global." UBYTE OneToOne 1 100 0.00 255.0 FORMAT "%5.1" ECU_ADDRESS 0x9FFEB3 /end MEASUREMENT
/begin MEASUREMENT FrmMng_stGblCANErrCHRGR1_mp "Zustand der CAN-Botschaft CHRGR1 und Fehlerzustand vom CAN global." UBYTE OneToOne 1 100 0.00 255.0 FORMAT "%5.1" ECU_ADDRESS 0x9FFE7F /end MEASUREMENT
/begin MEASUREMENT FrmMng_stGblCANErrCHRGR2_mp "Zustand der CAN-Botschaft CHRGR2 und Fehlerzustand vom CAN global." UBYTE OneToOne 1 100 0.00 255.0 FORMAT "%5.1" ECU_ADDRESS 0x9FFE80 /end MEASUREMENT
/begin MEASUREMENT FrmMng_stGblCANErrDIA1_mp "Zustand der CAN-Botschaft DIA1 und Fehlerzustand vom CAN global." UBYTE OneToOne 1 100 0.00 255.0 FORMAT "%5.1" ECU_ADDRESS 0x9FFEB4 /end MEASUREMENT
/begin MEASUREMENT FrmMng_stGblCANErrDSP1_mp "Zustand der CAN-Botschaft DSP1 und Fehlerzustand vom CAN global." UBYTE OneToOne 1 100 0.00 255.0 FORMAT "%5.1" ECU_ADDRESS 0x9FFEB5 /end MEASUREMENT
/begin MEASUREMENT FrmMng_stGblCANErrDSP2_mp "Zustand der CAN-Botschaft DSP2 und Fehlerzustand vom CAN global." UBYTE OneToOne 1 100 0.00 255.0 FORMAT "%5.1" ECU_ADDRESS 0x9FFEB6 /end MEASUREMENT
/begin MEASUREMENT FrmMng_stGblCANErrDSP3_mp "Messpunkt fuer Funktions Identifier Fid_FrmMngDSP3TO" UBYTE OneToOne 1 100 0.00 255.0 FORMAT "%5.1" ECU_ADDRESS 0x9FFEB7 /end MEASUREMENT
/begin MEASUREMENT FrmMng_stGblCANErrEPB1_mp "Zustand der CAN-Botschaft EPB1 und Fehlerzustand vom CAN global." UBYTE OneToOne 1 100 0.00 255.0 FORMAT "%5.1" ECU_ADDRESS 0x9FFEB8 /end MEASUREMENT
/begin MEASUREMENT FrmMng_stGblCANErrESCU_mp "Zustand der CAN-Botschaft ESCU und Fehlerzustand vom CAN global." UBYTE OneToOne 1 100 0.00 255.0 FORMAT "%5.1" ECU_ADDRESS 0x9FFEB9 /end MEASUREMENT
/begin MEASUREMENT FrmMng_stGblCANErrGW1_mp "Zustand der CAN-Botschaft GW1 und Fehlerzustand vom CAN global." UBYTE OneToOne 1 100 0.00 255.0 FORMAT "%5.1" ECU_ADDRESS 0x9FFEBA /end MEASUREMENT
/begin MEASUREMENT FrmMng_stGblCANErrNIVEAU1_mp "Zustand der CAN-Botschaft NIVEAU1 und Fehlerzustand vom CAN global." UBYTE OneToOne 1 100 0.00 255.0 FORMAT "%5.1" ECU_ADDRESS 0x9FFEBB /end MEASUREMENT
/begin MEASUREMENT FrmMng_stGblCANErrSA1_mp "Zustand der CAN-Botschaft SA1 und Fehlerzustand vom CAN global" UBYTE OneToOne 1 100 0.00 255.0 FORMAT "%5.1" ECU_ADDRESS 0x9FFEBC /end MEASUREMENT
/begin MEASUREMENT FrmMng_stGblCANErrSTIGN_mp "Zustand der CAN-Botschaft STIGN und Fehlerzustand vom CAN global." UBYTE OneToOne 1 100 0.00 255.0 FORMAT "%5.1" ECU_ADDRESS 0x9FFEBD /end MEASUREMENT
/begin MEASUREMENT FrmMng_stGblCANErrTOS_mp "Zustand der CAN-Botschaft TOS und Fehlerzustand vom CAN global." UBYTE OneToOne 1 100 0.00 255.0 FORMAT "%5.1" ECU_ADDRESS 0x9FFEBE /end MEASUREMENT
/begin MEASUREMENT FrmMng_stGblCANErrTSC1_mp "Zustand der CAN-Botschaft TSC1 und Fehlerzustand vom CAN global." UBYTE OneToOne 1 100 0.00 255.0 FORMAT "%5.1" ECU_ADDRESS 0x9FFEBF /end MEASUREMENT
/begin MEASUREMENT FrmMng_stGblCANErrTSC2_mp "Zustand der CAN-Botschaft TSC2 und Fehlerzustand vom CAN global." UBYTE OneToOne 1 100 0.00 255.0 FORMAT "%5.1" ECU_ADDRESS 0x9FFEC0 /end MEASUREMENT
/begin MEASUREMENT FrmMng_stGblCANErrTSC3_mp "Zustand der CAN-Botschaft TSC3 und Fehlerzustand vom CAN global." UBYTE OneToOne 1 100 0.00 255.0 FORMAT "%5.1" ECU_ADDRESS 0x9FFEC1 /end MEASUREMENT
/begin MEASUREMENT FrmMng_stGblCANErrTSC6_mp "Zustand der CAN-Botschaft TSC6 und Fehlerzustand vom CAN global" UBYTE OneToOne 1 100 0.00 255.0 FORMAT "%5.1" ECU_ADDRESS 0x9FFEC2 /end MEASUREMENT
/begin MEASUREMENT FrmMng_stGear "Istganginformation vom CAN" UWORD OneToOne 1 100 0.00 65535.00 FORMAT "%8.2" ECU_ADDRESS 0x7F99C2 /end MEASUREMENT
/begin MEASUREMENT FrmMng_stGearLever "Status Wählhebelposition" UWORD OneToOne 1 100 0.00 65535.00 FORMAT "%8.2" ECU_ADDRESS 0x7F99C4 /end MEASUREMENT
/begin MEASUREMENT FrmMng_stGearReached "Information, wenn ""Zielgang erreicht""" UBYTE OneToOne 1 100 0.00 255.0 FORMAT "%5.1" ECU_ADDRESS 0x7F9432 /end MEASUREMENT
/begin MEASUREMENT FrmMng_stGearShifting "Information, daß Gangwechsel aktiv ist" UBYTE OneToOne 1 100 0.00 255.0 FORMAT "%5.1" ECU_ADDRESS 0x7F9433 /end MEASUREMENT
/begin MEASUREMENT FrmMng_stGW1 "Status für Stop-Lampe fehler,Botschaft Gateway1" UBYTE OneToOne 1 100 0.00 255.0 FORMAT "%5.1" ECU_ADDRESS 0x7F942F /end MEASUREMENT
/begin MEASUREMENT FrmMng_stGW1AAGErr_mp "Can-Fehlerstatusleiste Botschaft AAG" UBYTE OneToOne 1 100 0.00 255.0 FORMAT "%5.1" ECU_ADDRESS 0x9FFEC3 /end MEASUREMENT
/begin MEASUREMENT FrmMng_stGW1ILMErr_mp "Can-Fehlerstatusleiste Botschaft ILM" UBYTE OneToOne 1 100 0.00 255.0 FORMAT "%5.1" ECU_ADDRESS 0x9FFEC4 /end MEASUREMENT
/begin MEASUREMENT FrmMng_stGW1LICHT1Err_mp "Can-Fehlerstatusleiste Botschaft LICHT1" UBYTE OneToOne 1 100 0.00 255.0 FORMAT "%5.1" ECU_ADDRESS 0x9FFEC5 /end MEASUREMENT
/begin MEASUREMENT FrmMng_stGW1LICHT2Err_mp "Can-Fehlerstatusleiste Botschaft LICHT2" UBYTE OneToOne 1 100 0.00 255.0 FORMAT "%5.1" ECU_ADDRESS 0x9FFEC6 /end MEASUREMENT
/begin MEASUREMENT FrmMng_stGW1RevLght_mp "Status des Rückfahrlichtes" UBYTE OneToOne 1 100 0.00 255.0 FORMAT "%5.1" ECU_ADDRESS 0x9FFEC7 /end MEASUREMENT
/begin MEASUREMENT FrmMng_stGW1Wiper "Zustand der Windschutzscheibenwischer" UBYTE OneToOne 1 100 0.00 255.0 FORMAT "%5.1" ECU_ADDRESS 0x7F9430 /end MEASUREMENT
/begin MEASUREMENT FrmMng_stGW1WIPERErr_mp "Can-Fehlerstatusleiste Botschaft WIPER" UBYTE OneToOne 1 100 0.00 255.0 FORMAT "%5.1" ECU_ADDRESS 0x9FFEC8 /end MEASUREMENT
/begin MEASUREMENT FrmMng_stGWSlpAck "Sleep acknowledge Zustand der von GW - SG gesendet wird" UBYTE OneToOne 1 100 0.00 255.0 FORMAT "%5.1" ECU_ADDRESS 0x7F9431 /end MEASUREMENT
/begin MEASUREMENT FrmMng_stIgn "Zustände der Botschaft ZAS1 (STIGN)" UBYTE OneToOne 1 100 0.00 255.0 FORMAT "%5.1" ECU_ADDRESS 0x7F9434 /end MEASUREMENT
/begin MEASUREMENT FrmMng_stIgnLock "Status Klemme15 über CAN" UBYTE OneToOne 1 100 0.00 255.0 FORMAT "%5.1" ECU_ADDRESS 0x7F9435 /end MEASUREMENT
/begin MEASUREMENT FrmMng_stKombiTst "Kombi im Stellgliedtest" UBYTE OneToOne 1 100 0.00 255.0 FORMAT "%5.1" ECU_ADDRESS 0x7F9436 /end MEASUREMENT
/begin MEASUREMENT FrmMng_stLckCanRxMsg "Status welche Empfangsbotschaften gesperrt sind" ULONG OneToOne 1 100 0.00 4294967295.00 FORMAT "%13.2" ECU_ADDRESS 0x7F9E40 /end MEASUREMENT
/begin MEASUREMENT FrmMng_stLckCanTxMsg "Status welche Sendebotschaften gesperrt sind" UWORD OneToOne 1 100 0.00 65535.00 FORMAT "%8.2" ECU_ADDRESS 0x7F99C6 /end MEASUREMENT
/begin MEASUREMENT FrmMng_stLckCanUsrMsg "Status welche User - Messages gesperrt sind" UWORD OneToOne 1 100 0.00 65535.00 FORMAT "%8.2" ECU_ADDRESS 0x7F99C8 /end MEASUREMENT
/begin MEASUREMENT FrmMng_stLFRAdp "LFR Adaption" UBYTE OneToOne 1 100 0.00 255.0 FORMAT "%5.1" ECU_ADDRESS 0x7F9437 /end MEASUREMENT
/begin MEASUREMENT FrmMng_stMIL "Status MIL" UBYTE OneToOne 1 100 0.00 255.0 FORMAT "%5.1" ECU_ADDRESS 0x7F9438 /end MEASUREMENT
/begin MEASUREMENT FrmMng_stMsgErrAC1 "Fehlerstatus Botschaft AC1" UBYTE OneToOne 1 100 0.00 255.0 FORMAT "%5.1" ECU_ADDRESS 0x7F9439 /end MEASUREMENT
/begin MEASUREMENT FrmMng_stMsgErrACC "Fehlerstatus Botschaft ACC-System" UBYTE OneToOne 1 100 0.00 255.0 FORMAT "%5.1" ECU_ADDRESS 0x7F943A /end MEASUREMENT
/begin MEASUREMENT FrmMng_stMsgErrAIRBG "Fehlerstatus Botschaft AIRBG" UBYTE OneToOne 1 100 0.00 255.0 FORMAT "%5.1" ECU_ADDRESS 0x7F943B /end MEASUREMENT
/begin MEASUREMENT FrmMng_stMsgErrAWD1 "Errorstatus Allrad1" UBYTE OneToOne 1 100 0.00 255.0 FORMAT "%5.1" ECU_ADDRESS 0x7F943C /end MEASUREMENT
/begin MEASUREMENT FrmMng_stMsgErrBEM1 "Fehlerstatus für Botschaft BEM1" UBYTE OneToOne 1 100 0.00 255.0 FORMAT "%5.1" ECU_ADDRESS 0x7F943D /end MEASUREMENT
/begin MEASUREMENT FrmMng_stMsgErrBRK1 "Fehlerstatus Botschaft BRK1" UBYTE OneToOne 1 100 0.00 255.0 FORMAT "%5.1" ECU_ADDRESS 0x7F943E /end MEASUREMENT
/begin MEASUREMENT FrmMng_stMsgErrBRK2 "Status der CAN Botschaft - BRK2" UBYTE OneToOne 1 100 0.00 255.0 FORMAT "%5.1" ECU_ADDRESS 0x7F943F /end MEASUREMENT
/begin MEASUREMENT FrmMng_stMsgErrBRK8 "Fehlerstatus Botschaft BRK8" UBYTE OneToOne 1 100 0.00 255.0 FORMAT "%5.1" ECU_ADDRESS 0x7F9440 /end MEASUREMENT
/begin MEASUREMENT FrmMng_stMsgErrCCTL "Fehlerstatus Botschaft CCTL" UBYTE OneToOne 1 100 0.00 255.0 FORMAT "%5.1" ECU_ADDRESS 0x7F9441 /end MEASUREMENT
/begin MEASUREMENT FrmMng_stMsgErrChrgr1 "Fehlerstatus Botschaft CHRGR1" UBYTE OneToOne 1 100 0.00 255.0 FORMAT "%5.1" ECU_ADDRESS 0x7F9442 /end MEASUREMENT
/begin MEASUREMENT FrmMng_stMsgErrChrgr2 "Fehlerstatus Botschaft CHRGR2" UBYTE OneToOne 1 100 0.00 255.0 FORMAT "%5.1" ECU_ADDRESS 0x7F9443 /end MEASUREMENT
/begin MEASUREMENT FrmMng_stMsgErrDIA1 "Fehlerstatus für Botschaft DIA1" UBYTE OneToOne 1 100 0.00 255.0 FORMAT "%5.1" ECU_ADDRESS 0x7F9444 /end MEASUREMENT
/begin MEASUREMENT FrmMng_stMsgErrDSP1 "Fehlerstatus Botsschaft DSP1" UBYTE OneToOne 1 100 0.00 255.0 FORMAT "%5.1" ECU_ADDRESS 0x7F9445 /end MEASUREMENT
/begin MEASUREMENT FrmMng_stMsgErrDSP2 "Fehlerstatus Botschaft DSP2" UBYTE OneToOne 1 100 0.00 255.0 FORMAT "%5.1" ECU_ADDRESS 0x7F9446 /end MEASUREMENT
/begin MEASUREMENT FrmMng_stMsgErrDSP3 "Fehlerstatus Botschaft DSP3" UBYTE OneToOne 1 100 0.00 255.0 FORMAT "%5.1" ECU_ADDRESS 0x7F9447 /end MEASUREMENT
/begin MEASUREMENT FrmMng_stMsgErrEPB1 "CAN-Fehlerstatusleiste EPB1 - Botschaft" UBYTE OneToOne 1 100 0.00 255.0 FORMAT "%5.1" ECU_ADDRESS 0x7F9448 /end MEASUREMENT
/begin MEASUREMENT FrmMng_stMsgErrESCU "Fehlerstatus Botschaft ESCU" UBYTE OneToOne 1 100 0.00 255.0 FORMAT "%5.1" ECU_ADDRESS 0x7F9449 /end MEASUREMENT
/begin MEASUREMENT FrmMng_stMsgErrGW1 "Fehlerstatus für Botschaft GW1" UBYTE OneToOne 1 100 0.00 255.0 FORMAT "%5.1" ECU_ADDRESS 0x7F944A /end MEASUREMENT
/begin MEASUREMENT FrmMng_stMsgErrNIVEAU1 "Fehlerstatus Botschaft NIVEAU1" UBYTE OneToOne 1 100 0.00 255.0 FORMAT "%5.1" ECU_ADDRESS 0x7F944B /end MEASUREMENT
/begin MEASUREMENT FrmMng_stMsgErrSA1 "Fehlerstatus Botschaft SA1" UBYTE OneToOne 1 100 0.00 255.0 FORMAT "%5.1" ECU_ADDRESS 0x7F944C /end MEASUREMENT
/begin MEASUREMENT FrmMng_stMsgErrStIgn "Fehlerstatus Botschaft ZAS1 (STIGN)" UBYTE OneToOne 1 100 0.00 255.0 FORMAT "%5.1" ECU_ADDRESS 0x7F944D /end MEASUREMENT
/begin MEASUREMENT FrmMng_stMsgErrTOS "Fehlerstatus für Botschaft TOG" UBYTE OneToOne 1 100 0.00 255.0 FORMAT "%5.1" ECU_ADDRESS 0x7F944E /end MEASUREMENT
/begin MEASUREMENT FrmMng_stMsgErrTSC1 "Fehlerstatus Botschaft TSC1" UBYTE OneToOne 1 100 0.00 255.0 FORMAT "%5.1" ECU_ADDRESS 0x7F944F /end MEASUREMENT
/begin MEASUREMENT FrmMng_stMsgErrTSC2 "Fehlerstatus Botschaft TSC2" UBYTE OneToOne 1 100 0.00 255.0 FORMAT "%5.1" ECU_ADDRESS 0x7F9450 /end MEASUREMENT
/begin MEASUREMENT FrmMng_stMsgErrTSC3 "Fehlerstatus Botschaft TSC3" UBYTE OneToOne 1 100 0.00 255.0 FORMAT "%5.1" ECU_ADDRESS 0x7F9451 /end MEASUREMENT
/begin MEASUREMENT FrmMng_stMsgErrTSC6 "Fehlerstatus Botschaft TSC6" UBYTE OneToOne 1 100 0.00 255.0 FORMAT "%5.1" ECU_ADDRESS 0x7F9452 /end MEASUREMENT
/begin MEASUREMENT FrmMng_stMsgMSnSetpGov "Fehlerstatus von frmmng_rxtgovms und frmmng_txtgovms Prozeß" UBYTE OneToOne 1 100 0.00 255.0 FORMAT "%5.1" ECU_ADDRESS 0x7F9454 /end MEASUREMENT
/begin MEASUREMENT FrmMng_stNIVEAU1 "Status Niveausteuergerät" UBYTE OneToOne 1 100 0.00 255.0 FORMAT "%5.1" ECU_ADDRESS 0x7F9455 /end MEASUREMENT
/begin MEASUREMENT FrmMng_stNoTORxMsg "Timeout Status von allen CAN Empfangs Botschaften; 1=Botschaft wird korrekt empfangen; 0=Botschaft wird nicht empfangen" ULONG OneToOne 1 100 0.00 4294967295.00 FORMAT "%13.2" ECU_ADDRESS 0x7F9E44 /end MEASUREMENT
/begin MEASUREMENT FrmMng_stNoTOUsrMsg "Timeout Status von allen CAN User Botschaften; 1=Botschaft wird korrekt empfangen; 0=Botschaft wird nicht empfangen" UWORD OneToOne 1 100 0.00 65535.00 FORMAT "%8.2" ECU_ADDRESS 0x7F99CA /end MEASUREMENT
/begin MEASUREMENT FrmMng_stNumTOOvrFlowECU "Message Array welches enthält, wieviele Timeout Überläufe pro Steuergerät aufgetreten sind" UBYTE OneToOne 1 100 0.00 255.0 FORMAT "%5.1" ARRAY_SIZE 32 ECU_ADDRESS 0x7FA036 /end MEASUREMENT
/begin MEASUREMENT FrmMng_stOilWrnThres "Status des Öltemperatur - Sensors / Ölwarnschwelle" UBYTE OneToOne 1 100 0.00 255.0 FORMAT "%5.1" ECU_ADDRESS 0x7F9456 /end MEASUREMENT
/begin MEASUREMENT FrmMng_stOvrRunCut "Status ACC Schub" UBYTE OneToOne 1 100 0.00 255.0 FORMAT "%5.1" ECU_ADDRESS 0x7F9457 /end MEASUREMENT
/begin MEASUREMENT FrmMng_stPlsPanErr_mp "Status Plausibilitätsfehler Bedienteil" UWORD OneToOne 1 100 0.00 65535.00 FORMAT "%8.2" ECU_ADDRESS 0x9FF444 /end MEASUREMENT
/begin MEASUREMENT FrmMng_stPreGlwLamp "Status Vorglühlampe" UBYTE OneToOne 1 100 0.00 255.0 FORMAT "%5.1" ECU_ADDRESS 0x7F9458 /end MEASUREMENT
/begin MEASUREMENT FrmMng_stRevGear "Rückwärtsgang" UBYTE OneToOne 1 100 0.00 255.0 FORMAT "%5.1" ECU_ADDRESS 0x7F9459 /end MEASUREMENT
/begin MEASUREMENT FrmMng_stSAEcu "aktueller Status Lenkwinkel Steuergerät" UBYTE OneToOne 1 100 0.00 255.0 FORMAT "%5.1" ECU_ADDRESS 0x7F945A /end MEASUREMENT
/begin MEASUREMENT FrmMng_stSendACC "StatusACC-Typ (0:Ini,1:AudiTX,2AudiRX,3:VWRX,4:Ungültiger Typ)" UBYTE OneToOne 1 100 0.00 255.0 FORMAT "%5.1" ECU_ADDRESS 0x7F945B /end MEASUREMENT
/begin MEASUREMENT FrmMng_stSendEng6_B1 "Message für Byte 1 in ENG6 (nur für Bypass)" UBYTE OneToOne 1 100 0.00 255.0 FORMAT "%5.1" ECU_ADDRESS 0x7F945C /end MEASUREMENT
/begin MEASUREMENT FrmMng_stSendEng6_B1Byp_mp "Meßpunkt für Bypass message" UBYTE OneToOne 1 100 0.00 255.0 FORMAT "%5.1" ECU_ADDRESS 0x9FFEC9 /end MEASUREMENT
/begin MEASUREMENT FrmMng_stSendEng6_B2 "Message für Byte 2 in ENG6 (nur für Bypass)" UBYTE OneToOne 1 100 0.00 255.0 FORMAT "%5.1" ECU_ADDRESS 0x7F945D /end MEASUREMENT
/begin MEASUREMENT FrmMng_stSendEng6_B2Byp_mp "Meßpunkt für Bypass Freischnitt" UBYTE OneToOne 1 100 0.00 255.0 FORMAT "%5.1" ECU_ADDRESS 0x9FFECA /end MEASUREMENT
/begin MEASUREMENT FrmMng_stSendEng6_B3 "Message für Byte 3 in ENG6 (nur für Bypass)" UBYTE OneToOne 1 100 0.00 255.0 FORMAT "%5.1" ECU_ADDRESS 0x7F945E /end MEASUREMENT
/begin MEASUREMENT FrmMng_stSendEng6_B3Byp_mp "Meßpunkt für Bypass Freischnitt" UBYTE OneToOne 1 100 0.00 255.0 FORMAT "%5.1" ECU_ADDRESS 0x9FFECB /end MEASUREMENT
/begin MEASUREMENT FrmMng_stSendEng6_B4 "Message für Byte 4 in ENG6 (nur für Bypass)" UBYTE OneToOne 1 100 0.00 255.0 FORMAT "%5.1" ECU_ADDRESS 0x7F945F /end MEASUREMENT
/begin MEASUREMENT FrmMng_stSendEng6_B4Byp_mp "Meßpunkt für Bypass Freischnitt" UBYTE OneToOne 1 100 0.00 255.0 FORMAT "%5.1" ECU_ADDRESS 0x9FFECC /end MEASUREMENT
/begin MEASUREMENT FrmMng_stSendEng6_B5 "Message für Byte 5 in ENG6 (nur für Bypass)" UBYTE OneToOne 1 100 0.00 255.0 FORMAT "%5.1" ECU_ADDRESS 0x7F9460 /end MEASUREMENT
/begin MEASUREMENT FrmMng_stSendEng6_B5Byp_mp "Meßpunkt für Bypass Freischnitt" UBYTE OneToOne 1 100 0.00 255.0 FORMAT "%5.1" ECU_ADDRESS 0x9FFECD /end MEASUREMENT
/begin MEASUREMENT FrmMng_stSendEng6_B6 "Message für Byte 6 in ENG6 (nur für Bypass)" UBYTE OneToOne 1 100 0.00 255.0 FORMAT "%5.1" ECU_ADDRESS 0x7F9461 /end MEASUREMENT
/begin MEASUREMENT FrmMng_stSendEng6_B6Byp_mp "Meßpunkt für Bypass Freischnitt" UBYTE OneToOne 1 100 0.00 255.0 FORMAT "%5.1" ECU_ADDRESS 0x9FFECE /end MEASUREMENT
/begin MEASUREMENT FrmMng_stSendEng6_B7 "Message für Byte 7 in ENG6 (nur für Bypass)" UBYTE OneToOne 1 100 0.00 255.0 FORMAT "%5.1" ECU_ADDRESS 0x7F9462 /end MEASUREMENT
/begin MEASUREMENT FrmMng_stSendEng6_B7Byp_mp "Meßpunkt für Bypass Freischnitt" UBYTE OneToOne 1 100 0.00 255.0 FORMAT "%5.1" ECU_ADDRESS 0x9FFECF /end MEASUREMENT
/begin MEASUREMENT FrmMng_stSendEng6_B8 "Message für Byte 8 in ENG6 (nur für Bypass)" UBYTE OneToOne 1 100 0.00 255.0 FORMAT "%5.1" ECU_ADDRESS 0x7F9463 /end MEASUREMENT
/begin MEASUREMENT FrmMng_stSendEng6_B8Byp_mp "Meßpunkt für Bypass Freischnitt" UBYTE OneToOne 1 100 0.00 255.0 FORMAT "%5.1" ECU_ADDRESS 0x9FFED0 /end MEASUREMENT
/begin MEASUREMENT FrmMng_stSendEngTrq1_B1 "Message für Byte 1 in ENGTRQ1 (nur für Bypass)" UBYTE OneToOne 1 100 0.00 255.0 FORMAT "%5.1" ECU_ADDRESS 0x7F9464 /end MEASUREMENT
/begin MEASUREMENT FrmMng_stSendEngTrq1_B1Byp_mp "Meßpunkt für Bypass Freischnitt" UBYTE OneToOne 1 100 0.00 255.0 FORMAT "%5.1" ECU_ADDRESS 0x9FFED1 /end MEASUREMENT
/begin MEASUREMENT FrmMng_stSendEngTrq1_B2 "Message für Byte 2 in ENGTRQ1 (nur für Bypass)" UBYTE OneToOne 1 100 0.00 255.0 FORMAT "%5.1" ECU_ADDRESS 0x7F9465 /end MEASUREMENT
/begin MEASUREMENT FrmMng_stSendEngTrq1_B2Byp_mp "Meßpunkt für Bypass Freischnitt" UBYTE OneToOne 1 100 0.00 255.0 FORMAT "%5.1" ECU_ADDRESS 0x9FFED2 /end MEASUREMENT
/begin MEASUREMENT FrmMng_stSendEngTrq1_B3 "Message für Byte 3 in ENGTRQ1 (nur für Bypass)" UBYTE OneToOne 1 100 0.00 255.0 FORMAT "%5.1" ECU_ADDRESS 0x7F9466 /end MEASUREMENT
/begin MEASUREMENT FrmMng_stSendEngTrq1_B3Byp_mp "Meßpunkt für Bypass Freischnitt" UBYTE OneToOne 1 100 0.00 255.0 FORMAT "%5.1" ECU_ADDRESS 0x9FFED3 /end MEASUREMENT
/begin MEASUREMENT FrmMng_stSendEngTrq1_B4 "Message für Byte 4 in ENGTRQ1 (nur für Bypass)" UBYTE OneToOne 1 100 0.00 255.0 FORMAT "%5.1" ECU_ADDRESS 0x7F9467 /end MEASUREMENT
/begin MEASUREMENT FrmMng_stSendEngTrq1_B4Byp_mp "Meßpunkt für Bypass Freischnitt" UBYTE OneToOne 1 100 0.00 255.0 FORMAT "%5.1" ECU_ADDRESS 0x9FFED4 /end MEASUREMENT
/begin MEASUREMENT FrmMng_stSendEngTrq1_B5 "Message für Byte 5 in ENGTRQ1 (nur für Bypass)" UBYTE OneToOne 1 100 0.00 255.0 FORMAT "%5.1" ECU_ADDRESS 0x7F9468 /end MEASUREMENT
/begin MEASUREMENT FrmMng_stSendEngTrq1_B5Byp_mp "Meßpunkt für Bypass Freischnitt" UBYTE OneToOne 1 100 0.00 255.0 FORMAT "%5.1" ECU_ADDRESS 0x9FFED5 /end MEASUREMENT
/begin MEASUREMENT FrmMng_stSendEngTrq1_B6 "Message für Byte 6 in ENGTRQ1 (nur für Bypass)" UBYTE OneToOne 1 100 0.00 255.0 FORMAT "%5.1" ECU_ADDRESS 0x7F9469 /end MEASUREMENT
/begin MEASUREMENT FrmMng_stSendEngTrq1_B6Byp_mp "Meßpunkt für Bypass Freischnitt" UBYTE OneToOne 1 100 0.00 255.0 FORMAT "%5.1" ECU_ADDRESS 0x9FFED6 /end MEASUREMENT
/begin MEASUREMENT FrmMng_stSendEngTrq1_B7 "Message für Byte 7 in ENGTRQ1 (nur für Bypass)" UBYTE OneToOne 1 100 0.00 255.0 FORMAT "%5.1" ECU_ADDRESS 0x7F946A /end MEASUREMENT
/begin MEASUREMENT FrmMng_stSendEngTrq1_B7Byp_mp "Meßpunkt für Bypass Freischnitt" UBYTE OneToOne 1 100 0.00 255.0 FORMAT "%5.1" ECU_ADDRESS 0x9FFED7 /end MEASUREMENT
/begin MEASUREMENT FrmMng_stSendEngTrq1_B8 "Message für Byte 8 in ENGTRQ1 (nur für Bypass)" UBYTE OneToOne 1 100 0.00 255.0 FORMAT "%5.1" ECU_ADDRESS 0x7F946B /end MEASUREMENT
/begin MEASUREMENT FrmMng_stSendEngTrq1_B8Byp_mp "Meßpunkt für Bypass Freischnitt" UBYTE OneToOne 1 100 0.00 255.0 FORMAT "%5.1" ECU_ADDRESS 0x9FFED8 /end MEASUREMENT
/begin MEASUREMENT FrmMng_stSendEngTrq2_B1 "Message für Byte 1 in ENGTRQ2 (nur für Bypass)" UBYTE OneToOne 1 100 0.00 255.0 FORMAT "%5.1" ECU_ADDRESS 0x7F946C /end MEASUREMENT
/begin MEASUREMENT FrmMng_stSendEngTrq2_B1Byp_mp "Meßpunkt für Bypass Freischnitt" UBYTE OneToOne 1 100 0.00 255.0 FORMAT "%5.1" ECU_ADDRESS 0x9FFED9 /end MEASUREMENT
/begin MEASUREMENT FrmMng_stSendEngTrq2_B2 "Message für Byte 2 in ENGTRQ2 (nur für Bypass)" UBYTE OneToOne 1 100 0.00 255.0 FORMAT "%5.1" ECU_ADDRESS 0x7F946D /end MEASUREMENT
/begin MEASUREMENT FrmMng_stSendEngTrq2_B2Byp_mp "Meßpunkt für Bypass Freischnitt" UBYTE OneToOne 1 100 0.00 255.0 FORMAT "%5.1" ECU_ADDRESS 0x9FFEDA /end MEASUREMENT
/begin MEASUREMENT FrmMng_stSendEngTrq2_B3 "Message für Byte 3 in ENGTRQ2 (nur für Bypass)" UBYTE OneToOne 1 100 0.00 255.0 FORMAT "%5.1" ECU_ADDRESS 0x7F946E /end MEASUREMENT
/begin MEASUREMENT FrmMng_stSendEngTrq2_B3Byp_mp "Meßpunkt für Bypass Freischnitt" UBYTE OneToOne 1 100 0.00 255.0 FORMAT "%5.1" ECU_ADDRESS 0x9FFEDB /end MEASUREMENT
/begin MEASUREMENT FrmMng_stSendEngTrq2_B4 "Message für Byte 4 in ENGTRQ2 (nur für Bypass)" UBYTE OneToOne 1 100 0.00 255.0 FORMAT "%5.1" ECU_ADDRESS 0x7F946F /end MEASUREMENT
/begin MEASUREMENT FrmMng_stSendEngTrq2_B4Byp_mp "Meßpunkt für Bypass message" UBYTE OneToOne 1 100 0.00 255.0 FORMAT "%5.1" ECU_ADDRESS 0x9FFEDC /end MEASUREMENT
/begin MEASUREMENT FrmMng_stSendEngTrq2_B5 "Message für Byte 5 in ENGTRQ2 (nur für Bypass)" UBYTE OneToOne 1 100 0.00 255.0 FORMAT "%5.1" ECU_ADDRESS 0x7F9470 /end MEASUREMENT
/begin MEASUREMENT FrmMng_stSendEngTrq2_B5Byp_mp "Meßpunkt für Bypass Freischnitt" UBYTE OneToOne 1 100 0.00 255.0 FORMAT "%5.1" ECU_ADDRESS 0x9FFEDD /end MEASUREMENT
/begin MEASUREMENT FrmMng_stSendEngTrq2_B6 "Message für Byte 6 in ENGTRQ2 (nur für Bypass)" UBYTE OneToOne 1 100 0.00 255.0 FORMAT "%5.1" ECU_ADDRESS 0x7F9471 /end MEASUREMENT
/begin MEASUREMENT FrmMng_stSendEngTrq2_B6Byp_mp "Meßpunkt für Bypass Freischnitt" UBYTE OneToOne 1 100 0.00 255.0 FORMAT "%5.1" ECU_ADDRESS 0x9FFEDE /end MEASUREMENT
/begin MEASUREMENT FrmMng_stSendEngTrq2_B7 "Message für Byte 7 in ENGTRQ2 (nur für Bypass)" UBYTE OneToOne 1 100 0.00 255.0 FORMAT "%5.1" ECU_ADDRESS 0x7F9472 /end MEASUREMENT
/begin MEASUREMENT FrmMng_stSendEngTrq2_B7Byp_mp "Meßpunkt für Bypass Freischnitt" UBYTE OneToOne 1 100 0.00 255.0 FORMAT "%5.1" ECU_ADDRESS 0x9FFEDF /end MEASUREMENT
/begin MEASUREMENT FrmMng_stSendEngTrq2_B8 "Message für Byte 8 in ENGTRQ2 (nur für Bypass)" UBYTE OneToOne 1 100 0.00 255.0 FORMAT "%5.1" ECU_ADDRESS 0x7F9473 /end MEASUREMENT
/begin MEASUREMENT FrmMng_stSendEngTrq2_B8Byp_mp "Meßpunkt für Bypass Freischnitt" UBYTE OneToOne 1 100 0.00 255.0 FORMAT "%5.1" ECU_ADDRESS 0x9FFEE0 /end MEASUREMENT
/begin MEASUREMENT FrmMng_stSendEngTrq3_B1 "Message für Byte 1 in ENGTRQ3 (nur für Bypass)" UBYTE OneToOne 1 100 0.00 255.0 FORMAT "%5.1" ECU_ADDRESS 0x7F9474 /end MEASUREMENT
/begin MEASUREMENT FrmMng_stSendEngTrq3_B1Byp_mp "Meßpunkt für Bypass Freischnitt" UBYTE OneToOne 1 100 0.00 255.0 FORMAT "%5.1" ECU_ADDRESS 0x9FFEE1 /end MEASUREMENT
/begin MEASUREMENT FrmMng_stSendEngTrq3_B2 "Message für Byte 2 in ENGTRQ3 (nur für Bypass)" UBYTE OneToOne 1 100 0.00 255.0 FORMAT "%5.1" ECU_ADDRESS 0x7F9475 /end MEASUREMENT
/begin MEASUREMENT FrmMng_stSendEngTrq3_B2Byp_mp "Meßpunkt für Bypass Freischnitt" UBYTE OneToOne 1 100 0.00 255.0 FORMAT "%5.1" ECU_ADDRESS 0x9FFEE2 /end MEASUREMENT
/begin MEASUREMENT FrmMng_stSendEngTrq3_B3 "Message für Byte 3 in ENGTRQ3 (nur für Bypass)" UBYTE OneToOne 1 100 0.00 255.0 FORMAT "%5.1" ECU_ADDRESS 0x7F9476 /end MEASUREMENT
/begin MEASUREMENT FrmMng_stSendEngTrq3_B3Byp_mp "Meßpunkt für Bypass Freischnitt" UBYTE OneToOne 1 100 0.00 255.0 FORMAT "%5.1" ECU_ADDRESS 0x9FFEE3 /end MEASUREMENT
/begin MEASUREMENT FrmMng_stSendEngTrq3_B4 "Message für Byte 4 in ENGTRQ3 (nur für Bypass)" UBYTE OneToOne 1 100 0.00 255.0 FORMAT "%5.1" ECU_ADDRESS 0x7F9477 /end MEASUREMENT
/begin MEASUREMENT FrmMng_stSendEngTrq3_B4Byp_mp "Meßpunkt für Bypass Freischnitt" UBYTE OneToOne 1 100 0.00 255.0 FORMAT "%5.1" ECU_ADDRESS 0x9FFEE4 /end MEASUREMENT
/begin MEASUREMENT FrmMng_stSendEngTrq3_B5 "Message für Byte 5 in ENGTRQ3 (nur für Bypass)" UBYTE OneToOne 1 100 0.00 255.0 FORMAT "%5.1" ECU_ADDRESS 0x7F9478 /end MEASUREMENT
/begin MEASUREMENT FrmMng_stSendEngTrq3_B5Byp_mp "Meßpunkt für Bypass Freischnitt" UBYTE OneToOne 1 100 0.00 255.0 FORMAT "%5.1" ECU_ADDRESS 0x9FFEE5 /end MEASUREMENT
/begin MEASUREMENT FrmMng_stSendEngTrq3_B6 "Message für Byte 6 in ENGTRQ3 (nur für Bypass)" UBYTE OneToOne 1 100 0.00 255.0 FORMAT "%5.1" ECU_ADDRESS 0x7F9479 /end MEASUREMENT
/begin MEASUREMENT FrmMng_stSendEngTrq3_B6Byp_mp "Meßpunkt für Bypass Freischnitt" UBYTE OneToOne 1 100 0.00 255.0 FORMAT "%5.1" ECU_ADDRESS 0x9FFEE6 /end MEASUREMENT
/begin MEASUREMENT FrmMng_stSendEngTrq3_B7 "Message für Byte 7 in ENGTRQ3 (nur für Bypass)" UBYTE OneToOne 1 100 0.00 255.0 FORMAT "%5.1" ECU_ADDRESS 0x7F947A /end MEASUREMENT
/begin MEASUREMENT FrmMng_stSendEngTrq3_B7Byp_mp "Meßpunkt für Bypass Freischnitt" UBYTE OneToOne 1 100 0.00 255.0 FORMAT "%5.1" ECU_ADDRESS 0x9FFEE7 /end MEASUREMENT
/begin MEASUREMENT FrmMng_stSendEngTrq3_B8 "Message für Byte 8 in ENGTRQ3 (nur für Bypass)" UBYTE OneToOne 1 100 0.00 255.0 FORMAT "%5.1" ECU_ADDRESS 0x7F947B /end MEASUREMENT
/begin MEASUREMENT FrmMng_stSendEngTrq3_B8Byp_mp "Meßpunkt für Bypass Freischnitt" UBYTE OneToOne 1 100 0.00 255.0 FORMAT "%5.1" ECU_ADDRESS 0x9FFEE8 /end MEASUREMENT
/begin MEASUREMENT FrmMng_stSpdLim "Geschwindigkeitsbegrenzung status für GRA" UBYTE OneToOne 1 100 0.00 255.0 FORMAT "%5.1" ECU_ADDRESS 0x7F947C /end MEASUREMENT
/begin MEASUREMENT FrmMng_stSvLpErr "Bitcodierte Messae für Fehlerstatus TOS-Signale" UBYTE OneToOne 1 100 0.00 255.0 FORMAT "%5.1" ECU_ADDRESS 0x7F947D /end MEASUREMENT
/begin MEASUREMENT FrmMng_stTClnt "Status der Wassertemperatur über CAN" UBYTE OneToOne 1 100 0.00 255.0 FORMAT "%5.1" ECU_ADDRESS 0x7F947E /end MEASUREMENT
/begin MEASUREMENT FrmMng_stTCS "Status des ASR Momenteneingriffs" UWORD OneToOne 1 100 0.00 65535.00 FORMAT "%8.2" ECU_ADDRESS 0x7F99CC /end MEASUREMENT
/begin MEASUREMENT FrmMng_stTEnv "Status der Umgebungstemperatur über CAN" UBYTE OneToOne 1 100 0.00 255.0 FORMAT "%5.1" ECU_ADDRESS 0x7F947F /end MEASUREMENT
/begin MEASUREMENT FrmMng_stTOil "Status der Öltemperatur über CAN" UBYTE OneToOne 1 100 0.00 255.0 FORMAT "%5.1" ECU_ADDRESS 0x7F9481 /end MEASUREMENT
/begin MEASUREMENT FrmMng_stTOSSensErr "Status des TOS - Sensor-Errors" UBYTE OneToOne 1 100 0.00 255.0 FORMAT "%5.1" ECU_ADDRESS 0x7F9480 /end MEASUREMENT
/begin MEASUREMENT FrmMng_stTrqLimAct_mp "Meßpunkt für das Bit S_NPRI der Motor3 Botschaft" UBYTE OneToOne 1 100 0.00 255.0 FORMAT "%5.1" ECU_ADDRESS 0x9FFEE9 /end MEASUREMENT
/begin MEASUREMENT FrmMng_stTSC "Status EGS-Eingriff" UWORD OneToOne 1 100 0.00 65535.00 FORMAT "%8.2" ECU_ADDRESS 0x7F99CE /end MEASUREMENT
/begin MEASUREMENT FrmMng_stTSC3 "Status Sollmoment - TSC3 / Status Dynamischer Eingriff" UBYTE OneToOne 1 100 0.00 255.0 FORMAT "%5.1" ECU_ADDRESS 0x7F9482 /end MEASUREMENT
/begin MEASUREMENT FrmMng_stTSC3Trgt "Status Langfristiger Eingriff" UBYTE OneToOne 1 100 0.00 255.0 FORMAT "%5.1" ECU_ADDRESS 0x7F9483 /end MEASUREMENT
/begin MEASUREMENT FrmMng_stUsrMsgRxOrTx "Status, welche Botschaften versendet bzw. empfangen werden" UWORD OneToOne 1 100 0.00 65535.00 FORMAT "%8.2" ECU_ADDRESS 0x7F99D0 /end MEASUREMENT
/begin MEASUREMENT FrmMng_stVelDsplInMiles "Einheit der angezeigten  Geschwindigkeit" UBYTE OneToOne 1 100 0.00 255.0 FORMAT "%5.1" ECU_ADDRESS 0x7F9484 /end MEASUREMENT
/begin MEASUREMENT FrmMng_stVolFuelVld "Qualifizierungsmessage für Tankfüllstand über CAN" UBYTE OneToOne 1 100 0.00 255.0 FORMAT "%5.1" ECU_ADDRESS 0x7F9485 /end MEASUREMENT
/begin MEASUREMENT FrmMng_swtBrkSig "Auswahl der verwendeten CAN Bremssignale" UBYTE OneToOne 1 100 0.00 255.0 FORMAT "%5.1" ECU_ADDRESS 0x7F9486 /end MEASUREMENT
/begin MEASUREMENT FrmMng_swtTSC3Type "Switch Typs Botschaft Getriebe3" UBYTE OneToOne 1 100 0.00 255.0 FORMAT "%5.1" ECU_ADDRESS 0x7F9487 /end MEASUREMENT
/begin MEASUREMENT FrmMng_tAir "Ansauglufttemperatur über CAN" SWORD OneToOne 1 100 -32768.00 32767.00 FORMAT "%8.2" ECU_ADDRESS 0x7F99D2 /end MEASUREMENT
/begin MEASUREMENT FrmMng_tChrgr1ASIC "Temperatur des ASIC im E-Steller in Deg. C (Turboloader 1)" SWORD Temp_Cels 1 100 -3549.940 3003.560 FORMAT "%8.3" ECU_ADDRESS 0x7F99D4 /end MEASUREMENT
/begin MEASUREMENT FrmMng_tChrgr2ASIC "Temperatur des ASIC im E-Steller in Deg. C (Turboloader 2" SWORD Temp_Cels 1 100 -3549.940 3003.560 FORMAT "%8.3" ECU_ADDRESS 0x7F99D6 /end MEASUREMENT
/begin MEASUREMENT FrmMng_tClnt "Kühlmitteltemperatur" SWORD Temp_Cels 1 100 -3549.940 3003.560 FORMAT "%8.3" ECU_ADDRESS 0x7F99D8 /end MEASUREMENT
/begin MEASUREMENT FrmMng_tEnv "Umgebungstemperatur" SWORD Temp_Cels 1 100 -3549.940 3003.560 FORMAT "%8.3" ECU_ADDRESS 0x7F99DA /end MEASUREMENT
/begin MEASUREMENT FrmMng_tiDesAST "Synchronisationszeit" SWORD Time_ms 1 100 -327680.0 327670.0 FORMAT "%8.1" ECU_ADDRESS 0x7F99DE /end MEASUREMENT
/begin MEASUREMENT FrmMng_tiDIA1Date "Datum im JJ-MM-TT Format für Botschaft Diagnose1." ULONG OneToOne 1 100 0.00 4294967295.00 FORMAT "%13.2" ECU_ADDRESS 0x7F9E48 /end MEASUREMENT
/begin MEASUREMENT FrmMng_tiDIA1Time "Zeit im HH-MM-SS Format  für Botschaft Diagnose1." ULONG OneToOne 1 100 0.00 4294967295.00 FORMAT "%13.2" ECU_ADDRESS 0x7F9E4C /end MEASUREMENT
/begin MEASUREMENT FrmMng_tiTODet_mp "Zeit um ein Timeout fuer CAN Empfangsbotschaften" UBYTE TimeCAN_TO_ms 1 100 20.00 5120. FORMAT "%5.0" ARRAY_SIZE 28 ECU_ADDRESS 0x9FFE5D /end MEASUREMENT
/begin MEASUREMENT FrmMng_tiTOSFillLvl1 "Füllstandszeit 1" UWORD Time_RtmLowRes 1 100 0.00 6553.500 FORMAT "%8.3" ECU_ADDRESS 0x7F99E0 /end MEASUREMENT
/begin MEASUREMENT FrmMng_tiTOSFillLvl2 "Füllstandszeit 2" UWORD Time_RtmLowRes 1 100 0.00 6553.500 FORMAT "%8.3" ECU_ADDRESS 0x7F99E2 /end MEASUREMENT
/begin MEASUREMENT FrmMng_tiTOSFillLvl3 "Füllstandszeit 3" UWORD Time_RtmLowRes 1 100 0.00 6553.500 FORMAT "%8.3" ECU_ADDRESS 0x7F99E4 /end MEASUREMENT
/begin MEASUREMENT FrmMng_tiTOSFillLvl4 "Füllstandszeit 4" UWORD Time_RtmLowRes 1 100 0.00 6553.500 FORMAT "%8.3" ECU_ADDRESS 0x7F99E6 /end MEASUREMENT
/begin MEASUREMENT FrmMng_tiTOSOilT "Öltemperatur - Zeit von CAN(TOS)" UWORD Time_HighRes 1 100 0.00 8191.875 FORMAT "%8.3" ECU_ADDRESS 0x7F99E8 /end MEASUREMENT
/begin MEASUREMENT FrmMng_tOil "Öltemperatur" SWORD Temp_Cels 1 100 -3549.940 3003.560 FORMAT "%8.3" ECU_ADDRESS 0x7F99DC /end MEASUREMENT
/begin MEASUREMENT FrmMng_trqACCDes "empfangenes ACC-Wunschmoment" SLONG TrqPrpHigh 1 100 -214748364.800 214748364.700 FORMAT "%13.3" ECU_ADDRESS 0x7F9E50 /end MEASUREMENT
/begin MEASUREMENT FrmMng_trqACCompr "Momentenanforderung vom Klimakompressor via CAN" SWORD Trq 1 100 -3276.800 3276.700 FORMAT "%8.3" ECU_ADDRESS 0x7F99EA /end MEASUREMENT
/begin MEASUREMENT FrmMng_trqBrkACC "Gefordertes Summenradbremsmoment" SLONG TrqPrpHigh 1 100 -214748364.800 214748364.700 FORMAT "%13.3" ECU_ADDRESS 0x7F9E54 /end MEASUREMENT
/begin MEASUREMENT FrmMng_trqConvLoss "Wandlerverlustmoment" SWORD Trq 1 100 -3276.800 3276.700 FORMAT "%8.3" ECU_ADDRESS 0x7F99EC /end MEASUREMENT
/begin MEASUREMENT FrmMng_trqDCS "vom MSR gefordertes Getriebeausgangsmoment" SLONG TrqPrpHigh 1 100 -214748364.800 214748364.700 FORMAT "%13.3" ECU_ADDRESS 0x7F9E58 /end MEASUREMENT
/begin MEASUREMENT FrmMng_trqDCSraw "DCS Rohwert vom CAN" UBYTE OneToOne 1 100 0.00 255.0 FORMAT "%5.1" ECU_ADDRESS 0x7F9488 /end MEASUREMENT
/begin MEASUREMENT FrmMng_trqDesCC "Vortriebsmoment gesendet vom Slave über CAN" SLONG TrqPrpHigh 1 100 -214748364.800 214748364.700 FORMAT "%13.3" ECU_ADDRESS 0x7F9E5C /end MEASUREMENT
/begin MEASUREMENT FrmMng_trqFrc "Reibmoment" SWORD Trq 1 100 -3276.800 3276.700 FORMAT "%8.3" ECU_ADDRESS 0x7F99EE /end MEASUREMENT
/begin MEASUREMENT FrmMng_trqFrcCan "Reibmoment -> CAN" SWORD Trq 1 100 -3276.800 3276.700 FORMAT "%8.3" ECU_ADDRESS 0x7F99F0 /end MEASUREMENT
/begin MEASUREMENT FrmMng_trqFrcRaw_mp "Rohwert des Reibmomentes" SWORD Trq 1 100 -3276.800 3276.700 FORMAT "%8.3" ECU_ADDRESS 0x9FF446 /end MEASUREMENT
/begin MEASUREMENT FrmMng_trqGearbxCur1_mp "Meßpunkt 1 für Ist-Getriebemoment" SWORD Trq 1 100 -3276.800 3276.700 FORMAT "%8.3" ECU_ADDRESS 0x9FF448 /end MEASUREMENT
/begin MEASUREMENT FrmMng_trqGearbxCur2_mp "Meßpunkt 2 für Ist-Getriebemoment" SWORD Trq 1 100 -3276.800 3276.700 FORMAT "%8.3" ECU_ADDRESS 0x9FF44A /end MEASUREMENT
/begin MEASUREMENT FrmMng_trqGearbxCur3_mp "Meßpunkt 3 für Ist-Getriebemoment" SWORD Trq 1 100 -3276.800 3276.700 FORMAT "%8.3" ECU_ADDRESS 0x9FF44C /end MEASUREMENT
/begin MEASUREMENT FrmMng_trqGearbxCur4_mp "Meßpunkt 4 für Getriebe Istmoment" SWORD Trq 1 100 -3276.800 3276.700 FORMAT "%8.3" ECU_ADDRESS 0x9FF44E /end MEASUREMENT
/begin MEASUREMENT FrmMng_trqGearbxCur5_mp "Meßpunkt 5 für Getriebe Istmoment" SWORD Trq 1 100 -3276.800 3276.700 FORMAT "%8.3" ECU_ADDRESS 0x9FF450 /end MEASUREMENT
/begin MEASUREMENT FrmMng_trqGearbxDes1_mp "Meßpunkt 1 für Getriebe Sollmoment" SWORD Trq 1 100 -3276.800 3276.700 FORMAT "%8.3" ECU_ADDRESS 0x9FF452 /end MEASUREMENT
/begin MEASUREMENT FrmMng_trqGearbxDes2_mp "Meßpunkt 2 für Getriebe Sollmoment" SWORD Trq 1 100 -3276.800 3276.700 FORMAT "%8.3" ECU_ADDRESS 0x9FF454 /end MEASUREMENT
/begin MEASUREMENT FrmMng_trqGearbxDes3_mp "Meßpunkt 3 für Getriebe Sollmoment" SWORD Trq 1 100 -3276.800 3276.700 FORMAT "%8.3" ECU_ADDRESS 0x9FF456 /end MEASUREMENT
/begin MEASUREMENT FrmMng_trqGearbxDes4_mp "Meßpunkt 4 für Getriebe Sollmoment" SWORD Trq 1 100 -3276.800 3276.700 FORMAT "%8.3" ECU_ADDRESS 0x9FF458 /end MEASUREMENT
/begin MEASUREMENT FrmMng_trqInrDCS "Eingriffsmoment MSR" SWORD Trq 1 100 -3276.800 3276.700 FORMAT "%8.3" ECU_ADDRESS 0x7F99F2 /end MEASUREMENT
/begin MEASUREMENT FrmMng_trqInrEngNoExtDem "Meßpunkt für inneres Motormoment ohne externe Momente" SWORD Trq 1 100 -3276.800 3276.700 FORMAT "%8.3" ECU_ADDRESS 0x7F99F4 /end MEASUREMENT
/begin MEASUREMENT FrmMng_trqInrEng_mp "Meßpunkt für inneres Motormoment" SWORD Trq 1 100 -3276.800 3276.700 FORMAT "%8.3" ECU_ADDRESS 0x9FF45A /end MEASUREMENT
/begin MEASUREMENT FrmMng_trqInrTCS "Eingriffsmoment ASR" SWORD Trq 1 100 -3276.800 3276.700 FORMAT "%8.3" ECU_ADDRESS 0x7F99F6 /end MEASUREMENT
/begin MEASUREMENT FrmMng_trqInrTSC "Eingriffsmoment EGS" SWORD Trq 1 100 -3276.800 3276.700 FORMAT "%8.3" ECU_ADDRESS 0x7F99F8 /end MEASUREMENT
/begin MEASUREMENT FrmMng_trqLeadCC "Vortriebsvorhaltemoment vom Slave über CAN" SLONG TrqPrpHigh 1 100 -214748364.800 214748364.700 FORMAT "%13.3" ECU_ADDRESS 0x7F9E64 /end MEASUREMENT
/begin MEASUREMENT FrmMng_trqLimAWD "Begrenzungsmoment durch Allradsteuergerät" SLONG TrqPrpHigh 1 100 -214748364.800 214748364.700 FORMAT "%13.3" ECU_ADDRESS 0x7F9E68 /end MEASUREMENT
/begin MEASUREMENT FrmMng_trqPreFill_mp "Korrekturwert zur Prädiktion des rechnerischen Radbremsemomentes über den Zeitraum des Vorbefüllens" SLONG TrqPrpHigh 1 100 -214748364.800 214748364.700 FORMAT "%13.3" ECU_ADDRESS 0x9FE5BC /end MEASUREMENT
/begin MEASUREMENT FrmMng_trqRelDrvDem4_mp "Meßpunkt 4 für relatives Fahrerwunschmoment" SWORD Trq 1 100 -3276.800 3276.700 FORMAT "%8.3" ECU_ADDRESS 0x9FF45C /end MEASUREMENT
/begin MEASUREMENT FrmMng_trqTCS "vom ASR gefordertes Getriebeausgangsmoment" SLONG TrqPrpHigh 1 100 -214748364.800 214748364.700 FORMAT "%13.3" ECU_ADDRESS 0x7F9E6C /end MEASUREMENT
/begin MEASUREMENT FrmMng_trqTCSraw "TCS Rohwert vom CAN" UBYTE OneToOne 1 100 0.00 255.0 FORMAT "%5.1" ECU_ADDRESS 0x7F9489 /end MEASUREMENT
/begin MEASUREMENT FrmMng_trqTSC "Eingriffsmoment EGS" SWORD Trq 1 100 -3276.800 3276.700 FORMAT "%8.3" ECU_ADDRESS 0x7F99FA /end MEASUREMENT
/begin MEASUREMENT FrmMng_trqTSC3 "TSC3 Motorsollmoment" SWORD Trq 1 100 -3276.800 3276.700 FORMAT "%8.3" ECU_ADDRESS 0x7F99FC /end MEASUREMENT
/begin MEASUREMENT FrmMng_trqTSC3Inr "Rohwert Motorsollmoment" SWORD Trq 1 100 -3276.800 3276.700 FORMAT "%8.3" ECU_ADDRESS 0x7F99FE /end MEASUREMENT
/begin MEASUREMENT FrmMng_trqTSC3Trgt "Langfristiger Eingriff" SWORD Trq 1 100 -3276.800 3276.700 FORMAT "%8.3" ECU_ADDRESS 0x7F9A00 /end MEASUREMENT
/begin MEASUREMENT FrmMng_trqTSC3Trgt_mp "Meßpunkt für Rohwerte -FrmMng_trqTSC3Trgt message" SWORD Trq 1 100 -3276.800 3276.700 FORMAT "%8.3" ECU_ADDRESS 0x9FF45E /end MEASUREMENT
/begin MEASUREMENT FrmMng_trqWheel1_mp "Meßpunkt 1 für Radmoment" SWORD Trq 1 100 -3276.800 3276.700 FORMAT "%8.3" ECU_ADDRESS 0x9FF460 /end MEASUREMENT
/begin MEASUREMENT FrmMng_trqWheel2_mp "Meßpunkt 2 für Radmoment" SLONG TrqPrpHigh 1 100 -214748364.800 214748364.700 FORMAT "%13.3" ECU_ADDRESS 0x9FE5C0 /end MEASUREMENT
/begin MEASUREMENT FrmMng_trqWheel3_mp "Meßpunkt 3 für Radmoment" SLONG TrqPrpHigh 1 100 -214748364.800 214748364.700 FORMAT "%13.3" ECU_ADDRESS 0x9FE5C4 /end MEASUREMENT
/begin MEASUREMENT FrmMng_trqWheel4_mp "Meßpunkt 4 für Radmoment" SLONG TrqPrpHigh 1 100 -214748364.800 214748364.700 FORMAT "%13.3" ECU_ADDRESS 0x9FE5C8 /end MEASUREMENT
/begin MEASUREMENT FrmMng_trqWheel5_mp "Meßpunkt 5 für Radmoment" SLONG TrqPrpHigh 1 100 -214748364.800 214748364.700 FORMAT "%13.3" ECU_ADDRESS 0x9FE5CC /end MEASUREMENT
/begin MEASUREMENT FrmMng_vDspl1 "Fahrzeuggeschwindigkeit" SWORD Vel 1 100 -327.6800 327.6700 FORMAT "%8.4" ECU_ADDRESS 0x7F9A02 /end MEASUREMENT
/begin MEASUREMENT FrmMng_vDsplTacho "angezeigte Geschwindigkeit, inkl. Voreilung" SWORD Vel 1 100 -327.6800 327.6700 FORMAT "%8.4" ECU_ADDRESS 0x7F9A04 /end MEASUREMENT
/begin MEASUREMENT FrmMng_vGS "Fahrzeuggeschwindigkeit über Grund" SWORD Vel 1 100 -327.6800 327.6700 FORMAT "%8.4" ECU_ADDRESS 0x7F9A06 /end MEASUREMENT
/begin MEASUREMENT FrmMng_vLimAWD "Höchstgeschwindigkeit durch Allradsteuergerät" SWORD Vel 1 100 -327.6800 327.6700 FORMAT "%8.4" ECU_ADDRESS 0x7F9A08 /end MEASUREMENT
/begin MEASUREMENT FrmMng_volFuelFil "Tankfüllstand" UBYTE Fl_Half_L 1 100 0.00 127.5 FORMAT "%5.1" ECU_ADDRESS 0x7F948A /end MEASUREMENT
/begin MEASUREMENT FrmMng_vPhiSteer "Aktuelle Lenkwinkelgeschwindigkeit" SWORD VPhiSteer 1 100 -3276.800 3276.700 FORMAT "%8.3" ECU_ADDRESS 0x7F9A0A /end MEASUREMENT
/begin MEASUREMENT FTSCD_stPlausibilityTest "Kraftstofftemperatur Plausibilitätstest Status" SWORD OneToOne 1 100 -32768.00 32767.00 FORMAT "%8.2" ECU_ADDRESS 0x7F994C /end MEASUREMENT
/begin MEASUREMENT FTSCD_tDiffAbsCARB "Absolute Kraftstofftemperaturdifferenz des A-Tests" SWORD TempDiff_Kelv 1 100 -3276.800 3276.700 FORMAT "%8.3" ECU_ADDRESS 0x7F994E /end MEASUREMENT
/begin MEASUREMENT FTSCD_tDiffAbs_mp "Absolute Kraftstofftemperaturdifferenz" SWORD TempDiff_Kelv 1 100 -3276.800 3276.700 FORMAT "%8.3" ECU_ADDRESS 0x9FF462 /end MEASUREMENT
/begin MEASUREMENT FTSCD_tDiffMinCARB "Minimale absolute Kraftstofftemperaturdifferenz des A-Tests" SWORD TempDiff_Kelv 1 100 -3276.800 3276.700 FORMAT "%8.3" ECU_ADDRESS 0x7F9950 /end MEASUREMENT
/begin MEASUREMENT FTSCD_tDiff_mp "Absolute Kraftstofftemperaturdifferenzschwelle  - Kopie von FTSCD_tDiff_C für Signale" SWORD TempDiff_Kelv 1 100 -3276.800 3276.700 FORMAT "%8.3" ECU_ADDRESS 0x9FF464 /end MEASUREMENT
/begin MEASUREMENT FTSCD_tFuel "Kraftstofftemperatur" SWORD Temp_Cels 1 100 -3549.940 3003.560 FORMAT "%8.3" ECU_ADDRESS 0x7F9952 /end MEASUREMENT
/begin MEASUREMENT FTSCD_tFuelLin "linearisierter Wert der Kraftstoffstemperatur" SWORD Temp_Cels 1 100 -3549.940 3003.560 FORMAT "%8.3" ECU_ADDRESS 0x7F9954 /end MEASUREMENT
/begin MEASUREMENT FTSCD_tiEngOnZyc_mp "Zyklusflag-Timer Kraftstofftemperaturtest" ULONG TimeEngOn 1 100 0.00 4294967295.00 FORMAT "%13.2" ECU_ADDRESS 0x9FE5D0 /end MEASUREMENT
/begin MEASUREMENT FTSCD_tiEngOn_mp "Betriebsstundenzähler seit dem Start des DTI-Tests" ULONG TimeEngOn 1 100 0.00 4294967295.00 FORMAT "%13.2" ECU_ADDRESS 0x9FE5D4 /end MEASUREMENT
/begin MEASUREMENT FTSCD_tiMaxCARB "Maximale Testdauer des DTI-Test" ULONG TimeEngOn 1 100 0.00 4294967295.00 FORMAT "%13.2" ECU_ADDRESS 0x7F9E2C /end MEASUREMENT
/begin MEASUREMENT FTSCD_tImn_mp "minimale Kraftstofftemperaturdifferenz - Kopie von FTSCD_tImn_C für Signale" SWORD TempDiff_Kelv 1 100 -3276.800 3276.700 FORMAT "%8.3" ECU_ADDRESS 0x9FF466 /end MEASUREMENT
/begin MEASUREMENT FTSCD_tInt "Kraftstofftemperaturdifferenz Integralwert" SWORD TempDiff_Kelv 1 100 -3276.800 3276.700 FORMAT "%8.3" ECU_ADDRESS 0x7F9956 /end MEASUREMENT
/begin MEASUREMENT FTSCD_tIntCARB "Integrale Kraftstofftemperaturdifferenz des DTI-Tests" SWORD TempDiff_Kelv 1 100 -3276.800 3276.700 FORMAT "%8.3" ECU_ADDRESS 0x7F9958 /end MEASUREMENT
/begin MEASUREMENT FTSCD_tIntMinCARB "Minimale integrale Kraftstofftemperaturdifferenz des DTI-Tests" SWORD TempDiff_Kelv 1 100 -3276.800 3276.700 FORMAT "%8.3" ECU_ADDRESS 0x7F995A /end MEASUREMENT
/begin MEASUREMENT FTSCD_tInt_Carb_mp "Kraftstofftemperaturdifferenz Integral Schwelle - Kopie von FTSCD_tInt_C für Signale" SWORD TempDiff_Kelv 1 100 -3276.800 3276.700 FORMAT "%8.3" ECU_ADDRESS 0x9FF468 /end MEASUREMENT
/begin MEASUREMENT FTSCD_tiTestCARB "Testdauer des DTI-Test" ULONG TimeEngOn 1 100 0.00 4294967295.00 FORMAT "%13.2" ECU_ADDRESS 0x7F9E30 /end MEASUREMENT
/begin MEASUREMENT FTSCD_tiTestDuration "Kraftstofftemperatur DTI Testdauer" ULONG TimeEngOn 1 100 0.00 4294967295.00 FORMAT "%13.2" ECU_ADDRESS 0x7F9E34 /end MEASUREMENT
/begin MEASUREMENT FTSCD_tiTmn_mp "minimale Kraftstofftemperatur DTI Testdauer  - Kopie von FTSCD_tiTmn_C für Signale" ULONG TimeEngOn 1 100 0.00 4294967295.00 FORMAT "%13.2" ECU_ADDRESS 0x9FE5D8 /end MEASUREMENT
/begin MEASUREMENT FTSCD_uRaw "Spannungsrohwert der Kraftstoffstemperatur" SWORD Volt 1 100 -160156.4 160151.5 FORMAT "%8.1" ECU_ADDRESS 0x7F995C /end MEASUREMENT
/begin MEASUREMENT GbSSCD_nRev "Getriebeeingangsdrehzahl" SWORD EngN 1 100 0.00 6000.000 FORMAT "%8.3" ECU_ADDRESS 0x7F9A0C /end MEASUREMENT
/begin MEASUREMENT GbSSCD_nRevSens "Sensordrehzahl am Getriebeeingang" SWORD EngN 1 100 0.00 6000.000 FORMAT "%8.3" ECU_ADDRESS 0x7F9A0E /end MEASUREMENT
/begin MEASUREMENT GbSSCD_stErrPwm "HWE Status TPWM" UBYTE OneToOne 1 100 0.00 255.0 FORMAT "%5.1" ECU_ADDRESS 0x7F948B /end MEASUREMENT
/begin MEASUREMENT GbSSCD_stNpl_mp "Drehzahlerfassung nicht plausibel" UBYTE OneToOne 1 100 0.00 255.0 FORMAT "%5.1" ECU_ADDRESS 0x9FFEEA /end MEASUREMENT
/begin MEASUREMENT GbSSCD_stSensEna "Aktivierung der Getriebedrehzahlerfassung" UBYTE OneToOne 1 100 0.00 255.0 FORMAT "%5.1" ECU_ADDRESS 0x7F948C /end MEASUREMENT
/begin MEASUREMENT GbSSCD_tiPerSens_mp "Aktuelle Periodendauer des Getriebedrehzahlsignales" SLONG Time_PwmHigh 1 100 -214748364.800 214748364.700 FORMAT "%13.3" ECU_ADDRESS 0x9FE5DC /end MEASUREMENT
/begin MEASUREMENT Gearbx_aAdaptMax_mp "Maximale Fahrzeugverzögerung für die Berechunng der Tasse Diesel" SWORD Acc 1 100 -32.76800 32.76700 FORMAT "%8.5" ECU_ADDRESS 0x9FF480 /end MEASUREMENT
/begin MEASUREMENT Gearbx_amIncFree_mp "Wert des freien Integralmoments" UWORD AngMom 1 100 0.00 33553.92 FORMAT "%8.2" ECU_ADDRESS 0x9FF482 /end MEASUREMENT
/begin MEASUREMENT Gearbx_amINT1AKT_mp "Integriertes Moment 1 für den Increasing torque Eingriff" UWORD AngMom 1 100 0.00 33553.92 FORMAT "%8.2" ECU_ADDRESS 0x9FF484 /end MEASUREMENT
/begin MEASUREMENT Gearbx_amINT2AKT_mp "Integriertes Moment 2 für den Increasing torque Eingriff" UWORD AngMom 1 100 0.00 33553.92 FORMAT "%8.2" ECU_ADDRESS 0x9FF486 /end MEASUREMENT
/begin MEASUREMENT Gearbx_aPT1_mp "Gefilterte Wert von VSSCD_a" SWORD Acc 1 100 -32.76800 32.76700 FORMAT "%8.5" ECU_ADDRESS 0x9FF476 /end MEASUREMENT
/begin MEASUREMENT Gearbx_dnEng_mp "DT1 filtered Engine speed" SWORD Eng_dN 1 100 -32768.00 32767.00 FORMAT "%8.2" ECU_ADDRESS 0x9FF46A /end MEASUREMENT
/begin MEASUREMENT Gearbx_dnNoGearDetRst_mp "Messpunkt für die den Motordrehzahlgradienten für die Reset-Bedingung" SWORD Eng_dN 1 100 -32768.00 32767.00 FORMAT "%8.2" ECU_ADDRESS 0x9FF46C /end MEASUREMENT
/begin MEASUREMENT Gearbx_dnNoGearDetSet_mp "Messpunkt für die den Motordrehzahlgradienten für die Set-Bedingung" SWORD Eng_dN 1 100 -32768.00 32767.00 FORMAT "%8.2" ECU_ADDRESS 0x9FF46E /end MEASUREMENT
/begin MEASUREMENT Gearbx_nASTSyncStepInr_mp "Drehzahlinkrement für Wunschdrehzahlberchnung" SWORD EngN 1 100 -32768.00 32767.00 FORMAT "%8.2" ECU_ADDRESS 0x9FF488 /end MEASUREMENT
/begin MEASUREMENT Gearbx_nASTSyncStep_mp "Neue Drehzahlstufe zum Erreichen der Wunschdrehzahl" SWORD EngN 1 100 -32768.00 32767.00 FORMAT "%8.2" ECU_ADDRESS 0x9FF48A /end MEASUREMENT
/begin MEASUREMENT Gearbx_nASTSyntmp_mp "Begrenzte Frame Manager Wunschdrehzahl" SWORD EngN 1 100 -32768.00 32767.00 FORMAT "%8.2" ECU_ADDRESS 0x9FF48C /end MEASUREMENT
/begin MEASUREMENT Gearbx_nHys_mp "ausgegebene LL-Solldrehzahl nach Fehlerbehandlung unterhalb min Hystereseschwelle" SWORD EngN 1 100 -32768.00 32767.00 FORMAT "%8.2" ECU_ADDRESS 0x9FF478 /end MEASUREMENT
/begin MEASUREMENT Gearbx_nMaxLIdem_mp "Messwert der maximal tolerierten Drehzahlanforderung vom CVT-Getriebe plus mitlerer Drehzahl" SWORD EngN 1 100 -32768.00 32767.00 FORMAT "%8.2" ECU_ADDRESS 0x9FF47A /end MEASUREMENT
/begin MEASUREMENT Gearbx_nMin "LL_Solldrehzahlanforderung durch Getriebe2 Botschaft" SWORD EngN 1 100 -32768.00 32767.00 FORMAT "%8.2" ECU_ADDRESS 0x7F9A10 /end MEASUREMENT
/begin MEASUREMENT Gearbx_nMinIn_mp "Leerlaufdrehzal Anhebung vor der Überwachung" SWORD EngN 1 100 -32768.00 32767.00 FORMAT "%8.2" ECU_ADDRESS 0x9FF47C /end MEASUREMENT
/begin MEASUREMENT Gearbx_nSyncPrcAST_mp "Präzise Berechnungswert der AST Wunschdrehzahl" ULONG EngN 1 100 0.00 4294967295.00 FORMAT "%13.2" ECU_ADDRESS 0x9FE5E0 /end MEASUREMENT
/begin MEASUREMENT Gearbx_nSyncTmp_mp "Berechnete AST Wunschdrehzahl" SWORD EngN 1 100 -32768.00 32767.00 FORMAT "%8.2" ECU_ADDRESS 0x9FF48E /end MEASUREMENT
/begin MEASUREMENT Gearbx_nSynGovDev_mp "Reglerabweichung für AST Wunschdrehzahl" SWORD EngN 1 100 -32768.00 32767.00 FORMAT "%8.2" ECU_ADDRESS 0x9FF490 /end MEASUREMENT
/begin MEASUREMENT Gearbx_numGearFast "erkannter schneller Getriebegang" SBYTE OneToOne 1 100 -128.0 127.0 FORMAT "%5.1" ECU_ADDRESS 0x7F948D /end MEASUREMENT
/begin MEASUREMENT Gearbx_rIncFree "Anteils von dem freien Integralmoment" SWORD Prc 1 100 -327.6800 327.6700 FORMAT "%8.4" ECU_ADDRESS 0x7F9A12 /end MEASUREMENT
/begin MEASUREMENT Gearbx_rTrans "Getriebeübersetzung" SWORD TransR 1 100 -327.6800 327.6700 FORMAT "%8.4" ECU_ADDRESS 0x7F9A14 /end MEASUREMENT
/begin MEASUREMENT Gearbx_rTransConv_mp "Triebstrangübersetzung ermittelt aus dem V/N Verhältnis" SWORD TransR 1 100 -327.6800 327.6700 FORMAT "%8.4" ECU_ADDRESS 0x9FF470 /end MEASUREMENT
/begin MEASUREMENT Gearbx_rVnAWDLow_mp "Umgerechnetes v/n Verhältnis zur Berechnung des tatsächlichen Ganges bei aktiver Untersetzung" SWORD VelToN 1 100 -0.3276800 0.3276700 FORMAT "%9.7" ECU_ADDRESS 0x9FF472 /end MEASUREMENT
/begin MEASUREMENT Gearbx_rVnTrbn_mp "Das mittels Turbinendrehzahl berechnete v/n Verhältnis" SWORD VelToN 1 100 -0.3276800 0.3276700 FORMAT "%9.7" ECU_ADDRESS 0x9FF474 /end MEASUREMENT
/begin MEASUREMENT Gearbx_stActGear "Ganginformation, Übernahme des Zielgangs mit steigender Flanke des Bits ""Zielgang erreicht""" SBYTE OneToOne 1 100 -128.0 127.0 FORMAT "%5.1" ECU_ADDRESS 0x7F9490 /end MEASUREMENT
/begin MEASUREMENT Gearbx_stAST "Status des automatischen Schaltgetriebes" UWORD OneToOne 1 100 0.00 65535.00 FORMAT "%8.2" ECU_ADDRESS 0x7F9A16 /end MEASUREMENT
/begin MEASUREMENT Gearbx_stAWDAct "Getriebezustand abhänging von der Aktivierung der Reduzierung" UBYTE OneToOne 1 100 0.00 255.0 FORMAT "%5.1" ECU_ADDRESS 0x7F948E /end MEASUREMENT
/begin MEASUREMENT Gearbx_stAWDErr "Fehler im AWD Getriebe" UBYTE OneToOne 1 100 0.00 255.0 FORMAT "%5.1" ECU_ADDRESS 0x7F948F /end MEASUREMENT
/begin MEASUREMENT Gearbx_stCond1_mp "Meßpunkt für Fehlerbedingungen" UBYTE OneToOne 1 100 0.00 255.0 FORMAT "%5.1" ECU_ADDRESS 0x9FFEF2 /end MEASUREMENT
/begin MEASUREMENT Gearbx_stCond2_mp "Meßpunkt für abgelaufenen Timer" UBYTE OneToOne 1 100 0.00 255.0 FORMAT "%5.1" ECU_ADDRESS 0x9FFEF3 /end MEASUREMENT
/begin MEASUREMENT Gearbx_stDetType "Gangerkennung über CAN oder v/n" UBYTE OneToOne 1 100 0.00 255.0 FORMAT "%5.1" ECU_ADDRESS 0x7F9491 /end MEASUREMENT
/begin MEASUREMENT Gearbx_stGear "Ganginformation" SBYTE OneToOne 1 100 -128.0 127.0 FORMAT "%5.1" ECU_ADDRESS 0x7F9492 /end MEASUREMENT
/begin MEASUREMENT Gearbx_stGearAftShift "Ganginformation, Übernahme des Zielgangs mit fallender Flanke des Bits ""Schaltung aktiv""" SBYTE OneToOne 1 100 -128.0 127.0 FORMAT "%5.1" ECU_ADDRESS 0x7F9493 /end MEASUREMENT
/begin MEASUREMENT Gearbx_stGearPlaus_mp "Der aktuell verwendete Gang ist plausibel" UBYTE OneToOne 1 100 0.00 255.0 FORMAT "%5.1" ECU_ADDRESS 0x9FFEEB /end MEASUREMENT
/begin MEASUREMENT Gearbx_stGvnrPlaus_mp "Zustand der plausibilität für den AST regler" UBYTE OneToOne 1 100 0.00 255.0 FORMAT "%5.1" ECU_ADDRESS 0x9FFEEE /end MEASUREMENT
/begin MEASUREMENT Gearbx_stLnchCtlActv "Erkennung ob Launch Control aktiv." UBYTE OneToOne 1 100 0.00 255.0 FORMAT "%5.1" ECU_ADDRESS 0x7F9494 /end MEASUREMENT
/begin MEASUREMENT Gearbx_stNMinMon_mp "Status der Überwachung" UWORD OneToOne 1 100 0.00 65535.00 FORMAT "%8.2" ECU_ADDRESS 0x9FF47E /end MEASUREMENT
/begin MEASUREMENT Gearbx_stNoGearDet_mp "Messpunkt für den Status der Leergang-Erkennung(1=Leergang erkannt)" UBYTE OneToOne 1 100 0.00 255.0 FORMAT "%5.1" ECU_ADDRESS 0x9FFEEC /end MEASUREMENT
/begin MEASUREMENT Gearbx_stParGear "Paramatergang bei aktiver Untersetzung zur Parameterauswahl" SBYTE OneToOne 1 100 -128.0 127.0 FORMAT "%5.1" ECU_ADDRESS 0x7F9495 /end MEASUREMENT
/begin MEASUREMENT Gearbx_stRamping_mp "Status der Rampe" UBYTE OneToOne 1 100 0.00 255.0 FORMAT "%5.1" ECU_ADDRESS 0x9FFEF4 /end MEASUREMENT
/begin MEASUREMENT Gearbx_strVnTrbnEna_mp "Freigabe für das aus der Turbinendrehzahl berechnete v/n Verhältnis" UBYTE OneToOne 1 100 0.00 255.0 FORMAT "%5.1" ECU_ADDRESS 0x9FFEED /end MEASUREMENT
/begin MEASUREMENT Gearbx_stShftUp "Statusmeldung, es wurde soeben in einen höheren Gang geschalten" UBYTE OneToOne 1 100 0.00 255.0 FORMAT "%5.1" ECU_ADDRESS 0x7F9496 /end MEASUREMENT
/begin MEASUREMENT Gearbx_stTII "Statuswort Momentenerhöhende Getriebeschnittstelle" UWORD OneToOne 1 100 0.00 65535.00 FORMAT "%8.2" ECU_ADDRESS 0x7F9A18 /end MEASUREMENT
/begin MEASUREMENT Gearbx_stTIILim_mp "Zustand der AST - Begrenzung" UBYTE OneToOne 1 100 0.00 255.0 FORMAT "%5.1" ECU_ADDRESS 0x9FFEEF /end MEASUREMENT
/begin MEASUREMENT Gearbx_stTransPlaus "Bitfeld mit der aktuellen Plausibilitätsinformation von FrmMng_rTransConv" UBYTE OneToOne 1 100 0.00 255.0 FORMAT "%5.1" ECU_ADDRESS 0x7F9498 /end MEASUREMENT
/begin MEASUREMENT Gearbx_stTrqLim_mp "Status der Momentenselektion" UBYTE OneToOne 1 100 0.00 255.0 FORMAT "%5.1" ECU_ADDRESS 0x9FFEF5 /end MEASUREMENT
/begin MEASUREMENT Gearbx_stTSC "Status des TSC-Eingriffes (zB.: EGS aktiv ja/nein)" UWORD OneToOne 1 100 0.00 65535.00 FORMAT "%8.2" ECU_ADDRESS 0x7F9A1A /end MEASUREMENT
/begin MEASUREMENT Gearbx_stTSC2Err "Getriebemessage bei TSC2-Fehler" UBYTE OneToOne 1 100 0.00 255.0 FORMAT "%5.1" ECU_ADDRESS 0x7F9497 /end MEASUREMENT
/begin MEASUREMENT Gearbx_stTSC3MaxLim_mp "Status der Momentenselektion von TSC3" UBYTE OneToOne 1 100 0.00 255.0 FORMAT "%5.1" ECU_ADDRESS 0x9FFEF6 /end MEASUREMENT
/begin MEASUREMENT Gearbx_stTSCErr_mp "Fehler Status des TSC-Eingriffes (begrenzte Eingriffszeit)" UBYTE OneToOne 1 100 0.00 255.0 FORMAT "%5.1" ECU_ADDRESS 0x9FFEF0 /end MEASUREMENT
/begin MEASUREMENT Gearbx_stTSC_mp "Status des TSC-Eingriffes (zB.: EGS aktiv ja/nein)" UBYTE OneToOne 1 100 0.00 255.0 FORMAT "%5.1" ECU_ADDRESS 0x7FDDF4 /end MEASUREMENT
/begin MEASUREMENT Gearbx_swtDemtype "Ausgang des Softwareschalters für die Freigabe des TSC Eingriffs" UBYTE OneToOne 1 100 0.00 255.0 FORMAT "%5.1" ECU_ADDRESS 0x7F9499 /end MEASUREMENT
/begin MEASUREMENT Gearbx_swtTIIFrc_mp "Schalterwert für Reibmomentkorrektur" UBYTE OneToOne 1 100 0.00 255.0 FORMAT "%5.1" ECU_ADDRESS 0x9FFEF1 /end MEASUREMENT
/begin MEASUREMENT Gearbx_swtType "Getriebetyp (0: manuell(MT); 1: automatisch(AT); 2: Schaltautomatisch(AST); 3: StufenlosesGetriebe (CVT); 4:automatic Z-Car)" UBYTE OneToOne 1 100 0.00 255.0 FORMAT "%5.1" ECU_ADDRESS 0x7F949A /end MEASUREMENT
/begin MEASUREMENT Gearbx_tiHoldTmr_mp "Timerwert des Haltetimers des Getriebeschutzes" UWORD Time_ms 1 100 0.00 655350.0 FORMAT "%8.1" ECU_ADDRESS 0x9FF4C4 /end MEASUREMENT
/begin MEASUREMENT Gearbx_tiTSCINT_mp "Wert des Zeitintegrals TSC (EGS)" SWORD OneToOne 1 100 -32768.00 32767.00 FORMAT "%8.2" ECU_ADDRESS 0x9FF492 /end MEASUREMENT
/begin MEASUREMENT Gearbx_trqASTIn1_mp "Wert des Überwachungsmoments von AST für Momentenintegral 1" SWORD Trq 1 100 -3276.800 3276.700 FORMAT "%8.3" ECU_ADDRESS 0x9FF494 /end MEASUREMENT
/begin MEASUREMENT Gearbx_trqASTIn2_mp "Wert des Überwachungsmoments von AST für Momentenintegral 2" SWORD Trq 1 100 -3276.800 3276.700 FORMAT "%8.3" ECU_ADDRESS 0x9FF496 /end MEASUREMENT
/begin MEASUREMENT Gearbx_trqASTInc_mp "Meßpunkt für berechnetes AST Eingriffsmoment - after plausibility" SWORD Trq 1 100 -3276.800 3276.700 FORMAT "%8.3" ECU_ADDRESS 0x9FF498 /end MEASUREMENT
/begin MEASUREMENT Gearbx_trqASTMax_mp "Momentengrenzwert für den AST Eingriff" SWORD Trq 1 100 -3276.800 3276.700 FORMAT "%8.3" ECU_ADDRESS 0x9FF49A /end MEASUREMENT
/begin MEASUREMENT Gearbx_trqASTOut1_mp "Wert des Überwachungsmoments von AST für Momentenintegral 1 - after Governor Plausibilty" SWORD Trq 1 100 -3276.800 3276.700 FORMAT "%8.3" ECU_ADDRESS 0x9FF49C /end MEASUREMENT
/begin MEASUREMENT Gearbx_trqASTOut2_mp "Wert des Überwachungsmoments von AST für Momentenintegral 2 - after Governor Plausibility" SWORD Trq 1 100 -3276.800 3276.700 FORMAT "%8.3" ECU_ADDRESS 0x9FF49E /end MEASUREMENT
/begin MEASUREMENT Gearbx_trqAST_mp "Meßpunkt für berechnetes AST Eingriffsmoment" SWORD Trq 1 100 -3276.800 3276.700 FORMAT "%8.3" ECU_ADDRESS 0x9FF4A0 /end MEASUREMENT
/begin MEASUREMENT Gearbx_trqCANerrMax_mp "Ersatzwert nach Haltezeit" SWORD Trq 1 100 -3276.800 3276.700 FORMAT "%8.3" ECU_ADDRESS 0x9FF4C6 /end MEASUREMENT
/begin MEASUREMENT Gearbx_trqCluNoExtDem_mp "Fahrerwunschmoment an der Kupplung ohne externe Eingriffe" SWORD Trq 1 100 -3276.800 3276.700 FORMAT "%8.3" ECU_ADDRESS 0x9FF4A2 /end MEASUREMENT
/begin MEASUREMENT Gearbx_trqDec "erniedrigender Momenteneingriff vom Getriebe" SWORD Trq 1 100 -3276.800 3276.700 FORMAT "%8.3" ECU_ADDRESS 0x7F9A1C /end MEASUREMENT
/begin MEASUREMENT Gearbx_trqEngFrc_mp "Reibmoment zur Berechnung des Überwachungsmoments" SWORD Trq 1 100 -3276.800 3276.700 FORMAT "%8.3" ECU_ADDRESS 0x9FF4A4 /end MEASUREMENT
/begin MEASUREMENT Gearbx_trqExtAST_mp "AST Ersatzeingriffsmoment" SWORD Trq 1 100 -3276.800 3276.700 FORMAT "%8.3" ECU_ADDRESS 0x9FF4A6 /end MEASUREMENT
/begin MEASUREMENT Gearbx_trqFrc "aktuelles Verlustmoment Getriebe" SWORD Trq 1 100 -3276.800 3276.700 FORMAT "%8.3" ECU_ADDRESS 0x7F9A1E /end MEASUREMENT
/begin MEASUREMENT Gearbx_trqInc "erhöhender Momenteneingriff vom Getriebe" SWORD Trq 1 100 -3276.800 3276.700 FORMAT "%8.3" ECU_ADDRESS 0x7F9A22 /end MEASUREMENT
/begin MEASUREMENT Gearbx_trqInMax "maximales Getriebeeingangsmoment" SWORD Trq 1 100 -3276.800 3276.700 FORMAT "%8.3" ECU_ADDRESS 0x7F9A20 /end MEASUREMENT
/begin MEASUREMENT Gearbx_trqInMax_mp "Meßpunkt für maximales Getriebeeingangsmoment ohne beschränkung" SWORD Trq 1 100 -3276.800 3276.700 FORMAT "%8.3" ECU_ADDRESS 0x9FF4C8 /end MEASUREMENT
/begin MEASUREMENT Gearbx_trqMaxCur_mp "maximales Getriebeeingangsmoment aus Kennlinie" SWORD Trq 1 100 -3276.800 3276.700 FORMAT "%8.3" ECU_ADDRESS 0x9FF4CA /end MEASUREMENT
/begin MEASUREMENT Gearbx_trqMon1_mp "Wert des Überwachungsmoments 1 used in the Momentenintegral" SWORD Trq 1 100 -3276.800 3276.700 FORMAT "%8.3" ECU_ADDRESS 0x9FF4A8 /end MEASUREMENT
/begin MEASUREMENT Gearbx_trqMon2_mp "Wert des Überwachungsmoments 2 - used in the Momentenintegral" SWORD Trq 1 100 -3276.800 3276.700 FORMAT "%8.3" ECU_ADDRESS 0x9FF4AA /end MEASUREMENT
/begin MEASUREMENT Gearbx_trqNoExtDem_mp "Fahrerwunschmoment ohne externer Eingriffe mit Leerlaufregler" SWORD Trq 1 100 -3276.800 3276.700 FORMAT "%8.3" ECU_ADDRESS 0x9FF4AC /end MEASUREMENT
/begin MEASUREMENT Gearbx_trqNoExtLiLtd "Begrenztes Fahrerwunschmoment ohne externer Eingriffe mit Leerlaufregler" SWORD Trq 1 100 -3276.800 3276.700 FORMAT "%8.3" ECU_ADDRESS 0x7F9A24 /end MEASUREMENT
/begin MEASUREMENT Gearbx_trqPGvnrOut_mp "Reglerausgang des AST-drehzahlreglers" SWORD Trq 1 100 -3276.800 3276.700 FORMAT "%8.3" ECU_ADDRESS 0x9FF4AE /end MEASUREMENT
/begin MEASUREMENT Gearbx_trqPreCtlLtd_mp "Vorsteuermoment nach Berücksichtigung des Leerlaufreglers ohne Begrenzung auf Null" SWORD Trq 1 100 -3276.800 3276.700 FORMAT "%8.3" ECU_ADDRESS 0x9FF4B0 /end MEASUREMENT
/begin MEASUREMENT Gearbx_trqPreCtlOp_mp "AST Eingriffsmoment , Reglerausgang nach Berücksichtigung der Vorsteuerung" SWORD Trq 1 100 -3276.800 3276.700 FORMAT "%8.3" ECU_ADDRESS 0x9FF4B2 /end MEASUREMENT
/begin MEASUREMENT Gearbx_trqPreCtl_mp "AST Vorsteuermoment" SWORD Trq 1 100 -3276.800 3276.700 FORMAT "%8.3" ECU_ADDRESS 0x9FF4B4 /end MEASUREMENT
/begin MEASUREMENT Gearbx_trqRotMass_mp "Wert des dynamischer Moments" SWORD Trq 1 100 -3276.800 3276.700 FORMAT "%8.3" ECU_ADDRESS 0x9FF4B6 /end MEASUREMENT
/begin MEASUREMENT Gearbx_trqSprTSC_mp "Ersatzmoment von TSC" SWORD Trq 1 100 -3276.800 3276.700 FORMAT "%8.3" ECU_ADDRESS 0x9FF4B8 /end MEASUREMENT
/begin MEASUREMENT Gearbx_trqTIIInc_mp "Meßpunkt für berechnetes TII Eingriffsmoment - after plausibility" SWORD Trq 1 100 -3276.800 3276.700 FORMAT "%8.3" ECU_ADDRESS 0x9FF4BA /end MEASUREMENT
/begin MEASUREMENT Gearbx_trqTIIMon1_mp "Wert des Überwachungsmoments" SWORD Trq 1 100 -3276.800 3276.700 FORMAT "%8.3" ECU_ADDRESS 0x9FF4BC /end MEASUREMENT
/begin MEASUREMENT Gearbx_trqTIIMon2_mp "Wert des Überwachungsmoments 2" SWORD Trq 1 100 -3276.800 3276.700 FORMAT "%8.3" ECU_ADDRESS 0x9FF4BE /end MEASUREMENT
/begin MEASUREMENT Gearbx_trqTII_mp "Meßpunkt für berechnetes TII Eingriffsmoment" SWORD Trq 1 100 -3276.800 3276.700 FORMAT "%8.3" ECU_ADDRESS 0x9FF4C0 /end MEASUREMENT
/begin MEASUREMENT Gearbx_trqTSC3Max_mp "maximales Getriebeeingangsmoment von entspricht Getriebe" SWORD Trq 1 100 -3276.800 3276.700 FORMAT "%8.3" ECU_ADDRESS 0x9FF4CC /end MEASUREMENT
/begin MEASUREMENT Gearbx_trqTSCAftSpr_mp "Getriebeeingriff TSC vor Plausibilität mit dem Zeitintegral" SWORD Trq 1 100 -3276.800 3276.700 FORMAT "%8.3" ECU_ADDRESS 0x9FF4C2 /end MEASUREMENT
/begin MEASUREMENT GlwCD_rGSK "an den Ausgang geschicktes GSK3-Tastverhältnis" SWORD DtyCyc 1 100 -327.6800 327.6700 FORMAT "%8.4" ECU_ADDRESS 0x7F9A26 /end MEASUREMENT
/begin MEASUREMENT GlwCD_stActrRun_mp "Laufzeit Meßpunkt" UWORD OneToOne 1 100 0.00 65535.00 FORMAT "%8.2" ECU_ADDRESS 0x9FF4D0 /end MEASUREMENT
/begin MEASUREMENT GlwCD_stCodBuf_mp "Status des Kodierworts" UWORD OneToOne 1 100 0.00 65535.00 FORMAT "%8.2" ECU_ADDRESS 0x9FF4D2 /end MEASUREMENT
/begin MEASUREMENT GlwCD_stCodRdy "Codierung GZS aus EEPROM" UBYTE OneToOne 1 100 0.00 255.0 FORMAT "%5.1" ECU_ADDRESS 0x7F949B /end MEASUREMENT
/begin MEASUREMENT GlwCD_stDebVal "Entprellter Eingang Glühkontrolle" UBYTE OneToOne 1 100 0.00 255.0 FORMAT "%5.1" ECU_ADDRESS 0x7F949C /end MEASUREMENT
/begin MEASUREMENT GlwCD_stDia_mp "Diagnose-Status von GSK3" UBYTE OneToOne 1 100 0.00 255.0 FORMAT "%5.1" ECU_ADDRESS 0x9FFEF8 /end MEASUREMENT
/begin MEASUREMENT GlwCD_stDigInRun_mp "veraltetes Label nur für Testzwecke, nicht beachten" UWORD OneToOne 1 100 0.00 65535.00 FORMAT "%8.2" ECU_ADDRESS 0x9FF4D4 /end MEASUREMENT
/begin MEASUREMENT GlwCD_stGSK3 "GSK3-Fehlerdiagnoseergebnis" UWORD OneToOne 1 100 0.00 65535.00 FORMAT "%8.2" ECU_ADDRESS 0x7F9A28 /end MEASUREMENT
/begin MEASUREMENT GlwCD_stLampOut "Statusmessage für Glühanzeige" UBYTE OneToOne 1 100 0.00 255.0 FORMAT "%5.1" ECU_ADDRESS 0x7F949D /end MEASUREMENT
/begin MEASUREMENT GlwCD_stLmpOut_mp "Aktivierung des Glühlampe-Aktuator" UBYTE OneToOne 1 100 0.00 255.0 FORMAT "%5.1" ECU_ADDRESS 0x9FFEF7 /end MEASUREMENT
/begin MEASUREMENT GlwCD_stLmpRun_mp "Messpunkt für die Laufzeitmessung" UWORD OneToOne 1 100 0.00 65535.00 FORMAT "%8.2" ECU_ADDRESS 0x9FF4CE /end MEASUREMENT
/begin MEASUREMENT GlwCD_stLogVal_mp "Rückmeldeeingangssignal nicht entprellt" UBYTE OneToOne 1 100 0.00 255.0 FORMAT "%5.1" ECU_ADDRESS 0x9FFEF9 /end MEASUREMENT
/begin MEASUREMENT GlwCD_stOutHWE_mp "Glührelais Steller Ansteuersignal" UBYTE OneToOne 1 100 0.00 255.0 FORMAT "%5.1" ECU_ADDRESS 0x7FDDF5 /end MEASUREMENT
/begin MEASUREMENT GlwCD_stPwrStg "Status der Vorglühlampe über CAN" SWORD OneToOne 1 100 -32768.00 32767.00 FORMAT "%8.2" ECU_ADDRESS 0x7F9A2A /end MEASUREMENT
/begin MEASUREMENT GlwCD_stRawVal "Roheingangswert Glühsteuerung" UBYTE OneToOne 1 100 0.00 255.0 FORMAT "%5.1" ECU_ADDRESS 0x7F949E /end MEASUREMENT
/begin MEASUREMENT GlwCD_stValOk_mp "Größe anzeigt, ob Abtasten erlaubt wird oder nicht" UWORD OneToOne 1 100 0.00 65535.00 FORMAT "%8.2" ECU_ADDRESS 0x9FF4D6 /end MEASUREMENT
/begin MEASUREMENT GlwCtl_facGlwPwrRed_mp "Faktor der Leistungsreduzierung" SWORD Fact1 1 100 -256.0000 255.9922 FORMAT "%8.4" ECU_ADDRESS 0x9FF4E8 /end MEASUREMENT
/begin MEASUREMENT GlwCtl_qInjQnt_mp "Selektierte Einspritzmenge für GlwCtl_Logic" SWORD InjMass 1 100 -327.6800 327.6700 FORMAT "%8.4" ECU_ADDRESS 0x9FF4D8 /end MEASUREMENT
/begin MEASUREMENT GlwCtl_qPst_mp "Mengenschwelle für Übergang zu Warten auf Nachglühen" SWORD InjMass 1 100 -327.6800 327.6700 FORMAT "%8.4" ECU_ADDRESS 0x9FF4DA /end MEASUREMENT
/begin MEASUREMENT GlwCtl_rGSK3Raw "Tastverhältnis für Glühkerzen beim Niederspannungssystem" SWORD DtyCyc 1 100 -327.6800 327.6700 FORMAT "%8.4" ECU_ADDRESS 0x7F9A2C /end MEASUREMENT
/begin MEASUREMENT GlwCtl_rOutGlw_mp "Berechnetes Tastverhältnis für die Glühphasen" SWORD DtyCyc 1 100 -327.6800 327.6700 FORMAT "%8.4" ECU_ADDRESS 0x9FF4EA /end MEASUREMENT
/begin MEASUREMENT GlwCtl_rOutPre_mp "GSK3 Tastverhältnis im Vorglühfall" SWORD DtyCyc 1 100 -327.6800 327.6700 FORMAT "%8.4" ECU_ADDRESS 0x9FF4EC /end MEASUREMENT
/begin MEASUREMENT GlwCtl_rOutPstCor_mp "korrigiertes Tastverhältnis für das Nachglühen" SWORD DtyCyc 1 100 -327.6800 327.6700 FORMAT "%8.4" ECU_ADDRESS 0x9FF4EE /end MEASUREMENT
/begin MEASUREMENT GlwCtl_rOutPst_mp "Tastverhältnis während des Nachglühens" SWORD DtyCyc 1 100 -327.6800 327.6700 FORMAT "%8.4" ECU_ADDRESS 0x9FF4F0 /end MEASUREMENT
/begin MEASUREMENT GlwCtl_rOutRdy_mp "Tastverhältnis während Startbereitschaftsglühens" SWORD DtyCyc 1 100 -327.6800 327.6700 FORMAT "%8.4" ECU_ADDRESS 0x9FF4F2 /end MEASUREMENT
/begin MEASUREMENT GlwCtl_rOut_mp "GSK3 Tastverhältnis für bereitschaftsglühen, Nachglühen und Zwischenglühen" SWORD DtyCyc 1 100 -327.6800 327.6700 FORMAT "%8.4" ECU_ADDRESS 0x9FF4F4 /end MEASUREMENT
/begin MEASUREMENT GlwCtl_stActrOut "Glühkerzen-Ansteuerungsstatus beim Standardsystem" UBYTE OneToOne 1 100 0.00 255.0 FORMAT "%5.1" ECU_ADDRESS 0x7F949F /end MEASUREMENT
/begin MEASUREMENT GlwCtl_stAftRunDelDem "Statusbit des Glühkerzen Abkühl-Timers des Steuergeräte-Nachlaufs" UBYTE OneToOne 1 100 0.00 255.0 FORMAT "%5.1" ECU_ADDRESS 0x7F94A0 /end MEASUREMENT
/begin MEASUREMENT GlwCtl_stAllw_mp "Status, ob von ""Kein Glühen"" in ""warten auf Zwischenglühen"" gewechselt werden darf" UBYTE OneToOne 1 100 0.00 255.0 FORMAT "%5.1" ECU_ADDRESS 0x9FFEFA /end MEASUREMENT
/begin MEASUREMENT GlwCtl_stGlwBitEco "Status Vorglühlampe" UBYTE OneToOne 1 100 0.00 255.0 FORMAT "%5.1" ECU_ADDRESS 0x7F94A2 /end MEASUREMENT
/begin MEASUREMENT GlwCtl_stGlwPwrRed "Anforderung der Leistungsreduzierung" UBYTE OneToOne 1 100 0.00 255.0 FORMAT "%5.1" ECU_ADDRESS 0x7F94A3 /end MEASUREMENT
/begin MEASUREMENT GlwCtl_stGlwPwrRedHys_mp "Status der Glühleistungsreduzierung nach der Hysterese" UBYTE OneToOne 1 100 0.00 255.0 FORMAT "%5.1" ECU_ADDRESS 0x9FFEFF /end MEASUREMENT
/begin MEASUREMENT GlwCtl_stGlwPwrRed_mp "Meßpunkt für Status der Glühleistungsreduzierung" UBYTE OneToOne 1 100 0.00 255.0 FORMAT "%5.1" ECU_ADDRESS 0x9FFF00 /end MEASUREMENT
/begin MEASUREMENT GlwCtl_stGSKHiPreGlwActv "Status Vorglühen mit Energieeintrag" UBYTE OneToOne 1 100 0.00 255.0 FORMAT "%5.1" ECU_ADDRESS 0x7F94A1 /end MEASUREMENT
/begin MEASUREMENT GlwCtl_stHiPreGlwRes "Status für Energieintegrator, Integration im letzten Fahrzyklus nicht abgeschlossen" UBYTE OneToOne 1 100 0.00 255.0 FORMAT "%5.1" ECU_ADDRESS 0x7F94A4 /end MEASUREMENT
/begin MEASUREMENT GlwCtl_stIntegEnrg_mp "Status des Energieintegrators" UWORD OneToOne 1 100 0.00 65535.00 FORMAT "%8.2" ECU_ADDRESS 0x9FF4DC /end MEASUREMENT
/begin MEASUREMENT GlwCtl_stLmpOut "Glühlampenansteuerung" UBYTE OneToOne 1 100 0.00 255.0 FORMAT "%5.1" ECU_ADDRESS 0x7F94A5 /end MEASUREMENT
/begin MEASUREMENT GlwCtl_stLogic "aktueller Zustand der Glühzeitsteuerung" UWORD OneToOne 1 100 0.00 65535.00 FORMAT "%8.2" ECU_ADDRESS 0x7F9A2E /end MEASUREMENT
/begin MEASUREMENT GlwCtl_stPFltRgn_mp "Status Zwischenglühen bei Regeneration Partikelfilter" UBYTE OneToOne 1 100 0.00 255.0 FORMAT "%5.1" ECU_ADDRESS 0x9FFEFB /end MEASUREMENT
/begin MEASUREMENT GlwCtl_stPshDisbl "Status Pushen verboten" UBYTE OneToOne 1 100 0.00 255.0 FORMAT "%5.1" ECU_ADDRESS 0x7F94A6 /end MEASUREMENT
/begin MEASUREMENT GlwCtl_stPshEna_mp "Status zur Feststellung, ob das Pushen aktuell erlaubt ist" UBYTE OneToOne 1 100 0.00 255.0 FORMAT "%5.1" ECU_ADDRESS 0x9FFEFC /end MEASUREMENT
/begin MEASUREMENT GlwCtl_stPshRd "Push information, die vom EEPROM für den aktuellen Fahrzyklus gelesen wurde" UBYTE OneToOne 1 100 0.00 255.0 FORMAT "%5.1" ECU_ADDRESS 0x7F94A7 /end MEASUREMENT
/begin MEASUREMENT GlwCtl_stPshWr "Push information, die in das EEPROM für den nächsten Fahrzyklus geschrieben wird" UBYTE OneToOne 1 100 0.00 255.0 FORMAT "%5.1" ECU_ADDRESS 0x7F94A8 /end MEASUREMENT
/begin MEASUREMENT GlwCtl_stRly_mp "Aktivierungsstatus der Glühkerzen" UBYTE OneToOne 1 100 0.00 255.0 FORMAT "%5.1" ECU_ADDRESS 0x9FFF01 /end MEASUREMENT
/begin MEASUREMENT GlwCtl_stShOff_mp "Abschaltbedingung für Glühkerzen und Glühkontrolllampe" UBYTE OneToOne 1 100 0.00 255.0 FORMAT "%5.1" ECU_ADDRESS 0x9FFF02 /end MEASUREMENT
/begin MEASUREMENT GlwCtl_stStrtOk_mp "Status ob erster Start beendet" UBYTE OneToOne 1 100 0.00 255.0 FORMAT "%5.1" ECU_ADDRESS 0x9FFEFD /end MEASUREMENT
/begin MEASUREMENT GlwCtl_stTmr_mp "Status des Glühkerzen Abkühl-Timers (0: gestoppt, 1: läuft)" UBYTE OneToOne 1 100 0.00 255.0 FORMAT "%5.1" ECU_ADDRESS 0x9FFEFE /end MEASUREMENT
/begin MEASUREMENT GlwCtl_swtEnrgPreEna "S/w Schalter für Vorglühen mit Energieeintrag" UBYTE OneToOne 1 100 0.00 255.0 FORMAT "%5.1" ECU_ADDRESS 0x7F94A9 /end MEASUREMENT
/begin MEASUREMENT GlwCtl_swtGSKMode "Schalterwert zur Wahl von GSK-Modus" UBYTE OneToOne 1 100 0.00 255.0 FORMAT "%5.1" ECU_ADDRESS 0x7F94AA /end MEASUREMENT
/begin MEASUREMENT GlwCtl_swtPreGlw "EEPROM Schalter für die Glühanzeige" UBYTE OneToOne 1 100 0.00 255.0 FORMAT "%5.1" ECU_ADDRESS 0x7F94AB /end MEASUREMENT
/begin MEASUREMENT GlwCtl_tEng "Motortemperatur für das Glühsystem" SWORD Temp_Cels 1 100 -3549.940 3003.560 FORMAT "%8.3" ECU_ADDRESS 0x7F9A30 /end MEASUREMENT
/begin MEASUREMENT GlwCtl_tEngAdj "Motortemperatur für Glühsystem nach Korrektur über Abgleichwert" SWORD Temp_Cels 1 100 -3549.940 3003.560 FORMAT "%8.3" ECU_ADDRESS 0x7F9A32 /end MEASUREMENT
/begin MEASUREMENT GlwCtl_tiLmp_mp "Ansteuerungszeit der Glühkontrolllampe im Vorglühfall" ULONG GlwCtl_Time_ms 1 100 0.00 429496729500. FORMAT "%13.0" ECU_ADDRESS 0x9FE5E8 /end MEASUREMENT
/begin MEASUREMENT GlwCtl_tiOut1 "GSK3 Vorglühzeit Bereich 1" ULONG GlwCtl_Time_ms 1 100 0.00 429496729500. FORMAT "%13.0" ECU_ADDRESS 0x7F9E70 /end MEASUREMENT
/begin MEASUREMENT GlwCtl_tiOut_mp "Vorglühzeit für GSK3" ULONG GlwCtl_Time_ms 1 100 0.00 429496729500. FORMAT "%13.0" ECU_ADDRESS 0x9FE5E4 /end MEASUREMENT
/begin MEASUREMENT GlwCtl_tiPre "Vorglühzeit" ULONG GlwCtl_Time_ms 1 100 0.00 429496729500. FORMAT "%13.0" ECU_ADDRESS 0x7F9E74 /end MEASUREMENT
/begin MEASUREMENT GlwCtl_tiPreGlw "Verbleibende Vorglühzeit" UWORD GlwCtl_Time_ms 1 100 0.00 6553500. FORMAT "%8.0" ECU_ADDRESS 0x7F9A34 /end MEASUREMENT
/begin MEASUREMENT GlwCtl_tiPst_mp "Nachglühzeit" ULONG GlwCtl_Time_ms 1 100 0.00 429496729500. FORMAT "%13.0" ECU_ADDRESS 0x7FDDF8 /end MEASUREMENT
/begin MEASUREMENT GlwCtl_tiThresFl1_mp "errechnete Wartezeit für Übergang ""Kein Glühen"" zu ""Warten auf Zwischenglühen""" SWORD Time_ms 1 100 -327680.0 327670.0 FORMAT "%8.1" ECU_ADDRESS 0x9FF4DE /end MEASUREMENT
/begin MEASUREMENT GlwCtl_tTempVal_mp "Temperaturwert des Arrays Eng_tFld" SWORD Temp_Cels 1 100 -3549.940 3003.560 FORMAT "%8.3" ECU_ADDRESS 0x9FF4E0 /end MEASUREMENT
/begin MEASUREMENT GlwCtl_tValEEP_mp "Temperaturabgleichwert aus dem EEPROM" SWORD TempDiff_Kelv 1 100 -3276.800 3276.700 FORMAT "%8.3" ECU_ADDRESS 0x9FF4E2 /end MEASUREMENT
/begin MEASUREMENT GlwCtl_wEnrgPre_mp "Energie aus dem Kennlinie GlwCtl_wEnrgPre_CUR" SWORD SqrVltg_s 1 100 -3276.800 3276.700 FORMAT "%8.3" ECU_ADDRESS 0x9FF4E4 /end MEASUREMENT
/begin MEASUREMENT GlwCtl_wIntegEnrg_mp "Energie aus dem Integrator" SWORD SqrVltg_s 1 100 -3276.800 3276.700 FORMAT "%8.3" ECU_ADDRESS 0x9FF4E6 /end MEASUREMENT
/begin MEASUREMENT HCInj_dqInjAct "Aktuell extern eingespritzte Kraftstoffmenge pro Sekunde" SWORD InjMassPerSecHCI 1 100 -3276.800 3276.700 FORMAT "%8.3" ECU_ADDRESS 0x7F9A36 /end MEASUREMENT
/begin MEASUREMENT HCInj_rLmbdPstPFlt "Lambda nach Partikelfilter" SWORD lambda 1 100 -32.76800 32.76700 FORMAT "%8.5" ECU_ADDRESS 0x7F9A38 /end MEASUREMENT
/begin MEASUREMENT HCInj_tDiffPFltExo "HCI Temperaturunterschied für PFlt" SWORD Temp_Kelv 1 100 -3276.800 3276.700 FORMAT "%8.3" ECU_ADDRESS 0x7F9A3A /end MEASUREMENT
/begin MEASUREMENT HDSCD_prcAir "Prozent der Heizungstemperaturanforderung" SWORD Prc 1 100 -327.6800 327.6700 FORMAT "%8.4" ECU_ADDRESS 0x7F9A3C /end MEASUREMENT
/begin MEASUREMENT HDSCD_prcAirLin "Prozent der Heizungsanforderungstemperatur linearisiert" SWORD Prc 1 100 -327.6800 327.6700 FORMAT "%8.4" ECU_ADDRESS 0x7F9A3E /end MEASUREMENT
/begin MEASUREMENT HDSCD_uRaw "Rohwert des HZA-Senorsignals" SWORD Volt 1 100 -160156.4 160151.5 FORMAT "%8.1" ECU_ADDRESS 0x7F9A40 /end MEASUREMENT
/begin MEASUREMENT HPUn_qLim "Begrenzungsmenge der Hochdruckpumpe" SWORD InjMassCyc 1 100 -327.6800 327.6700 FORMAT "%8.4" ECU_ADDRESS 0x7F9A42 /end MEASUREMENT
/begin MEASUREMENT HPUn_trqDes "Momentenanforderung der Hochdruckpumpe" SWORD Trq 1 100 -3276.800 3276.700 FORMAT "%8.3" ECU_ADDRESS 0x7F9A44 /end MEASUREMENT
/begin MEASUREMENT HWEMon_ctErrEEPROM_mp "Fehlerzaehler fuer Eeprom Fehler" UBYTE OneToOne 1 100 0.00 255.0 FORMAT "%5.1" ECU_ADDRESS 0x9FFF03 /end MEASUREMENT
/begin MEASUREMENT HWEMon_ctRecovery "Anzahl der während 2 Sekunden aufgetretenen Recoverys" UBYTE OneToOne 1 100 0.00 255.0 FORMAT "%5.1" ECU_ADDRESS 0x7F94AC /end MEASUREMENT
/begin MEASUREMENT HWEMon_lOld "Letzter E2PROM Schreibvorgang bei dieser gefahrenen Strecke" ULONG Length 1 100 0.00 4294967295.00 FORMAT "%13.2" ECU_ADDRESS 0x7F9E78 /end MEASUREMENT
/begin MEASUREMENT HWEMon_numRecovery "Herkunft des letzten Reset ( >0 = Recovery )" UWORD OneToOne 1 100 0.00 65535.00 FORMAT "%8.2" ECU_ADDRESS 0x7F9A4A /end MEASUREMENT
/begin MEASUREMENT HWEMon_stVoltMon_mp "Latchbetrieb der Überspannungsüberwachung (1 = Latch aktiv)" UBYTE OneToOne 1 100 0.00 255.0 FORMAT "%5.1" ECU_ADDRESS 0x9FFF04 /end MEASUREMENT
/begin MEASUREMENT IATSCD_dtAir "Änderungsrate der angesaugten Lufttemperatur" SWORD TempCels_100ms 1 100 -32768.00 32767.00 FORMAT "%8.2" ECU_ADDRESS 0x7F9A4C /end MEASUREMENT
/begin MEASUREMENT IATSCD_swtSig "Signalquelle Schalter ADC/CAN" UBYTE OneToOne 1 100 0.00 255.0 FORMAT "%5.1" ECU_ADDRESS 0x7F94AD /end MEASUREMENT
/begin MEASUREMENT IATSCD_tAir "Ansauglufttemperatur" SWORD Temp_Cels 1 100 -3549.940 3003.560 FORMAT "%8.3" ECU_ADDRESS 0x7F9A4E /end MEASUREMENT
/begin MEASUREMENT IATSCD_tAirLin "linearisierter Wert aus HWK vorm Aufruf der Übergangsfunktion" SWORD Temp_Cels 1 100 -3549.940 3003.560 FORMAT "%8.3" ECU_ADDRESS 0x7F9A50 /end MEASUREMENT
/begin MEASUREMENT IATSCD_uRaw "Lufttemperatur Spannungsrohwert" SWORD Volt 1 100 -160156.4 160151.5 FORMAT "%8.1" ECU_ADDRESS 0x7F9A52 /end MEASUREMENT
/begin MEASUREMENT IFCD_stOutHWE_mp "Ausgabewert zur Hardware nach der Fehlerbehandlung" SWORD OneToOne 1 100 -32768.00 32767.00 FORMAT "%8.2" ECU_ADDRESS 0x9FF4F6 /end MEASUREMENT
/begin MEASUREMENT IFCtl_stFan "Status der Lüfteranforderung für den Ladeluftkühler" UBYTE OneToOne 1 100 0.00 255.0 FORMAT "%5.1" ECU_ADDRESS 0x7F94AE /end MEASUREMENT
/begin MEASUREMENT IFCtl_stFantAir_mp "Lüfterstatus aufgrund Lufttemperatur" UBYTE OneToOne 1 100 0.00 255.0 FORMAT "%5.1" ECU_ADDRESS 0x9FFF05 /end MEASUREMENT
/begin MEASUREMENT IFCtl_stFantClnt_mp "Lüfterstatus aufgrund Kühlmitteltemperatur" UBYTE OneToOne 1 100 0.00 255.0 FORMAT "%5.1" ECU_ADDRESS 0x9FFF06 /end MEASUREMENT
/begin MEASUREMENT IgnLck_st "Abschaltanforderungen für Immobilizer/Wegfahrsperre" UBYTE OneToOne 1 100 0.00 255.0 FORMAT "%5.1" ECU_ADDRESS 0x7F94AF /end MEASUREMENT
/begin MEASUREMENT ImmCtl_ctImmo2_mp "Zaehler 2 fuer Wegfahrsperre" UBYTE OneToOne 1 100 0.00 255.0 FORMAT "%5.1" ECU_ADDRESS 0x9FFF07 /end MEASUREMENT
/begin MEASUREMENT ImmCtl_dRndNr_mp "Zufallszahl, berechnet vom MSG" ULONG OneToOne 1 100 0.00 4294967295.00 FORMAT "%13.2" ECU_ADDRESS 0x9FE5EC /end MEASUREMENT
/begin MEASUREMENT ImmCtl_lrnRndNr "Zufallszahl" ULONG OneToOne 1 100 0.00 4294967295.00 FORMAT "%13.2" ECU_ADDRESS 0x7F9E7C /end MEASUREMENT
/begin MEASUREMENT ImmCtl_stAftRunRdy "Nachlauf für Wegfahrsperre fertig" UBYTE OneToOne 1 100 0.00 255.0 FORMAT "%5.1" ECU_ADDRESS 0x7F94B0 /end MEASUREMENT
/begin MEASUREMENT ImmCtl_StateImmCtl_mp "Wegfahrsperre - Status Lern-state-machine" UBYTE OneToOne 1 100 0.00 255.0 FORMAT "%5.1" ECU_ADDRESS 0x9FFF08 /end MEASUREMENT
/begin MEASUREMENT ImmCtl_stCom "Kommunikationsstatus der Wegfahrsperre" UBYTE OneToOne 1 100 0.00 255.0 FORMAT "%5.1" ECU_ADDRESS 0x7F94B1 /end MEASUREMENT
/begin MEASUREMENT ImmCtl_stGblCANErrRXIMMCTL_mp "Zustand der CAN-Botschaft RXIMMCTL und Fehlerzustand vom CAN global." UBYTE OneToOne 1 100 0.00 255.0 FORMAT "%5.1" ECU_ADDRESS 0x9FFF09 /end MEASUREMENT
/begin MEASUREMENT ImmCtl_stImmo "Status der Wegfahrsperre" UBYTE OneToOne 1 100 0.00 255.0 FORMAT "%5.1" ECU_ADDRESS 0x7F94B2 /end MEASUREMENT
/begin MEASUREMENT ImmCtl_stOnOff "Status der Wegfahrsperre (Aktiv/Inaktiv)" UBYTE OneToOne 1 100 0.00 255.0 FORMAT "%5.1" ECU_ADDRESS 0x7F94B3 /end MEASUREMENT
/begin MEASUREMENT ImmCtl_stProcess "Prozessinformation der Wegfahrsperre" UWORD OneToOne 1 100 0.00 65535.00 FORMAT "%8.2" ECU_ADDRESS 0x7F9A54 /end MEASUREMENT
/begin MEASUREMENT ImmCtl_stStartEnable "Motorstart erlaubt" UBYTE OneToOne 1 100 0.00 255.0 FORMAT "%5.1" ECU_ADDRESS 0x7F94B4 /end MEASUREMENT
/begin MEASUREMENT ImmCtl_stVersion "Wegfahrsperrengeneration -> 1 = WFS4; 0 = WFS3" UBYTE OneToOne 1 100 0.00 255.0 FORMAT "%5.1" ECU_ADDRESS 0x7F94B5 /end MEASUREMENT
/begin MEASUREMENT ImmCtl_tiLockCount "Sperrzeit vom Combi-Instrument" UBYTE OneToOne 1 100 0.00 255.0 FORMAT "%5.1" ECU_ADDRESS 0x7F94B6 /end MEASUREMENT
/begin MEASUREMENT IndSys_pAdj "Ansaugluftdruck-Abgleichwert Berechnung" SWORD Pres_hPa 1 100 -32768.00 32767.00 FORMAT "%8.2" ECU_ADDRESS 0x7F9A56 /end MEASUREMENT
/begin MEASUREMENT IndSys_pAdjDiff "Abgleichdruckdifferenz" SWORD Pres_hPa 1 100 -32768.00 32767.00 FORMAT "%8.2" ECU_ADDRESS 0x7F9A58 /end MEASUREMENT
/begin MEASUREMENT IndSys_pAdjDiff_mp "Begrenzte Druckdifferenz zwischen Lade -und Atmosphärendruck" SWORD Pres_hPa 1 100 -32768.00 32767.00 FORMAT "%8.2" ECU_ADDRESS 0x9FF518 /end MEASUREMENT
/begin MEASUREMENT IndSys_pAdjNew "Interne Speichergröße für neuen Abgleichwert" SWORD Pres_hPa 1 100 -32768.00 32767.00 FORMAT "%8.2" ECU_ADDRESS 0x7F9A5A /end MEASUREMENT
/begin MEASUREMENT IndSys_pDiffHigh_mp "Druckdifferenz obere Schwelle zwischen Lade -und Atmosphärendruck" SWORD Pres_hPa 1 100 -32768.00 32767.00 FORMAT "%8.2" ECU_ADDRESS 0x9FF512 /end MEASUREMENT
/begin MEASUREMENT IndSys_pDiffLow_mp "Druckdifferenz untere Schwelle zwischen Lade -und Atmosphärendruck" SWORD Pres_hPa 1 100 -32768.00 32767.00 FORMAT "%8.2" ECU_ADDRESS 0x9FF514 /end MEASUREMENT
/begin MEASUREMENT IndSys_pDiffMonIntMnf_mp "Vergleichs-Druck fuer die Ladeschlauch-Abfall-Erkennung" SWORD Pres_hPa 1 100 -32768.00 32767.00 FORMAT "%8.2" ECU_ADDRESS 0x9FF510 /end MEASUREMENT
/begin MEASUREMENT IndSys_pDiff_mp "Ansaugluftdruck nachdem der Atmosphären und der Abgleichdruck vom Ladedruck subtrahiert wurden" SWORD Pres_hPa 1 100 -32768.00 32767.00 FORMAT "%8.2" ECU_ADDRESS 0x9FF516 /end MEASUREMENT
/begin MEASUREMENT IndSys_rAPCorVSARgn1_mp "Messpunkt nach atmosphärendruck-korrigiertem Drallniveau bei Regenerationsstufe 1" SWORD DtyCyc 1 100 -327.6800 327.6700 FORMAT "%8.4" ECU_ADDRESS 0x9FF4F8 /end MEASUREMENT
/begin MEASUREMENT IndSys_rAPCorVSARgn2_mp "Messpunkt nach atmosphärendruck-korrigiertem Drallniveau bei Regenerationsstufe 2" SWORD DtyCyc 1 100 -327.6800 327.6700 FORMAT "%8.4" ECU_ADDRESS 0x9FF4FA /end MEASUREMENT
/begin MEASUREMENT IndSys_rAPCorVSARgn3_mp "Messpunkt nach atmosphärendruck-korrigiertem Drallniveau bei Regenerationsstufe 3" SWORD DtyCyc 1 100 -327.6800 327.6700 FORMAT "%8.4" ECU_ADDRESS 0x9FF4FC /end MEASUREMENT
/begin MEASUREMENT IndSys_rAPCorVSA_mp "Luftdruckkorrekturwert des Drallniveaus" SWORD DtyCyc 1 100 -327.6800 327.6700 FORMAT "%8.4" ECU_ADDRESS 0x9FF4FE /end MEASUREMENT
/begin MEASUREMENT IndSys_rVSA "Sollposition für Einlaßkanalabschaltung" SWORD DtyCyc 1 100 -327.6800 327.6700 FORMAT "%8.4" ECU_ADDRESS 0x7F9A5C /end MEASUREMENT
/begin MEASUREMENT IndSys_rVSABefHys_mp "Drallniveau" SWORD DtyCyc 1 100 -327.6800 327.6700 FORMAT "%8.4" ECU_ADDRESS 0x9FF500 /end MEASUREMENT
/begin MEASUREMENT IndSys_rVSAByp_mp "Bypass-Label, Kopie von IndSys_rVSA" SWORD DtyCyc 1 100 -327.6800 327.6700 FORMAT "%8.4" ECU_ADDRESS 0x9FF502 /end MEASUREMENT
/begin MEASUREMENT IndSys_rVSACorBefHys_mp "Drallniveau nach Korrektur durch Akustikerweiterung" SWORD DtyCyc 1 100 -327.6800 327.6700 FORMAT "%8.4" ECU_ADDRESS 0x9FF504 /end MEASUREMENT
/begin MEASUREMENT IndSys_rVSACorBefRmp_mp "Korrigiertes Drallniveau vor EGT Rampe im Standardbetrieb" SWORD DtyCyc 1 100 -327.6800 327.6700 FORMAT "%8.4" ECU_ADDRESS 0x9FF506 /end MEASUREMENT
/begin MEASUREMENT IndSys_rVSARgn1_mp "Messpunkt für Drallniveau bei Regenerationsstufe 1" SWORD DtyCyc 1 100 -327.6800 327.6700 FORMAT "%8.4" ECU_ADDRESS 0x9FF508 /end MEASUREMENT
/begin MEASUREMENT IndSys_rVSARgn2_mp "Messpunkt für Drallniveau bei Regenerationsstufe 2" SWORD DtyCyc 1 100 -327.6800 327.6700 FORMAT "%8.4" ECU_ADDRESS 0x9FF50A /end MEASUREMENT
/begin MEASUREMENT IndSys_rVSARgn3_mp "Messpunkt für Drallniveau bei Regenerationsstufe 3" SWORD DtyCyc 1 100 -327.6800 327.6700 FORMAT "%8.4" ECU_ADDRESS 0x9FF50C /end MEASUREMENT
/begin MEASUREMENT IndSys_rWtTempCorVSA_mp "Wassertemperaturkorrekturwert des Drallniveaus" SWORD DtyCyc 1 100 -327.6800 327.6700 FORMAT "%8.4" ECU_ADDRESS 0x9FF50E /end MEASUREMENT
/begin MEASUREMENT IndSys_stAdj "Zustandsgröße die den Status des Abgleichs anzeigt" UBYTE OneToOne 1 100 0.00 255.0 FORMAT "%5.1" ECU_ADDRESS 0x7F94B7 /end MEASUREMENT
/begin MEASUREMENT IndSys_stAdjEna_mp "Status ob Abgleich möglich" UBYTE OneToOne 1 100 0.00 255.0 FORMAT "%5.1" ECU_ADDRESS 0x9FFF0D /end MEASUREMENT
/begin MEASUREMENT IndSys_stBPLoDetActv "Unterdruckstatus im Ansaugkrümmer 1: Unterdruck erkannt  0: kein Unterdruck" UBYTE OneToOne 1 100 0.00 255.0 FORMAT "%5.1" ECU_ADDRESS 0x7F94B8 /end MEASUREMENT
/begin MEASUREMENT IndSys_stMonIntMnf_mp "Plausibilitätscheck für aufgenommen Mengenverlust" UBYTE OneToOne 1 100 0.00 255.0 FORMAT "%5.1" ECU_ADDRESS 0x9FFF0B /end MEASUREMENT
/begin MEASUREMENT IndSys_stOldNewAdjVal_mp "Status ob der aktuelle oder der Abgleichwert vom EEPROM verwendet wird" UBYTE OneToOne 1 100 0.00 255.0 FORMAT "%5.1" ECU_ADDRESS 0x9FFF0E /end MEASUREMENT
/begin MEASUREMENT IndSys_stPDiffSrcSel_mp "Quelle der Druckdifferenz" UBYTE OneToOne 1 100 0.00 255.0 FORMAT "%5.1" ECU_ADDRESS 0x9FFF0F /end MEASUREMENT
/begin MEASUREMENT IndSys_stRead_mp "Zustand des Lesens vom EEPROM Wert für IndSys_pAdj" SWORD OneToOne 1 100 -32768.00 32767.00 FORMAT "%8.2" ECU_ADDRESS 0x9FF51A /end MEASUREMENT
/begin MEASUREMENT IndSys_stRgn_mp "Messpunkt für die Codierung des gewählten Rampenschalterausgangs" ULONG OneToOne 1 100 0.00 4294967295.00 FORMAT "%13.2" ECU_ADDRESS 0x9FE5F0 /end MEASUREMENT
/begin MEASUREMENT IndSys_stVacRaw_mp "Roher Unterdruck-Status nach Entprellung" UBYTE OneToOne 1 100 0.00 255.0 FORMAT "%5.1" ECU_ADDRESS 0x9FFF0C /end MEASUREMENT
/begin MEASUREMENT IndSys_stWrite_mp "Zustand des Schreibens vom Wert IndSys_pAdj in das EEPROM" SWORD OneToOne 1 100 -32768.00 32767.00 FORMAT "%8.2" ECU_ADDRESS 0x9FF51C /end MEASUREMENT
/begin MEASUREMENT IndSys_swtLdDet_mp "Wert der Drallklappe eingefroren" UBYTE OneToOne 1 100 0.00 255.0 FORMAT "%5.1" ECU_ADDRESS 0x9FFF0A /end MEASUREMENT
/begin MEASUREMENT IndSys_swtVacMonOn "Unterdruck Überwachung erlaubt (0) , nicht erlaubt (1)" UBYTE OneToOne 1 100 0.00 255.0 FORMAT "%5.1" ECU_ADDRESS 0x7F94B9 /end MEASUREMENT
/begin MEASUREMENT InjCrv_ctPoI2HC_mp "Zylinderzähler für die Auswahl des verlängerten Zylinders bei PoI2 HC" UBYTE OneToOne 1 100 0.00 255.0 FORMAT "%5.1" ECU_ADDRESS 0x9FFF12 /end MEASUREMENT
/begin MEASUREMENT InjCrv_ctRevCor3_mp "Förderbeginnberechnung Umdrehungsschwelle Korrekturwert 3" SWORD OneToOne 1 100 -32768.00 32767.00 FORMAT "%8.2" ECU_ADDRESS 0x9FF544 /end MEASUREMENT
/begin MEASUREMENT InjCrv_ctT3DiaMax_mp "Entprellzähler für Max Fehler des Fehlerpfades Dfp_InjCrvT3Max_mp" SWORD OneToOne 1 100 -32768.00 32767.00 FORMAT "%8.2" ECU_ADDRESS 0x9FF5EA /end MEASUREMENT
/begin MEASUREMENT InjCrv_ctT3DiaMin_mp "Entprellzähler für Min Fehler des Fehlerpfades Dfp_InjCrvT3Min_mp" SWORD OneToOne 1 100 -32768.00 32767.00 FORMAT "%8.2" ECU_ADDRESS 0x7FDDFC /end MEASUREMENT
/begin MEASUREMENT InjCrv_dfacPoI2LmbdKp_mp "Wert der Einschaltrampe des Lambdareglers" UWORD Fact_U1601 1 100 0.00 1.000000 FORMAT "%8.6" ECU_ADDRESS 0x9FF5B4 /end MEASUREMENT
/begin MEASUREMENT InjCrv_dfacPoI2LmbdT3Kp_mp "Einschaltrampe des T3-Reglers" UWORD Fact_U1601 1 100 0.00 1.000000 FORMAT "%8.6" ECU_ADDRESS 0x9FF5D4 /end MEASUREMENT
/begin MEASUREMENT InjCrv_drLmbdT3MinDev_mp "Sollwert fuer Lambdaregler-Minimum minus momentaner Lambda-Wert (fuer T3-Regler)" SWORD lambda 1 100 -32.76800 32.76700 FORMAT "%8.5" ECU_ADDRESS 0x9FF5D6 /end MEASUREMENT
/begin MEASUREMENT InjCrv_drPoI2LmbdMinDev_mp "Sollwert fuer Lambdaregler-Minimum minus momentaner Lambda-Wert (fuer Lambda-Regler)" SWORD lambda 1 100 -32.76800 32.76700 FORMAT "%8.5" ECU_ADDRESS 0x9FF5B6 /end MEASUREMENT
/begin MEASUREMENT InjCrv_drPoI2LmbdT3Out_mp "Ausgangssignal des T3-Reglers" SWORD lambda 1 100 -32.76800 32.76700 FORMAT "%8.5" ECU_ADDRESS 0x9FF5D8 /end MEASUREMENT
/begin MEASUREMENT InjCrv_facEGTWghCor_mp "Gewichtungsfaktor für Mengenkorrekturwerte" SWORD Fact 1 100 -4.000000 3.999878 FORMAT "%8.6" ECU_ADDRESS 0x9FF56C /end MEASUREMENT
/begin MEASUREMENT InjCrv_facFBDynAirDelta "Skalierungsfaktor zur Korrektur des FB in der Dynamik" SWORD Fact 1 100 -4.000000 3.999878 FORMAT "%8.6" ECU_ADDRESS 0x7F9A5E /end MEASUREMENT
/begin MEASUREMENT InjCrv_facMI1EGTCor_mp "Korrekturwertfaktor für Förderbeginnbrechnung im Regenerationsbetrieb" SWORD Fact 1 100 -4.000000 3.999878 FORMAT "%8.6" ECU_ADDRESS 0x9FF54C /end MEASUREMENT
/begin MEASUREMENT InjCrv_facMI1PCRCor_mp "Korrekturfaktor für die Haupteinspritzung der von der Ladedruckreglerabweichung abhängig ist" SWORD Fact 1 100 -4.000000 3.999878 FORMAT "%8.6" ECU_ADDRESS 0x9FF536 /end MEASUREMENT
/begin MEASUREMENT InjCrv_facPiI1QCor "Mengenkorrekturfaktor der Haupteinspritzmenge auf Grund der Voreinspritzung" SWORD Fact 1 100 -4.000000 3.999878 FORMAT "%8.6" ECU_ADDRESS 0x7F9A60 /end MEASUREMENT
/begin MEASUREMENT InjCrv_facPiI1QCor0_mp "Mengenkorrekturfaktor 0 der Haupteinspritzung auf Grund der Voreinspritzung" SWORD Fact 1 100 -4.000000 3.999878 FORMAT "%8.6" ECU_ADDRESS 0x9FF556 /end MEASUREMENT
/begin MEASUREMENT InjCrv_facPiI1QCor1_mp "Mengenkorrekturfaktor 1 der Haupteinspritzung auf Grund der Voreinspritzung" SWORD Fact 1 100 -4.000000 3.999878 FORMAT "%8.6" ECU_ADDRESS 0x9FF558 /end MEASUREMENT
/begin MEASUREMENT InjCrv_facPiI1QCor2_mp "Mengenkorrekturfaktor 2 der Haupteinspritzung auf Grund der Voreinspritzung" SWORD Fact 1 100 -4.000000 3.999878 FORMAT "%8.6" ECU_ADDRESS 0x9FF55A /end MEASUREMENT
/begin MEASUREMENT InjCrv_facPoI2LmbdKi_mp "Integralverstärkung für Lambda-Regler (im Nacheinspritzbetrieb)" SWORD Fact_GOVILMBD 1 100 -512.0000 511.9844 FORMAT "%8.4" ECU_ADDRESS 0x9FF5B8 /end MEASUREMENT
/begin MEASUREMENT InjCrv_facPoI2LmbdKp_mp "Proportionalverstärkung für Lambda-Regler (im Nacheinspritzbetrieb)" SWORD Fact_GOVPLMBD 1 100 -256.0000 255.9922 FORMAT "%8.4" ECU_ADDRESS 0x9FF5BA /end MEASUREMENT
/begin MEASUREMENT InjCrv_facPoI2LmbdWgh_mp "Gewichtungsfaktor für Lambda-Sollwert Nacheinspritzung" SWORD Fact 1 100 -4.000000 3.999878 FORMAT "%8.6" ECU_ADDRESS 0x9FF5BC /end MEASUREMENT
/begin MEASUREMENT InjCrv_facPoI2PhiWgh_mp "Gewichtungsfaktor für Förderbeginn-Grundwerte" SWORD Fact 1 100 -4.000000 3.999878 FORMAT "%8.6" ECU_ADDRESS 0x9FF586 /end MEASUREMENT
/begin MEASUREMENT InjCrv_facPoI2QCor "Haupteinspritzkorrekturfaktur im Nacheinspritz-Betrieb" SWORD Fact 1 100 -4.000000 3.999878 FORMAT "%8.6" ECU_ADDRESS 0x7F9A62 /end MEASUREMENT
/begin MEASUREMENT InjCrv_facPoI2QCor_mp "Regenerationswert für Mengenkorrekturfaktor Nacheinspritzung" SWORD Fact 1 100 -4.000000 3.999878 FORMAT "%8.6" ECU_ADDRESS 0x9FF574 /end MEASUREMENT
/begin MEASUREMENT InjCrv_facPoI2QntWgh_mp "Gewichtungsfaktor für Mengen-Grundwerte" SWORD Fact 1 100 -4.000000 3.999878 FORMAT "%8.6" ECU_ADDRESS 0x9FF588 /end MEASUREMENT
/begin MEASUREMENT InjCrv_facPreTrbnKi_mp "Integralverstaerkung fuer T3-Regler (im Nacheinspritzbetrieb)" SWORD Fact_GOVIT3 1 100 -64.00000 63.99805 FORMAT "%8.5" ECU_ADDRESS 0x9FF5DA /end MEASUREMENT
/begin MEASUREMENT InjCrv_facPreTrbnKp_mp "Proportionalverstaerkung fuer T3-Regler (im Nacheinspritzbetrieb)" SWORD Fact_GOVPT3 1 100 -128.0000 127.9961 FORMAT "%8.4" ECU_ADDRESS 0x9FF5DC /end MEASUREMENT
/begin MEASUREMENT InjCrv_facT3DiaEnv_mp "Korrekturfaktor zur Bestimmung der Temperatursollwerte" SWORD Fact 1 100 -4.000000 3.999878 FORMAT "%8.6" ECU_ADDRESS 0x9FF5EC /end MEASUREMENT
/begin MEASUREMENT InjCrv_mAirGovDevFlt "Gefilterte Regelabweichung bei ARF" SWORD AirMassPerCyl 1 100 -3276.800 3276.700 FORMAT "%8.3" ECU_ADDRESS 0x7F9A64 /end MEASUREMENT
/begin MEASUREMENT InjCrv_numPiI1 "Voreinspritzbereich" UBYTE OneToOne 1 100 0.00 255.0 FORMAT "%5.1" ECU_ADDRESS 0x7F94BA /end MEASUREMENT
/begin MEASUREMENT InjCrv_numPiI1_mp "Nummer des Kennfeld-Auswahlschalters für die Voreinspritzung" UBYTE OneToOne 1 100 0.00 255.0 FORMAT "%5.1" ECU_ADDRESS 0x9FFF11 /end MEASUREMENT
/begin MEASUREMENT InjCrv_numPoI2HC_mp "Periode der HC-Nacheinspritzung" UBYTE OneToOne 1 100 0.00 255.0 FORMAT "%5.1" ECU_ADDRESS 0x9FFF13 /end MEASUREMENT
/begin MEASUREMENT InjCrv_phiBasGear12_mp "Förderbeginn Grundkennfeld MI1 für Gänge 1 und 2" SWORD AngleCrS 1 100 -768.0000 767.9766 FORMAT "%8.4" ECU_ADDRESS 0x9FF51E /end MEASUREMENT
/begin MEASUREMENT InjCrv_phiBasGear34_mp "Förderbeginn Grundwert MI1 für Gänge 3 und 4" SWORD AngleCrS 1 100 -768.0000 767.9766 FORMAT "%8.4" ECU_ADDRESS 0x9FF520 /end MEASUREMENT
/begin MEASUREMENT InjCrv_phiBasGear56_mp "Förderbeginn Grundwert MI1 für Gänge 5 und 6" SWORD AngleCrS 1 100 -768.0000 767.9766 FORMAT "%8.4" ECU_ADDRESS 0x9FF522 /end MEASUREMENT
/begin MEASUREMENT InjCrv_phiBasNormUnCorr_mp "unkorrigierter FB Grundwert" SWORD AngleCrS 1 100 -768.0000 767.9766 FORMAT "%8.4" ECU_ADDRESS 0x9FF524 /end MEASUREMENT
/begin MEASUREMENT InjCrv_phiBasNorm_mp "SB-Sollwert: Ausgang des Grundkennraums" SWORD AngleCrS 1 100 -768.0000 767.9766 FORMAT "%8.4" ECU_ADDRESS 0x9FF526 /end MEASUREMENT
/begin MEASUREMENT InjCrv_phiCor1_mp "Spritzbeginn-Sollwert Korrekturwert 1" SWORD AngleCrS 1 100 -768.0000 767.9766 FORMAT "%8.4" ECU_ADDRESS 0x9FF538 /end MEASUREMENT
/begin MEASUREMENT InjCrv_phiCor2_mp "Spritzbeginn-Sollwert Korrekturwert 2" SWORD AngleCrS 1 100 -768.0000 767.9766 FORMAT "%8.4" ECU_ADDRESS 0x9FF53A /end MEASUREMENT
/begin MEASUREMENT InjCrv_phiCor3 "Förderbeginn-Sollwert Korrekturwert nach Startrampe" SWORD AngleCrS 1 100 -768.0000 767.9766 FORMAT "%8.4" ECU_ADDRESS 0x7F9A66 /end MEASUREMENT
/begin MEASUREMENT InjCrv_phiCor3Raw_mp "Förderbeginn-Sollwert Korrekturwert 3 vor Rampe" SWORD AngleCrS 1 100 -768.0000 767.9766 FORMAT "%8.4" ECU_ADDRESS 0x9FF546 /end MEASUREMENT
/begin MEASUREMENT InjCrv_phiFBDynCorFlt_mp "Die Winkelkorrektur des FB in der Dynamik (nach PT1-Filter)" SWORD AngleCrS 1 100 -768.0000 767.9766 FORMAT "%8.4" ECU_ADDRESS 0x9FF53C /end MEASUREMENT
/begin MEASUREMENT InjCrv_phiFBDynCorMax_mp "Die maximale Verschiebung des FB in der Dynamik" SWORD AngleCrS 1 100 -768.0000 767.9766 FORMAT "%8.4" ECU_ADDRESS 0x9FF53E /end MEASUREMENT
/begin MEASUREMENT InjCrv_phiFBDynCor_mp "Die Winkelkorrektur des FB in der Dynamik" SWORD AngleCrS 1 100 -768.0000 767.9766 FORMAT "%8.4" ECU_ADDRESS 0x9FF540 /end MEASUREMENT
/begin MEASUREMENT InjCrv_phiMI1 "Förderbeginn gewünschter Bezugswinkel" SWORD AngleCrS 1 100 -768.0000 767.9766 FORMAT "%8.4" ECU_ADDRESS 0x7F9A68 /end MEASUREMENT
/begin MEASUREMENT InjCrv_phiMI1AddCor "Korrekturwinkel für Ansteuerbeginn MI1 in Abhängigkeit kundenspezifischer Funktionen" SWORD AngleCrS 1 100 -768.0000 767.9766 FORMAT "%8.4" ECU_ADDRESS 0x7F9A6A /end MEASUREMENT
/begin MEASUREMENT InjCrv_phiMI1Bas_mp "Grundwert Ansteuerbeginn MI1" SWORD AngleCrS 1 100 -768.0000 767.9766 FORMAT "%8.4" ECU_ADDRESS 0x9FF528 /end MEASUREMENT
/begin MEASUREMENT InjCrv_phiMI1Des "gewünschter Bezugswinkel für Beginn der MI1" SWORD AngleCrS 1 100 -768.0000 767.9766 FORMAT "%8.4" ECU_ADDRESS 0x7F9A6C /end MEASUREMENT
/begin MEASUREMENT InjCrv_phiMI1DesByp_mp "Bypass-Label, Kopie von InjCrv_phiMI1Des" SWORD AngleCrS 1 100 -768.0000 767.9766 FORMAT "%8.4" ECU_ADDRESS 0x9FF548 /end MEASUREMENT
/begin MEASUREMENT InjCrv_phiMI1EGT "Förderbeginn-Sollwert Haupteinspritzung nach EGT-Verarbeitung" SWORD AngleCrS 1 100 -768.0000 767.9766 FORMAT "%8.4" ECU_ADDRESS 0x7F9A6E /end MEASUREMENT
/begin MEASUREMENT InjCrv_phiMI1EGTBas_mp "Basiswert für Förderbeginnberechnung im Regenerationsbetrieb" SWORD AngleCrS 1 100 -768.0000 767.9766 FORMAT "%8.4" ECU_ADDRESS 0x9FF54E /end MEASUREMENT
/begin MEASUREMENT InjCrv_phiMI1EGTCor_mp "Korrekturwertwert für Förderbeginnberechnung im Regenerationsbetrieb" SWORD AngleCrS 1 100 -768.0000 767.9766 FORMAT "%8.4" ECU_ADDRESS 0x9FF550 /end MEASUREMENT
/begin MEASUREMENT InjCrv_phiMI1EGTOfs_mp "Offset für Förderbeginnberechnung im Regenerationsbetrieb" SWORD AngleCrS 1 100 -768.0000 767.9766 FORMAT "%8.4" ECU_ADDRESS 0x9FF552 /end MEASUREMENT
/begin MEASUREMENT InjCrv_phiMI1EGT_mp "Förderbeginn-Sollwert Haupteinspritzung bei Regeneration" SWORD AngleCrS 1 100 -768.0000 767.9766 FORMAT "%8.4" ECU_ADDRESS 0x9FF554 /end MEASUREMENT
/begin MEASUREMENT InjCrv_phiMI1HCDes_mp "gewünschte Bezugswinkelkomponente für Beginn der MI1 während PoI2HC" SWORD AngleCrS 1 100 -768.0000 767.9766 FORMAT "%8.4" ECU_ADDRESS 0x9FF54A /end MEASUREMENT
/begin MEASUREMENT InjCrv_phiMI1PCRCor_mp "Winkelkorrektur für die Haupteinspritzung, die von der Ladedruckreglerabweichung abhängig ist" SWORD AngleCrS 1 100 -768.0000 767.9766 FORMAT "%8.4" ECU_ADDRESS 0x9FF542 /end MEASUREMENT
/begin MEASUREMENT InjCrv_phiMIPCRCor "Korrekturwinkel abh. von PCR_pBGDev und Eng_tEng" SWORD AngleCrS 1 100 -768.0000 767.9766 FORMAT "%8.4" ECU_ADDRESS 0x7F9A70 /end MEASUREMENT
/begin MEASUREMENT InjCrv_phiPiI1Cor "Förderbeginnkorrekturwinkel Haupteinspritzung auf Grund der Voreinspritzung" SWORD AngleCrS 1 100 -768.0000 767.9766 FORMAT "%8.4" ECU_ADDRESS 0x7F9A72 /end MEASUREMENT
/begin MEASUREMENT InjCrv_phiPiI1Cor0_mp "Korrekturwinkel 0 der Haupteinspritzung auf Grund der Voreinspritzung" SWORD AngleCrS 1 100 -768.0000 767.9766 FORMAT "%8.4" ECU_ADDRESS 0x9FF55C /end MEASUREMENT
/begin COMPU_METHOD Acc "Fahrzeugbeschleunigung" RAT_FUNC "%6.5" "[m/s^2]" COEFFS 0 1000 0 0 0 1 /end COMPU_METHOD
/begin COMPU_METHOD AirMassPerCyl "Luftmasse pro Zylinder" RAT_FUNC "%6.3" "[mg/Hub Luft]" COEFFS 0 10 0 0 0 1 /end COMPU_METHOD
/begin COMPU_METHOD AngleCrS "Winkel Kurbelwelle" RAT_FUNC "%6.4" "[deg CrS]" COEFFS 0 42.6666666666667 0 0 0 1 /end COMPU_METHOD
/begin COMPU_METHOD AngMom "Drehimpuls" RAT_FUNC "%6.3" "[Nms]" COEFFS 0 1.953125 0 0 0 1 /end COMPU_METHOD
/begin COMPU_METHOD Dist2_km "Umrechnungsformel für Strecke in km" RAT_FUNC "%6.2" "[km]" COEFFS 0 1 0 0 0 1 /end COMPU_METHOD
/begin COMPU_METHOD dQnt_dT1 "Einspritzmengenabweichung per 100 Kelvin" RAT_FUNC "%6.4" "[(mg/hub)/100C]" COEFFS 0 50 0 0 0 1 /end COMPU_METHOD
/begin COMPU_METHOD DtyCyc "Tastverhaeltnis" RAT_FUNC "%6.4" "[%]" COEFFS 0 100 0 0 0 1 /end COMPU_METHOD
/begin COMPU_METHOD DtyCycCan "Tastverhältnis CAN-Wert" RAT_FUNC "%6.3" "[%]" COEFFS 0 10 0 0 0 1 /end COMPU_METHOD
/begin COMPU_METHOD EngN "Motordrehzahl" RAT_FUNC "%6.2" "[rpm]" COEFFS 0 1 0 0 0 1 /end COMPU_METHOD
/begin COMPU_METHOD Eng_dN "Motorbeschleunigung" RAT_FUNC "%6.2" "rpm/s" COEFFS 0 1 0 0 0 1 /end COMPU_METHOD
/begin COMPU_METHOD Eta "Umrechnugsformel für Wirkungsgradfaktor eta" RAT_FUNC "%6.4" "Nm/(mg/cyc)" COEFFS 0 128 0 0 0 1 /end COMPU_METHOD
/begin COMPU_METHOD Fact "Faktor mit Auflösung 1 / 8192, hauptsächlich für einen Faktorenbereich 0...1 verwendet" RAT_FUNC "%6.5" "[-]" COEFFS 0 8192 0 0 0 1 /end COMPU_METHOD
/begin COMPU_METHOD Fact1 "Faktor mit Auflösung 0,01 (100 mal höherer Bereich als Fact)" RAT_FUNC "%6.4" "[-]" COEFFS 0 128 0 0 0 1 /end COMPU_METHOD
/begin COMPU_METHOD Fact_GOVILMBD "Umrechnungsregel: Integralverstärkung des Lambdareglers" RAT_FUNC "%6.4" "[1/s]" COEFFS 0 64 0 0 0 1 /end COMPU_METHOD
/begin COMPU_METHOD Fact_GOVIT3 "Umrechnungsregel: Integralverstärkung des T3-Reglers" RAT_FUNC "%6.4" "[1/s]" COEFFS 0 512 0 0 0 1 /end COMPU_METHOD
/begin COMPU_METHOD Fact_GOVPLMBD "Umrechnungsregel: Proportionalverstärkung des Lambdareglers" RAT_FUNC "%6.4" "[-]" COEFFS 0 128 0 0 0 1 /end COMPU_METHOD
/begin COMPU_METHOD Fact_GOVPT3 "Umrechnungsregel: Proportional-Verstärkung des T3-Reglers" RAT_FUNC "%6.4" "[-]" COEFFS 0 256 0 0 0 1 /end COMPU_METHOD
/begin COMPU_METHOD Fact_U1601 "Umrechnungsregel: Zahl 0..1 in 16-Bit-Integer (vorzeichenlos)" RAT_FUNC "%7.6" "[-]" COEFFS 0 65535 0 0 0 1 /end COMPU_METHOD
/begin COMPU_METHOD Fl_Half_L "Kraftstoffverbrauchsintegral" RAT_FUNC "%6.3" "[l]" COEFFS 0 2 0 0 0 1 /end COMPU_METHOD
/begin COMPU_METHOD GlwCtl_Time_ms "zur Zeitumrechnung von um den Faktor 10 größeren Zeiten als Time_ms" RAT_FUNC "%6.0" "[ms]" COEFFS 0 0.01 0 0 0 1 /end COMPU_METHOD
/begin COMPU_METHOD InjMass "Einspritzmenge" RAT_FUNC "%6.4" "[mg/hub]" COEFFS 0 100 0 0 0 1 /end COMPU_METHOD
/begin COMPU_METHOD InjMassCorr "Korrektureinspritzmenge" RAT_FUNC "%6.5" "[mg/hub]" COEFFS 0 1000 0 0 0 1 /end COMPU_METHOD
/begin COMPU_METHOD InjMassCyc "Einspritzmenge pro Zyklus (mg/Zyklus)" RAT_FUNC "%6.4" "[mg/cyc]" COEFFS 0 100 0 0 0 1 /end COMPU_METHOD
/begin COMPU_METHOD InjMassPerSecHCI "Einspritzmenge pro Sekunde für HC Einspritzung" RAT_FUNC "%6.3" "[mg/s]" COEFFS 0 10 0 0 0 1 /end COMPU_METHOD
/begin COMPU_METHOD InjMassSec "Einspritzmenge pro Sekunde" RAT_FUNC "%6.4" "[mg/hub/s]" COEFFS 0 100 0 0 0 1 /end COMPU_METHOD
/begin COMPU_METHOD lambda "Lambda" RAT_FUNC "%6.5" "[-]" COEFFS 0 1000 0 0 0 1 /end COMPU_METHOD
/begin COMPU_METHOD lambdaRec "Kehrwert von Lambda" RAT_FUNC "%7.6" "[-]" COEFFS 0 10000 0 0 0 1 /end COMPU_METHOD
/begin COMPU_METHOD lambdaSec "Lambda Aenderungsrate" RAT_FUNC "%6.5" "[-/s]" COEFFS 0 1000 0 0 0 1 /end COMPU_METHOD
/begin COMPU_METHOD Length "Länge in Meter" RAT_FUNC "%6.2" "[m]" COEFFS 0 1 0 0 0 1 /end COMPU_METHOD
/begin COMPU_METHOD Length_mm "Länge in mm" RAT_FUNC "%6.4" "[mm]" COEFFS 0 128 0 0 0 1 /end COMPU_METHOD
/begin COMPU_METHOD OneToOne "eins zu eins (physikalischer Wert ist gleich dem internen Wert)" RAT_FUNC "%6.2" "[-]" COEFFS 0 1 0 0 0 1 /end COMPU_METHOD
/begin COMPU_METHOD PhiSteer "Lenkwinkel in Grad, Umrechnung vom CAN in internen Wert" RAT_FUNC "%6.3" "[deg]" COEFFS 0 10 0 0 0 1 /end COMPU_METHOD
/begin COMPU_METHOD Prc "Prozent, gleiche interne Auflösung wie Fact, aber Darstellung in Prozent (0...100%)" RAT_FUNC "%6.4" "[%]" COEFFS 0 100 0 0 0 1 /end COMPU_METHOD
/begin COMPU_METHOD PrcHigh "Höch prozentanteil auflösung" RAT_FUNC "%6.5" "[%]" COEFFS 0 1000 0 0 0 1 /end COMPU_METHOD
/begin COMPU_METHOD Prc_D4ms_FrmMng "Prozent fuer 20ms - Task fuer FrmMng" RAT_FUNC "%6.1" "[%/s]" COEFFS 0 0.04 0 0 0 1 /end COMPU_METHOD
/begin COMPU_METHOD Prc_FrmMng "Prozent (0...100%) fuer FrmMng" RAT_FUNC "%6.3" "[%]" COEFFS 0 2.5 0 0 0 1 /end COMPU_METHOD
/begin COMPU_METHOD Prc_Soot "Auflösung für Russmasse, höhere Auflösung als Prc (1/512)" RAT_FUNC "%6.4" "[%/sample]" COEFFS 0 512 0 0 0 1 /end COMPU_METHOD
/begin COMPU_METHOD Prc_Soot32 "Rußmengenumrechnung" RAT_FUNC "%6.4" "[%]" COEFFS 0 512 0 0 0 1 /end COMPU_METHOD
/begin COMPU_METHOD PresAC_hPa "Druck (Klimatisierung) angezeigt in [hPa]" RAT_FUNC "%6.2" "[hPa]" COEFFS 0 0.5 0 0 0 1 /end COMPU_METHOD
/begin COMPU_METHOD PresPerSec "Difference pressure per second" RAT_FUNC "%6.1" "[hPa/s]" COEFFS 0 0.1 0 0 0 1 /end COMPU_METHOD
/begin COMPU_METHOD Pres_bar "Druck (angezeigt in bar)" RAT_FUNC "%6.4" "[Bar]" COEFFS 0 16 0 0 0 1 /end COMPU_METHOD
/begin COMPU_METHOD Pres_hPa "Druck (angezeigt in [hPa])" RAT_FUNC "%6.2" "[hPa]" COEFFS 0 1 0 0 0 1 /end COMPU_METHOD
/begin COMPU_METHOD Pres_Rail "Raildruck in hPa" RAT_FUNC "%6.0" "[hPa]" COEFFS 0 0.01 0 0 0 1 /end COMPU_METHOD
/begin COMPU_METHOD Pres_SI "Druck (angezeigt in [Pa])" RAT_FUNC "%6.0" "[Pa]" COEFFS 0 0.01 0 0 0 1 /end COMPU_METHOD
/begin COMPU_METHOD Pwr "Leistung" RAT_FUNC "%6.2" "[W]" COEFFS 0 0.10610329539459 0 0 0 1 /end COMPU_METHOD
/begin COMPU_METHOD Pwr_HiRes "Hochaufloesung der Leistung" RAT_FUNC "%6.3" "[W]" COEFFS 0 2 0 0 0 1 /end COMPU_METHOD
/begin COMPU_METHOD Pwr_J_Sec "Leistung in Watt (Joule pro Sekunde)" RAT_FUNC "%6.1" "[W]" COEFFS 0 0.1 0 0 0 1 /end COMPU_METHOD
/begin COMPU_METHOD P_Class "Umwandlung von kw in Internen Wert" RAT_FUNC "%6.2" "[kW]" COEFFS 0 1 0 0 0 1 /end COMPU_METHOD
/begin COMPU_METHOD RatAirMass "Luftmassenverhältnis" RAT_FUNC "%6.4" "[-]" COEFFS 0 100 0 0 0 1 /end COMPU_METHOD
/begin COMPU_METHOD RatFuelMass "Kraftstoffmassenverhältnis" RAT_FUNC "%6.4" "[-]" COEFFS 0 100 0 0 0 1 /end COMPU_METHOD
/begin COMPU_METHOD RhoFuel "Kraftstoffdichte" RAT_FUNC "%6.3" "[kg/m^3]" COEFFS 0 10 0 0 0 1 /end COMPU_METHOD
/begin COMPU_METHOD RmpAccCan "Rate of change of acceleration m/s2/s" RAT_FUNC "%6.4" "[m/s^2/s]" COEFFS 0 100 0 0 0 1 /end COMPU_METHOD
/begin COMPU_METHOD RmpAirMassPerTimeLow "Luftmasse Rampensteigung" RAT_FUNC "%6.2" "[(kg/h)/s]" COEFFS 0 1 0 0 0 1 /end COMPU_METHOD
/begin COMPU_METHOD rRmpTrq "Drehmomentverhältnisgradient" RAT_FUNC "%6.4" "[%/s]" COEFFS 0 167.11674150914 0 0 0 1 /end COMPU_METHOD
/begin COMPU_METHOD rTrqCAN "Momentenverhältnis für CAN" RAT_FUNC "%6.3" "[%]" COEFFS 0 2.54999910750031 0 0 0 1 /end COMPU_METHOD
/begin COMPU_METHOD SqrVltg_s "Umrechnung für Batterie-Spannungs-Quadrat mehr als eine Sekunde" RAT_FUNC "%6.3" "[V^2s]" COEFFS 0 10 0 0 0 1 /end COMPU_METHOD
/begin COMPU_METHOD TempCels_100ms "Temperatur Differenz in Grad C/sec (bezgl. 100ms task)" RAT_FUNC "%6.2" "deg C/s" COEFFS 0 1 0 0 0 1 /end COMPU_METHOD
/begin COMPU_METHOD TempDiff_Kelv "Offsettemperatur dargestellt in [K]" RAT_FUNC "%6.3" "[ deg C ]" COEFFS 0 10 0 0 0 1 /end COMPU_METHOD
/begin COMPU_METHOD Temp_Cels "Temperatur dargestellt in °C (gleiche interne Darstellung wie Temp_Kelv)" RAT_FUNC "%6.1" "[deg C]" COEFFS 0 10 2731.4 0 0 1 /end COMPU_METHOD
/begin COMPU_METHOD Temp_Kelv "Temperatur dargestellt in Kelvin" RAT_FUNC "%6.3" "[ deg C ]" COEFFS 0 10 0 0 0 1 /end COMPU_METHOD
/begin COMPU_METHOD TimeCAN_TO_ms "Umrechnung von einer Inputzeit (ms) in eine Nummer" RAT_FUNC "%6.1" "[ms]" COEFFS 0 0.05 -1 0 0 1 /end COMPU_METHOD
/begin COMPU_METHOD TimeEngOn "Motorbetriebszeit in Sekunden" RAT_FUNC "%6.2" "[s]" COEFFS 0 1 0 0 0 1 /end COMPU_METHOD
/begin COMPU_METHOD Time_HighRes "Höhere Auflösung für Zeit in Sekunden" RAT_FUNC "%6.3" "[ms]" COEFFS 0 8 0 0 0 1 /end COMPU_METHOD
/begin COMPU_METHOD Time_ms "Zeit in ms für Fehlerentprellung (DSM) und SW-Timer" RAT_FUNC "%6.1" "[ms]" COEFFS 0 0.1 0 0 0 1 /end COMPU_METHOD
/begin COMPU_METHOD Time_PwmHigh "Periodenzeit von der HWE (Tio_PwmGetAvrg)" RAT_FUNC "%6.3" "[us]" COEFFS 0 10 0 0 0 1 /end COMPU_METHOD
/begin COMPU_METHOD Time_RtmLowRes "Zeit mit niedriger Auflösung für Laufzeitmessung" RAT_FUNC "%6.3" "[ms]" COEFFS 0 10 0 0 0 1 /end COMPU_METHOD
/begin COMPU_METHOD TransR "Übersetzungsverhältnis (Getriebe etc.)" RAT_FUNC "%6.4" "[-]" COEFFS 0 100 0 0 0 1 /end COMPU_METHOD
/begin COMPU_METHOD TrnvrsAcc "Umrechnung für Querbeschleunigung" RAT_FUNC "%6.4" "[g]" COEFFS 0 100 0 0 0 1 /end COMPU_METHOD
/begin COMPU_METHOD Trq "Motormoment" RAT_FUNC "%6.3" "[Nm]" COEFFS 0 10 0 0 0 1 /end COMPU_METHOD
/begin COMPU_METHOD TrqPerSec "Motormomentengradient" RAT_FUNC "%6.2" "[Nm/s]" COEFFS 0 1 0 0 0 1 /end COMPU_METHOD
/begin COMPU_METHOD TrqPrpHigh "vortriebsmoment" RAT_FUNC "%6.3" "[Nm]" COEFFS 0 10 0 0 0 1 /end COMPU_METHOD
/begin COMPU_METHOD Vel "Fahrzeuggeschwindigkeit, gleiche interne Auflösung wie Vel_SI" RAT_FUNC "%6.4" "[km/h]" COEFFS 0 100 0 0 0 1 /end COMPU_METHOD
/begin COMPU_METHOD VelToN "Verhältnis Fahrzeuggeschwindigkeit zu Motordrehzahl v/n" RAT_FUNC "%8.7" "[(km/h)/rpm]" COEFFS 0 100000 0 0 0 1 /end COMPU_METHOD
/begin COMPU_METHOD Volt "Spannung in V (von ADC)" RAT_FUNC "%6.2" "[mV]" COEFFS 0 0.2046 0 0 0 1 /end COMPU_METHOD
/begin COMPU_METHOD VPhiSteer "Lenkwinkelgeschwindigkeit in Grad, Umrechnung vom CAN in internen Wert" RAT_FUNC "%6.3" "[deg/s]" COEFFS 0 10 0 0 0 1 /end COMPU_METHOD
/end MODULE
/end PROJECT
