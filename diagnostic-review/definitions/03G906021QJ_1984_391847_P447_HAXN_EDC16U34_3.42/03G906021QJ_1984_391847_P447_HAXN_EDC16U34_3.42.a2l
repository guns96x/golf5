/* Erstellt von DAMOS++ V1.20-1 SunOS */
ASAP2_VERSION 1 3
/begin PROJECT X447 "EDC16U34"
/begin HEADER "" VERSION "VAA1" PROJECT_NO X447 /end HEADER
/begin MODULE DIM ""
/begin MOD_PAR "EDC16U34" VERSION "xxxxxx" CUSTOMER_NO "3" USER "DS/SVW" PHONE_NO "X" CPU_TYPE "SilverOak" ECU "SIO"
 /begin MEMORY_SEGMENT Pst10000 "" RESERVED FLASH INTERN 0x10000 0x1E8 -1 -1 -1 -1 -1 /begin IF_DATA ETK ADDRESS_MAPPING 0x10000 0x10000 0x1E8 /end IF_DATA /end MEMORY_SEGMENT
 /begin MEMORY_SEGMENT Pst101E8 "" CODE FLASH INTERN 0x101E8 0x27C94 -1 -1 -1 -1 -1 /begin IF_DATA ETK ADDRESS_MAPPING 0x101E8 0x101E8 0x27C94 /end IF_DATA /end MEMORY_SEGMENT
 /begin MEMORY_SEGMENT Pst37E7C "" RESERVED FLASH INTERN 0x37E7C 0x8184 -1 -1 -1 -1 -1 /begin IF_DATA ETK ADDRESS_MAPPING 0x37E7C 0x37E7C 0x8184 /end IF_DATA /end MEMORY_SEGMENT
 /begin MEMORY_SEGMENT Pst40000 "" RESERVED FLASH INTERN 0x40000 0x58 -1 -1 -1 -1 -1 /begin IF_DATA ETK ADDRESS_MAPPING 0x40000 0x40000 0x58 /end IF_DATA /end MEMORY_SEGMENT
 /begin MEMORY_SEGMENT Pst40058 "" CODE FLASH INTERN 0x40058 0x5FF20 -1 -1 -1 -1 -1 /begin IF_DATA ETK ADDRESS_MAPPING 0x40058 0x40058 0x5FF20 /end IF_DATA /end MEMORY_SEGMENT
 /begin MEMORY_SEGMENT Pst9FF78 "" RESERVED FLASH INTERN 0x9FF78 0x88 -1 -1 -1 -1 -1 /begin IF_DATA ETK ADDRESS_MAPPING 0x9FF78 0x9FF78 0x88 /end IF_DATA /end MEMORY_SEGMENT
 /begin MEMORY_SEGMENT PstA0000 "" CODE FLASH INTERN 0xA0000 0xDFF78 -1 -1 -1 -1 -1 /begin IF_DATA ETK ADDRESS_MAPPING 0xA0000 0xA0000 0xDFF78 /end IF_DATA /end MEMORY_SEGMENT
 /begin MEMORY_SEGMENT Pst17FF78 "" RESERVED FLASH INTERN 0x17FF78 0x88 -1 -1 -1 -1 -1 /begin IF_DATA ETK ADDRESS_MAPPING 0x17FF78 0x17FF78 0x88 /end IF_DATA /end MEMORY_SEGMENT
 /begin MEMORY_SEGMENT Pst180000 "" RESERVED FLASH INTERN 0x180000 0x40000 -1 -1 -1 -1 -1 /begin IF_DATA ETK ADDRESS_MAPPING 0x180000 0x180000 0x40000 /end IF_DATA /end MEMORY_SEGMENT
 /begin MEMORY_SEGMENT Dst1C0000 "" OFFLINE_DATA FLASH INTERN 0x1C0000 0x58 -1 -1 -1 -1 -1 /begin IF_DATA ETK ADDRESS_MAPPING 0x1C0000 0x11C0000 0x58 /end IF_DATA /end MEMORY_SEGMENT
 /begin MEMORY_SEGMENT Dst1C0058 "" DATA FLASH INTERN 0x1C0058 0x3DF20 -1 -1 -1 -1 -1 /begin IF_DATA ETK ADDRESS_MAPPING 0x1C0058 0x11C0058 0x3DF20 /end IF_DATA /end MEMORY_SEGMENT
 /begin MEMORY_SEGMENT Dst1FDF78 "" RESERVED FLASH INTERN 0x1FDF78 0x88 -1 -1 -1 -1 -1 /begin IF_DATA ETK ADDRESS_MAPPING 0x1FDF78 0x11FDF78 0x88 /end IF_DATA /end MEMORY_SEGMENT
 /begin MEMORY_SEGMENT ExtRam9FE000 "" VARIABLES RAM EXTERN 0x9FE000 0x2000 -1 -1 -1 -1 -1 /* AsapMLXFm - CCP_V2_3 */ /begin IF_DATA ETK ADDRESS_MAPPING 0x9FE000 0x9FE000 0x2000 /end IF_DATA /* AsapMLXFm - KWP2000 */ /* AsapMLXFm - McMess */ /end MEMORY_SEGMENT
 /begin MEMORY_SEGMENT Ram7F8000 "" VARIABLES RAM INTERN 0x7F8000 0x8000 -1 -1 -1 -1 -1 /end MEMORY_SEGMENT
 /begin MEMORY_SEGMENT Ram800000 "" VARIABLES RAM INTERN 0x800000 0x8000 -1 -1 -1 -1 -1 /end MEMORY_SEGMENT
 SYSTEM_CONSTANT "ACCCD_AACCELTHRES_CUR_X" "5"
 SYSTEM_CONSTANT "ACCCD_ADDRAGLIM_CUR_X" "5"
 SYSTEM_CONSTANT "ACCCD_ADESLIMNEG_CUR_X" "5"
 SYSTEM_CONSTANT "ACCCD_ADESLIMPOS_CUR_X" "5"
 SYSTEM_CONSTANT "ACCCD_FACATRNVRS_CUR_X" "7"
 SYSTEM_CONSTANT "ACCCD_FACCOSPHI_CUR_X" "35"
 SYSTEM_CONSTANT "ACCCD_FACENV_MAP_X" "6"
 SYSTEM_CONSTANT "ACCCD_FACENV_MAP_Y" "6"
 SYSTEM_CONSTANT "ACCCD_FACKICORR_CUR_X" "6"
 SYSTEM_CONSTANT "ACCCD_FACKIPOSCORR_CUR_X" "6"
 SYSTEM_CONSTANT "ACCCD_FACKPCORR_CUR_X" "6"
 SYSTEM_CONSTANT "ACCCD_FACKPPOSCORR_CUR_X" "6"
 SYSTEM_CONSTANT "ACCCD_FACSINPHI_CUR_X" "35"
 SYSTEM_CONSTANT "ACCCD_FRSTRTFRC_CUR_X" "6"
 SYSTEM_CONSTANT "ACCCD_IKIPOS_MAP_X" "6"
 SYSTEM_CONSTANT "ACCCD_IKIPOS_MAP_Y" "8"
 SYSTEM_CONSTANT "ACCCD_IKI_CUR_X" "6"
 SYSTEM_CONSTANT "ACCCD_PHIARCSIN_CUR_X" "35"
 SYSTEM_CONSTANT "ACCCD_PKPBRKLIM_CUR_X" "5"
 SYSTEM_CONSTANT "ACCCD_PKPBRK_CUR_X" "6"
 SYSTEM_CONSTANT "ACCCD_PKPPOS_MAP_X" "6"
 SYSTEM_CONSTANT "ACCCD_PKPPOS_MAP_Y" "8"
 SYSTEM_CONSTANT "ACCCD_PKP_CUR_X" "6"
 SYSTEM_CONSTANT "ACCCD_TIACCDRAGFLT_MAP_X" "6"
 SYSTEM_CONSTANT "ACCCD_TIACCDRAGFLT_MAP_Y" "6"
 SYSTEM_CONSTANT "ACCCD_TRQBRKZERO_CUR_X" "5"
 SYSTEM_CONSTANT "ACCD_ACTYPE_CAN" "2"
 SYSTEM_CONSTANT "ACCD_ACTYPE_DIG" "1"
 SYSTEM_CONSTANT "ACCD_ACTYPE_NOTPRESENT" "0"
 SYSTEM_CONSTANT "ACCD_PANALIN_CUR_X" "25"
 SYSTEM_CONSTANT "ACCD_PPRESLIN_CUR_X" "25"
 SYSTEM_CONSTANT "ACCD_RLIN_CUR_X" "2"
 SYSTEM_CONSTANT "ACCD_SWTACTYPE_TYPE" "2"
 SYSTEM_CONSTANT "ACCD_SWTACTYPE_VAL" "1"
 SYSTEM_CONSTANT "ACCD_SWTSIG_TYPE" "2"
 SYSTEM_CONSTANT "ACCD_SWTSIG_VAL" "0"
 SYSTEM_CONSTANT "ACCD_TIACSTRTDLY_CUR_X" "4"
 SYSTEM_CONSTANT "ACCPED_DNDORMPSLPPOS_CUR_X" "6"
 SYSTEM_CONSTANT "ACCPED_DNDOSETP_MAP_X" "6"
 SYSTEM_CONSTANT "ACCPED_DNDOSETP_MAP_Y" "6"
 SYSTEM_CONSTANT "ACCPED_FACAPPWNTRMODE0_MAP_X" "16"
 SYSTEM_CONSTANT "ACCPED_FACAPPWNTRMODE0_MAP_Y" "8"
 SYSTEM_CONSTANT "ACCPED_NPWINDO_CUR_X" "6"
 SYSTEM_CONSTANT "ACCPED_PKPDO_CUR_X" "6"
 SYSTEM_CONSTANT "ACCPED_PKPSIGDO_CUR_X" "6"
 SYSTEM_CONSTANT "ACCPED_RAPPWNTRMODE0_MAP_X" "16"
 SYSTEM_CONSTANT "ACCPED_RAPPWNTRMODE0_MAP_Y" "9"
 SYSTEM_CONSTANT "ACCPED_STGEARSEL_CUR_X" "7"
 SYSTEM_CONSTANT "ACCPED_TRQENG0_MAP_X" "16"
 SYSTEM_CONSTANT "ACCPED_TRQENG0_MAP_Y" "9"
 SYSTEM_CONSTANT "ACCPED_TRQENG1_MAP_X" "16"
 SYSTEM_CONSTANT "ACCPED_TRQENG1_MAP_Y" "9"
 SYSTEM_CONSTANT "ACCPED_TRQENG2_MAP_X" "16"
 SYSTEM_CONSTANT "ACCPED_TRQENG2_MAP_Y" "9"
 SYSTEM_CONSTANT "ACCPED_TRQENG3_MAP_X" "16"
 SYSTEM_CONSTANT "ACCPED_TRQENG3_MAP_Y" "9"
 SYSTEM_CONSTANT "ACCPED_TRQENG4_MAP_X" "16"
 SYSTEM_CONSTANT "ACCPED_TRQENG4_MAP_Y" "9"
 SYSTEM_CONSTANT "ACCPED_TRQENG5_MAP_X" "16"
 SYSTEM_CONSTANT "ACCPED_TRQENG5_MAP_Y" "9"
 SYSTEM_CONSTANT "ACCPED_TRQENG6_MAP_X" "16"
 SYSTEM_CONSTANT "ACCPED_TRQENG6_MAP_Y" "9"
 SYSTEM_CONSTANT "ACCPED_TRQENGLIM_MAP_X" "6"
 SYSTEM_CONSTANT "ACCPED_TRQENGLIM_MAP_Y" "7"
 SYSTEM_CONSTANT "ACCPED_TRQENGLOW_MAP_X" "16"
 SYSTEM_CONSTANT "ACCPED_TRQENGLOW_MAP_Y" "9"
 SYSTEM_CONSTANT "ACCPED_TRQPRPSPORT_MAP_X" "12"
 SYSTEM_CONSTANT "ACCPED_TRQPRPSPORT_MAP_Y" "8"
 SYSTEM_CONSTANT "ACCPED_TRQPRP_MAP_X" "12"
 SYSTEM_CONSTANT "ACCPED_TRQPRP_MAP_Y" "8"
 SYSTEM_CONSTANT "ACCTL_TIDAMAX_MAP_X" "4"
 SYSTEM_CONSTANT "ACCTL_TIDAMAX_MAP_Y" "4"
 SYSTEM_CONSTANT "ACCTL_TIDAMIN_MAP_X" "4"
 SYSTEM_CONSTANT "ACCTL_TIDAMIN_MAP_Y" "4"
 SYSTEM_CONSTANT "ACCTL_TWTHI_CUR_X" "3"
 SYSTEM_CONSTANT "ACC_DTRQBRKHOLD_CUR" "9"
 SYSTEM_CONSTANT "ACC_DTRQBRKLOW_CUR" "9"
 SYSTEM_CONSTANT "ACC_DTRQBRKRMPDWN_CUR" "2"
 SYSTEM_CONSTANT "ACC_DTRQBRKRMPUP_CUR" "2"
 SYSTEM_CONSTANT "ACC_NORM_FAC" "2777777.77777778"
 SYSTEM_CONSTANT "ACC_RBRK_CUR_X" "8"
 SYSTEM_CONSTANT "ACC_RES" "0.001"
 SYSTEM_CONSTANT "ACC_RES_INV" "1000"
 SYSTEM_CONSTANT "ACC_REV_RES" "1"
 SYSTEM_CONSTANT "ACC_TISOFTBRKLOW_CUR" "9"
 SYSTEM_CONSTANT "ACC_TRQBRKHOLD_CUR" "9"
 SYSTEM_CONSTANT "ACC_TRQBRKLOW_CUR" "9"
 SYSTEM_CONSTANT "ACC_TRQCORR_CUR_X" "6"
 SYSTEM_CONSTANT "ACC_UNUSED" "1"
 SYSTEM_CONSTANT "ACC_VSOFTBRKHI_CUR" "9"
 SYSTEM_CONSTANT "ACC_ZERO" "0"
 SYSTEM_CONSTANT "ACTRQC_SWTCALC_ACCDP" "1"
 SYSTEM_CONSTANT "ACTRQC_SWTCALC_CAN" "2"
 SYSTEM_CONSTANT "ACTRQC_SWTCALC_IATSCD" "0"
 SYSTEM_CONSTANT "ACTRQC_TRQCONV_MAP_X" "8"
 SYSTEM_CONSTANT "ACTRQC_TRQCONV_MAP_Y" "8"
 SYSTEM_CONSTANT "ADCMON_UREFLIN_CUR_X" "2"
 SYSTEM_CONSTANT "ADCMON_UTSTIMP_CUR_X" "2"
 SYSTEM_CONSTANT "ADC_RES" "1023"
 SYSTEM_CONSTANT "ADD2ASH_EXP" "0"
 SYSTEM_CONSTANT "ADDPCD_STTNKLVLLIN_CUR_X" "2"
 SYSTEM_CONSTANT "ADDPCD_TION_CUR_X" "8"
 SYSTEM_CONSTANT "ADDPMP_SWTSERVICE_TYPE" "2"
 SYSTEM_CONSTANT "ADDPMP_SWTSERVICE_VAL" "0"
 SYSTEM_CONSTANT "ADDPMP_VOLADDDEM_CUR_X" "4"
 SYSTEM_CONSTANT "AFSCD_DMCORRAIRPERTIME_CUR_X" "30"
 SYSTEM_CONSTANT "AFSCD_DMCORVAL_MAP_X" "16"
 SYSTEM_CONSTANT "AFSCD_DMCORVAL_MAP_Y" "16"
 SYSTEM_CONSTANT "AFSCD_DMLIN2_CUR_X" "32"
 SYSTEM_CONSTANT "AFSCD_DMLIN_CUR_X" "32"
 SYSTEM_CONSTANT "AFSCD_DOUBLE" "2"
 SYSTEM_CONSTANT "AFSCD_DUALBRANCH" "3"
 SYSTEM_CONSTANT "AFSCD_FACAIRPERCYLCOR2_MAP_X" "8"
 SYSTEM_CONSTANT "AFSCD_FACAIRPERCYLCOR2_MAP_Y" "8"
 SYSTEM_CONSTANT "AFSCD_FACAIRPERCYLCOR_MAP_X" "8"
 SYSTEM_CONSTANT "AFSCD_FACAIRPERCYLCOR_MAP_Y" "8"
 SYSTEM_CONSTANT "AFSCD_FACAIRRAW2_MAP_X" "10"
 SYSTEM_CONSTANT "AFSCD_FACAIRRAW2_MAP_Y" "10"
 SYSTEM_CONSTANT "AFSCD_FACAIRRAW_MAP_X" "10"
 SYSTEM_CONSTANT "AFSCD_FACAIRRAW_MAP_Y" "10"
 SYSTEM_CONSTANT "AFSCD_FACCORRVAL_MAP_X" "10"
 SYSTEM_CONSTANT "AFSCD_FACCORRVAL_MAP_Y" "12"
 SYSTEM_CONSTANT "AFSCD_FACPLSCOR2_MAP_X" "16"
 SYSTEM_CONSTANT "AFSCD_FACPLSCOR2_MAP_Y" "16"
 SYSTEM_CONSTANT "AFSCD_FACPLSCOR_MAP_X" "16"
 SYSTEM_CONSTANT "AFSCD_FACPLSCOR_MAP_Y" "16"
 SYSTEM_CONSTANT "AFSCD_MAIRCONV" "33333"
 SYSTEM_CONSTANT "AFSCD_MAIRPERCYLDFL2_MAP_X" "8"
 SYSTEM_CONSTANT "AFSCD_MAIRPERCYLDFL2_MAP_Y" "8"
 SYSTEM_CONSTANT "AFSCD_MAIRPERCYLDFL_MAP_X" "8"
 SYSTEM_CONSTANT "AFSCD_MAIRPERCYLDFL_MAP_Y" "8"
 SYSTEM_CONSTANT "AFSCD_MCORVAL_MAP_X" "16"
 SYSTEM_CONSTANT "AFSCD_MCORVAL_MAP_Y" "16"
 SYSTEM_CONSTANT "AFSCD_MDIFFMAX_CUR_X" "6"
 SYSTEM_CONSTANT "AFSCD_QAIRMTHRSRCHIACTV_CUR_X" "12"
 SYSTEM_CONSTANT "AFSCD_SENSSEL_SWT" "5"
 SYSTEM_CONSTANT "AFSCD_SINGLE" "1"
 SYSTEM_CONSTANT "AFSCD_SWTAIRSYS_TYPE" "0"
 SYSTEM_CONSTANT "AFSCD_SWTAIRSYS_VAL" "1"
 SYSTEM_CONSTANT "AFSCD_SWTAVR" "1"
 SYSTEM_CONSTANT "AFSCD_SWTDIR" "0"
 SYSTEM_CONSTANT "AFSCD_SWTMAX" "2"
 SYSTEM_CONSTANT "AFSCD_SWTMIN" "3"
 SYSTEM_CONSTANT "AFSCD_SWTSENSINST_TYPE" "2"
 SYSTEM_CONSTANT "AFSCD_SWTSENSINST_VAL" "1"
 SYSTEM_CONSTANT "AFSCD_SWTSENS_INST" "1"
 SYSTEM_CONSTANT "AFSCD_SWTSENS_NOTINST" "0"
 SYSTEM_CONSTANT "AFSCD_SWTSEPARATE_TYPE" "0"
 SYSTEM_CONSTANT "AFSCD_SWTSEPARATE_VAL" "0"
 SYSTEM_CONSTANT "AFSCD_SWT_HFM5" "5"
 SYSTEM_CONSTANT "AFSCD_SWT_HFM6" "6"
 SYSTEM_CONSTANT "AFSCD_SWT_HFM6_DOUBLE" "7"
 SYSTEM_CONSTANT "AFSCD_SWT_HFM6_SINGLE" "6"
 SYSTEM_CONSTANT "AFSCD_TAIRTEMPCORR2_CUR_X" "25"
 SYSTEM_CONSTANT "AFSCD_TAIRTEMPCORR_CUR_X" "25"
 SYSTEM_CONSTANT "AGC_RES" "0.1"
 SYSTEM_CONSTANT "AIRCTLGOVRGNLVL_NUM" "2"
 SYSTEM_CONSTANT "AIRCTLRGNLVL_NUM" "3"
 SYSTEM_CONSTANT "AIRCTL_ADD" "0"
 SYSTEM_CONSTANT "AIRCTL_AIRBALGVNR_DISABLE" "0"
 SYSTEM_CONSTANT "AIRCTL_AIRBALGVNR_ENABLE" "1"
 SYSTEM_CONSTANT "AIRCTL_AIRBALGVNR_SEL_SWT" "0"
 SYSTEM_CONSTANT "AIRCTL_APCORRGN_CUR_X" "4"
 SYSTEM_CONSTANT "AIRCTL_APCOR_CUR_X" "4"
 SYSTEM_CONSTANT "AIRCTL_ATCORRGN_MAP_X" "2"
 SYSTEM_CONSTANT "AIRCTL_ATCORRGN_MAP_Y" "2"
 SYSTEM_CONSTANT "AIRCTL_ATCOR_CUR_X" "10"
 SYSTEM_CONSTANT "AIRCTL_CTCOR1_CUR_X" "2"
 SYSTEM_CONSTANT "AIRCTL_CTCORRGN_CUR_X" "5"
 SYSTEM_CONSTANT "AIRCTL_CTCOR_CUR_X" "5"
 SYSTEM_CONSTANT "AIRCTL_FACATPARAD_CUR_X" "16"
 SYSTEM_CONSTANT "AIRCTL_FACBPAHOLD_CUR_X" "8"
 SYSTEM_CONSTANT "AIRCTL_FACCTLRGN1_CUR_X" "2"
 SYSTEM_CONSTANT "AIRCTL_FACCTLRGN2_CUR_X" "2"
 SYSTEM_CONSTANT "AIRCTL_FACCTLVALRGNPT1_CUR_X" "8"
 SYSTEM_CONSTANT "AIRCTL_FACDESRGN1_CUR_X" "2"
 SYSTEM_CONSTANT "AIRCTL_FACDESRGN2_CUR_X" "2"
 SYSTEM_CONSTANT "AIRCTL_FACDESRGN3_CUR_X" "2"
 SYSTEM_CONSTANT "AIRCTL_FACDESRGN4_CUR_X" "2"
 SYSTEM_CONSTANT "AIRCTL_FACDESVALRGNPT1_CUR_X" "8"
 SYSTEM_CONSTANT "AIRCTL_FACEGROPNLPCOR2_CUR_X" "8"
 SYSTEM_CONSTANT "AIRCTL_FACEGR_CUR_X" "8"
 SYSTEM_CONSTANT "AIRCTL_FACGOVRGNRMPEGR_CUR_X" "8"
 SYSTEM_CONSTANT "AIRCTL_FACGOVRGNRMPTVA_CUR_X" "8"
 SYSTEM_CONSTANT "AIRCTL_FACILIMCOR_MAP_X" "8"
 SYSTEM_CONSTANT "AIRCTL_FACILIMCOR_MAP_Y" "8"
 SYSTEM_CONSTANT "AIRCTL_FACLMBDRECCOR_MAP_X" "8"
 SYSTEM_CONSTANT "AIRCTL_FACLMBDRECCOR_MAP_Y" "8"
 SYSTEM_CONSTANT "AIRCTL_FACMAXDEVCORRGN_MAP_X" "16"
 SYSTEM_CONSTANT "AIRCTL_FACMAXDEVCORRGN_MAP_Y" "13"
 SYSTEM_CONSTANT "AIRCTL_FACMAXDEVCOR_MAP_X" "16"
 SYSTEM_CONSTANT "AIRCTL_FACMAXDEVCOR_MAP_Y" "13"
 SYSTEM_CONSTANT "AIRCTL_FACMAXDEVTEMPCORRGN_CUR_X" "8"
 SYSTEM_CONSTANT "AIRCTL_FACMAXDEVTEMPCOR_CUR_X" "8"
 SYSTEM_CONSTANT "AIRCTL_FACMINDEVCORRGN_MAP_X" "16"
 SYSTEM_CONSTANT "AIRCTL_FACMINDEVCORRGN_MAP_Y" "13"
 SYSTEM_CONSTANT "AIRCTL_FACMINDEVCOR_MAP_X" "16"
 SYSTEM_CONSTANT "AIRCTL_FACMINDEVCOR_MAP_Y" "13"
 SYSTEM_CONSTANT "AIRCTL_FACMINDEVTEMPCORRGN_CUR_X" "8"
 SYSTEM_CONSTANT "AIRCTL_FACMINDEVTEMPCOR_CUR_X" "8"
 SYSTEM_CONSTANT "AIRCTL_FACNQPARAD_MAP_X" "10"
 SYSTEM_CONSTANT "AIRCTL_FACNQPARAD_MAP_Y" "10"
 SYSTEM_CONSTANT "AIRCTL_FACP3CORR_MAP_X" "10"
 SYSTEM_CONSTANT "AIRCTL_FACP3CORR_MAP_Y" "10"
 SYSTEM_CONSTANT "AIRCTL_MAIRCBVHYSHI_CUR_X" "8"
 SYSTEM_CONSTANT "AIRCTL_MAIRCBVHYSLO_CUR_X" "8"
 SYSTEM_CONSTANT "AIRCTL_MAPCORAFTERSTRT_CUR_X" "6"
 SYSTEM_CONSTANT "AIRCTL_MCOR_CUR_X" "4"
 SYSTEM_CONSTANT "AIRCTL_MDESBASEPIL_MAP_X" "2"
 SYSTEM_CONSTANT "AIRCTL_MDESBASEPIL_MAP_Y" "2"
 SYSTEM_CONSTANT "AIRCTL_MDESBASE_MAP_X" "16"
 SYSTEM_CONSTANT "AIRCTL_MDESBASE_MAP_Y" "16"
 SYSTEM_CONSTANT "AIRCTL_MDESRGN1A_MAP_X" "16"
 SYSTEM_CONSTANT "AIRCTL_MDESRGN1A_MAP_Y" "16"
 SYSTEM_CONSTANT "AIRCTL_MDESRGN1B_MAP_X" "16"
 SYSTEM_CONSTANT "AIRCTL_MDESRGN1B_MAP_Y" "16"
 SYSTEM_CONSTANT "AIRCTL_MDESRGN2A_MAP_X" "16"
 SYSTEM_CONSTANT "AIRCTL_MDESRGN2A_MAP_Y" "16"
 SYSTEM_CONSTANT "AIRCTL_MDESRGN2B_MAP_X" "16"
 SYSTEM_CONSTANT "AIRCTL_MDESRGN2B_MAP_Y" "16"
 SYSTEM_CONSTANT "AIRCTL_MDESRGN3A_MAP_X" "16"
 SYSTEM_CONSTANT "AIRCTL_MDESRGN3A_MAP_Y" "16"
 SYSTEM_CONSTANT "AIRCTL_MDESRGN3B_MAP_X" "16"
 SYSTEM_CONSTANT "AIRCTL_MDESRGN3B_MAP_Y" "16"
 SYSTEM_CONSTANT "AIRCTL_MDESRGN4A_MAP_X" "2"
 SYSTEM_CONSTANT "AIRCTL_MDESRGN4A_MAP_Y" "2"
 SYSTEM_CONSTANT "AIRCTL_MDESRGN4B_MAP_X" "2"
 SYSTEM_CONSTANT "AIRCTL_MDESRGN4B_MAP_Y" "2"
 SYSTEM_CONSTANT "AIRCTL_MDESSHTRP_CUR_X" "6"
 SYSTEM_CONSTANT "AIRCTL_MLMBD" "689.655172413793"
 SYSTEM_CONSTANT "AIRCTL_MMAXDEVRGN_MAP_X" "16"
 SYSTEM_CONSTANT "AIRCTL_MMAXDEVRGN_MAP_Y" "13"
 SYSTEM_CONSTANT "AIRCTL_MMAXDEVSHTRP_CUR_X" "6"
 SYSTEM_CONSTANT "AIRCTL_MMAXDEV_MAP_X" "16"
 SYSTEM_CONSTANT "AIRCTL_MMAXDEV_MAP_Y" "13"
 SYSTEM_CONSTANT "AIRCTL_MMINDEVRGN_MAP_X" "16"
 SYSTEM_CONSTANT "AIRCTL_MMINDEVRGN_MAP_Y" "13"
 SYSTEM_CONSTANT "AIRCTL_MMINDEVSHTRP_CUR_X" "6"
 SYSTEM_CONSTANT "AIRCTL_MMINDEV_MAP_X" "16"
 SYSTEM_CONSTANT "AIRCTL_MMINDEV_MAP_Y" "13"
 SYSTEM_CONSTANT "AIRCTL_MUL" "1"
 SYSTEM_CONSTANT "AIRCTL_NOVRRUN_CUR_X" "10"
 SYSTEM_CONSTANT "AIRCTL_NQAPCORRGN_MAP_X" "8"
 SYSTEM_CONSTANT "AIRCTL_NQAPCORRGN_MAP_Y" "8"
 SYSTEM_CONSTANT "AIRCTL_NQAPCOR_MAP_X" "8"
 SYSTEM_CONSTANT "AIRCTL_NQAPCOR_MAP_Y" "8"
 SYSTEM_CONSTANT "AIRCTL_NQATCOR1_MAP_X" "2"
 SYSTEM_CONSTANT "AIRCTL_NQATCOR1_MAP_Y" "4"
 SYSTEM_CONSTANT "AIRCTL_NQATCOR_MAP_X" "2"
 SYSTEM_CONSTANT "AIRCTL_NQATCOR_MAP_Y" "8"
 SYSTEM_CONSTANT "AIRCTL_NQCTCORRGN1_MAP_X" "2"
 SYSTEM_CONSTANT "AIRCTL_NQCTCORRGN1_MAP_Y" "2"
 SYSTEM_CONSTANT "AIRCTL_NQCTCORRGN2_MAP_X" "2"
 SYSTEM_CONSTANT "AIRCTL_NQCTCORRGN2_MAP_Y" "2"
 SYSTEM_CONSTANT "AIRCTL_NQCTCORRGN3_MAP_X" "2"
 SYSTEM_CONSTANT "AIRCTL_NQCTCORRGN3_MAP_Y" "2"
 SYSTEM_CONSTANT "AIRCTL_NQCTCOR_MAP_X" "10"
 SYSTEM_CONSTANT "AIRCTL_NQCTCOR_MAP_Y" "8"
 SYSTEM_CONSTANT "AIRCTL_NS_MAP_X" "6"
 SYSTEM_CONSTANT "AIRCTL_NS_MAP_Y" "6"
 SYSTEM_CONSTANT "AIRCTL_PCOR_MAP_X" "16"
 SYSTEM_CONSTANT "AIRCTL_PCOR_MAP_Y" "10"
 SYSTEM_CONSTANT "AIRCTL_QCBVHYSHI_CUR_X" "16"
 SYSTEM_CONSTANT "AIRCTL_QCBVHYSLO_CUR_X" "16"
 SYSTEM_CONSTANT "AIRCTL_QGOVOFF_CUR_X" "10"
 SYSTEM_CONSTANT "AIRCTL_QGOVON_CUR_X" "10"
 SYSTEM_CONSTANT "AIRCTL_QHIGH1_CUR_X" "20"
 SYSTEM_CONSTANT "AIRCTL_QHIGH_CUR_X" "20"
 SYSTEM_CONSTANT "AIRCTL_QLOW_CUR_X" "20"
 SYSTEM_CONSTANT "AIRCTL_QMIDDLE1_CUR_X" "20"
 SYSTEM_CONSTANT "AIRCTL_QMIDDLE_CUR_X" "20"
 SYSTEM_CONSTANT "AIRCTL_QRGN1OFF_CUR_X" "10"
 SYSTEM_CONSTANT "AIRCTL_QRGN1ON_CUR_X" "10"
 SYSTEM_CONSTANT "AIRCTL_QRGN2OFF_CUR_X" "10"
 SYSTEM_CONSTANT "AIRCTL_QRGN2ON_CUR_X" "10"
 SYSTEM_CONSTANT "AIRCTL_QRPOILCORR_CUR_X" "16"
 SYSTEM_CONSTANT "AIRCTL_RAPCOR_MAP_X" "10"
 SYSTEM_CONSTANT "AIRCTL_RAPCOR_MAP_Y" "4"
 SYSTEM_CONSTANT "AIRCTL_RCTLBASE_MAP_X" "16"
 SYSTEM_CONSTANT "AIRCTL_RCTLBASE_MAP_Y" "13"
 SYSTEM_CONSTANT "AIRCTL_RCTLRGN1A_MAP_X" "16"
 SYSTEM_CONSTANT "AIRCTL_RCTLRGN1A_MAP_Y" "16"
 SYSTEM_CONSTANT "AIRCTL_RCTLRGN1B_MAP_X" "16"
 SYSTEM_CONSTANT "AIRCTL_RCTLRGN1B_MAP_Y" "16"
 SYSTEM_CONSTANT "AIRCTL_RCTLRGN2A_MAP_X" "16"
 SYSTEM_CONSTANT "AIRCTL_RCTLRGN2A_MAP_Y" "16"
 SYSTEM_CONSTANT "AIRCTL_RCTLRGN2B_MAP_X" "16"
 SYSTEM_CONSTANT "AIRCTL_RCTLRGN2B_MAP_Y" "16"
 SYSTEM_CONSTANT "AIRCTL_RCTLRGN3A_MAP_X" "16"
 SYSTEM_CONSTANT "AIRCTL_RCTLRGN3A_MAP_Y" "16"
 SYSTEM_CONSTANT "AIRCTL_RCTLRGN3B_MAP_X" "16"
 SYSTEM_CONSTANT "AIRCTL_RCTLRGN3B_MAP_Y" "16"
 SYSTEM_CONSTANT "AIRCTL_RCTLRGN4A_MAP_X" "2"
 SYSTEM_CONSTANT "AIRCTL_RCTLRGN4A_MAP_Y" "2"
 SYSTEM_CONSTANT "AIRCTL_RCTLRGN4B_MAP_X" "2"
 SYSTEM_CONSTANT "AIRCTL_RCTLRGN4B_MAP_Y" "2"
 SYSTEM_CONSTANT "AIRCTL_REGR2_MAP_X" "10"
 SYSTEM_CONSTANT "AIRCTL_REGR2_MAP_Y" "10"
 SYSTEM_CONSTANT "AIRCTL_REGR_MAP_X" "10"
 SYSTEM_CONSTANT "AIRCTL_REGR_MAP_Y" "10"
 SYSTEM_CONSTANT "AIRCTL_REVTHRES_CUR_X" "8"
 SYSTEM_CONSTANT "AIRCTL_RGOVBRKCOR_CUR_X" "4"
 SYSTEM_CONSTANT "AIRCTL_RGOVPCOR_MAP_X" "9"
 SYSTEM_CONSTANT "AIRCTL_RGOVPCOR_MAP_Y" "9"
 SYSTEM_CONSTANT "AIRCTL_RGOVQDES_MAP_X" "10"
 SYSTEM_CONSTANT "AIRCTL_RGOVQDES_MAP_Y" "10"
 SYSTEM_CONSTANT "AIRCTL_RGOVRGN1TVAMIN_MAP_X" "8"
 SYSTEM_CONSTANT "AIRCTL_RGOVRGN1TVAMIN_MAP_Y" "8"
 SYSTEM_CONSTANT "AIRCTL_RGOVRGN2TVAMIN_MAP_X" "8"
 SYSTEM_CONSTANT "AIRCTL_RGOVRGN2TVAMIN_MAP_Y" "8"
 SYSTEM_CONSTANT "AIRCTL_RGOVRGNMIN_MAP_X" "8"
 SYSTEM_CONSTANT "AIRCTL_RGOVRGNMIN_MAP_Y" "8"
 SYSTEM_CONSTANT "AIRCTL_RGOVTENGCOR_MAP_X" "10"
 SYSTEM_CONSTANT "AIRCTL_RGOVTENGCOR_MAP_Y" "8"
 SYSTEM_CONSTANT "AIRCTL_RLMBD_MAP_X" "3"
 SYSTEM_CONSTANT "AIRCTL_RLMBD_MAP_Y" "3"
 SYSTEM_CONSTANT "AIRCTL_RRGN1EGROPNLP_MAP_X" "2"
 SYSTEM_CONSTANT "AIRCTL_RRGN1EGROPNLP_MAP_Y" "2"
 SYSTEM_CONSTANT "AIRCTL_RRGN1EGR_MAP_X" "8"
 SYSTEM_CONSTANT "AIRCTL_RRGN1EGR_MAP_Y" "10"
 SYSTEM_CONSTANT "AIRCTL_RRGN1TVA_MAP_X" "8"
 SYSTEM_CONSTANT "AIRCTL_RRGN1TVA_MAP_Y" "10"
 SYSTEM_CONSTANT "AIRCTL_RRGN2EGROPNLP_MAP_X" "8"
 SYSTEM_CONSTANT "AIRCTL_RRGN2EGROPNLP_MAP_Y" "8"
 SYSTEM_CONSTANT "AIRCTL_RRGN2EGR_MAP_X" "8"
 SYSTEM_CONSTANT "AIRCTL_RRGN2EGR_MAP_Y" "10"
 SYSTEM_CONSTANT "AIRCTL_RRGN2TVA_MAP_X" "8"
 SYSTEM_CONSTANT "AIRCTL_RRGN2TVA_MAP_Y" "10"
 SYSTEM_CONSTANT "AIRCTL_RRGNTVA_MAP_X" "8"
 SYSTEM_CONSTANT "AIRCTL_RRGNTVA_MAP_Y" "10"
 SYSTEM_CONSTANT "AIRCTL_RTENGCOR1_MAP_X" "2"
 SYSTEM_CONSTANT "AIRCTL_RTENGCOR1_MAP_Y" "2"
 SYSTEM_CONSTANT "AIRCTL_RTENGCORRGN_MAP_X" "10"
 SYSTEM_CONSTANT "AIRCTL_RTENGCORRGN_MAP_Y" "8"
 SYSTEM_CONSTANT "AIRCTL_RTENGCOR_MAP_X" "10"
 SYSTEM_CONSTANT "AIRCTL_RTENGCOR_MAP_Y" "8"
 SYSTEM_CONSTANT "AIRCTL_RTRMVALCOR_CUR_X" "5"
 SYSTEM_CONSTANT "AIRCTL_RTVA_MAP_X" "10"
 SYSTEM_CONSTANT "AIRCTL_RTVA_MAP_Y" "10"
 SYSTEM_CONSTANT "AIRCTL_SWTAPCOR_TYPE" "0"
 SYSTEM_CONSTANT "AIRCTL_SWTAPCOR_VAL" "0"
 SYSTEM_CONSTANT "AIRCTL_SWTATCOR_TYPE" "0"
 SYSTEM_CONSTANT "AIRCTL_SWTATCOR_VAL" "1"
 SYSTEM_CONSTANT "AIRCTL_SWTDYNDT1ABS_DISABLE" "0"
 SYSTEM_CONSTANT "AIRCTL_SWTDYNDT1ABS_ENABLE" "1"
 SYSTEM_CONSTANT "AIRCTL_SWTDYNDT1ABS_TYPE" "2"
 SYSTEM_CONSTANT "AIRCTL_SWTDYNDT1ABS_VAL" "0"
 SYSTEM_CONSTANT "AIRCTL_SWTGOVDT1ABS_DISABLE" "0"
 SYSTEM_CONSTANT "AIRCTL_SWTGOVDT1ABS_ENABLE" "1"
 SYSTEM_CONSTANT "AIRCTL_SWTGOVDT1ABS_VAL" "0"
 SYSTEM_CONSTANT "AIRCTL_SWTGOV_DISABLE" "0"
 SYSTEM_CONSTANT "AIRCTL_SWTGOV_ENABLE" "1"
 SYSTEM_CONSTANT "AIRCTL_SWTGOV_TYPE" "2"
 SYSTEM_CONSTANT "AIRCTL_SWTGOV_VAL" "1"
 SYSTEM_CONSTANT "AIRCTL_SWTLDDET_CUR_X" "4"
 SYSTEM_CONSTANT "AIRCTL_SWTTRM_TYPE" "0"
 SYSTEM_CONSTANT "AIRCTL_SWTTRM_VAL" "0"
 SYSTEM_CONSTANT "AIRCTL_TIBPAHOLD_CUR_X" "8"
 SYSTEM_CONSTANT "AIRCTL_TICOSTRT_CUR_X" "25"
 SYSTEM_CONSTANT "AIRCTL_TICTLVALRGNPT1_CUR_X" "8"
 SYSTEM_CONSTANT "AIRCTL_TIDESVALRGNPT1_CUR_X" "8"
 SYSTEM_CONSTANT "AIRCTL_TIDLY_CUR_X" "25"
 SYSTEM_CONSTANT "AIRMASS_ABS_MAX" "327.67"
 SYSTEM_CONSTANT "AIRMASS_ABS_MIN" "-327.67"
 SYSTEM_CONSTANT "AIRMASS_MAX" "5000"
 SYSTEM_CONSTANT "AIRMASS_MIN" "-5000"
 SYSTEM_CONSTANT "AIRMASS_ONE" "1"
 SYSTEM_CONSTANT "AIRMASS_ZERO" "0"
 SYSTEM_CONSTANT "AIRSYS_BANKSEL_SWT" "0"
 SYSTEM_CONSTANT "AIRSYS_SWT_DOUBLE" "1"
 SYSTEM_CONSTANT "AIRSYS_SWT_SINGLE" "0"
 SYSTEM_CONSTANT "AIR_KG_GM" "10"
 SYSTEM_CONSTANT "AIR_MASS_MAX" "2000"
 SYSTEM_CONSTANT "AIR_MASS_MIN" "0"
 SYSTEM_CONSTANT "ALTCD_RLOADLIN_CUR_X" "25"
 SYSTEM_CONSTANT "ALT_PWRALTLOADVAR2_MAP_X" "8"
 SYSTEM_CONSTANT "ALT_PWRALTLOADVAR2_MAP_Y" "8"
 SYSTEM_CONSTANT "ALT_PWRALTLOADVAR3_MAP_X" "8"
 SYSTEM_CONSTANT "ALT_PWRALTLOADVAR3_MAP_Y" "8"
 SYSTEM_CONSTANT "ALT_PWRALTLOAD_MAP_X" "8"
 SYSTEM_CONSTANT "ALT_PWRALTLOAD_MAP_Y" "8"
 SYSTEM_CONSTANT "ALT_PWRCANDEF_MAP_X" "4"
 SYSTEM_CONSTANT "ALT_PWRCANDEF_MAP_Y" "8"
 SYSTEM_CONSTANT "ALT_TIDELPT_MAP_X" "4"
 SYSTEM_CONSTANT "ALT_TIDELPT_MAP_Y" "5"
 SYSTEM_CONSTANT "ALT_TILDRESPTI_CUR_X" "4"
 SYSTEM_CONSTANT "AMPC_RES" "0.1"
 SYSTEM_CONSTANT "AMPC_RES_FL" "0.1"
 SYSTEM_CONSTANT "AMPC_RES_REV" "10"
 SYSTEM_CONSTANT "AMPC_ZERO" "0"
 SYSTEM_CONSTANT "AMPS_RES" "0.01"
 SYSTEM_CONSTANT "AMPS_RES_FL" "0.01"
 SYSTEM_CONSTANT "AMPT_2_RMP_AMPT_LOW" "100000"
 SYSTEM_CONSTANT "AMPT_GPS_RES" "0.01"
 SYSTEM_CONSTANT "AMPT_GPS_RES_REV" "100"
 SYSTEM_CONSTANT "AMPT_RES" "0.1"
 SYSTEM_CONSTANT "AMPT_RES_FL" "0.1"
 SYSTEM_CONSTANT "AMPT_RES_INV" "10"
 SYSTEM_CONSTANT "AMPT_RES_REV" "10"
 SYSTEM_CONSTANT "AMPT_ZERO" "0"
 SYSTEM_CONSTANT "AM_RES" "0.01"
 SYSTEM_CONSTANT "AM_RES_2" "0.1"
 SYSTEM_CONSTANT "AM_RES_FL" "0.01"
 SYSTEM_CONSTANT "ANGLERAD_MAX" "3.2"
 SYSTEM_CONSTANT "ANGLERAD_MIN" "-3.2"
 SYSTEM_CONSTANT "ANGLERAD_RES" "0.0001"
 SYSTEM_CONSTANT "ANGLERAD_RES_REV" "10000"
 SYSTEM_CONSTANT "ANGLERAD_ZERO" "0"
 SYSTEM_CONSTANT "ANGLE_CRS_REV" "15360"
 SYSTEM_CONSTANT "ANGLE_RES" "42.6666666666667"
 SYSTEM_CONSTANT "ANGLE_RES_INC" "256"
 SYSTEM_CONSTANT "ANHR_NRM_EXP" "7"
 SYSTEM_CONSTANT "AOHTCD_HEATER12_DISABLED" "0"
 SYSTEM_CONSTANT "AOHTCD_HEATER12_ENABLED" "1"
 SYSTEM_CONSTANT "AOHTCD_TI1" "100"
 SYSTEM_CONSTANT "AOHTCD_TI2" "274"
 SYSTEM_CONSTANT "AOHTCD_TI3" "10000"
 SYSTEM_CONSTANT "AOHT_CANHEATER12" "1"
 SYSTEM_CONSTANT "AOHT_CANHEATER3" "2"
 SYSTEM_CONSTANT "AOHT_EATS" "0"
 SYSTEM_CONSTANT "AOHT_ENGOFF_AC" "4"
 SYSTEM_CONSTANT "AOHT_ENGOFF_KWH" "2"
 SYSTEM_CONSTANT "AOHT_IATS" "1"
 SYSTEM_CONSTANT "AOHT_OFF_AC" "0"
 SYSTEM_CONSTANT "AOHT_OFF_KWH" "1"
 SYSTEM_CONSTANT "AOHT_ROFF_CUR_X" "25"
 SYSTEM_CONSTANT "AOHT_RON_CUR_X" "25"
 SYSTEM_CONSTANT "AOHT_SWTCANHEATER_TYPE" "2"
 SYSTEM_CONSTANT "AOHT_SWTCANHEATER_VAL" "2"
 SYSTEM_CONSTANT "AOHT_SWTHTSHUTOFF_TYPE" "2"
 SYSTEM_CONSTANT "AOHT_SWTHTSHUTOFF_VAL" "0"
 SYSTEM_CONSTANT "AOHT_SWTSENSAIR_TYPE" "2"
 SYSTEM_CONSTANT "AOHT_SWTSENSAIR_VAL" "0"
 SYSTEM_CONSTANT "AOHT_TAIRUPLI_CUR_X" "25"
 SYSTEM_CONSTANT "APPCD_PWGTYPE_VARIANT" "2"
 SYSTEM_CONSTANT "APPCD_RLINAPP1_CUR_X" "10"
 SYSTEM_CONSTANT "APPCD_RLINAPP2_CUR_X" "10"
 SYSTEM_CONSTANT "APPCD_RLINAPPPRE_CUR_X" "2"
 SYSTEM_CONSTANT "APPCD_RLINAPP_CUR_X" "2"
 SYSTEM_CONSTANT "APPCD_SWTTYPE_ALL" "3"
 SYSTEM_CONSTANT "APPCD_SWTTYPE_DOUBLEANALOGUE" "1"
 SYSTEM_CONSTANT "APPCD_SWTTYPE_DOUBLEANALOGUENC" "2"
 SYSTEM_CONSTANT "APPCD_SWTTYPE_POTISWITCH" "0"
 SYSTEM_CONSTANT "APPCD_SWTTYPE_TYPE" "2"
 SYSTEM_CONSTANT "APPCD_SWTTYPE_VAL" "2"
 SYSTEM_CONSTANT "APPCD_USYNC_CUR_X" "5"
 SYSTEM_CONSTANT "APSCD_PCOR_MAP_X" "10"
 SYSTEM_CONSTANT "APSCD_PCOR_MAP_Y" "10"
 SYSTEM_CONSTANT "APSCD_PLIN_CUR_X" "25"
 SYSTEM_CONSTANT "APSCD_SWTSIG_TYPE" "2"
 SYSTEM_CONSTANT "APSCD_SWTSIG_VAL" "0"
 SYSTEM_CONSTANT "AREA_LOW_RES" "0.0001"
 SYSTEM_CONSTANT "ASDDC_DACTGEARFAC_CUR_X" "6"
 SYSTEM_CONSTANT "ASDDC_DENUM1" "512"
 SYSTEM_CONSTANT "ASDDC_DENUM2" "3.90636921292764"
 SYSTEM_CONSTANT "ASDDC_DFACRMP_MAP_X" "6"
 SYSTEM_CONSTANT "ASDDC_DFACRMP_MAP_Y" "4"
 SYSTEM_CONSTANT "ASDDC_DNAVRGLTDEXITNEG_CUR_X" "6"
 SYSTEM_CONSTANT "ASDDC_DNAVRGLTDEXITPOS_CUR_X" "6"
 SYSTEM_CONSTANT "ASDDC_DNAVRGLTDNEG_CUR_X" "6"
 SYSTEM_CONSTANT "ASDDC_DNAVRGLTDPOS_CUR_X" "6"
 SYSTEM_CONSTANT "ASDDC_DNINTEGLTDNEG_CUR_X" "6"
 SYSTEM_CONSTANT "ASDDC_DNINTEGLTDPOS_MAP_X" "6"
 SYSTEM_CONSTANT "ASDDC_DNINTEGLTDPOS_MAP_Y" "4"
 SYSTEM_CONSTANT "ASDDC_FACPOS_CUR_X" "8"
 SYSTEM_CONSTANT "ASDDC_GRIP_MAP_X" "16"
 SYSTEM_CONSTANT "ASDDC_GRIP_MAP_Y" "10"
 SYSTEM_CONSTANT "ASDDC_NGVNRDT1KDNEG_CUR_X" "6"
 SYSTEM_CONSTANT "ASDDC_NGVNRDT1KDPOS_CUR_X" "6"
 SYSTEM_CONSTANT "ASDDC_NGVNRIKINEG_CUR_X" "6"
 SYSTEM_CONSTANT "ASDDC_NGVNRIKIPOS_CUR_X" "6"
 SYSTEM_CONSTANT "ASDDC_NGVNRPKPNEG_CUR_X" "6"
 SYSTEM_CONSTANT "ASDDC_NGVNRPKPPOS_CUR_X" "6"
 SYSTEM_CONSTANT "ASDDC_NGVNRRSTINEG_MAP_X" "6"
 SYSTEM_CONSTANT "ASDDC_NGVNRRSTINEG_MAP_Y" "8"
 SYSTEM_CONSTANT "ASDDC_NGVNRRSTIPOS0_MAP_X" "6"
 SYSTEM_CONSTANT "ASDDC_NGVNRRSTIPOS0_MAP_Y" "6"
 SYSTEM_CONSTANT "ASDDC_NGVNRRSTIPOS1_MAP_X" "6"
 SYSTEM_CONSTANT "ASDDC_NGVNRRSTIPOS1_MAP_Y" "6"
 SYSTEM_CONSTANT "ASDDC_NGVNRRSTIPOS2_MAP_X" "6"
 SYSTEM_CONSTANT "ASDDC_NGVNRRSTIPOS2_MAP_Y" "6"
 SYSTEM_CONSTANT "ASDDC_NGVNRRSTIPOS3_MAP_X" "6"
 SYSTEM_CONSTANT "ASDDC_NGVNRRSTIPOS3_MAP_Y" "6"
 SYSTEM_CONSTANT "ASDDC_NGVNRRSTIPOS4_MAP_X" "6"
 SYSTEM_CONSTANT "ASDDC_NGVNRRSTIPOS4_MAP_Y" "6"
 SYSTEM_CONSTANT "ASDDC_NGVNRRSTIPOS5_MAP_X" "6"
 SYSTEM_CONSTANT "ASDDC_NGVNRRSTIPOS5_MAP_Y" "6"
 SYSTEM_CONSTANT "ASDDC_NLTDEXITNEG_CUR_X" "6"
 SYSTEM_CONSTANT "ASDDC_NLTDEXITPOS_CUR_X" "6"
 SYSTEM_CONSTANT "ASDDC_NMAXNLDREVLNEG_CUR_X" "6"
 SYSTEM_CONSTANT "ASDDC_NMAXNLDREVLPOS_MAP_X" "6"
 SYSTEM_CONSTANT "ASDDC_NMAXNLDREVLPOS_MAP_Y" "6"
 SYSTEM_CONSTANT "ASDDC_NMINNLDREVLNEG_CUR_X" "6"
 SYSTEM_CONSTANT "ASDDC_NMINNLDREVLPOS_CUR_X" "6"
 SYSTEM_CONSTANT "ASDDC_NSPOFSNEG_CUR_X" "6"
 SYSTEM_CONSTANT "ASDDC_NSPOFSPOS_MAP_X" "6"
 SYSTEM_CONSTANT "ASDDC_NSPOFSPOS_MAP_Y" "4"
 SYSTEM_CONSTANT "ASDDC_PWRONOFF_X" "2"
 SYSTEM_CONSTANT "ASDDC_STACTGEAR_CUR_X" "6"
 SYSTEM_CONSTANT "ASDDC_TIPT1NEG_CUR_X" "6"
 SYSTEM_CONSTANT "ASDDC_TIPT1POS_CUR_X" "6"
 SYSTEM_CONSTANT "ASDDC_TIRMPSTRT_MAP_X" "6"
 SYSTEM_CONSTANT "ASDDC_TIRMPSTRT_MAP_Y" "4"
 SYSTEM_CONSTANT "ASDDC_TISWTOFF_CUR_X" "4"
 SYSTEM_CONSTANT "ASDDC_TRQLIM_CUR_X" "5"
 SYSTEM_CONSTANT "ASDDC_TRQPWRONOFFOFFSET_CUR_X" "3"
 SYSTEM_CONSTANT "ASDDC_TRQPWRONOFF_MAP_X" "8"
 SYSTEM_CONSTANT "ASDDC_TRQPWRONOFF_MAP_Y" "12"
 SYSTEM_CONSTANT "ASDRF_CLUTCH_CUR_X" "4"
 SYSTEM_CONSTANT "ASDRF_DTRQINRLTDLIM_CUR_X" "7"
 SYSTEM_CONSTANT "ASDRF_DTRQ_MAP_X" "8"
 SYSTEM_CONSTANT "ASDRF_DTRQ_MAP_Y" "12"
 SYSTEM_CONSTANT "ASDRF_FACPOS_CUR_X" "8"
 SYSTEM_CONSTANT "ASDRF_RACCPED_CUR_X" "8"
 SYSTEM_CONSTANT "ASDRF_T1GRIPPOS_MAP_X" "12"
 SYSTEM_CONSTANT "ASDRF_T1GRIPPOS_MAP_Y" "8"
 SYSTEM_CONSTANT "ASDRF_TMFWROACT" "4"
 SYSTEM_CONSTANT "ASDRF_TRQPUSHPULL_CUR_X" "12"
 SYSTEM_CONSTANT "ASD_TIME_DT_RES_FL" "1e-06"
 SYSTEM_CONSTANT "ASH2PRC_EXP" "19"
 SYSTEM_CONSTANT "ASHVOL_RES" "0.001"
 SYSTEM_CONSTANT "ASHVOL_RES_REV" "1000"
 SYSTEM_CONSTANT "ASMOD_AREFFEGR_CUR_X" "12"
 SYSTEM_CONSTANT "ASMOD_AREFFTVA_MAP_X" "10"
 SYSTEM_CONSTANT "ASMOD_AREFFTVA_MAP_Y" "10"
 SYSTEM_CONSTANT "ASMOD_CALCBACKUP" "14500"
 SYSTEM_CONSTANT "ASMOD_DMAIRCONV" "2949.12"
 SYSTEM_CONSTANT "ASMOD_DMFUELBURNED_RES" "6896.55172413793"
 SYSTEM_CONSTANT "ASMOD_DMFUEL_RES" "33333.3333333333"
 SYSTEM_CONSTANT "ASMOD_DMINDAIRREF_MAP_X" "8"
 SYSTEM_CONSTANT "ASMOD_DMINDAIRREF_MAP_Y" "8"
 SYSTEM_CONSTANT "ASMOD_DMO2_RES" "10000"
 SYSTEM_CONSTANT "ASMOD_ENGVOL_MAX" "20"
 SYSTEM_CONSTANT "ASMOD_ENGVOL_MIN" "0"
 SYSTEM_CONSTANT "ASMOD_ETAEGRCLG_MAP_X" "6"
 SYSTEM_CONSTANT "ASMOD_ETAEGRCLG_MAP_Y" "3"
 SYSTEM_CONSTANT "ASMOD_ETATURB_CUR_X" "8"
 SYSTEM_CONSTANT "ASMOD_FACDMCORTDIFF_CUR_X" "8"
 SYSTEM_CONSTANT "ASMOD_FACPRESLSEGRCLG_CUR_X" "3"
 SYSTEM_CONSTANT "ASMOD_FACSOICORTDIFF_CUR_X" "8"
 SYSTEM_CONSTANT "ASMOD_FACTCORVOLEFF_CUR_X" "8"
 SYSTEM_CONSTANT "ASMOD_FACVOLEFF_MAP_X" "10"
 SYSTEM_CONSTANT "ASMOD_FACVOLEFF_MAP_Y" "10"
 SYSTEM_CONSTANT "ASMOD_FACVSACORVOLEFF_MAP_X" "10"
 SYSTEM_CONSTANT "ASMOD_FACVSACORVOLEFF_MAP_Y" "10"
 SYSTEM_CONSTANT "ASMOD_FULL" "2"
 SYSTEM_CONSTANT "ASMOD_IMPT2AMPT" "10"
 SYSTEM_CONSTANT "ASMOD_INDVOL_MAX" "50"
 SYSTEM_CONSTANT "ASMOD_INDVOL_MIN" "0"
 SYSTEM_CONSTANT "ASMOD_LAMBDAREC1" "335671.375"
 SYSTEM_CONSTANT "ASMOD_LIN" "1"
 SYSTEM_CONSTANT "ASMOD_MASS_NORM" "287.356321839081"
 SYSTEM_CONSTANT "ASMOD_NDELAY_RES" "937500"
 SYSTEM_CONSTANT "ASMOD_NO" "0"
 SYSTEM_CONSTANT "ASMOD_NTRBCHRED_MAP_X" "16"
 SYSTEM_CONSTANT "ASMOD_NTRBCHRED_MAP_Y" "16"
 SYSTEM_CONSTANT "ASMOD_ONE_R32" "1"
 SYSTEM_CONSTANT "ASMOD_PDIFFEGPIPE_CUR_X" "8"
 SYSTEM_CONSTANT "ASMOD_PHISOIREF_MAP_X" "8"
 SYSTEM_CONSTANT "ASMOD_PHISOIREF_MAP_Y" "8"
 SYSTEM_CONSTANT "ASMOD_QSWTOUTOBSVRMAX_CUR" "8"
 SYSTEM_CONSTANT "ASMOD_QSWTOUTOBSVRMIN_CUR" "8"
 SYSTEM_CONSTANT "ASMOD_RFUELBURNED_RES" "100"
 SYSTEM_CONSTANT "ASMOD_RLMBDREC" "1450"
 SYSTEM_CONSTANT "ASMOD_RO2EXHGS_RES" "10000"
 SYSTEM_CONSTANT "ASMOD_RTDIFFTURBADBT_CUR_X" "8"
 SYSTEM_CONSTANT "ASMOD_SEL" "0"
 SYSTEM_CONSTANT "ASMOD_TCLNT_CUR_X" "8"
 SYSTEM_CONSTANT "ASMOD_TCORR_MAP_X" "8"
 SYSTEM_CONSTANT "ASMOD_TCORR_MAP_Y" "8"
 SYSTEM_CONSTANT "ASMOD_TDIFFENG_MAP_X" "8"
 SYSTEM_CONSTANT "ASMOD_TDIFFENG_MAP_Y" "8"
 SYSTEM_CONSTANT "ASMOD_TDIFFLIN_RES" "1280"
 SYSTEM_CONSTANT "ASMOD_TDIFFSQ_RES" "1000"
 SYSTEM_CONSTANT "ASMOD_TDIFF_MAX" "200"
 SYSTEM_CONSTANT "ASMOD_TDIFF_MIN" "-200"
 SYSTEM_CONSTANT "ASMOD_TENGCORTDIFF_CUR_X" "8"
 SYSTEM_CONSTANT "ASMOD_TIDT1_MAX" "5"
 SYSTEM_CONSTANT "ASMOD_TIDT1_MIN" "0.05"
 SYSTEM_CONSTANT "ASMOD_TINDAIRREF_MAP_X" "10"
 SYSTEM_CONSTANT "ASMOD_TINDAIRREF_MAP_Y" "10"
 SYSTEM_CONSTANT "ASMOD_VOL_NORM" "33333.3333333333"
 SYSTEM_CONSTANT "AVPC_RES" "0.1"
 SYSTEM_CONSTANT "AVPT_RES" "0.1"
 SYSTEM_CONSTANT "AVPT_RES_REV" "10"
 SYSTEM_CONSTANT "BASADJ_K2SigBlkVal0_MAP_X" "5"
 SYSTEM_CONSTANT "BASADJ_K2SigBlkVal0_MAP_Y" "14"
 SYSTEM_CONSTANT "BASADJ_K2SigBlkVal1_MAP_X" "5"
 SYSTEM_CONSTANT "BASADJ_K2SigBlkVal1_MAP_Y" "14"
 SYSTEM_CONSTANT "BASADJ_K2SigBlkVal2_MAP_X" "5"
 SYSTEM_CONSTANT "BASADJ_K2SigBlkVal2_MAP_Y" "14"
 SYSTEM_CONSTANT "BATTCD_ULIN_CUR_X" "5"
 SYSTEM_CONSTANT "BATT_FACCOR_CUR_X" "4"
 SYSTEM_CONSTANT "BIP_facInjBegCorInfl_MAP_X" "10"
 SYSTEM_CONSTANT "BIP_facInjBegCorInfl_MAP_Y" "8"
 SYSTEM_CONSTANT "BIP_facInjBegCor_MAP_X" "10"
 SYSTEM_CONSTANT "BIP_facInjBegCor_MAP_Y" "17"
 SYSTEM_CONSTANT "BIP_tiMultiInjCor_MAP_X" "10"
 SYSTEM_CONSTANT "BIP_tiMultiInjCor_MAP_Y" "8"
 SYSTEM_CONSTANT "BPACD_ACTSEL_SWT" "0"
 SYSTEM_CONSTANT "BPACD_DCYCCONV_CUR_X" "25"
 SYSTEM_CONSTANT "BPACD_DIAGNOSIS_SWT" "255"
 SYSTEM_CONSTANT "BPACD_RBPAOFF" "12"
 SYSTEM_CONSTANT "BPACD_RLRNLMS" "84"
 SYSTEM_CONSTANT "BPACD_RLRNUMS" "16"
 SYSTEM_CONSTANT "BPACD_SWT_BIDIRIFDIAG" "1"
 SYSTEM_CONSTANT "BPACD_SWT_BPAGOV" "3"
 SYSTEM_CONSTANT "BPACD_SWT_DIAG" "0"
 SYSTEM_CONSTANT "BPACD_SWT_DIAGCJ220" "0"
 SYSTEM_CONSTANT "BPACD_SWT_DIAGCJ945" "1"
 SYSTEM_CONSTANT "BPACD_SWT_DIAGNOTUSED" "255"
 SYSTEM_CONSTANT "BPACD_SWT_NODIAG" "2"
 SYSTEM_CONSTANT "BPASCD_NMINOFS_CUR_X" "4"
 SYSTEM_CONSTANT "BPASCD_RBPAMAX" "81"
 SYSTEM_CONSTANT "BPASCD_RBPAMIN" "19"
 SYSTEM_CONSTANT "BPASCD_RDEVTEMPEXCMAX" "90.5"
 SYSTEM_CONSTANT "BPASCD_RDEVTEMPEXCMIN" "89.5"
 SYSTEM_CONSTANT "BPASCD_RLMSLRNDEFMAX" "89"
 SYSTEM_CONSTANT "BPASCD_RLMSLRNDEFMIN" "87"
 SYSTEM_CONSTANT "BPASCD_RLMSLRNOKMAX" "85"
 SYSTEM_CONSTANT "BPASCD_RLMSLRNOKMIN" "83"
 SYSTEM_CONSTANT "BPASCD_RPWMDEFMAX" "9"
 SYSTEM_CONSTANT "BPASCD_RPWMDEFMIN" "7"
 SYSTEM_CONSTANT "BPASCD_RRELPOS_CUR_X" "9"
 SYSTEM_CONSTANT "BPASCD_RUMSLRNDEFMAX" "13"
 SYSTEM_CONSTANT "BPASCD_RUMSLRNDEFMIN" "11"
 SYSTEM_CONSTANT "BPASCD_RUMSLRNOKMAX" "17"
 SYSTEM_CONSTANT "BPASCD_RUMSLRNOKMIN" "15"
 SYSTEM_CONSTANT "BPASCD_ULIN_CUR_X" "16"
 SYSTEM_CONSTANT "BPSCD_PLIN_CUR_X" "25"
 SYSTEM_CONSTANT "BPSCD_SWTSIG_TYPE" "2"
 SYSTEM_CONSTANT "BPSCD_SWTSIG_VAL" "0"
 SYSTEM_CONSTANT "BRKCD_SWTSIG_TYPE" "2"
 SYSTEM_CONSTANT "BRKCD_SWTSIG_VAL" "0"
 SYSTEM_CONSTANT "BRKCD_TYPE_CAN_BRK" "1"
 SYSTEM_CONSTANT "BRKCD_TYPE_CAN_MNBRK" "4"
 SYSTEM_CONSTANT "BRKCD_TYPE_CAN_RED" "2"
 SYSTEM_CONSTANT "BRKCD_TYPE_CAN_REDBRK" "3"
 SYSTEM_CONSTANT "BRKCD_TYPE_HW" "0"
 SYSTEM_CONSTANT "BRKCD_UMNSWTLIN_CUR_X" "3"
 SYSTEM_CONSTANT "BRK_NOTACITVE" "0"
 SYSTEM_CONSTANT "CALORY1_RES" "0.001"
 SYSTEM_CONSTANT "CALORY1_RES_FL" "0.001"
 SYSTEM_CONSTANT "CALORY_LOW_RES" "100"
 SYSTEM_CONSTANT "CALORY_LOW_RES_REV" "0"
 SYSTEM_CONSTANT "CALORY_RES" "1"
 SYSTEM_CONSTANT "CAN1_RES" "0.0001"
 SYSTEM_CONSTANT "CAN1_RES_REV" "10000"
 SYSTEM_CONSTANT "CAN_BAUDRATE" "500"
 SYSTEM_CONSTANT "CAN_RES" "0.001"
 SYSTEM_CONSTANT "CAN_RES_REV" "1000"
 SYSTEM_CONSTANT "CASCD_FACPLAUSHIGH_CUR_X" "12"
 SYSTEM_CONSTANT "CASCD_FACPLAUSLOW_CUR_X" "12"
 SYSTEM_CONSTANT "CAS_MAX" "2"
 SYSTEM_CONSTANT "CLG_TIMAXDYNTST_CUR_X" "10"
 SYSTEM_CONSTANT "CMBCHB_DISABLED" "0"
 SYSTEM_CONSTANT "CMBCHB_ENABLED" "3"
 SYSTEM_CONSTANT "CMBCHB_ENGN_INCR_FACT" "10000"
 SYSTEM_CONSTANT "CMBCHB_NOT_PRESSED" "2"
 SYSTEM_CONSTANT "CMBCHB_PHICMBLIM_CUR_X" "4"
 SYSTEM_CONSTANT "CMBCHB_PRESSED" "1"
 SYSTEM_CONSTANT "CMBCHB_SWTMONCLUTCH_TYPE" "2"
 SYSTEM_CONSTANT "CMBCHB_SWTMONCLUTCH_VAL" "3"
 SYSTEM_CONSTANT "CODT_DNNOGEARFFRST_CUR_X" "6"
 SYSTEM_CONSTANT "CODT_DNNOGEARFFSET_CUR_X" "6"
 SYSTEM_CONSTANT "CODT_DTRQSLPLIMERR_CUR_X" "5"
 SYSTEM_CONSTANT "CODT_SLPNEG_MAX" "4294967295"
 SYSTEM_CONSTANT "CODT_SLPPOS_MAX" "4294967295"
 SYSTEM_CONSTANT "CODT_SWTCOTYPE_CNV" "0"
 SYSTEM_CONSTANT "CODT_SWTCOTYPE_MSFT" "1"
 SYSTEM_CONSTANT "CODT_SWTCOTYPE_TYPE" "2"
 SYSTEM_CONSTANT "CODT_SWTCOTYPE_VAL" "1"
 SYSTEM_CONSTANT "COEFFA_MAX" "159.9951171875"
 SYSTEM_CONSTANT "COEFFA_RES" "0.0048828125"
 SYSTEM_CONSTANT "COENG_APDTRQSLPLIMDWN_CUR_X" "25"
 SYSTEM_CONSTANT "COENG_APDTRQSLPLIMUP_CUR_X" "25"
 SYSTEM_CONSTANT "COENG_ATCOR_CUR_X" "10"
 SYSTEM_CONSTANT "COENG_SWTAWDLIMENA_OFF" "0"
 SYSTEM_CONSTANT "COENG_SWTAWDLIMENA_ON" "1"
 SYSTEM_CONSTANT "COENG_SWTAWDLIMENA_TYPE" "2"
 SYSTEM_CONSTANT "COENG_SWTAWDLIMENA_VAL" "1"
 SYSTEM_CONSTANT "COENG_TRQLIMBIT_CUR_X" "2"
 SYSTEM_CONSTANT "COENG_TRQLIMERR_CUR_X" "25"
 SYSTEM_CONSTANT "COENG_TRQOFFS_CUR_X" "5"
 SYSTEM_CONSTANT "CONVCD_DIGIN_PRESENT_NO" "0"
 SYSTEM_CONSTANT "CONVCD_DIGIN_PRESENT_YES" "1"
 SYSTEM_CONSTANT "CONVCD_SWTILSDIGIN_P_TYPE" "2"
 SYSTEM_CONSTANT "CONVCD_SWTILSDIGIN_P_VAL" "1"
 SYSTEM_CONSTANT "CONVCD_SWTSIG_TYPE" "2"
 SYSTEM_CONSTANT "CONVCD_SWTSIG_VAL" "0"
 SYSTEM_CONSTANT "CONV_HR2SEC" "36"
 SYSTEM_CONSTANT "CONV_KD_16_TO_KD_32" "2.00006103701895"
 SYSTEM_CONSTANT "CONV_S_SINT16_TO_S" "100"
 SYSTEM_CONSTANT "CONV_S_TO_5S" "500"
 SYSTEM_CONSTANT "CONV_T1_16_2_TO_1_T1_32_3" "562932.773552128"
 SYSTEM_CONSTANT "CONV_T1_16_TO_1_T1_32" "28146638.6776064"
 SYSTEM_CONSTANT "COTSCD_TLIN_CUR_X" "25"
 SYSTEM_CONSTANT "COVEH_NRGN_CUR_X" "2"
 SYSTEM_CONSTANT "COVEH_TRQLIMSAFE_CUR_X" "10"
 SYSTEM_CONSTANT "COVEH_TRQLIM_CUR_X" "25"
 SYSTEM_CONSTANT "COVM_SWTSLIPCTL_TYPE" "2"
 SYSTEM_CONSTANT "COVM_SWTSLIPCTL_VAL" "3"
 SYSTEM_CONSTANT "COVM_TCS_OFF_DCS_OFF" "0"
 SYSTEM_CONSTANT "COVM_TCS_OFF_DCS_ON" "2"
 SYSTEM_CONSTANT "COVM_TCS_ON_DCS_OFF" "1"
 SYSTEM_CONSTANT "COVM_TCS_ON_DCS_ON" "3"
 SYSTEM_CONSTANT "CRCCD_SWTFGR_DISABLE" "0"
 SYSTEM_CONSTANT "CRCCD_SWTFGR_ENABLE" "1"
 SYSTEM_CONSTANT "CRCCD_SWTFGR_TYPE" "2"
 SYSTEM_CONSTANT "CRCCD_SWTFGR_VAL" "0"
 SYSTEM_CONSTANT "CRCCD_SWTLEARN_DISABLE" "0"
 SYSTEM_CONSTANT "CRCCD_SWTLEARN_ENABLE" "1"
 SYSTEM_CONSTANT "CRCCD_SWTLEARN_TYPE" "2"
 SYSTEM_CONSTANT "CRCCD_SWTLEARN_VAL" "0"
 SYSTEM_CONSTANT "CRCTLP_AAG_OFF" "0"
 SYSTEM_CONSTANT "CRCTLP_AAG_ON" "1"
 SYSTEM_CONSTANT "CRCTLP_SWTAAG_TYPE" "1"
 SYSTEM_CONSTANT "CRCTLP_SWTAAG_VAL" "0"
 SYSTEM_CONSTANT "CRCTL_AACCEL_CUR_X" "8"
 SYSTEM_CONSTANT "CRCTL_AACC_CUR_X" "8"
 SYSTEM_CONSTANT "CRCTL_ACC_SWT" "1"
 SYSTEM_CONSTANT "CRCTL_ADECDEMDECP_MAP_X" "8"
 SYSTEM_CONSTANT "CRCTL_ADECDEMDECP_MAP_Y" "8"
 SYSTEM_CONSTANT "CRCTL_ADECDEMHOLDP_MAP_X" "8"
 SYSTEM_CONSTANT "CRCTL_ADECDEMHOLDP_MAP_Y" "8"
 SYSTEM_CONSTANT "CRCTL_ADECDEMOVRDP_MAP_X" "8"
 SYSTEM_CONSTANT "CRCTL_ADECDEMOVRDP_MAP_Y" "8"
 SYSTEM_CONSTANT "CRCTL_ADECEL_CUR_X" "8"
 SYSTEM_CONSTANT "CRCTL_ADECRESABVP_MAP_X" "8"
 SYSTEM_CONSTANT "CRCTL_ADECRESABVP_MAP_Y" "8"
 SYSTEM_CONSTANT "CRCTL_ADEC_CUR_X" "8"
 SYSTEM_CONSTANT "CRCTL_ADEMSTANDBY_CUR_X" "6"
 SYSTEM_CONSTANT "CRCTL_ADEMUNLIMOVER_MAP_X" "6"
 SYSTEM_CONSTANT "CRCTL_ADEMUNLIMOVER_MAP_Y" "6"
 SYSTEM_CONSTANT "CRCTL_ALIMHIGH_CUR_X" "8"
 SYSTEM_CONSTANT "CRCTL_ALIMLOW_CUR_X" "8"
 SYSTEM_CONSTANT "CRCTL_ARESABVACT_MAP_X" "8"
 SYSTEM_CONSTANT "CRCTL_ARESABVACT_MAP_Y" "8"
 SYSTEM_CONSTANT "CRCTL_ARESBELACT_MAP_X" "8"
 SYSTEM_CONSTANT "CRCTL_ARESBELACT_MAP_Y" "8"
 SYSTEM_CONSTANT "CRCTL_CAN" "0"
 SYSTEM_CONSTANT "CRCTL_DSPLSPDMAX" "254"
 SYSTEM_CONSTANT "CRCTL_DVINITRMPACC_CUR_X" "6"
 SYSTEM_CONSTANT "CRCTL_DVINITRMPDEC_CUR_X" "6"
 SYSTEM_CONSTANT "CRCTL_FACATRANS_CUR_X" "4"
 SYSTEM_CONSTANT "CRCTL_FACDEMUNLIMOVRCOR_CUR_X" "6"
 SYSTEM_CONSTANT "CRCTL_FACPARCOR_CUR_X" "8"
 SYSTEM_CONSTANT "CRCTL_FACPHIROADACC_CUR_X" "4"
 SYSTEM_CONSTANT "CRCTL_FACPHIROADDEC_CUR_X" "4"
 SYSTEM_CONSTANT "CRCTL_FACPHIROADOVR_CUR_X" "4"
 SYSTEM_CONSTANT "CRCTL_FACPHIROAD_CUR_X" "4"
 SYSTEM_CONSTANT "CRCTL_FACSLPACCCOR_CUR_X" "8"
 SYSTEM_CONSTANT "CRCTL_FACSLPDECCOR_CUR_X" "8"
 SYSTEM_CONSTANT "CRCTL_FACSLPHOLDCOR_CUR_X" "8"
 SYSTEM_CONSTANT "CRCTL_FACSLPRESABVCOR_CUR_X" "8"
 SYSTEM_CONSTANT "CRCTL_FACSLPRESBELCOR_CUR_X" "8"
 SYSTEM_CONSTANT "CRCTL_RSLPRES_MAP_X" "8"
 SYSTEM_CONSTANT "CRCTL_RSLPRES_MAP_Y" "8"
 SYSTEM_CONSTANT "CRCTL_SWTCAN_VAL" "0"
 SYSTEM_CONSTANT "CRCTL_SWT_ACC" "1"
 SYSTEM_CONSTANT "CRCTL_SWT_TRQ" "2"
 SYSTEM_CONSTANT "CRCTL_TRQSETPRECTL_MAP_X" "8"
 SYSTEM_CONSTANT "CRCTL_TRQSETPRECTL_MAP_Y" "8"
 SYSTEM_CONSTANT "CRCTL_VCTLPKP_MAP_X" "8"
 SYSTEM_CONSTANT "CRCTL_VCTLPKP_MAP_Y" "8"
 SYSTEM_CONSTANT "CRCTL_VSETPOINTSLPNEG_MAP_X" "8"
 SYSTEM_CONSTANT "CRCTL_VSETPOINTSLPNEG_MAP_Y" "8"
 SYSTEM_CONSTANT "CRCTL_VSETPOINTSLPPOS_MAP_X" "8"
 SYSTEM_CONSTANT "CRCTL_VSETPOINTSLPPOS_MAP_Y" "8"
 SYSTEM_CONSTANT "CRCTL_VSETSTTRQLIMNEG_CUR_X" "4"
 SYSTEM_CONSTANT "CRSCD_DYNPL_HEALSEC" "0"
 SYSTEM_CONSTANT "CRSCD_FACGAPPLAUSHIGH_CUR_X" "10"
 SYSTEM_CONSTANT "CRSCD_FACGAPPLAUSLOW_CUR_X" "10"
 SYSTEM_CONSTANT "CRSCD_FACINCPLAUSHIGH_CUR_X" "10"
 SYSTEM_CONSTANT "CRSCD_FACINCPLAUSLOW_CUR_X" "10"
 SYSTEM_CONSTANT "CRSCD_PHIINCCOR_CUR_X" "12"
 SYSTEM_CONSTANT "CRSCD_STATPL_SEC" "0"
 SYSTEM_CONSTANT "CRSCD_SWTDYNPL_TYPE" "2"
 SYSTEM_CONSTANT "CRSCD_SWTDYNPL_VAL" "0"
 SYSTEM_CONSTANT "CRSCD_SWTSTATPL_TYPE" "2"
 SYSTEM_CONSTANT "CRSCD_SWTSTATPL_VAL" "0"
 SYSTEM_CONSTANT "CRS_FACSEGTIME_CUR_X" "3"
 SYSTEM_CONSTANT "CRS_TO_CAS" "2"
 SYSTEM_CONSTANT "CTSCD_SWTSIG_TYPE" "2"
 SYSTEM_CONSTANT "CTSCD_SWTSIG_VAL" "0"
 SYSTEM_CONSTANT "CTSCD_TEMPDFL_FTS" "0"
 SYSTEM_CONSTANT "CTSCD_TEMPDFL_OTS" "1"
 SYSTEM_CONSTANT "CTSCD_TLIN_CUR_X" "25"
 SYSTEM_CONSTANT "CTTCTL_CTL_DISABLE" "0"
 SYSTEM_CONSTANT "CTTCTL_CTL_ENABLE" "1"
 SYSTEM_CONSTANT "CTTCTL_DCYCCTL_MAP_X" "8"
 SYSTEM_CONSTANT "CTTCTL_DCYCCTL_MAP_Y" "8"
 SYSTEM_CONSTANT "CTTCTL_SWTCTL_TYPE" "2"
 SYSTEM_CONSTANT "CTTCTL_SWTCTL_VAL" "1"
 SYSTEM_CONSTANT "CTTCTL_TBASE_MAP_X" "8"
 SYSTEM_CONSTANT "CTTCTL_TBASE_MAP_Y" "8"
 SYSTEM_CONSTANT "CTTCTL_TCLNTCOR2_MAP_X" "8"
 SYSTEM_CONSTANT "CTTCTL_TCLNTCOR2_MAP_Y" "8"
 SYSTEM_CONSTANT "CTTCTL_TCLNTCOR3_CUR_X" "5"
 SYSTEM_CONSTANT "CTTCTL_TCLNTCOR4_CUR_X" "5"
 SYSTEM_CONSTANT "CTTCTL_TCLNTCOR5_CUR_X" "5"
 SYSTEM_CONSTANT "CTTCTL_TCLNTCOR6_CUR_X" "4"
 SYSTEM_CONSTANT "CTT_MOD_DTCONSUM_CUR_X" "12"
 SYSTEM_CONSTANT "CTT_MOD_DTENV_CUR_X" "15"
 SYSTEM_CONSTANT "CTT_MOD_TCLNT_CUR_X" "8"
 SYSTEM_CONSTANT "CTT_MOD_TCORR_MAP_X" "8"
 SYSTEM_CONSTANT "CTT_MOD_TCORR_MAP_Y" "8"
 SYSTEM_CONSTANT "CURR_A_RES" "0.01"
 SYSTEM_CONSTANT "CURR_RES" "1"
 SYSTEM_CONSTANT "CYL_FAC_NORM" "33333"
 SYSTEM_CONSTANT "CYL_MAX" "4"
 SYSTEM_CONSTANT "CYL_NUM" "4"
 SYSTEM_CONSTANT "DDVOL_RES" "10"
 SYSTEM_CONSTANT "DELTA_N_PER_TIME_NBR" "5"
 SYSTEM_CONSTANT "DENGSPD_S_RES" "1"
 SYSTEM_CONSTANT "DIA_MAX" "3.2"
 SYSTEM_CONSTANT "DIA_RES" "0.0001"
 SYSTEM_CONSTANT "DIA_RES_REV" "10000"
 SYSTEM_CONSTANT "DIA_ZERO" "0"
 SYSTEM_CONSTANT "DINJQNT_S_RES" "1"
 SYSTEM_CONSTANT "DIST1_RES" "500"
 SYSTEM_CONSTANT "DIST1_RES_DIR" "500"
 SYSTEM_CONSTANT "DISTM_FAC" "6366.19772367539"
 SYSTEM_CONSTANT "DISTM_FAC1" "407436654.315225"
 SYSTEM_CONSTANT "DIST_RES" "25"
 SYSTEM_CONSTANT "DIST_RES_DIR" "25"
 SYSTEM_CONSTANT "DIUMPR_NUM_ACT_SY" "10"
 SYSTEM_CONSTANT "DIUMPR_NUM_GROUPS_SY" "9"
 SYSTEM_CONSTANT "DIUMPR_NUM_MESSAGEGROUP_SY" "15"
 SYSTEM_CONSTANT "DIUMPR_NUM_RATIO_SY" "40"
 SYSTEM_CONSTANT "DIUMPR_TIME_MS_100MS_RES" "100"
 SYSTEM_CONSTANT "DM_NOX2SOOT" "3"
 SYSTEM_CONSTANT "DM_NOX_MAX" "982.8"
 SYSTEM_CONSTANT "DM_NOX_MIN" "0"
 SYSTEM_CONSTANT "DM_NOX_RES" "0.03"
 SYSTEM_CONSTANT "DM_SOOT_MAX" "100"
 SYSTEM_CONSTANT "DM_SOOT_MIN" "0"
 SYSTEM_CONSTANT "DM_SOOT_RES" "0.01"
 SYSTEM_CONSTANT "DPDIFFTMP_RES" "100"
 SYSTEM_CONSTANT "DPDIFF_RES" "0.1"
 SYSTEM_CONSTANT "DRAGACCLIM" "2"
 SYSTEM_CONSTANT "DRAGLIMOFF" "0"
 SYSTEM_CONSTANT "DRAGTORQUELIM" "1"
 SYSTEM_CONSTANT "DRVTRN_SWTSIG_TYPE" "2"
 SYSTEM_CONSTANT "DRVTRN_SWTSIG_VAL" "0"
 SYSTEM_CONSTANT "DSM_DEB_MAX_TIME" "65535"
 SYSTEM_CONSTANT "DTRQPRPHIGH_20MS_RES" "5"
 SYSTEM_CONSTANT "DTRQPRP_20MS_RES" "80"
 SYSTEM_CONSTANT "DTRQ_MAX" "2000"
 SYSTEM_CONSTANT "DTRQ_MIN" "-2000"
 SYSTEM_CONSTANT "DTRQ_RES" "0.1"
 SYSTEM_CONSTANT "DTRQ_ZERO" "0"
 SYSTEM_CONSTANT "DTYCYC_SLP_10" "10"
 SYSTEM_CONSTANT "DTYCYC_SLP_MIN" "0"
 SYSTEM_CONSTANT "DTY_CYC_10" "10"
 SYSTEM_CONSTANT "DTY_CYC_100" "100"
 SYSTEM_CONSTANT "DTY_CYC_120" "120"
 SYSTEM_CONSTANT "DTY_CYC_150" "150"
 SYSTEM_CONSTANT "DTY_CYC_20" "20"
 SYSTEM_CONSTANT "DTY_CYC_30" "30"
 SYSTEM_CONSTANT "DTY_CYC_50" "50"
 SYSTEM_CONSTANT "DTY_CYC_CAN_RES" "0.1"
 SYSTEM_CONSTANT "DTY_CYC_CAN_RES_REV" "10"
 SYSTEM_CONSTANT "DTY_CYC_MAX" "100"
 SYSTEM_CONSTANT "DTY_CYC_MIN" "0"
 SYSTEM_CONSTANT "DTY_CYC_RES" "0.01"
 SYSTEM_CONSTANT "DTY_CYC_RES_REV" "100"
 SYSTEM_CONSTANT "DTY_CYC_ZERO" "0"
 SYSTEM_CONSTANT "DT_DEN" "5"
 SYSTEM_CONSTANT "DT_DQNTD1" "512"
 SYSTEM_CONSTANT "DT_NUM" "1.43000143000143"
 SYSTEM_CONSTANT "DT_SCAL" "200"
 SYSTEM_CONSTANT "DU_VBATFAC" "100"
 SYSTEM_CONSTANT "DVEL_20MS_RES" "0.5"
 SYSTEM_CONSTANT "DVOL_MAX" "3000"
 SYSTEM_CONSTANT "DVOL_MIN" "0"
 SYSTEM_CONSTANT "DVOL_RES" "0.1"
 SYSTEM_CONSTANT "DVOL_RES_FL" "0.1"
 SYSTEM_CONSTANT "DVOL_RES_INV" "10"
 SYSTEM_CONSTANT "DXS_FL" "4000000"
 SYSTEM_CONSTANT "DYN_TST_TIME_FACT" "655.36"
 SYSTEM_CONSTANT "D_ENG_N_MAX" "6000"
 SYSTEM_CONSTANT "D_ENG_N_MIN" "-6000"
 SYSTEM_CONSTANT "D_ENG_N_ZERO" "0"
 SYSTEM_CONSTANT "D_FLCONS_RES" "0.01"
 SYSTEM_CONSTANT "D_INJ_MASS_MAX" "327.67"
 SYSTEM_CONSTANT "D_INJ_MASS_MIN" "-327.67"
 SYSTEM_CONSTANT "D_INJ_MASS_ZERO" "0"
 SYSTEM_CONSTANT "EATSCD_SWTSIG_NOCON" "2"
 SYSTEM_CONSTANT "EATSCD_SWTSIG_TYPE" "2"
 SYSTEM_CONSTANT "EATSCD_SWTSIG_VAL" "0"
 SYSTEM_CONSTANT "EATSCD_TLIN_CUR_X" "25"
 SYSTEM_CONSTANT "EEPDEV_NUMINITBLOCKS_CA" "36"
 SYSTEM_CONSTANT "EGPPCD_NUM_FLTSIZE" "5"
 SYSTEM_CONSTANT "EGPPCD_TLINTEMP2_CUR_X" "2"
 SYSTEM_CONSTANT "EGPPCD_TLINTEMP_CUR_X" "40"
 SYSTEM_CONSTANT "EGPP_FACPOW_CUR_X" "2"
 SYSTEM_CONSTANT "EGPP_FACRHOETA_CUR_X" "2"
 SYSTEM_CONSTANT "EGPP_PPRESCALC_MAP_X" "5"
 SYSTEM_CONSTANT "EGPP_PPRESCALC_MAP_Y" "5"
 SYSTEM_CONSTANT "EGPP_PPSTPFLT_MAP_X" "8"
 SYSTEM_CONSTANT "EGPP_PPSTPFLT_MAP_Y" "8"
 SYSTEM_CONSTANT "EGRCD_ACTSEL_SWT" "2"
 SYSTEM_CONSTANT "EGRCD_DCYCEGR_MAP_X" "2"
 SYSTEM_CONSTANT "EGRCD_DCYCEGR_MAP_Y" "2"
 SYSTEM_CONSTANT "EGRCD_FACENGSPDCOR_CUR_X" "20"
 SYSTEM_CONSTANT "EGRCD_PATMCOR_CUR_X" "20"
 SYSTEM_CONSTANT "EGRCD_PDIFF_CUR_X" "20"
 SYSTEM_CONSTANT "EGRCD_SWT_EEGR" "1"
 SYSTEM_CONSTANT "EGRCD_SWT_EGR" "0"
 SYSTEM_CONSTANT "EGRCD_SWT_EGRDUO" "2"
 SYSTEM_CONSTANT "EGRCD_TAIRCOR_CUR_X" "20"
 SYSTEM_CONSTANT "EGRSCD_RLIN_CUR_X" "25"
 SYSTEM_CONSTANT "EGRVLV_DIAG_ACTSEL_SWT" "0"
 SYSTEM_CONSTANT "EGRVLV_IEFF_CUR_X" "8"
 SYSTEM_CONSTANT "EGRVLV_RGVNRMAX_CUR_X" "3"
 SYSTEM_CONSTANT "EGRVLV_RGVNRMIN_CUR_X" "3"
 SYSTEM_CONSTANT "EGRVLV_SWT_NODIAG" "0"
 SYSTEM_CONSTANT "EGSYS_ALPOXICAT_MAP_X" "16"
 SYSTEM_CONSTANT "EGSYS_ALPOXICAT_MAP_Y" "16"
 SYSTEM_CONSTANT "EGSYS_CNDHTEG_CUR_X" "8"
 SYSTEM_CONSTANT "EGSYS_CPEG_MAP_X" "6"
 SYSTEM_CONSTANT "EGSYS_CPEG_MAP_Y" "6"
 SYSTEM_CONSTANT "EGSYS_CT_MON" "3"
 SYSTEM_CONSTANT "EGSYS_CT_TUBES" "4"
 SYSTEM_CONSTANT "EGSYS_DMAIR_MAP_X" "8"
 SYSTEM_CONSTANT "EGSYS_DMAIR_MAP_Y" "8"
 SYSTEM_CONSTANT "EGSYS_DMEXHGAS_MAP_X" "10"
 SYSTEM_CONSTANT "EGSYS_DMEXHGAS_MAP_Y" "10"
 SYSTEM_CONSTANT "EGSYS_DMHCCLDSTRT_CUR_X" "12"
 SYSTEM_CONSTANT "EGSYS_DPEXHGAS_MAP_X" "10"
 SYSTEM_CONSTANT "EGSYS_DPEXHGAS_MAP_Y" "10"
 SYSTEM_CONSTANT "EGSYS_ETACHRG_MAP_X" "8"
 SYSTEM_CONSTANT "EGSYS_ETACHRG_MAP_Y" "8"
 SYSTEM_CONSTANT "EGSYS_FACAIRMASS_CUR_X" "8"
 SYSTEM_CONSTANT "EGSYS_FACCMPRINTK_CUR_X" "8"
 SYSTEM_CONSTANT "EGSYS_FACCORRCLDENG_CUR_X" "8"
 SYSTEM_CONSTANT "EGSYS_FACHCPOI1GVNR_MAP_X" "12"
 SYSTEM_CONSTANT "EGSYS_FACHCPOI1GVNR_MAP_Y" "12"
 SYSTEM_CONSTANT "EGSYS_FACHCPOI2GVNR_MAP_X" "12"
 SYSTEM_CONSTANT "EGSYS_FACHCPOI2GVNR_MAP_Y" "12"
 SYSTEM_CONSTANT "EGSYS_FACSTRTDLV_CUR_X" "8"
 SYSTEM_CONSTANT "EGSYS_FACTEMPCLG_CUR_X" "8"
 SYSTEM_CONSTANT "EGSYS_FACTEMPCMB_CUR_X" "8"
 SYSTEM_CONSTANT "EGSYS_FACTHCCNVOXICAT_CUR_X" "8"
 SYSTEM_CONSTANT "EGSYS_FACTIMECLG_CUR_X" "8"
 SYSTEM_CONSTANT "EGSYS_NTRBNMAX_MAP_X" "10"
 SYSTEM_CONSTANT "EGSYS_NTRBNMAX_MAP_Y" "10"
 SYSTEM_CONSTANT "EGSYS_NUMNSC" "1"
 SYSTEM_CONSTANT "EGSYS_NUM_HCMODES" "2"
 SYSTEM_CONSTANT "EGSYS_NUM_TRBCHRGRMODELS" "2"
 SYSTEM_CONSTANT "EGSYS_NUPIPEENV_CUR_X" "8"
 SYSTEM_CONSTANT "EGSYS_NUPIPE_CUR_X" "8"
 SYSTEM_CONSTANT "EGSYS_NUTUBEENV_CUR_X" "8"
 SYSTEM_CONSTANT "EGSYS_NUTUBE_CUR_X" "8"
 SYSTEM_CONSTANT "EGSYS_PHISTRTDLV_MAP_X" "8"
 SYSTEM_CONSTANT "EGSYS_PHISTRTDLV_MAP_Y" "8"
 SYSTEM_CONSTANT "EGSYS_QHCNRM_MAP_X" "12"
 SYSTEM_CONSTANT "EGSYS_QHCNRM_MAP_Y" "12"
 SYSTEM_CONSTANT "EGSYS_QHCOXICATMON_MAP_X" "12"
 SYSTEM_CONSTANT "EGSYS_QHCOXICATMON_MAP_Y" "12"
 SYSTEM_CONSTANT "EGSYS_QHCRGN1_MAP_X" "12"
 SYSTEM_CONSTANT "EGSYS_QHCRGN1_MAP_Y" "12"
 SYSTEM_CONSTANT "EGSYS_QHCRGN2_MAP_X" "12"
 SYSTEM_CONSTANT "EGSYS_QHCRGN2_MAP_Y" "12"
 SYSTEM_CONSTANT "EGSYS_RPRES_MAP_X" "10"
 SYSTEM_CONSTANT "EGSYS_RPRES_MAP_Y" "10"
 SYSTEM_CONSTANT "EGSYS_RTEMPADBT_CUR_X" "8"
 SYSTEM_CONSTANT "EGSYS_TIAT_MAP_X" "8"
 SYSTEM_CONSTANT "EGSYS_TIAT_MAP_Y" "8"
 SYSTEM_CONSTANT "EGSYS_TMANFSTAT_MAP_X" "8"
 SYSTEM_CONSTANT "EGSYS_TMANFSTAT_MAP_Y" "8"
 SYSTEM_CONSTANT "EGSYS_TNSCEXOINCR_MAP_X" "8"
 SYSTEM_CONSTANT "EGSYS_TNSCEXOINCR_MAP_Y" "8"
 SYSTEM_CONSTANT "EGSYS_TOXICATEXOINCR_MAP_X" "8"
 SYSTEM_CONSTANT "EGSYS_TOXICATEXOINCR_MAP_Y" "8"
 SYSTEM_CONSTANT "EGSYS_VSCDYNEG_CUR_X" "8"
 SYSTEM_CONSTANT "EGSYS_VSCKINEG_CUR_X" "8"
 SYSTEM_CONSTANT "EGSYS_WTHRESLSU0_MAP_X" "10"
 SYSTEM_CONSTANT "EGSYS_WTHRESLSU0_MAP_Y" "10"
 SYSTEM_CONSTANT "EGTFACT_MAX" "3"
 SYSTEM_CONSTANT "EGTFACT_MIN" "-3"
 SYSTEM_CONSTANT "EGTFACT_RES" "0.001"
 SYSTEM_CONSTANT "EGTFACT_RES_INV" "1000"
 SYSTEM_CONSTANT "EGTRMP16_MAX" "32000"
 SYSTEM_CONSTANT "EGTRMP16_MIN" "0"
 SYSTEM_CONSTANT "EGTRMP16_RES" "32000"
 SYSTEM_CONSTANT "EGTRMP32TO16_FACT" "9"
 SYSTEM_CONSTANT "EGTRMP32_MAX" "16384000"
 SYSTEM_CONSTANT "EGTRMP32_MIN" "0"
 SYSTEM_CONSTANT "EGTRMP32_RES" "16384000"
 SYSTEM_CONSTANT "EGTSWT_FACT" "16384000"
 SYSTEM_CONSTANT "EGTSWT_FACT_S16" "16384"
 SYSTEM_CONSTANT "EGTSWT_NRM_EXP" "14"
 SYSTEM_CONSTANT "EGTSWT_RES" "6.103515625e-08"
 SYSTEM_CONSTANT "EGTSWT_RES_S16" "6.103515625e-05"
 SYSTEM_CONSTANT "EGTSWT_ZERO" "0"
 SYSTEM_CONSTANT "EGT_FACKIAMPT_CUR_X" "8"
 SYSTEM_CONSTANT "EGT_FACKIAMPT_MAP_X" "8"
 SYSTEM_CONSTANT "EGT_FACKIAMPT_MAP_Y" "8"
 SYSTEM_CONSTANT "EGT_FACKIQNTPOI1_MAP_X" "8"
 SYSTEM_CONSTANT "EGT_FACKIQNTPOI1_MAP_Y" "8"
 SYSTEM_CONSTANT "EGT_FACKIQNTPOI2_MAP_X" "8"
 SYSTEM_CONSTANT "EGT_FACKIQNTPOI2_MAP_Y" "8"
 SYSTEM_CONSTANT "EGT_FACKITEMPINRCOR_MAP_X" "8"
 SYSTEM_CONSTANT "EGT_FACKITEMPINRCOR_MAP_Y" "8"
 SYSTEM_CONSTANT "EGT_FACKPAMPT_CUR_X" "8"
 SYSTEM_CONSTANT "EGT_FACKPAMPT_MAP_X" "8"
 SYSTEM_CONSTANT "EGT_FACKPAMPT_MAP_Y" "8"
 SYSTEM_CONSTANT "EGT_FACKPQNTPOI1_MAP_X" "8"
 SYSTEM_CONSTANT "EGT_FACKPQNTPOI1_MAP_Y" "8"
 SYSTEM_CONSTANT "EGT_FACKPQNTPOI2_MAP_X" "8"
 SYSTEM_CONSTANT "EGT_FACKPQNTPOI2_MAP_Y" "8"
 SYSTEM_CONSTANT "EGT_FACKPTEMPINRCOR_MAP_X" "8"
 SYSTEM_CONSTANT "EGT_FACKPTEMPINRCOR_MAP_Y" "8"
 SYSTEM_CONSTANT "EGT_FACQNTPOI2RMP_CUR_X" "3"
 SYSTEM_CONSTANT "EGT_FACTMAX" "1"
 SYSTEM_CONSTANT "EGT_KIZERO" "0"
 SYSTEM_CONSTANT "EGT_KPZERO" "0"
 SYSTEM_CONSTANT "EGT_LIMMAX" "1"
 SYSTEM_CONSTANT "EGT_LIMMIN" "-1"
 SYSTEM_CONSTANT "EGT_MAIRLMBD_CUR_X" "4"
 SYSTEM_CONSTANT "EGT_MAIRTEMPGVNRMAX_MAP_X" "12"
 SYSTEM_CONSTANT "EGT_MAIRTEMPGVNRMAX_MAP_Y" "12"
 SYSTEM_CONSTANT "EGT_MAIRTEMPGVNRMIN_MAP_X" "12"
 SYSTEM_CONSTANT "EGT_MAIRTEMPGVNRMIN_MAP_Y" "12"
 SYSTEM_CONSTANT "EGT_PHIPOI1TEMPGVNR_MAP_X" "8"
 SYSTEM_CONSTANT "EGT_PHIPOI1TEMPGVNR_MAP_Y" "8"
 SYSTEM_CONSTANT "EGT_PHIPOI2TEMPGVNR_MAP_X" "8"
 SYSTEM_CONSTANT "EGT_PHIPOI2TEMPGVNR_MAP_Y" "8"
 SYSTEM_CONSTANT "EGT_PKGSEL_SWT" "1"
 SYSTEM_CONSTANT "EGT_QHCQNTPOI1_CUR_X" "3"
 SYSTEM_CONSTANT "EGT_QPOI1TEMPGVNRMAX_MAP_X" "12"
 SYSTEM_CONSTANT "EGT_QPOI1TEMPGVNRMAX_MAP_Y" "12"
 SYSTEM_CONSTANT "EGT_QPOI1TEMPGVNRMIN_MAP_X" "12"
 SYSTEM_CONSTANT "EGT_QPOI1TEMPGVNRMIN_MAP_Y" "12"
 SYSTEM_CONSTANT "EGT_QPOI2TEMPGVNRMAX_MAP_X" "12"
 SYSTEM_CONSTANT "EGT_QPOI2TEMPGVNRMAX_MAP_Y" "12"
 SYSTEM_CONSTANT "EGT_QPOI2TEMPGVNRMIN_MAP_X" "12"
 SYSTEM_CONSTANT "EGT_QPOI2TEMPGVNRMIN_MAP_Y" "12"
 SYSTEM_CONSTANT "EGT_SUBPKGSEL_SWT" "5"
 SYSTEM_CONSTANT "EGT_SWT_ADD" "1"
 SYSTEM_CONSTANT "EGT_SWT_ADD_ADDPMP" "3"
 SYSTEM_CONSTANT "EGT_SWT_ADD_HCI" "4"
 SYSTEM_CONSTANT "EGT_SWT_ADD_NEARENG" "5"
 SYSTEM_CONSTANT "EGT_SWT_CAT" "2"
 SYSTEM_CONSTANT "EGT_SWT_DISABLED" "0"
 SYSTEM_CONSTANT "EGT_SWT_ENABLED" "1"
 SYSTEM_CONSTANT "EGT_SWT_NOSEL" "0"
 SYSTEM_CONSTANT "EGT_SWT_VAL" "0"
 SYSTEM_CONSTANT "EGT_TINRCORTEMPGVNRMAX_MAP_X" "12"
 SYSTEM_CONSTANT "EGT_TINRCORTEMPGVNRMAX_MAP_Y" "12"
 SYSTEM_CONSTANT "EGT_TINRCORTEMPGVNRMIN_MAP_X" "12"
 SYSTEM_CONSTANT "EGT_TINRCORTEMPGVNRMIN_MAP_Y" "12"
 SYSTEM_CONSTANT "EGT_TINRDESTEMPTURB_CUR_X" "4"
 SYSTEM_CONSTANT "EGT_TINRDES_MAP_X" "16"
 SYSTEM_CONSTANT "EGT_TINRDES_MAP_Y" "16"
 SYSTEM_CONSTANT "EGT_TOUTRDESMFLO2_CUR_X" "8"
 SYSTEM_CONSTANT "EGT_TOUTRDESMSSOT_CUR_X" "8"
 SYSTEM_CONSTANT "EGT_TOUTRDESTEMPPST_CUR_X" "4"
 SYSTEM_CONSTANT "EGT_TOUTRDES_MAP_X" "4"
 SYSTEM_CONSTANT "EGT_TOUTRDES_MAP_Y" "4"
 SYSTEM_CONSTANT "EGT_WINNEG" "-1000"
 SYSTEM_CONSTANT "EGT_WINPOS" "1000"
 SYSTEM_CONSTANT "EGT_ZERO" "0"
 SYSTEM_CONSTANT "ENERGY_J_100MS_ONE" "1"
 SYSTEM_CONSTANT "ENERGY_J_RES" "1"
 SYSTEM_CONSTANT "ENERGY_RES" "1"
 SYSTEM_CONSTANT "ENGDN_RES" "1"
 SYSTEM_CONSTANT "ENGM_DCYCMNT_MAP_X" "2"
 SYSTEM_CONSTANT "ENGM_DCYCMNT_MAP_Y" "2"
 SYSTEM_CONSTANT "ENGM_DN_NORM" "31250"
 SYSTEM_CONSTANT "ENGM_DN_NORM_RED" "7812.5"
 SYSTEM_CONSTANT "ENGM_ENGMNTCTL_OFF" "0"
 SYSTEM_CONSTANT "ENGM_ENGMNTCTL_ON" "1"
 SYSTEM_CONSTANT "ENGM_NDIFF_MAX" "68719.476704"
 SYSTEM_CONSTANT "ENGM_NDIFF_MIN" "-68719.476736"
 SYSTEM_CONSTANT "ENGM_NUMCYL_10" "10"
 SYSTEM_CONSTANT "ENGM_NUMCYL_12" "12"
 SYSTEM_CONSTANT "ENGM_NUMCYL_3" "3"
 SYSTEM_CONSTANT "ENGM_NUMCYL_4" "4"
 SYSTEM_CONSTANT "ENGM_NUMCYL_5" "5"
 SYSTEM_CONSTANT "ENGM_NUMCYL_6" "6"
 SYSTEM_CONSTANT "ENGM_NUMCYL_8" "8"
 SYSTEM_CONSTANT "ENGM_NUMTHRESH" "3"
 SYSTEM_CONSTANT "ENGM_N_SWT_RES" "400"
 SYSTEM_CONSTANT "ENGM_RED_FAC" "4"
 SYSTEM_CONSTANT "ENGM_SWTENGMNTCTL_TYPE" "2"
 SYSTEM_CONSTANT "ENGM_SWTENGMNTCTL_VAL" "0"
 SYSTEM_CONSTANT "ENGM_SWTNUMCYL_TYPE" "0"
 SYSTEM_CONSTANT "ENGM_SWTNUMCYL_VAL" "4"
 SYSTEM_CONSTANT "ENGM_TRQFRCMIN_CUR_X" "25"
 SYSTEM_CONSTANT "ENGM_TRQFRC_MAP_X" "10"
 SYSTEM_CONSTANT "ENGM_TRQFRC_MAP_Y" "10"
 SYSTEM_CONSTANT "ENGPRT_FACAIROVHTPRV_MAP_X" "10"
 SYSTEM_CONSTANT "ENGPRT_FACAIROVHTPRV_MAP_Y" "10"
 SYSTEM_CONSTANT "ENGPRT_FACAPCORR_MAP_X" "10"
 SYSTEM_CONSTANT "ENGPRT_FACAPCORR_MAP_Y" "10"
 SYSTEM_CONSTANT "ENGPRT_FACBPAPINCLOADCORR_MAP_X" "4"
 SYSTEM_CONSTANT "ENGPRT_FACBPAPINCLOADCORR_MAP_Y" "5"
 SYSTEM_CONSTANT "ENGPRT_FACCHGR_CUR_X" "8"
 SYSTEM_CONSTANT "ENGPRT_FACCTOVHTPRV_MAP_X" "6"
 SYSTEM_CONSTANT "ENGPRT_FACCTOVHTPRV_MAP_Y" "10"
 SYSTEM_CONSTANT "ENGPRT_FACFLTEMPLIM_MAP_X" "10"
 SYSTEM_CONSTANT "ENGPRT_FACFLTEMPLIM_MAP_Y" "10"
 SYSTEM_CONSTANT "ENGPRT_FACOILOVHTPRV_MAP_X" "10"
 SYSTEM_CONSTANT "ENGPRT_FACOILOVHTPRV_MAP_Y" "10"
 SYSTEM_CONSTANT "ENGPRT_FACTBOOSTFUNC_MAP_X" "2"
 SYSTEM_CONSTANT "ENGPRT_FACTBOOSTFUNC_MAP_Y" "2"
 SYSTEM_CONSTANT "ENGPRT_FACTEMPBOOSTPRETRBN_MAP_X" "2"
 SYSTEM_CONSTANT "ENGPRT_FACTEMPBOOSTPRETRBN_MAP_Y" "2"
 SYSTEM_CONSTANT "ENGPRT_FACTEMPPRETRBN_MAP_X" "8"
 SYSTEM_CONSTANT "ENGPRT_FACTEMPPRETRBN_MAP_Y" "8"
 SYSTEM_CONSTANT "ENGPRT_FLTEMPVIRT_MAP_X" "3"
 SYSTEM_CONSTANT "ENGPRT_FLTEMPVIRT_MAP_Y" "5"
 SYSTEM_CONSTANT "ENGPRT_OILOVHTPREV_OFF" "0"
 SYSTEM_CONSTANT "ENGPRT_OILOVHTPREV_ON" "1"
 SYSTEM_CONSTANT "ENGPRT_QLIMPBOOST_MAP_X" "2"
 SYSTEM_CONSTANT "ENGPRT_QLIMPBOOST_MAP_Y" "2"
 SYSTEM_CONSTANT "ENGPRT_QLIMP_MAP_X" "4"
 SYSTEM_CONSTANT "ENGPRT_QLIMP_MAP_Y" "25"
 SYSTEM_CONSTANT "ENGPRT_SWTOILOVHTPREV_TYPE" "2"
 SYSTEM_CONSTANT "ENGPRT_SWTOILOVHTPREV_VAL" "0"
 SYSTEM_CONSTANT "ENGPRT_SWTTEMPPRETRBN_TYPE" "2"
 SYSTEM_CONSTANT "ENGPRT_SWTTEMPPRETRBN_VAL" "0"
 SYSTEM_CONSTANT "ENGPRT_TEMPPRETRBN_MODEL" "1"
 SYSTEM_CONSTANT "ENGPRT_TEMPPRETRBN_SENSOR" "0"
 SYSTEM_CONSTANT "ENGPRT_TRQINCLOAD_MAP_X" "11"
 SYSTEM_CONSTANT "ENGPRT_TRQINCLOAD_MAP_Y" "10"
 SYSTEM_CONSTANT "ENGPRT_TRQLIMPBOOST_MAP_X" "2"
 SYSTEM_CONSTANT "ENGPRT_TRQLIMPBOOST_MAP_Y" "2"
 SYSTEM_CONSTANT "ENGPRT_TRQLIMP_MAP_X" "4"
 SYSTEM_CONSTANT "ENGPRT_TRQLIMP_MAP_Y" "25"
 SYSTEM_CONSTANT "ENGPRT_TRQLIMRVNNOPI_MAP_X" "3"
 SYSTEM_CONSTANT "ENGPRT_TRQLIMRVNNOPI_MAP_Y" "21"
 SYSTEM_CONSTANT "ENGPRT_TRQLIMRVNPI_MAP_X" "2"
 SYSTEM_CONSTANT "ENGPRT_TRQLIMRVNPI_MAP_Y" "2"
 SYSTEM_CONSTANT "ENGPRT_TRQNLIMSHTRP_CUR_X" "3"
 SYSTEM_CONSTANT "ENGPRT_TRQNLIMSPR_CUR_X" "25"
 SYSTEM_CONSTANT "ENGPRT_TRQNLIM_CUR_X" "25"
 SYSTEM_CONSTANT "ENGPRT_TRQPILIM_MAP_X" "6"
 SYSTEM_CONSTANT "ENGPRT_TRQPILIM_MAP_Y" "3"
 SYSTEM_CONSTANT "ENGTENG_SWTTEMPSUB_COTSCD" "1"
 SYSTEM_CONSTANT "ENGTENG_SWTTEMPSUB_FTSCD" "2"
 SYSTEM_CONSTANT "ENGTENG_SWTTEMPSUB_IATSCD" "3"
 SYSTEM_CONSTANT "ENGTENG_SWTTEMPSUB_OTSCD" "0"
 SYSTEM_CONSTANT "ENG_CTFLD_NUM" "5"
 SYSTEM_CONSTANT "ENG_DTENG_MAP_X" "4"
 SYSTEM_CONSTANT "ENG_DTENG_MAP_Y" "6"
 SYSTEM_CONSTANT "ENG_NRGNIDLE_MAX" "1490"
 SYSTEM_CONSTANT "ENG_N_2_RMP_ENG_N_LOW" "1000000"
 SYSTEM_CONSTANT "ENG_N_HIRES" "0.03125"
 SYSTEM_CONSTANT "ENG_N_HIRES_EXP" "5"
 SYSTEM_CONSTANT "ENG_N_MAX" "6000"
 SYSTEM_CONSTANT "ENG_N_MIN" "40"
 SYSTEM_CONSTANT "ENG_N_RES" "1"
 SYSTEM_CONSTANT "ENG_N_RES_FL" "1"
 SYSTEM_CONSTANT "ENG_N_RES_INV" "1"
 SYSTEM_CONSTANT "ENG_N_TEST" "8000"
 SYSTEM_CONSTANT "ENG_N_ZERO" "0"
 SYSTEM_CONSTANT "ENG_TRQSPD_CUR_X" "25"
 SYSTEM_CONSTANT "ERLPCD_SWTMIL_TYPE" "2"
 SYSTEM_CONSTANT "ERLPCD_SWTMIL_VAL" "0"
 SYSTEM_CONSTANT "ERLPCD_SWTSYS_TYPE" "2"
 SYSTEM_CONSTANT "ERLPCD_SWTSYS_VAL" "0"
 SYSTEM_CONSTANT "ESCU_DES_ZERO" "0"
 SYSTEM_CONSTANT "ESP_ECD" "2"
 SYSTEM_CONSTANT "ETA_CORR_FACT_ONE" "1"
 SYSTEM_CONSTANT "ETA_EXP" "7"
 SYSTEM_CONSTANT "ETA_RES" "0.0078125"
 SYSTEM_CONSTANT "ETA_RES_REV" "128"
 SYSTEM_CONSTANT "ETCLB_NUM_RAILP_CLB_PNT" "2"
 SYSTEM_CONSTANT "EULER2PRES_EXP" "35"
 SYSTEM_CONSTANT "EULER2PRES_EXP1" "4"
 SYSTEM_CONSTANT "EULER2PRES_EXP2" "31"
 SYSTEM_CONSTANT "EULER_NUM_RES" "0.1"
 SYSTEM_CONSTANT "FACT1_EXP" "7"
 SYSTEM_CONSTANT "FACT1_FACT1_RES" "16384"
 SYSTEM_CONSTANT "FACT1_ONE" "1"
 SYSTEM_CONSTANT "FACT1_RES" "0.0078125"
 SYSTEM_CONSTANT "FACT1_RES_REV" "128"
 SYSTEM_CONSTANT "FACT1_ZERO" "0"
 SYSTEM_CONSTANT "FACT2_EXP" "4"
 SYSTEM_CONSTANT "FACT2_RES" "0.0625"
 SYSTEM_CONSTANT "FACT2_RES_REV" "16"
 SYSTEM_CONSTANT "FACTLOW_NRM_EXP" "10"
 SYSTEM_CONSTANT "FACTLOW_ONE" "1"
 SYSTEM_CONSTANT "FACTOR_10" "10"
 SYSTEM_CONSTANT "FACTOR_100" "100"
 SYSTEM_CONSTANT "FACT_0_5_RES" "2"
 SYSTEM_CONSTANT "FACT_0_5_RES_REV" "0.5"
 SYSTEM_CONSTANT "FACT_100" "0.01"
 SYSTEM_CONSTANT "FACT_1000" "0.001"
 SYSTEM_CONSTANT "FACT_1000_ZERO" "0"
 SYSTEM_CONSTANT "FACT_100m_RES" "0.1"
 SYSTEM_CONSTANT "FACT_100m_RES_REV" "10"
 SYSTEM_CONSTANT "FACT_100U_RES" "0.0001"
 SYSTEM_CONSTANT "FACT_100U_RES_REV" "10000"
 SYSTEM_CONSTANT "FACT_10m_RES" "0.01"
 SYSTEM_CONSTANT "FACT_10m_RES_REV" "100"
 SYSTEM_CONSTANT "FACT_2m_RES" "0.002"
 SYSTEM_CONSTANT "FACT_2m_RES_REV" "500"
 SYSTEM_CONSTANT "FACT_500U_RES" "0.0005"
 SYSTEM_CONSTANT "FACT_500U_RES_REV" "2000"
 SYSTEM_CONSTANT "FACT_ANG_HRES" "128"
 SYSTEM_CONSTANT "FACT_BIP_RES" "4096"
 SYSTEM_CONSTANT "FACT_GOVILMBD_RES_REV" "64"
 SYSTEM_CONSTANT "FACT_GOVIT3_RES_REV" "512"
 SYSTEM_CONSTANT "FACT_GOVPLMBD_RES_REV" "128"
 SYSTEM_CONSTANT "FACT_GOVPT3_RES_REV" "256"
 SYSTEM_CONSTANT "FACT_HFMEXP" "14"
 SYSTEM_CONSTANT "FACT_HFMRES" "6.103515625e-05"
 SYSTEM_CONSTANT "FACT_HFMRES_REV" "16384"
 SYSTEM_CONSTANT "FACT_INV_100" "100"
 SYSTEM_CONSTANT "FACT_INV_1000" "1000"
 SYSTEM_CONSTANT "FACT_LAMBDAREC1" "100"
 SYSTEM_CONSTANT "FACT_LAMBDAREC2" "1000000"
 SYSTEM_CONSTANT "FACT_LAMBDAREC3" "2"
 SYSTEM_CONSTANT "FACT_NRM_EXP" "13"
 SYSTEM_CONSTANT "FACT_NRM_EXP_LOW" "10"
 SYSTEM_CONSTANT "FACT_O2THM_HI_TO_LO" "2"
 SYSTEM_CONSTANT "FACT_ONE" "1"
 SYSTEM_CONSTANT "FACT_ONE_LOW" "1"
 SYSTEM_CONSTANT "FACT_PERCLTRPER_G_RES" "0.001"
 SYSTEM_CONSTANT "FACT_PERCLTRPER_G_RES_REV" "1000"
 SYSTEM_CONSTANT "FACT_PI_EXP" "16"
 SYSTEM_CONSTANT "FACT_PI_I" "4295"
 SYSTEM_CONSTANT "FACT_PI_P" "65536"
 SYSTEM_CONSTANT "FACT_PRCBRK_RES" "5e-05"
 SYSTEM_CONSTANT "FACT_PRCBRK_RES_REV" "20000"
 SYSTEM_CONSTANT "FACT_PREFILL" "320"
 SYSTEM_CONSTANT "FACT_PRES_AC_HPA_RES_REV" "16384"
 SYSTEM_CONSTANT "FACT_RES" "0.0001220703125"
 SYSTEM_CONSTANT "FACT_RES_FL" "0.0001220703125"
 SYSTEM_CONSTANT "FACT_RES_HIGH" "0.0001"
 SYSTEM_CONSTANT "FACT_RES_LOW" "0.0009765625"
 SYSTEM_CONSTANT "FACT_RES_REV" "8192"
 SYSTEM_CONSTANT "FACT_RES_REV_HIGH" "10000"
 SYSTEM_CONSTANT "FACT_RES_REV_LOW" "1024"
 SYSTEM_CONSTANT "FACT_RPWR_CAN_RES_REV" "1206.37157897856"
 SYSTEM_CONSTANT "FACT_RTRQ_CAN_RES_REV" "3212.550144"
 SYSTEM_CONSTANT "FACT_TCLNT_MOD_NRM_EXP" "12"
 SYSTEM_CONSTANT "FACT_TCLNT_MOD_RES_REV" "4096"
 SYSTEM_CONSTANT "FACT_TEMP" "-2731.4"
 SYSTEM_CONSTANT "FACT_TEN" "10"
 SYSTEM_CONSTANT "FACT_TFCT_REV" "4096"
 SYSTEM_CONSTANT "FACT_TIME2RMPTRQ" "6553.6"
 SYSTEM_CONSTANT "FACT_TINC_HRES" "256"
 SYSTEM_CONSTANT "FACT_WEARSOOTIDX_RES" "2e-08"
 SYSTEM_CONSTANT "FACT_WEARSOOTIDX_RES_REV" "50000000"
 SYSTEM_CONSTANT "FACT_WEARSOOT_RES" "0.1"
 SYSTEM_CONSTANT "FACT_ZERO" "0"
 SYSTEM_CONSTANT "FAC_PERDUR_TO_RPM" "60000000"
 SYSTEM_CONSTANT "FAC_RPM_TO_SWTIME" "6000"
 SYSTEM_CONSTANT "FAC_USEC_TO_RPM" "60000000"
 SYSTEM_CONSTANT "FANCD_FANSHUTOFF_OFF" "0"
 SYSTEM_CONSTANT "FANCD_FANSHUTOFF_ON" "1"
 SYSTEM_CONSTANT "FANCD_SWTFANSHUTOFF_TYPE" "2"
 SYSTEM_CONSTANT "FANCD_SWTFANSHUTOFF_VAL" "1"
 SYSTEM_CONSTANT "FANCTL_CLGMODVAR_HFM" "1"
 SYSTEM_CONSTANT "FANCTL_CLGMODVAR_MBC" "0"
 SYSTEM_CONSTANT "FANCTL_CLGMODVAR_TYPE" "0"
 SYSTEM_CONSTANT "FANCTL_CLGMODVAR_VAL" "0"
 SYSTEM_CONSTANT "FANCTL_DCYCCALC_CUR_X" "25"
 SYSTEM_CONSTANT "FANCTL_DCYCFAN1PRESET3_MAP_X" "5"
 SYSTEM_CONSTANT "FANCTL_DCYCFAN1PRESET3_MAP_Y" "5"
 SYSTEM_CONSTANT "FANCTL_DCYCFAN1_MAP_X" "8"
 SYSTEM_CONSTANT "FANCTL_DCYCFAN1_MAP_Y" "8"
 SYSTEM_CONSTANT "FANCTL_DCYCFAN2PRESET3_MAP_X" "5"
 SYSTEM_CONSTANT "FANCTL_DCYCFAN2PRESET3_MAP_Y" "5"
 SYSTEM_CONSTANT "FANCTL_DCYCFAN2_CUR_X" "8"
 SYSTEM_CONSTANT "FANCTL_DTCLNTDESCORR_MAP_X" "5"
 SYSTEM_CONSTANT "FANCTL_DTCLNTDESCORR_MAP_Y" "5"
 SYSTEM_CONSTANT "FANCTL_DTCLNTDESDIFF_MAP_X" "8"
 SYSTEM_CONSTANT "FANCTL_DTCLNTDESDIFF_MAP_Y" "8"
 SYSTEM_CONSTANT "FANCTL_FACTACREQCORR_CUR_X" "6"
 SYSTEM_CONSTANT "FANCTL_FACTAPREQCORR_CUR_X" "6"
 SYSTEM_CONSTANT "FANCTL_FACTAPREQ_MAP_X" "6"
 SYSTEM_CONSTANT "FANCTL_FACTAPREQ_MAP_Y" "6"
 SYSTEM_CONSTANT "FANCTL_FACTARBASECOR_CUR_X" "4"
 SYSTEM_CONSTANT "FANCTL_FACTCORR_CUR_X" "8"
 SYSTEM_CONSTANT "FANCTL_NELMIN_CUR_X" "6"
 SYSTEM_CONSTANT "FANCTL_NFAN1BASE_MAP_X" "8"
 SYSTEM_CONSTANT "FANCTL_NFAN1BASE_MAP_Y" "8"
 SYSTEM_CONSTANT "FANCTL_NFAN2BASE_MAP_X" "8"
 SYSTEM_CONSTANT "FANCTL_NFAN2BASE_MAP_Y" "8"
 SYSTEM_CONSTANT "FANCTL_NHYDMIN_CUR_X" "6"
 SYSTEM_CONSTANT "FANCTL_PRCCANREQ_CUR_X" "5"
 SYSTEM_CONSTANT "FANCTL_PRCCLNTINC_CUR_X" "4"
 SYSTEM_CONSTANT "FANCTL_PRCCNVVAR2_MAP_X" "6"
 SYSTEM_CONSTANT "FANCTL_PRCCNVVAR2_MAP_Y" "6"
 SYSTEM_CONSTANT "FANCTL_PRCCNV_MAP_X" "6"
 SYSTEM_CONSTANT "FANCTL_PRCCNV_MAP_Y" "6"
 SYSTEM_CONSTANT "FANCTL_PRCCTL_MAP_X" "8"
 SYSTEM_CONSTANT "FANCTL_PRCCTL_MAP_Y" "8"
 SYSTEM_CONSTANT "FANCTL_PRCQK_MAP_X" "5"
 SYSTEM_CONSTANT "FANCTL_PRCQK_MAP_Y" "4"
 SYSTEM_CONSTANT "FANCTL_PRCQK_X" "6"
 SYSTEM_CONSTANT "FANCTL_TARTHRES_CUR_X" "4"
 SYSTEM_CONSTANT "FANCTL_TCLNTCRIT_MAP_X" "5"
 SYSTEM_CONSTANT "FANCTL_TCLNTCRIT_MAP_Y" "5"
 SYSTEM_CONSTANT "FANCTL_TCLNTDESRAW_MAP_X" "8"
 SYSTEM_CONSTANT "FANCTL_TCLNTDESRAW_MAP_Y" "8"
 SYSTEM_CONSTANT "FANCTL_TCLNTDES_MAP_X" "8"
 SYSTEM_CONSTANT "FANCTL_TCLNTDES_MAP_Y" "8"
 SYSTEM_CONSTANT "FANCTL_TIARBASE_MAP_X" "14"
 SYSTEM_CONSTANT "FANCTL_TIARBASE_MAP_Y" "8"
 SYSTEM_CONSTANT "FANCTL_TIARCOR1_MAP_X" "8"
 SYSTEM_CONSTANT "FANCTL_TIARCOR1_MAP_Y" "8"
 SYSTEM_CONSTANT "FANCTL_TIARCOR2_MAP_X" "8"
 SYSTEM_CONSTANT "FANCTL_TIARCOR2_MAP_Y" "8"
 SYSTEM_CONSTANT "FANCTL_TIAROILCOR_CUR_X" "8"
 SYSTEM_CONSTANT "FBASE_HFM" "40"
 SYSTEM_CONSTANT "FBC_AAL0" "0.0155861364"
 SYSTEM_CONSTANT "FBC_AAL1" "0.0571060835"
 SYSTEM_CONSTANT "FBC_AAL2" "0.125906618"
 SYSTEM_CONSTANT "FBC_AAL3" "0.191080679"
 SYSTEM_CONSTANT "FBC_AAL4" "0.220640963"
 SYSTEM_CONSTANT "FBC_AAL5" "0.191080679"
 SYSTEM_CONSTANT "FBC_AAL6" "0.125906618"
 SYSTEM_CONSTANT "FBC_AAL7" "0.0571060835"
 SYSTEM_CONSTANT "FBC_AAL8" "0.0155861364"
 SYSTEM_CONSTANT "FBC_AALORD" "8"
 SYSTEM_CONSTANT "FBC_BPfac_MAX" "0.0122074037903989"
 SYSTEM_CONSTANT "FBC_BPfac_MIN" "-0.0122074037903989"
 SYSTEM_CONSTANT "FBC_BPfac_RES" "0.000610370189519944"
 SYSTEM_CONSTANT "FBC_BPfac_RES_FL" "0.000610370189519944"
 SYSTEM_CONSTANT "FBC_CTSEGOFFSET" "2"
 SYSTEM_CONSTANT "FBC_DBPFAC1DEN1" "1.3611"
 SYSTEM_CONSTANT "FBC_DBPFAC1DEN2" "0.9245"
 SYSTEM_CONSTANT "FBC_DBPFAC2DEN1" "0.000944"
 SYSTEM_CONSTANT "FBC_DBPFAC2DEN2" "0.9245"
 SYSTEM_CONSTANT "FBC_DBPFAC3DEN1" "0"
 SYSTEM_CONSTANT "FBC_DBPFAC3DEN2" "0"
 SYSTEM_CONSTANT "FBC_DBPFAC4DEN1" "0"
 SYSTEM_CONSTANT "FBC_DBPFAC4DEN2" "0"
 SYSTEM_CONSTANT "FBC_DBPFAC5DEN1" "0"
 SYSTEM_CONSTANT "FBC_DBPFAC5DEN2" "0"
 SYSTEM_CONSTANT "FBC_DSYN" "1"
 SYSTEM_CONSTANT "FBC_NUMPRECTLLRNEEP" "6"
 SYSTEM_CONSTANT "FBC_NUMPRECTLLRNRAMN" "2"
 SYSTEM_CONSTANT "FBC_NUMPRECTLLRNRAMQ" "4"
 SYSTEM_CONSTANT "FBC_NUMPRECTLLRNRAMT" "2"
 SYSTEM_CONSTANT "FBC_NUMSEG" "3"
 SYSTEM_CONSTANT "FBC_QLIM_CUR_X" "4"
 SYSTEM_CONSTANT "FIOMAX" "8"
 SYSTEM_CONSTANT "FIR_SEQ_GEO" "1"
 SYSTEM_CONSTANT "FIR_SEQ_NUM" "0"
 SYSTEM_CONSTANT "FL2ASH_EXP" "16"
 SYSTEM_CONSTANT "FLCONS1_L_H_MIN" "0"
 SYSTEM_CONSTANT "FLCONS1_RES" "0.01"
 SYSTEM_CONSTANT "FLCONS1_RES_INV" "100"
 SYSTEM_CONSTANT "FLCONS2_RES" "1"
 SYSTEM_CONSTANT "FLCONS2_RES_1" "0.001"
 SYSTEM_CONSTANT "FLCONS2_RES_HIGH" "0.05"
 SYSTEM_CONSTANT "FLCONS2_RES_HIGH_REV" "20"
 SYSTEM_CONSTANT "FLCONS2_RES_REV" "1"
 SYSTEM_CONSTANT "FLMNG_DSMOKEMAPNR_MAP_X" "2"
 SYSTEM_CONSTANT "FLMNG_FACCORAIRTEMP_CUR_X" "12"
 SYSTEM_CONSTANT "FLMNG_FACCORAP_CUR_X" "12"
 SYSTEM_CONSTANT "FLMNG_FACCORENGTEMP_CUR_X" "12"
 SYSTEM_CONSTANT "FLMNG_FACDYNSMKAP_CUR_X" "5"
 SYSTEM_CONSTANT "FLMNG_FACDYNSMKTEMP_CUR_X" "5"
 SYSTEM_CONSTANT "FLMNG_FACDYNSMOKE_CUR_X" "8"
 SYSTEM_CONSTANT "FLMNG_FACLMBDSMKSOE_CUR_X" "6"
 SYSTEM_CONSTANT "FLMNG_FULLLDRGLIKI_CUR_X" "7"
 SYSTEM_CONSTANT "FLMNG_FULLLDRGLPKP_CUR_X" "7"
 SYSTEM_CONSTANT "FLMNG_PIATCORR_MAP_X" "16"
 SYSTEM_CONSTANT "FLMNG_PIATCORR_MAP_Y" "10"
 SYSTEM_CONSTANT "FLMNG_QAFSCDSMOKE_MAP_X" "16"
 SYSTEM_CONSTANT "FLMNG_QAFSCDSMOKE_MAP_Y" "13"
 SYSTEM_CONSTANT "FLMNG_QAFSCDTENGSMOKEMAP0_MAP_X" "2"
 SYSTEM_CONSTANT "FLMNG_QAFSCDTENGSMOKEMAP0_MAP_Y" "2"
 SYSTEM_CONSTANT "FLMNG_QAFSCDTENGSMOKEMAP1_MAP_X" "2"
 SYSTEM_CONSTANT "FLMNG_QAFSCDTENGSMOKEMAP1_MAP_Y" "2"
 SYSTEM_CONSTANT "FLMNG_QAFSCDTENGSMOKEMAP2_MAP_X" "2"
 SYSTEM_CONSTANT "FLMNG_QAFSCDTENGSMOKEMAP2_MAP_Y" "2"
 SYSTEM_CONSTANT "FLMNG_QDYNSMOKE_MAP_X" "8"
 SYSTEM_CONSTANT "FLMNG_QDYNSMOKE_MAP_Y" "8"
 SYSTEM_CONSTANT "FLMNG_QPRESSMOKE_MAP_X" "16"
 SYSTEM_CONSTANT "FLMNG_QPRESSMOKE_MAP_Y" "13"
 SYSTEM_CONSTANT "FLMNG_QTEMPFUEL_MAP_X" "10"
 SYSTEM_CONSTANT "FLMNG_QTEMPFUEL_MAP_Y" "10"
 SYSTEM_CONSTANT "FLMNG_RLMBDPARTLD_CUR_X" "12"
 SYSTEM_CONSTANT "FLMNG_RLMBDSMKEGT_MAP_X" "16"
 SYSTEM_CONSTANT "FLMNG_RLMBDSMKEGT_MAP_Y" "13"
 SYSTEM_CONSTANT "FLMNG_RLMBDSMKLIM0_MAP_X" "16"
 SYSTEM_CONSTANT "FLMNG_RLMBDSMKLIM0_MAP_Y" "13"
 SYSTEM_CONSTANT "FLMNG_RLMBDSMKLIM1_MAP_X" "16"
 SYSTEM_CONSTANT "FLMNG_RLMBDSMKLIM1_MAP_Y" "13"
 SYSTEM_CONSTANT "FLMNG_RLMBDSMKLIM2_MAP_X" "16"
 SYSTEM_CONSTANT "FLMNG_RLMBDSMKLIM2_MAP_Y" "13"
 SYSTEM_CONSTANT "FLMNG_RLMBDSMKLIMNR_CUR_X" "3"
 SYSTEM_CONSTANT "FLMNG_RLMBDSMKSOE_MAP_X" "16"
 SYSTEM_CONSTANT "FLMNG_RLMBDSMKSOE_MAP_Y" "6"
 SYSTEM_CONSTANT "FLMNG_R_STOICH" "14.5"
 SYSTEM_CONSTANT "FLMNG_R_STOICH_INT" "145"
 SYSTEM_CONSTANT "FLMNG_SMK_NORM" "689.655172413793"
 SYSTEM_CONSTANT "FLMNG_SWTFULLLDRGL_TYPE" "2"
 SYSTEM_CONSTANT "FLMNG_SWTFULLLDRGL_VAL" "0"
 SYSTEM_CONSTANT "FLMNG_TIFULLLDRGLDEL_CUR_X" "10"
 SYSTEM_CONSTANT "FLPPCD_FLPPACT_OFF" "0"
 SYSTEM_CONSTANT "FLPPCD_FLPPACT_ON" "1"
 SYSTEM_CONSTANT "FLPPCD_SWTFLPPACT_TYPE" "1"
 SYSTEM_CONSTANT "FLPPCD_SWTFLPPACT_VAL" "1"
 SYSTEM_CONSTANT "FLSCD_VOLTOTALLIN_CUR_X" "25"
 SYSTEM_CONSTANT "FLSYS_FTS_EXISTS" "1"
 SYSTEM_CONSTANT "FLSYS_FTS_NONE" "0"
 SYSTEM_CONSTANT "FLSYS_RHOFL_CUR_X" "2"
 SYSTEM_CONSTANT "FLSYS_SWTTEMPSENSCFG_TYPE" "2"
 SYSTEM_CONSTANT "FLSYS_SWTTEMPSENSCFG_VAL" "0"
 SYSTEM_CONSTANT "FLSYS_TEMP_CTS" "1"
 SYSTEM_CONSTANT "FLSYS_TEMP_DFL" "2"
 SYSTEM_CONSTANT "FLSYS_TEMP_FTS" "0"
 SYSTEM_CONSTANT "FL_2_RES" "100"
 SYSTEM_CONSTANT "FL_Half_L_MAX" "300"
 SYSTEM_CONSTANT "FL_Half_L_MIN" "0"
 SYSTEM_CONSTANT "FL_L_MAX" "320"
 SYSTEM_CONSTANT "FL_L_MIN" "0"
 SYSTEM_CONSTANT "FL_L_RES" "0.01"
 SYSTEM_CONSTANT "FL_L_RES_INV" "100"
 SYSTEM_CONSTANT "FL_RES" "0.5"
 SYSTEM_CONSTANT "FL_RES_INV" "2"
 SYSTEM_CONSTANT "FL_VOL_RES" "0.001"
 SYSTEM_CONSTANT "FL_VOL_RES_INV" "1000"
 SYSTEM_CONSTANT "FMA_ACTSEL_SWT" "0"
 SYSTEM_CONSTANT "FMA_DT1_RES" "4294.967296"
 SYSTEM_CONSTANT "FMA_FACAIRSWTOFF_CUR_X" "8"
 SYSTEM_CONSTANT "FMA_FACENGSWTOFF_CUR_X" "8"
 SYSTEM_CONSTANT "FMA_FACFLSWTOFF_CUR_X" "8"
 SYSTEM_CONSTANT "FMA_INJMASSNSLP_RES" "10"
 SYSTEM_CONSTANT "FMA_INJMASSQSLP_RES" "10"
 SYSTEM_CONSTANT "FMA_INJMASS_RES" "10"
 SYSTEM_CONSTANT "FMA_QRST_MAP_X" "8"
 SYSTEM_CONSTANT "FMA_QRST_MAP_Y" "8"
 SYSTEM_CONSTANT "FMA_SWT_FMA" "0"
 SYSTEM_CONSTANT "FMA_SWT_FMACC" "1"
 SYSTEM_CONSTANT "FMPS_RES" "0.001"
 SYSTEM_CONSTANT "FMPS_RES_REV" "1000"
 SYSTEM_CONSTANT "FMTC_ETABAS_MAP_X" "16"
 SYSTEM_CONSTANT "FMTC_ETABAS_MAP_Y" "16"
 SYSTEM_CONSTANT "FMTC_MAIRCOR_CUR_X" "25"
 SYSTEM_CONSTANT "FMTC_MAIROPT_MAP_X" "16"
 SYSTEM_CONSTANT "FMTC_MAIROPT_MAP_Y" "16"
 SYSTEM_CONSTANT "FMTC_PBSTCOR_CUR_X" "25"
 SYSTEM_CONSTANT "FMTC_PBSTOPT_MAP_X" "16"
 SYSTEM_CONSTANT "FMTC_PBSTOPT_MAP_Y" "16"
 SYSTEM_CONSTANT "FMTC_QBAS_MAP_X" "16"
 SYSTEM_CONSTANT "FMTC_QBAS_MAP_Y" "18"
 SYSTEM_CONSTANT "FMTC_STRTINJCORT_CUR_X" "25"
 SYSTEM_CONSTANT "FMTC_STRTINJCOR_CUR_X" "25"
 SYSTEM_CONSTANT "FMTC_STRTINJOPTCORT_CUR_X" "25"
 SYSTEM_CONSTANT "FMTC_STRTINJOPT_MAP_X" "16"
 SYSTEM_CONSTANT "FMTC_STRTINJOPT_MAP_Y" "16"
 SYSTEM_CONSTANT "FMTC_TRQ2QRGN2_MAP_X" "2"
 SYSTEM_CONSTANT "FMTC_TRQ2QRGN2_MAP_Y" "2"
 SYSTEM_CONSTANT "FMTC_TRQ2QRGN_MAP_X" "2"
 SYSTEM_CONSTANT "FMTC_TRQ2QRGN_MAP_Y" "2"
 SYSTEM_CONSTANT "FOSC" "20"
 SYSTEM_CONSTANT "FQLSCD_RLIN_CUR_X" "20"
 SYSTEM_CONSTANT "FQTSCD_RLIN_CUR_X" "20"
 SYSTEM_CONSTANT "FQTSCD_RLIN_MAP_X" "20"
 SYSTEM_CONSTANT "FQTSCD_RLIN_MAP_Y" "8"
 SYSTEM_CONSTANT "FQTSCD_SWT_DISABLED" "0"
 SYSTEM_CONSTANT "FQTSCD_SWT_ENABLED" "1"
 SYSTEM_CONSTANT "FQTSCD_SWT_TYPE" "2"
 SYSTEM_CONSTANT "FQTSCD_SWT_VAL" "1"
 SYSTEM_CONSTANT "FQTSCD_TLIN_CUR_X" "25"
 SYSTEM_CONSTANT "FRCSURE" "1"
 SYSTEM_CONSTANT "FRC_SWT_DISABLED" "0"
 SYSTEM_CONSTANT "FRC_SWT_ENABLED" "1"
 SYSTEM_CONSTANT "FRICCOEFF_RES" "0.0001"
 SYSTEM_CONSTANT "FRICCOEFF_RES_REV" "10000"
 SYSTEM_CONSTANT "FRICTION_MAX" "32000"
 SYSTEM_CONSTANT "FRICTION_MIN" "-32000"
 SYSTEM_CONSTANT "FRICTION_RES" "1"
 SYSTEM_CONSTANT "FRICTION_RES_REV" "1"
 SYSTEM_CONSTANT "FRICTION_ZERO" "0"
 SYSTEM_CONSTANT "FRMMNG_CANVERMAX" "45"
 SYSTEM_CONSTANT "FRMMNG_CANVERMIN" "12"
 SYSTEM_CONSTANT "FRMMNG_DEBTRQERRMAX" "1"
 SYSTEM_CONSTANT "FRMMNG_DTRQFRCCANMAX_CUR_X" "5"
 SYSTEM_CONSTANT "FRMMNG_DTRQFRCCANMIN_CUR_X" "5"
 SYSTEM_CONSTANT "FRMMNG_DTRQFRCMAX_CUR_X" "5"
 SYSTEM_CONSTANT "FRMMNG_DTRQFRCMIN_CUR_X" "5"
 SYSTEM_CONSTANT "FRMMNG_FACTRQDYNCORR_MAP_X" "2"
 SYSTEM_CONSTANT "FRMMNG_FACTRQDYNCORR_MAP_Y" "2"
 SYSTEM_CONSTANT "FRMMNG_FACTRQINN_MAP_X" "2"
 SYSTEM_CONSTANT "FRMMNG_FACTRQINN_MAP_Y" "2"
 SYSTEM_CONSTANT "FRMMNG_FACTRQINRTRQ_SLOPE_CA" "4"
 SYSTEM_CONSTANT "FRMMNG_LOIL_MAP_X" "8"
 SYSTEM_CONSTANT "FRMMNG_LOIL_MAP_Y" "8"
 SYSTEM_CONSTANT "FRMMNG_MULTRQERRMAX" "10"
 SYSTEM_CONSTANT "FRMMNG_NDESRGN_MAP_X" "10"
 SYSTEM_CONSTANT "FRMMNG_NDESRGN_MAP_Y" "10"
 SYSTEM_CONSTANT "FRMMNG_NDES_MAP_X" "6"
 SYSTEM_CONSTANT "FRMMNG_NDES_MAP_Y" "10"
 SYSTEM_CONSTANT "FRMMNG_NENGPRT_MAP_X" "10"
 SYSTEM_CONSTANT "FRMMNG_NENGPRT_MAP_Y" "10"
 SYSTEM_CONSTANT "FRMMNG_NUMTOOVRFLOWVAR" "28"
 SYSTEM_CONSTANT "FRMMNG_NUM_MUXFREEZEFRAME" "16"
 SYSTEM_CONSTANT "FRMMNG_PRCFAN_MAX" "100"
 SYSTEM_CONSTANT "FRMMNG_RCURINF_MAP_X" "6"
 SYSTEM_CONSTANT "FRMMNG_RCURINF_MAP_Y" "3"
 SYSTEM_CONSTANT "FRMMNG_STCANVER_MAX" "8"
 SYSTEM_CONSTANT "FRMMNG_STCANVER_MIN" "0"
 SYSTEM_CONSTANT "FRMMNG_TRQINRTRQ_OFFSET_CA" "4"
 SYSTEM_CONSTANT "FSYS" "56"
 SYSTEM_CONSTANT "FTSCD_TLIN_CUR_X" "25"
 SYSTEM_CONSTANT "FUELQNTCORR_PLAUSMAX" "1638.35"
 SYSTEM_CONSTANT "GBSSCD_TIPER_MAX" "2684354.56"
 SYSTEM_CONSTANT "GEARBX_AADAPTMAX_CUR_X" "5"
 SYSTEM_CONSTANT "GEARBX_AST_OFF" "0"
 SYSTEM_CONSTANT "GEARBX_AST_ON" "1"
 SYSTEM_CONSTANT "GEARBX_NTSCLIMACC_MAP_X" "8"
 SYSTEM_CONSTANT "GEARBX_NTSCLIMACC_MAP_Y" "6"
 SYSTEM_CONSTANT "GEARBX_NTSCLIMRAT_MAP_X" "8"
 SYSTEM_CONSTANT "GEARBX_NTSCLIMRAT_MAP_Y" "6"
 SYSTEM_CONSTANT "GEARBX_NTSCLIM_CUR_X" "6"
 SYSTEM_CONSTANT "GEARBX_NUMGEAR_MAX" "6"
 SYSTEM_CONSTANT "GEARBX_NUMGEAR_MIN" "-1"
 SYSTEM_CONSTANT "GEARBX_SWTDEMTYPE_TYPE" "2"
 SYSTEM_CONSTANT "GEARBX_SWTDEMTYPE_VAL" "1"
 SYSTEM_CONSTANT "GEARBX_SWTTYPEAST_TYPE" "2"
 SYSTEM_CONSTANT "GEARBX_SWTTYPEAST_VAL" "1"
 SYSTEM_CONSTANT "GEARBX_SWTTYPE_STRLEN" "25"
 SYSTEM_CONSTANT "GEARBX_SWTTYPE_TYPE" "2"
 SYSTEM_CONSTANT "GEARBX_SWTTYPE_VAL" "0"
 SYSTEM_CONSTANT "GEARBX_TRANSPLAUSFACT" "37699.11184308"
 SYSTEM_CONSTANT "GEARBX_TRQCANERRMAX_MAP_X" "10"
 SYSTEM_CONSTANT "GEARBX_TRQCANERRMAX_MAP_Y" "10"
 SYSTEM_CONSTANT "GEARBX_TRQMAXGEAR1_CUR_X" "15"
 SYSTEM_CONSTANT "GEARBX_TRQMAXGEAR2_CUR_X" "15"
 SYSTEM_CONSTANT "GEARBX_TRQMAXGEAR3_CUR_X" "15"
 SYSTEM_CONSTANT "GEARBX_TRQMAXGEAR4_CUR_X" "15"
 SYSTEM_CONSTANT "GEARBX_TRQMAXGEAR5_CUR_X" "15"
 SYSTEM_CONSTANT "GEARBX_TRQMAXGEAR6_CUR_X" "15"
 SYSTEM_CONSTANT "GEARBX_TRQMAXGEARR_CUR_X" "15"
 SYSTEM_CONSTANT "GEARBX_TRQMOVEOFF_CUR_X" "25"
 SYSTEM_CONSTANT "GEARBX_TSC_OFF" "0"
 SYSTEM_CONSTANT "GEARBX_TSC_ON" "1"
 SYSTEM_CONSTANT "GEARBX_TYPE_AST" "2"
 SYSTEM_CONSTANT "GEARBX_TYPE_AT" "1"
 SYSTEM_CONSTANT "GEARBX_TYPE_CVT" "3"
 SYSTEM_CONSTANT "GEARBX_TYPE_MT" "0"
 SYSTEM_CONSTANT "GLWCTL_BATTCORR" "2"
 SYSTEM_CONSTANT "GLWCTL_BATTCORR_MSG" "3"
 SYSTEM_CONSTANT "GLWCTL_DIA" "4"
 SYSTEM_CONSTANT "GLWCTL_DWENRGSLP_CUR_X" "6"
 SYSTEM_CONSTANT "GLWCTL_FACGLWPWRRED_MAP_X" "6"
 SYSTEM_CONSTANT "GLWCTL_FACGLWPWRRED_MAP_Y" "6"
 SYSTEM_CONSTANT "GLWCTL_FACT" "10"
 SYSTEM_CONSTANT "GLWCTL_FACT_TIME" "10"
 SYSTEM_CONSTANT "GLWCTL_GSK2" "0"
 SYSTEM_CONSTANT "GLWCTL_GSK3" "1"
 SYSTEM_CONSTANT "GLWCTL_PREGLOWCUR" "1"
 SYSTEM_CONSTANT "GLWCTL_PREGLOWMAP" "0"
 SYSTEM_CONSTANT "GLWCTL_QPST_CUR_X" "25"
 SYSTEM_CONSTANT "GLWCTL_ROUT_MAP_X" "10"
 SYSTEM_CONSTANT "GLWCTL_ROUT_MAP_Y" "10"
 SYSTEM_CONSTANT "GLWCTL_RPSTCOR_MAP_X" "6"
 SYSTEM_CONSTANT "GLWCTL_RPSTCOR_MAP_Y" "6"
 SYSTEM_CONSTANT "GLWCTL_STINTR1_MAP_X" "16"
 SYSTEM_CONSTANT "GLWCTL_STINTR1_MAP_Y" "16"
 SYSTEM_CONSTANT "GLWCTL_STINTR2_MAP_X" "16"
 SYSTEM_CONSTANT "GLWCTL_STINTR2_MAP_Y" "16"
 SYSTEM_CONSTANT "GLWCTL_STRLYCTL_MAP_X" "16"
 SYSTEM_CONSTANT "GLWCTL_STRLYCTL_MAP_Y" "16"
 SYSTEM_CONSTANT "GLWCTL_TIDEBPRE_CUR_X" "3"
 SYSTEM_CONSTANT "GLWCTL_TIOUT1_CUR_X" "25"
 SYSTEM_CONSTANT "GLWCTL_TIPRE1_MAP_X" "4"
 SYSTEM_CONSTANT "GLWCTL_TIPRE1_MAP_Y" "7"
 SYSTEM_CONSTANT "GLWCTL_TIPRE2_MAP_X" "4"
 SYSTEM_CONSTANT "GLWCTL_TIPRE2_MAP_Y" "7"
 SYSTEM_CONSTANT "GLWCTL_TIPREGLWPSH_CUR_X" "8"
 SYSTEM_CONSTANT "GLWCTL_TIPREGLW_CUR_X" "8"
 SYSTEM_CONSTANT "GLWCTL_TIPST_CUR_X" "25"
 SYSTEM_CONSTANT "GLWCTL_TIRDY_CUR_X" "4"
 SYSTEM_CONSTANT "GLWCTL_TITHRESFL1_CUR_X" "25"
 SYSTEM_CONSTANT "GLWCTL_WENRGPRE_CUR_X" "8"
 SYSTEM_CONSTANT "GRADTRQ_RES" "1"
 SYSTEM_CONSTANT "GRADTRQ_RES_REV" "1"
 SYSTEM_CONSTANT "HCINJ_DQLIMEVAP_MAP_X" "6"
 SYSTEM_CONSTANT "HCINJ_DQLIMEVAP_MAP_Y" "6"
 SYSTEM_CONSTANT "HCINJ_FACDIFFLOSSBAS_MAP_X" "6"
 SYSTEM_CONSTANT "HCINJ_FACDIFFLOSSBAS_MAP_Y" "6"
 SYSTEM_CONSTANT "HCINJ_MPERKMOLEXHGS_CUR_X" "7"
 SYSTEM_CONSTANT "HCINJ_RHOFL_CUR_X" "4"
 SYSTEM_CONSTANT "HCINJ_RLMBDMIN_MAP_X" "10"
 SYSTEM_CONSTANT "HCINJ_RLMBDMIN_MAP_Y" "10"
 SYSTEM_CONSTANT "HCINJ_TDIFFLOSSBAS_CUR_X" "6"
 SYSTEM_CONSTANT "HCINJ_TDIFFPFLTCTLVAL_CUR_X" "6"
 SYSTEM_CONSTANT "HCINJ_TDIFFPFLTDESVAL_CUR_X" "4"
 SYSTEM_CONSTANT "HCINJ_TDIFFSENSPRTOFF_CUR_X" "4"
 SYSTEM_CONSTANT "HCI_INJ_MASS_MAX" "67"
 SYSTEM_CONSTANT "HCI_INJ_MASS_MIN" "0"
 SYSTEM_CONSTANT "HCI_INJ_MASS_PER_MOL_RES" "0.005"
 SYSTEM_CONSTANT "HCI_INJ_MASS_PER_MOL_RES_FL" "0.005"
 SYSTEM_CONSTANT "HCI_INJ_MASS_PER_SEC_RES" "0.1"
 SYSTEM_CONSTANT "HCI_INJ_MASS_PER_SEC_RES_INV" "10"
 SYSTEM_CONSTANT "HCI_INJ_MASS_RES" "0.01"
 SYSTEM_CONSTANT "HCI_INJ_MASS_RES_INV" "100"
 SYSTEM_CONSTANT "HCI_MOL_PER_SEC_RES" "1e-08"
 SYSTEM_CONSTANT "HCI_MOL_PER_SEC_RES_FL" "1e-08"
 SYSTEM_CONSTANT "HCI_RES_DQPERSEC" "2000"
 SYSTEM_CONSTANT "HCI_RES_QPERMICROSEC" "100"
 SYSTEM_CONSTANT "HDSCD_TLIN_CUR" "4"
 SYSTEM_CONSTANT "HEAT_CAPACITY_LOW_RES" "100"
 SYSTEM_CONSTANT "HEAT_CAPACITY_RES" "0.1"
 SYSTEM_CONSTANT "HIGH_PREGLOW_NORM" "242.312928558422"
 SYSTEM_CONSTANT "HOUR_2_SEC" "3600"
 SYSTEM_CONSTANT "IATSCD_SWTSIG_TYPE" "2"
 SYSTEM_CONSTANT "IATSCD_SWTSIG_VAL" "0"
 SYSTEM_CONSTANT "IATSCD_TLIN_CUR_X" "25"
 SYSTEM_CONSTANT "IDEAL_GAS_CONSTANT" "287.5"
 SYSTEM_CONSTANT "IDEAL_GAS_CONSTANT_FL" "287"
 SYSTEM_CONSTANT "IDEAL_GAS_INT" "2875"
 SYSTEM_CONSTANT "IFCtl_tAirHysHi_CUR_X" "5"
 SYSTEM_CONSTANT "IFCtl_tAirHysLo_CUR_X" "5"
 SYSTEM_CONSTANT "IFCtl_tClntThrHiHysHi_CUR_X" "5"
 SYSTEM_CONSTANT "IFCtl_tClntThrHiHysLo_CUR_X" "5"
 SYSTEM_CONSTANT "IMMCTL_N_TRESH2" "300"
 SYSTEM_CONSTANT "IMMCTL_PCLASS_1" "19"
 SYSTEM_CONSTANT "IMMCTL_PCLASS_10" "201"
 SYSTEM_CONSTANT "IMMCTL_PCLASS_11" "1000"
 SYSTEM_CONSTANT "IMMCTL_PCLASS_2" "200"
 SYSTEM_CONSTANT "IMMCTL_PCLASS_3" "300"
 SYSTEM_CONSTANT "IMMCTL_PCLASS_4" "490"
 SYSTEM_CONSTANT "IMMCTL_PCLASS_5" "1221"
 SYSTEM_CONSTANT "IMMCTL_PCLASS_6" "1255"
 SYSTEM_CONSTANT "IMMCTL_PCLASS_7" "5"
 SYSTEM_CONSTANT "IMMCTL_PCLASS_8" "10"
 SYSTEM_CONSTANT "IMMCTL_PCLASS_9" "181"
 SYSTEM_CONSTANT "IMMCTL_PCLASS_CUR_X" "6"
 SYSTEM_CONSTANT "IMMCTL_TI_SLOT1" "2000"
 SYSTEM_CONSTANT "IMMCTL_TI_SLOT2" "700"
 SYSTEM_CONSTANT "IMMCTL_TI_VINDISPLAY" "400"
 SYSTEM_CONSTANT "IMPT_FACT_TO_INJ_MASS" "0.1"
 SYSTEM_CONSTANT "IMPT_RES" "0.01"
 SYSTEM_CONSTANT "IMPT_RES_HIGH" "0.001"
 SYSTEM_CONSTANT "IMPT_ZERO" "0"
 SYSTEM_CONSTANT "INDSYSRGNLVL_NUM" "3"
 SYSTEM_CONSTANT "INDSYS_FACAPCORRGN_CUR_X" "12"
 SYSTEM_CONSTANT "INDSYS_FACAPCOR_CUR_X" "5"
 SYSTEM_CONSTANT "INDSYS_FACWTTEMPCOR_CUR_X" "5"
 SYSTEM_CONSTANT "INDSYS_PDIFFHIGH_CUR_X" "15"
 SYSTEM_CONSTANT "INDSYS_PDIFFLOW_CUR_X" "15"
 SYSTEM_CONSTANT "INDSYS_PDIFFMONINTMNF_MAP_X" "8"
 SYSTEM_CONSTANT "INDSYS_PDIFFMONINTMNF_MAP_Y" "8"
 SYSTEM_CONSTANT "INDSYS_RAPCORVSARGN_MAP_X" "12"
 SYSTEM_CONSTANT "INDSYS_RAPCORVSARGN_MAP_Y" "10"
 SYSTEM_CONSTANT "INDSYS_RAPCORVSA_MAP_X" "10"
 SYSTEM_CONSTANT "INDSYS_RAPCORVSA_MAP_Y" "10"
 SYSTEM_CONSTANT "INDSYS_RVSAOVRRUN_MAP_X" "6"
 SYSTEM_CONSTANT "INDSYS_RVSAOVRRUN_MAP_Y" "6"
 SYSTEM_CONSTANT "INDSYS_RVSARGN_MAP_X" "8"
 SYSTEM_CONSTANT "INDSYS_RVSARGN_MAP_Y" "8"
 SYSTEM_CONSTANT "INDSYS_RVSA_MAP_X" "16"
 SYSTEM_CONSTANT "INDSYS_RVSA_MAP_Y" "16"
 SYSTEM_CONSTANT "INDSYS_RWTTEMPCORVSA_MAP_X" "10"
 SYSTEM_CONSTANT "INDSYS_RWTTEMPCORVSA_MAP_Y" "10"
 SYSTEM_CONSTANT "INDSYS_SWTLDDET_CUR_X" "2"
 SYSTEM_CONSTANT "INDSYS_TEMPFACMONINTMNF_CUR_X" "8"
 SYSTEM_CONSTANT "INJCRV_COR2_WITH_AIR_PRESSURE" "0"
 SYSTEM_CONSTANT "INJCRV_COR2_WITH_AIR_TEMPERATURE" "1"
 SYSTEM_CONSTANT "InjCrv_dRevMI1EGT4_CUR_X" "2"
 SYSTEM_CONSTANT "InjCrv_facdlmbddtPreTrbn_MAP_X" "4"
 SYSTEM_CONSTANT "InjCrv_facdlmbddtPreTrbn_MAP_Y" "4"
 SYSTEM_CONSTANT "InjCrv_facdqPoI2dlmbd_MAP_X" "4"
 SYSTEM_CONSTANT "InjCrv_facdqPoI2dlmbd_MAP_Y" "4"
 SYSTEM_CONSTANT "InjCrv_facEGTWghCor_CUR_X" "2"
 SYSTEM_CONSTANT "InjCrv_facMI1EGTCor1_MAP_X" "6"
 SYSTEM_CONSTANT "InjCrv_facMI1EGTCor1_MAP_Y" "6"
 SYSTEM_CONSTANT "InjCrv_facMI1EGTCor2_MAP_X" "6"
 SYSTEM_CONSTANT "InjCrv_facMI1EGTCor2_MAP_Y" "6"
 SYSTEM_CONSTANT "InjCrv_facMI1EGTCor3_MAP_X" "6"
 SYSTEM_CONSTANT "InjCrv_facMI1EGTCor3_MAP_Y" "6"
 SYSTEM_CONSTANT "InjCrv_facMI1EGTCor4_CUR_X" "2"
 SYSTEM_CONSTANT "InjCrv_facMI1EGTCor4_MAP_X" "2"
 SYSTEM_CONSTANT "InjCrv_facMI1EGTCor4_MAP_Y" "2"
 SYSTEM_CONSTANT "InjCrv_facMI1PCRPhiCor_MAP_X" "8"
 SYSTEM_CONSTANT "InjCrv_facMI1PCRPhiCor_MAP_Y" "6"
 SYSTEM_CONSTANT "InjCrv_facPoI2LmbdKi_CUR_X" "8"
 SYSTEM_CONSTANT "InjCrv_facPoI2LmbdKp_CUR_X" "8"
 SYSTEM_CONSTANT "InjCrv_facPoI2LmbdMax_MAP_X" "8"
 SYSTEM_CONSTANT "InjCrv_facPoI2LmbdMax_MAP_Y" "8"
 SYSTEM_CONSTANT "InjCrv_facPoI2LmbdMin_MAP_X" "8"
 SYSTEM_CONSTANT "InjCrv_facPoI2LmbdMin_MAP_Y" "8"
 SYSTEM_CONSTANT "InjCrv_facPoI2LmbdWgh_CUR_X" "2"
 SYSTEM_CONSTANT "InjCrv_facPoI2PhiWgh_CUR_X" "2"
 SYSTEM_CONSTANT "InjCrv_facPoI2QCor1_MAP_X" "8"
 SYSTEM_CONSTANT "InjCrv_facPoI2QCor1_MAP_Y" "8"
 SYSTEM_CONSTANT "InjCrv_facPoI2QCor2_MAP_X" "8"
 SYSTEM_CONSTANT "InjCrv_facPoI2QCor2_MAP_Y" "8"
 SYSTEM_CONSTANT "InjCrv_facPoI2QCor3_MAP_X" "2"
 SYSTEM_CONSTANT "InjCrv_facPoI2QCor3_MAP_Y" "2"
 SYSTEM_CONSTANT "InjCrv_facPoI2QCor4_MAP_X" "2"
 SYSTEM_CONSTANT "InjCrv_facPoI2QCor4_MAP_Y" "2"
 SYSTEM_CONSTANT "InjCrv_facPoI2QntWgh_CUR_X" "2"
 SYSTEM_CONSTANT "InjCrv_facPreTrbnKi_CUR_X" "8"
 SYSTEM_CONSTANT "InjCrv_facPreTrbnKp_CUR_X" "8"
 SYSTEM_CONSTANT "InjCrv_facT3DiapEnvCorr_CUR_X" "10"
 SYSTEM_CONSTANT "InjCrv_facT3DiatEnvCorr_CUR_X" "10"
 SYSTEM_CONSTANT "InjCrv_facTPstKp_CUR_X" "5"
 SYSTEM_CONSTANT "InjCrv_numPoI2HC_MAP_X" "10"
 SYSTEM_CONSTANT "InjCrv_numPoI2HC_MAP_Y" "10"
 SYSTEM_CONSTANT "InjCrv_phiBasGear12_MAP_X" "16"
 SYSTEM_CONSTANT "InjCrv_phiBasGear12_MAP_Y" "14"
 SYSTEM_CONSTANT "InjCrv_phiBasGear34_MAP_X" "16"
 SYSTEM_CONSTANT "InjCrv_phiBasGear34_MAP_Y" "14"
 SYSTEM_CONSTANT "InjCrv_phiBasGear56_MAP_X" "16"
 SYSTEM_CONSTANT "InjCrv_phiBasGear56_MAP_Y" "14"
 SYSTEM_CONSTANT "InjCrv_phiMI1EGTBas1_MAP_X" "16"
 SYSTEM_CONSTANT "InjCrv_phiMI1EGTBas1_MAP_Y" "16"
 SYSTEM_CONSTANT "InjCrv_phiMI1EGTBas2_MAP_X" "16"
 SYSTEM_CONSTANT "InjCrv_phiMI1EGTBas2_MAP_Y" "16"
 SYSTEM_CONSTANT "InjCrv_phiMI1EGTBas3_MAP_X" "16"
 SYSTEM_CONSTANT "InjCrv_phiMI1EGTBas3_MAP_Y" "16"
 SYSTEM_CONSTANT "InjCrv_phiMI1EGTBas4_MAP_X" "2"
 SYSTEM_CONSTANT "InjCrv_phiMI1EGTBas4_MAP_Y" "2"
 SYSTEM_CONSTANT "InjCrv_phiMI1EGTCor1_MAP_X" "16"
 SYSTEM_CONSTANT "InjCrv_phiMI1EGTCor1_MAP_Y" "16"
 SYSTEM_CONSTANT "InjCrv_phiMI1EGTCor2_MAP_X" "16"
 SYSTEM_CONSTANT "InjCrv_phiMI1EGTCor2_MAP_Y" "16"
 SYSTEM_CONSTANT "InjCrv_phiMI1EGTCor3_MAP_X" "16"
 SYSTEM_CONSTANT "InjCrv_phiMI1EGTCor3_MAP_Y" "16"
 SYSTEM_CONSTANT "InjCrv_phiMI1EGTCor4_MAP_X" "2"
 SYSTEM_CONSTANT "InjCrv_phiMI1EGTCor4_MAP_Y" "2"
 SYSTEM_CONSTANT "InjCrv_phiMI1HCDes_MAP_X" "10"
 SYSTEM_CONSTANT "InjCrv_phiMI1HCDes_MAP_Y" "11"
 SYSTEM_CONSTANT "InjCrv_phiMI1PCRCor_MAP_X" "12"
 SYSTEM_CONSTANT "InjCrv_phiMI1PCRCor_MAP_Y" "8"
 SYSTEM_CONSTANT "InjCrv_phiPoI2HCDes_MAP_X" "10"
 SYSTEM_CONSTANT "InjCrv_phiPoI2HCDes_MAP_Y" "10"
 SYSTEM_CONSTANT "InjCrv_phiPoI2Rgn10_MAP_X" "16"
 SYSTEM_CONSTANT "InjCrv_phiPoI2Rgn10_MAP_Y" "16"
 SYSTEM_CONSTANT "InjCrv_phiPoI2Rgn11_MAP_X" "16"
 SYSTEM_CONSTANT "InjCrv_phiPoI2Rgn11_MAP_Y" "16"
 SYSTEM_CONSTANT "InjCrv_phiPoI2Rgn20_MAP_X" "16"
 SYSTEM_CONSTANT "InjCrv_phiPoI2Rgn20_MAP_Y" "16"
 SYSTEM_CONSTANT "InjCrv_phiPoI2Rgn21_MAP_X" "16"
 SYSTEM_CONSTANT "InjCrv_phiPoI2Rgn21_MAP_Y" "16"
 SYSTEM_CONSTANT "InjCrv_phiPoI2Rgn30_MAP_X" "16"
 SYSTEM_CONSTANT "InjCrv_phiPoI2Rgn30_MAP_Y" "16"
 SYSTEM_CONSTANT "InjCrv_phiPoI2Rgn31_MAP_X" "16"
 SYSTEM_CONSTANT "InjCrv_phiPoI2Rgn31_MAP_Y" "16"
 SYSTEM_CONSTANT "InjCrv_phiPoI2Rgn4_MAP_X" "2"
 SYSTEM_CONSTANT "InjCrv_phiPoI2Rgn4_MAP_Y" "2"
 SYSTEM_CONSTANT "INJCRV_QACT" "1"
 SYSTEM_CONSTANT "InjCrv_qEGTCor10_MAP_X" "16"
 SYSTEM_CONSTANT "InjCrv_qEGTCor10_MAP_Y" "16"
 SYSTEM_CONSTANT "InjCrv_qEGTCor11_MAP_X" "16"
 SYSTEM_CONSTANT "InjCrv_qEGTCor11_MAP_Y" "16"
 SYSTEM_CONSTANT "InjCrv_qEGTCor20_MAP_X" "16"
 SYSTEM_CONSTANT "InjCrv_qEGTCor20_MAP_Y" "16"
 SYSTEM_CONSTANT "InjCrv_qEGTCor21_MAP_X" "16"
 SYSTEM_CONSTANT "InjCrv_qEGTCor21_MAP_Y" "16"
 SYSTEM_CONSTANT "InjCrv_qEGTCor30_MAP_X" "16"
 SYSTEM_CONSTANT "InjCrv_qEGTCor30_MAP_Y" "16"
 SYSTEM_CONSTANT "InjCrv_qEGTCor31_MAP_X" "16"
 SYSTEM_CONSTANT "InjCrv_qEGTCor31_MAP_Y" "16"
 SYSTEM_CONSTANT "InjCrv_qEGTCor40_MAP_X" "2"
 SYSTEM_CONSTANT "InjCrv_qEGTCor40_MAP_Y" "2"
 SYSTEM_CONSTANT "InjCrv_qEGTCor41_MAP_X" "2"
 SYSTEM_CONSTANT "InjCrv_qEGTCor41_MAP_Y" "2"
 SYSTEM_CONSTANT "InjCrv_qOpOfsMax_MAP_X" "14"
 SYSTEM_CONSTANT "InjCrv_qOpOfsMax_MAP_Y" "14"
 SYSTEM_CONSTANT "InjCrv_qPoI2HCAvrgCor_MAP_X" "10"
 SYSTEM_CONSTANT "InjCrv_qPoI2HCAvrgCor_MAP_Y" "10"
 SYSTEM_CONSTANT "InjCrv_qPoI2HCFBCCor_MAP_X" "10"
 SYSTEM_CONSTANT "InjCrv_qPoI2HCFBCCor_MAP_Y" "10"
 SYSTEM_CONSTANT "InjCrv_qPoI2HCHiOff_CUR_X" "12"
 SYSTEM_CONSTANT "InjCrv_qPoI2HCHiOn_CUR_X" "12"
 SYSTEM_CONSTANT "InjCrv_qPoI2HCLoOff_CUR_X" "12"
 SYSTEM_CONSTANT "InjCrv_qPoI2HCLoOn_CUR_X" "12"
 SYSTEM_CONSTANT "InjCrv_qPoI2HCTrqCor_MAP_X" "10"
 SYSTEM_CONSTANT "InjCrv_qPoI2HCTrqCor_MAP_Y" "10"
 SYSTEM_CONSTANT "InjCrv_qPoI2LmbdRgn1Off_CUR_X" "10"
 SYSTEM_CONSTANT "InjCrv_qPoI2LmbdRgn1On_CUR_X" "10"
 SYSTEM_CONSTANT "InjCrv_qPoI2LmbdRgn2Off_CUR_X" "10"
 SYSTEM_CONSTANT "InjCrv_qPoI2LmbdRgn2On_CUR_X" "10"
 SYSTEM_CONSTANT "InjCrv_qPoI2LmbdRgn3Off_CUR_X" "10"
 SYSTEM_CONSTANT "InjCrv_qPoI2LmbdRgn3On_CUR_X" "10"
 SYSTEM_CONSTANT "InjCrv_qPoI2LmbdRgn4Off_CUR_X" "2"
 SYSTEM_CONSTANT "InjCrv_qPoI2LmbdRgn4On_CUR_X" "2"
 SYSTEM_CONSTANT "InjCrv_qPoI2Rgn10_MAP_X" "16"
 SYSTEM_CONSTANT "InjCrv_qPoI2Rgn10_MAP_Y" "16"
 SYSTEM_CONSTANT "InjCrv_qPoI2Rgn11_MAP_X" "16"
 SYSTEM_CONSTANT "InjCrv_qPoI2Rgn11_MAP_Y" "16"
 SYSTEM_CONSTANT "InjCrv_qPoI2Rgn20_MAP_X" "16"
 SYSTEM_CONSTANT "InjCrv_qPoI2Rgn20_MAP_Y" "16"
 SYSTEM_CONSTANT "InjCrv_qPoI2Rgn21_MAP_X" "16"
 SYSTEM_CONSTANT "InjCrv_qPoI2Rgn21_MAP_Y" "16"
 SYSTEM_CONSTANT "InjCrv_qPoI2Rgn30_MAP_X" "16"
 SYSTEM_CONSTANT "InjCrv_qPoI2Rgn30_MAP_Y" "16"
 SYSTEM_CONSTANT "InjCrv_qPoI2Rgn31_MAP_X" "16"
 SYSTEM_CONSTANT "InjCrv_qPoI2Rgn31_MAP_Y" "16"
 SYSTEM_CONSTANT "InjCrv_qPoI2Rgn40_MAP_X" "2"
 SYSTEM_CONSTANT "InjCrv_qPoI2Rgn40_MAP_Y" "2"
 SYSTEM_CONSTANT "InjCrv_qPoI2Rgn41_MAP_X" "2"
 SYSTEM_CONSTANT "InjCrv_qPoI2Rgn41_MAP_Y" "2"
 SYSTEM_CONSTANT "INJCRV_QRAW" "0"
 SYSTEM_CONSTANT "INJCRV_QSETUNBAL" "2"
 SYSTEM_CONSTANT "InjCrv_qTPreOfsOvR_MAP_X" "6"
 SYSTEM_CONSTANT "InjCrv_qTPreOfsOvR_MAP_Y" "6"
 SYSTEM_CONSTANT "InjCrv_qTPstOfsOvR_MAP_X" "6"
 SYSTEM_CONSTANT "InjCrv_qTPstOfsOvR_MAP_Y" "6"
 SYSTEM_CONSTANT "INJCRV_QWODC" "3"
 SYSTEM_CONSTANT "InjCrv_rPoI2LmbdGovMin_CUR_X" "8"
 SYSTEM_CONSTANT "InjCrv_rPoI2LmbdMin1_MAP_X" "8"
 SYSTEM_CONSTANT "InjCrv_rPoI2LmbdMin1_MAP_Y" "8"
 SYSTEM_CONSTANT "InjCrv_rPoI2LmbdMin2_MAP_X" "8"
 SYSTEM_CONSTANT "InjCrv_rPoI2LmbdMin2_MAP_Y" "8"
 SYSTEM_CONSTANT "InjCrv_rPoI2LmbdMin3_MAP_X" "8"
 SYSTEM_CONSTANT "InjCrv_rPoI2LmbdMin3_MAP_Y" "8"
 SYSTEM_CONSTANT "InjCrv_rPoI2LmbdMin4_MAP_X" "2"
 SYSTEM_CONSTANT "InjCrv_rPoI2LmbdMin4_MAP_Y" "2"
 SYSTEM_CONSTANT "InjCrv_rPoI2LmbdMinNom_MAP_X" "8"
 SYSTEM_CONSTANT "InjCrv_rPoI2LmbdMinNom_MAP_Y" "8"
 SYSTEM_CONSTANT "InjCrv_rPoI2LmbdRgn10_MAP_X" "14"
 SYSTEM_CONSTANT "InjCrv_rPoI2LmbdRgn10_MAP_Y" "14"
 SYSTEM_CONSTANT "InjCrv_rPoI2LmbdRgn11_MAP_X" "2"
 SYSTEM_CONSTANT "InjCrv_rPoI2LmbdRgn11_MAP_Y" "2"
 SYSTEM_CONSTANT "InjCrv_rPoI2LmbdRgn20_MAP_X" "14"
 SYSTEM_CONSTANT "InjCrv_rPoI2LmbdRgn20_MAP_Y" "14"
 SYSTEM_CONSTANT "InjCrv_rPoI2LmbdRgn21_MAP_X" "2"
 SYSTEM_CONSTANT "InjCrv_rPoI2LmbdRgn21_MAP_Y" "2"
 SYSTEM_CONSTANT "InjCrv_rPoI2LmbdRgn30_MAP_X" "14"
 SYSTEM_CONSTANT "InjCrv_rPoI2LmbdRgn30_MAP_Y" "14"
 SYSTEM_CONSTANT "InjCrv_rPoI2LmbdRgn31_MAP_X" "2"
 SYSTEM_CONSTANT "InjCrv_rPoI2LmbdRgn31_MAP_Y" "2"
 SYSTEM_CONSTANT "InjCrv_rPoI2LmbdRgn40_MAP_X" "2"
 SYSTEM_CONSTANT "InjCrv_rPoI2LmbdRgn40_MAP_Y" "2"
 SYSTEM_CONSTANT "InjCrv_rPoI2LmbdRgn41_MAP_X" "2"
 SYSTEM_CONSTANT "InjCrv_rPoI2LmbdRgn41_MAP_Y" "2"
 SYSTEM_CONSTANT "InjCrv_rPoI2LmbdT3MinNom_MAP_X" "8"
 SYSTEM_CONSTANT "InjCrv_rPoI2LmbdT3MinNom_MAP_Y" "8"
 SYSTEM_CONSTANT "InjCrv_rPoI2LmbdT3Min_CUR_X" "8"
 SYSTEM_CONSTANT "INJCRV_SWTCOR2_TYPE" "2"
 SYSTEM_CONSTANT "INJCRV_SWTCOR2_VAL" "0"
 SYSTEM_CONSTANT "INJCRV_SWTQNTYSEL_TYPE" "2"
 SYSTEM_CONSTANT "INJCRV_SWTQNTYSEL_VAL" "1"
 SYSTEM_CONSTANT "InjCrv_tiPoI2OvRDel_CUR_X" "4"
 SYSTEM_CONSTANT "InjCrv_tiT3DiaDelCT_CUR_X" "10"
 SYSTEM_CONSTANT "InjCrv_tiT3DiaDelEGP_CUR_X" "13"
 SYSTEM_CONSTANT "InjCrv_tPreTrbn1_MAP_X" "14"
 SYSTEM_CONSTANT "InjCrv_tPreTrbn1_MAP_Y" "14"
 SYSTEM_CONSTANT "InjCrv_tPreTrbn2_MAP_X" "14"
 SYSTEM_CONSTANT "InjCrv_tPreTrbn2_MAP_Y" "14"
 SYSTEM_CONSTANT "InjCrv_tPreTrbn3_MAP_X" "14"
 SYSTEM_CONSTANT "InjCrv_tPreTrbn3_MAP_Y" "14"
 SYSTEM_CONSTANT "InjCrv_tPreTrbn4_MAP_X" "2"
 SYSTEM_CONSTANT "InjCrv_tPreTrbn4_MAP_Y" "2"
 SYSTEM_CONSTANT "InjCrv_tT3DiaDevMax_MAP_X" "40"
 SYSTEM_CONSTANT "InjCrv_tT3DiaDevMax_MAP_Y" "25"
 SYSTEM_CONSTANT "InjCrv_tT3DiaDevMin_MAP_X" "40"
 SYSTEM_CONSTANT "InjCrv_tT3DiaDevMin_MAP_Y" "25"
 SYSTEM_CONSTANT "INJCTL_QLIMERR_CUR_X" "25"
 SYSTEM_CONSTANT "INJTIME_US_S16_MAX" "327.67"
 SYSTEM_CONSTANT "INJTIME_US_S16_MIN" "-327.67"
 SYSTEM_CONSTANT "INJTIME_US_ZERO" "0"
 SYSTEM_CONSTANT "INJUN_MI1" "1"
 SYSTEM_CONSTANT "INJUN_PII1" "0"
 SYSTEM_CONSTANT "INJUN_POI2" "2"
 SYSTEM_CONSTANT "INJUN_POI3" "3"
 SYSTEM_CONSTANT "InjVlv_numMI1_CUR_X" "7"
 SYSTEM_CONSTANT "InjVlv_numPiI1_CUR_X" "2"
 SYSTEM_CONSTANT "InjVlv_numPoI2_CUR_X" "2"
 SYSTEM_CONSTANT "InjVlv_phiInjMI1_MAP0_X" "10"
 SYSTEM_CONSTANT "InjVlv_phiInjMI1_MAP0_Y" "10"
 SYSTEM_CONSTANT "InjVlv_phiInjMI1_MAP1_X" "19"
 SYSTEM_CONSTANT "InjVlv_phiInjMI1_MAP1_Y" "15"
 SYSTEM_CONSTANT "InjVlv_phiInjMI1_MAP2_X" "19"
 SYSTEM_CONSTANT "InjVlv_phiInjMI1_MAP2_Y" "15"
 SYSTEM_CONSTANT "InjVlv_phiInjMI1_MAP3_X" "19"
 SYSTEM_CONSTANT "InjVlv_phiInjMI1_MAP3_Y" "15"
 SYSTEM_CONSTANT "InjVlv_phiInjMI1_MAP4_X" "19"
 SYSTEM_CONSTANT "InjVlv_phiInjMI1_MAP4_Y" "15"
 SYSTEM_CONSTANT "InjVlv_phiInjMI1_MAP5_X" "19"
 SYSTEM_CONSTANT "InjVlv_phiInjMI1_MAP5_Y" "15"
 SYSTEM_CONSTANT "InjVlv_phiInjMI1_MAP6_X" "10"
 SYSTEM_CONSTANT "InjVlv_phiInjMI1_MAP6_Y" "10"
 SYSTEM_CONSTANT "InjVlv_phiInjPiI1_MAP0_X" "10"
 SYSTEM_CONSTANT "InjVlv_phiInjPiI1_MAP0_Y" "10"
 SYSTEM_CONSTANT "InjVlv_phiInjPiI1_MAP1_X" "10"
 SYSTEM_CONSTANT "InjVlv_phiInjPiI1_MAP1_Y" "10"
 SYSTEM_CONSTANT "InjVlv_phiInjPoI2_MAP0_X" "19"
 SYSTEM_CONSTANT "InjVlv_phiInjPoI2_MAP0_Y" "15"
 SYSTEM_CONSTANT "InjVlv_phiInjPoI2_MAP1_X" "19"
 SYSTEM_CONSTANT "InjVlv_phiInjPoI2_MAP1_Y" "15"
 SYSTEM_CONSTANT "InjVlv_tiMI1BreMin_MAP_X" "10"
 SYSTEM_CONSTANT "InjVlv_tiMI1BreMin_MAP_Y" "4"
 SYSTEM_CONSTANT "InjVlv_tiPiI1BreMin_MAP_X" "10"
 SYSTEM_CONSTANT "InjVlv_tiPiI1BreMin_MAP_Y" "4"
 SYSTEM_CONSTANT "INJ_MASSCORR_MAX" "32.767"
 SYSTEM_CONSTANT "INJ_MASSCORR_MIN" "-32.767"
 SYSTEM_CONSTANT "INJ_MASSCORR_RES" "0.001"
 SYSTEM_CONSTANT "INJ_MASSCYC_MAX" "327.67"
 SYSTEM_CONSTANT "INJ_MASSCYC_MIN" "0"
 SYSTEM_CONSTANT "INJ_MASSCYC_RES" "0.01"
 SYSTEM_CONSTANT "INJ_MASSCYC_RES_INV" "100"
 SYSTEM_CONSTANT "INJ_MASSCYC_ZERO" "0"
 SYSTEM_CONSTANT "INJ_MASSINJ_MAX" "327.67"
 SYSTEM_CONSTANT "INJ_MASSINJ_MIN" "0"
 SYSTEM_CONSTANT "INJ_MASSINJ_RES" "0.01"
 SYSTEM_CONSTANT "INJ_MASSINJ_RES_INV" "100"
 SYSTEM_CONSTANT "INJ_MASSINJ_ZERO" "0"
 SYSTEM_CONSTANT "INJ_MASSNSLP_RES" "0.0001"
 SYSTEM_CONSTANT "INJ_MASSQSLP_RES" "0.01"
 SYSTEM_CONSTANT "INJ_MASSTEMPGVNR_MAX" "200"
 SYSTEM_CONSTANT "INJ_MASSTEMPGVNR_MIN" "-200"
 SYSTEM_CONSTANT "INJ_MASS_2_RMP_INJ_MASS_LOW" "100000"
 SYSTEM_CONSTANT "INJ_MASS_HCI_RES_FL" "0.1"
 SYSTEM_CONSTANT "INJ_MASS_MAX" "327.67"
 SYSTEM_CONSTANT "INJ_MASS_MIN" "0"
 SYSTEM_CONSTANT "INJ_MASS_MIN_LMBD" "0.1"
 SYSTEM_CONSTANT "INJ_MASS_PER_SEC_RES" "0.01"
 SYSTEM_CONSTANT "INJ_MASS_PER_SEC_RES_FL" "0.01"
 SYSTEM_CONSTANT "INJ_MASS_RES" "0.01"
 SYSTEM_CONSTANT "INJ_MASS_RES_FL" "0.01"
 SYSTEM_CONSTANT "INJ_MASS_RES_FLOAT" "0.01"
 SYSTEM_CONSTANT "INJ_MASS_RES_INV" "100"
 SYSTEM_CONSTANT "INJ_MASS_TEMPGVNR" "0.1"
 SYSTEM_CONSTANT "INJ_MASS_TO_IMPT_FACT" "10"
 SYSTEM_CONSTANT "INJ_MASS_ZERO" "0"
 SYSTEM_CONSTANT "INJ_QNT_RES" "0.1"
 SYSTEM_CONSTANT "INJ_SYS" "0"
 SYSTEM_CONSTANT "INPUT_FREQ" "55944"
 SYSTEM_CONSTANT "INT_MAX" "5"
 SYSTEM_CONSTANT "JUL_RES" "0.1"
 SYSTEM_CONSTANT "J_SEC_HCI_RES" "1"
 SYSTEM_CONSTANT "J_SEC_HCI_RES_FL" "1"
 SYSTEM_CONSTANT "KDINJMASS32TO15_FACT" "6"
 SYSTEM_CONSTANT "KD_10" "10"
 SYSTEM_CONSTANT "KD_1_MAX" "50"
 SYSTEM_CONSTANT "KD_1_NRM" "7"
 SYSTEM_CONSTANT "KD_LIN_16_RES" "32767"
 SYSTEM_CONSTANT "KD_MIN" "0"
 SYSTEM_CONSTANT "KD_RES16_REV" "1024"
 SYSTEM_CONSTANT "KD_RES16_REV_FL" "1024"
 SYSTEM_CONSTANT "KD_RES_REV" "65536"
 SYSTEM_CONSTANT "KD_RPM2NM_2_NRM" "4"
 SYSTEM_CONSTANT "KD_RPM2NM_4_NRM" "7"
 SYSTEM_CONSTANT "KFACT_MAX" "1"
 SYSTEM_CONSTANT "KFACT_MIN" "0"
 SYSTEM_CONSTANT "KG_2_G" "1000"
 SYSTEM_CONSTANT "KG_2_MG" "1000000"
 SYSTEM_CONSTANT "KG_PER_H_TO_G_PER_M" "33333"
 SYSTEM_CONSTANT "KIAMPC32TO15_FACT" "3"
 SYSTEM_CONSTANT "KITEMPGOV_MAX" "4"
 SYSTEM_CONSTANT "KITEMPGOV_MIN" "0"
 SYSTEM_CONSTANT "KI_1" "1"
 SYSTEM_CONSTANT "KI_100" "100"
 SYSTEM_CONSTANT "KI_1000" "1000"
 SYSTEM_CONSTANT "KI_1_MAX" "250"
 SYSTEM_CONSTANT "KI_1_NRM" "6"
 SYSTEM_CONSTANT "KI_BPA_RES_REV" "65"
 SYSTEM_CONSTANT "KI_EGR_RES_REV" "6553.6"
 SYSTEM_CONSTANT "KI_EGTFACT_EXP" "1"
 SYSTEM_CONSTANT "KI_EGTFACT_NRM" "2"
 SYSTEM_CONSTANT "KI_FACTEGT_MAX" "0.06"
 SYSTEM_CONSTANT "KI_FACTEGT_MIN" "0"
 SYSTEM_CONSTANT "KI_LMBD2PRC_MAX" "1000"
 SYSTEM_CONSTANT "KI_LMBD2PRC_NRM" "4"
 SYSTEM_CONSTANT "KI_MIN" "0"
 SYSTEM_CONSTANT "KI_RES_REV" "4294.967296"
 SYSTEM_CONSTANT "KI_RPM2NM_2_NRM" "4"
 SYSTEM_CONSTANT "KI_THRVLV_RES_REV" "65"
 SYSTEM_CONSTANT "Ki_TRQ" "1"
 SYSTEM_CONSTANT "Ki_TRQ2" "1"
 SYSTEM_CONSTANT "KPAMPC32TO15_FACT" "8"
 SYSTEM_CONSTANT "KPTEMPGOV_MAX" "4"
 SYSTEM_CONSTANT "KPTEMPGOV_MIN" "0"
 SYSTEM_CONSTANT "KP_10" "10"
 SYSTEM_CONSTANT "KP_1_MAX" "300"
 SYSTEM_CONSTANT "KP_1_NRM" "10"
 SYSTEM_CONSTANT "KP_ACC_RES_REV" "8192"
 SYSTEM_CONSTANT "KP_EGTFACT_EXP" "7"
 SYSTEM_CONSTANT "KP_EGTFACT_RES_REV" "128"
 SYSTEM_CONSTANT "KP_FACTEGT_MAX" "0.06"
 SYSTEM_CONSTANT "KP_FACTEGT_MIN" "0"
 SYSTEM_CONSTANT "KP_LMBD2PRC_MAX" "500"
 SYSTEM_CONSTANT "KP_LMBD2PRC_NRM" "7"
 SYSTEM_CONSTANT "KP_LMBDREC2INJMASS_1_MAX" "250"
 SYSTEM_CONSTANT "KP_LMBDREC2INJMASS_1_NRM" "3"
 SYSTEM_CONSTANT "KP_LMBDREC2INJMASS_2_MAX" "250"
 SYSTEM_CONSTANT "KP_LMBDREC2INJMASS_2_NRM" "3"
 SYSTEM_CONSTANT "KP_MIN" "0"
 SYSTEM_CONSTANT "KP_RES_REV" "65536"
 SYSTEM_CONSTANT "KP_RPM2NM_2_NRM" "5"
 SYSTEM_CONSTANT "KP_RPM2NM_4_NRM" "7"
 SYSTEM_CONSTANT "K_CURVE_DTYCYCVOLT_RES" "0.001"
 SYSTEM_CONSTANT "K_CURVE_DTYCYCVOLT_RES_REV" "1000"
 SYSTEM_CONSTANT "LAMBDA" "10"
 SYSTEM_CONSTANT "LAMBDADYN_MIN" "-32"
 SYSTEM_CONSTANT "LAMBDAREC_INJMASS_RES" "14500"
 SYSTEM_CONSTANT "LAMBDAREC_ONE" "1"
 SYSTEM_CONSTANT "LAMBDAREC_RES" "0.0001"
 SYSTEM_CONSTANT "LAMBDAREC_RESVAL" "0.001"
 SYSTEM_CONSTANT "LAMBDAREC_RESVAL2LAMBDAREC_RES" "10"
 SYSTEM_CONSTANT "LAMBDAREC_RESVAL_FL" "0.001"
 SYSTEM_CONSTANT "LAMBDAREC_RESVAL_REV" "1000"
 SYSTEM_CONSTANT "LAMBDAREC_RES_REV" "10000"
 SYSTEM_CONSTANT "LAMBDAREC_ZERO" "0"
 SYSTEM_CONSTANT "LAMBDATEMP_RES_REV" "1000"
 SYSTEM_CONSTANT "LAMBDA_INJMASS_RES" "1450"
 SYSTEM_CONSTANT "LAMBDA_MAX" "30"
 SYSTEM_CONSTANT "LAMBDA_MIN" "0"
 SYSTEM_CONSTANT "LAMBDA_O2_AIR" "0.232"
 SYSTEM_CONSTANT "LAMBDA_ONE" "1"
 SYSTEM_CONSTANT "LAMBDA_ONETHIRD" "0.3333"
 SYSTEM_CONSTANT "LAMBDA_RES" "0.001"
 SYSTEM_CONSTANT "LAMBDA_RES2LAMBDAREC_RES" "10"
 SYSTEM_CONSTANT "LAMBDA_RES_FL" "0.001"
 SYSTEM_CONSTANT "LAMBDA_RES_INV" "1000"
 SYSTEM_CONSTANT "LAMBDA_RES_REV" "1000"
 SYSTEM_CONSTANT "LAMBDA_ZERO" "0"
 SYSTEM_CONSTANT "LASCD_TIFLT_CUR_X" "5"
 SYSTEM_CONSTANT "LENGTH1_RES" "0.004"
 SYSTEM_CONSTANT "LENGTH1_RES_REV" "250"
 SYSTEM_CONSTANT "LENGTHKM_RES" "1"
 SYSTEM_CONSTANT "LENGTH_KM2M" "1000"
 SYSTEM_CONSTANT "LENGTH_RES" "1"
 SYSTEM_CONSTANT "LENGTH_RES_INV" "1"
 SYSTEM_CONSTANT "LENGTH_RGN_MAX" "32767"
 SYSTEM_CONSTANT "LENGTH_RGN_MIN" "0"
 SYSTEM_CONSTANT "LIGOV_NCLTAIRP_MAP_X" "9"
 SYSTEM_CONSTANT "LIGOV_NCLTAIRP_MAP_Y" "4"
 SYSTEM_CONSTANT "LIGOV_NCORRFAC" "7"
 SYSTEM_CONSTANT "LIGOV_NREV_CUR_X" "25"
 SYSTEM_CONSTANT "LIGOV_NSETPOINTDAWAY_CUR_X" "4"
 SYSTEM_CONSTANT "LIGOV_NSETPOINTINIT_CUR_X" "25"
 SYSTEM_CONSTANT "LIGOV_NSETPOINTWARM_CUR_X" "4"
 SYSTEM_CONSTANT "LIGOV_NTEMP1_MAP_X" "6"
 SYSTEM_CONSTANT "LIGOV_NTEMP1_MAP_Y" "4"
 SYSTEM_CONSTANT "LIGOV_NTEMP2RGN_CUR_X" "2"
 SYSTEM_CONSTANT "LIGOV_NTEMP2_CUR_X" "25"
 SYSTEM_CONSTANT "LIGOV_PARDRIVEOFF_NOTUSED" "0"
 SYSTEM_CONSTANT "LIGOV_PARDRIVEOFF_USED" "1"
 SYSTEM_CONSTANT "LIGOV_RTRANS_CUR_X" "5"
 SYSTEM_CONSTANT "LIGOV_STGEAR_MAP_Y" "10"
 SYSTEM_CONSTANT "LIGOV_SWTPARDRIVEOFF_TYPE" "0"
 SYSTEM_CONSTANT "LIGOV_SWTPARDRIVEOFF_VAL" "1"
 SYSTEM_CONSTANT "LIGOV_TENGHYS_CUR_X" "15"
 SYSTEM_CONSTANT "LIGOV_TENGHYS_MAP_X" "15"
 SYSTEM_CONSTANT "LIGOV_TRQINITI_CUR_X" "25"
 SYSTEM_CONSTANT "LMBD_SENS_AFT_TRBN" "0"
 SYSTEM_CONSTANT "LMBD_SENS_AFT_TRBN1" "1"
 SYSTEM_CONSTANT "LMBD_SENS_AFT_TRBN2" "2"
 SYSTEM_CONSTANT "LSUCD_CT_ARRAY" "1"
 SYSTEM_CONSTANT "LSUCD_CT_EDC" "1"
 SYSTEM_CONSTANT "LSUCD_CT_SENSORS" "1"
 SYSTEM_CONSTANT "LSUCD_CT_SENSORS_MAX" "4"
 SYSTEM_CONSTANT "LSUCD_FCTRPCOMP_MAP_X" "10"
 SYSTEM_CONSTANT "LSUCD_FCTRPCOMP_MAP_Y" "5"
 SYSTEM_CONSTANT "LSUCD_RLMBDREC_CUR_X" "11"
 SYSTEM_CONSTANT "LSUCD_RO2_CUR_X" "15"
 SYSTEM_CONSTANT "LSUCD_SWTADPT_DISABLED" "0"
 SYSTEM_CONSTANT "LSUCD_SWTADPT_ENABLED" "1"
 SYSTEM_CONSTANT "LSUCD_SWTADPT_TYPE" "2"
 SYSTEM_CONSTANT "LSUCD_SWTADPT_VAL" "0"
 SYSTEM_CONSTANT "LSUCD_TEMPRI_CUR_X" "16"
 SYSTEM_CONSTANT "LSUCTL_DCYCSTRT_CUR_X" "5"
 SYSTEM_CONSTANT "LSUCTL_TEMPLIM_CUR_X" "5"
 SYSTEM_CONSTANT "LSU_NUM_SENSCMPCHKS" "0"
 SYSTEM_CONSTANT "LSU_RES" "4.88758553274682"
 SYSTEM_CONSTANT "LSU_SWT_DISABLED" "0"
 SYSTEM_CONSTANT "LSU_SWT_ENABLED" "1"
 SYSTEM_CONSTANT "LSU_SWT_TYPE" "2"
 SYSTEM_CONSTANT "LSU_SWT_VAL" "0"
 SYSTEM_CONSTANT "MAXNEG_ACC" "-10"
 SYSTEM_CONSTANT "MAXSINT16" "32767"
 SYSTEM_CONSTANT "MAXSINT32" "2147483647"
 SYSTEM_CONSTANT "MAXSINT8" "127"
 SYSTEM_CONSTANT "MAXUINT16" "65535"
 SYSTEM_CONSTANT "MAXUINT32" "4294967295"
 SYSTEM_CONSTANT "MAXUINT8" "255"
 SYSTEM_CONSTANT "MAX_MAP" "6"
 SYSTEM_CONSTANT "MG_2_G" "1000"
 SYSTEM_CONSTANT "MG_PER_SEC_TO_KG_PER_H_FACT" "100"
 SYSTEM_CONSTANT "MINSINT16" "-32768"
 SYSTEM_CONSTANT "MINSINT32" "-2147483648"
 SYSTEM_CONSTANT "MINSINT8" "-128"
 SYSTEM_CONSTANT "MINUS_ONE" "-1"
 SYSTEM_CONSTANT "MLTOL_RES" "0.01"
 SYSTEM_CONSTANT "MLTOL_RES_FINE" "0.001"
 SYSTEM_CONSTANT "MLTOL_RES_NORM" "20"
 SYSTEM_CONSTANT "MLTOL_RES_NORM_FINE" "2"
 SYSTEM_CONSTANT "MNELEM_VBATAVRG" "1"
 SYSTEM_CONSTANT "MODE1_SIGNALS_NUM" "40"
 SYSTEM_CONSTANT "MODE2_SIGNALS_NUM" "25"
 SYSTEM_CONSTANT "MOMENT_INERTIA_RES" "100"
 SYSTEM_CONSTANT "MS_MASTER_ECU" "0"
 SYSTEM_CONSTANT "MS_SINGLE_ECU" "255"
 SYSTEM_CONSTANT "MS_SLAVE1_ECU" "1"
 SYSTEM_CONSTANT "MS_SLAVE2_ECU" "2"
 SYSTEM_CONSTANT "MS_SLAVE3_ECU" "3"
 SYSTEM_CONSTANT "MS_SLAVE4_ECU" "4"
 SYSTEM_CONSTANT "MS_TO_S_CONV" "10"
 SYSTEM_CONSTANT "MXELEM_VBATAVRG" "10"
 SYSTEM_CONSTANT "M_ASHTRM_MAX" "500"
 SYSTEM_CONSTANT "M_ASHTRM_MIN" "0"
 SYSTEM_CONSTANT "M_ASH_MAX" "300"
 SYSTEM_CONSTANT "M_ASH_RES" "1.52587890625e-07"
 SYSTEM_CONSTANT "M_ASH_RES1" "0.1"
 SYSTEM_CONSTANT "M_ASH_RES1_REV" "10"
 SYSTEM_CONSTANT "M_ASH_RES_REV" "6553600"
 SYSTEM_CONSTANT "M_SOOT_MAX" "300"
 SYSTEM_CONSTANT "M_SOOT_MIN" "0"
 SYSTEM_CONSTANT "M_SOOT_RES" "0.01"
 SYSTEM_CONSTANT "M_SOOT_RES_REV" "100"
 SYSTEM_CONSTANT "NORM_ACC2FRIC" "10000"
 SYSTEM_CONSTANT "NORM_CALC_DI" "32000"
 SYSTEM_CONSTANT "NORM_CALC_IVIR" "100000"
 SYSTEM_CONSTANT "NORM_CALC_MVMR" "10000"
 SYSTEM_CONSTANT "NORM_DTRQ2TRQPERSEC" "10"
 SYSTEM_CONSTANT "NORM_DVOLPERSTRK_X_N" "3333.33333333333"
 SYSTEM_CONSTANT "NORM_DVOL_X_DT" "360000"
 SYSTEM_CONSTANT "NORM_DVOL_X_DT_HIGH" "18000"
 SYSTEM_CONSTANT "NORM_ETA_BY_FTRM" "128"
 SYSTEM_CONSTANT "NORM_ETA_X_ETA" "128"
 SYSTEM_CONSTANT "NORM_FACT1" "3333.3"
 SYSTEM_CONSTANT "NORM_FAC_EQU" "10"
 SYSTEM_CONSTANT "NORM_FLCONS2" "360000"
 SYSTEM_CONSTANT "NORM_L2UL" "1000000"
 SYSTEM_CONSTANT "NORM_MS2US" "1000"
 SYSTEM_CONSTANT "NORM_N_X_R" "100"
 SYSTEM_CONSTANT "NORM_PRPTRQ2ENGTRQ" "16"
 SYSTEM_CONSTANT "NORM_PWR2ENERGY" "9.42477796077"
 SYSTEM_CONSTANT "NORM_PWRACS" "900"
 SYSTEM_CONSTANT "NORM_PWRCLTH_REV" "900"
 SYSTEM_CONSTANT "NORM_PWRENG" "900"
 SYSTEM_CONSTANT "NORM_PWRPRP" "56.25"
 SYSTEM_CONSTANT "NORM_PWR_BY_ETA" "128"
 SYSTEM_CONSTANT "NORM_Q_BY_FAC" "8192"
 SYSTEM_CONSTANT "NORM_Q_BY_RHO" "1000"
 SYSTEM_CONSTANT "NORM_Q_X_ETA" "1280"
 SYSTEM_CONSTANT "NORM_RMP_CORR_RES" "23592.96"
 SYSTEM_CONSTANT "NORM_RMP_C_RES" "65536"
 SYSTEM_CONSTANT "NORM_R_X_R" "100"
 SYSTEM_CONSTANT "NORM_R_X_TRQ" "100"
 SYSTEM_CONSTANT "NORM_TRQ2PRC_CAN" "254.999910750031"
 SYSTEM_CONSTANT "NORM_TRQ2TRQPRP" "1600"
 SYSTEM_CONSTANT "NORM_TRQ2TRQPRPHIGH" "100"
 SYSTEM_CONSTANT "NORM_TRQACS" "900"
 SYSTEM_CONSTANT "NORM_TRQPERSEC2RMPTRQ" "655.36"
 SYSTEM_CONSTANT "NORM_TRQPRP" "56.25"
 SYSTEM_CONSTANT "NORM_TRQPRPHIGH2PRC_CAN" "254.999910750031"
 SYSTEM_CONSTANT "NORM_TRQPRPHIGH_CUR" "655.36"
 SYSTEM_CONSTANT "NORM_TRQ_BY_ETA" "1280"
 SYSTEM_CONSTANT "NORM_TRQ_BY_Q" "1280"
 SYSTEM_CONSTANT "NORM_TRQ_INERTIA" "100"
 SYSTEM_CONSTANT "NORM_TRQ_X_FAC" "8192"
 SYSTEM_CONSTANT "NORM_VOL_L_TO_UL" "20"
 SYSTEM_CONSTANT "NRM_PRECTL_TEMP_IDX" "15"
 SYSTEM_CONSTANT "NSCCD_CT_SENSORS" "0"
 SYSTEM_CONSTANT "NUM_EXH_SENSORS" "1"
 SYSTEM_CONSTANT "NUM_MAX_FBC_SEG" "8"
 SYSTEM_CONSTANT "NUM_POINT" "8"
 SYSTEM_CONSTANT "NUM_SINTAB_IDX" "30"
 SYSTEM_CONSTANT "NUM_SINTAB_INC" "2"
 SYSTEM_CONSTANT "O2MASS_MAX" "50"
 SYSTEM_CONSTANT "O2MASS_MIN" "0"
 SYSTEM_CONSTANT "O2MPT_RES" "0.01"
 SYSTEM_CONSTANT "O2MPT_RES_FL" "0.01"
 SYSTEM_CONSTANT "O2_NORM" "0.21"
 SYSTEM_CONSTANT "O2_NORM_INV" "4.773"
 SYSTEM_CONSTANT "O2_RES" "1e-05"
 SYSTEM_CONSTANT "O2_RES_FL" "1e-05"
 SYSTEM_CONSTANT "O2_RES_REV" "100000"
 SYSTEM_CONSTANT "O2_RMASS_AIR" "0.2314975"
 SYSTEM_CONSTANT "O2_RMASS_AIR_FL" "0.2314975"
 SYSTEM_CONSTANT "O2_RVOL_AIR" "0.2095"
 SYSTEM_CONSTANT "O2_THRES1_ADD" "0.063"
 SYSTEM_CONSTANT "O2_THRES1_FAC" "0.7"
 SYSTEM_CONSTANT "O2_THRES2_ADD" "0.126"
 SYSTEM_CONSTANT "O2_THRES2_FAC" "0.4"
 SYSTEM_CONSTANT "O2_ZERO" "0"
 SYSTEM_CONSTANT "ONE" "1"
 SYSTEM_CONSTANT "OTSCD_SWTSIG_TYPE" "2"
 SYSTEM_CONSTANT "OTSCD_SWTSIG_VAL" "0"
 SYSTEM_CONSTANT "OTSCD_TFLCNSMPCORCOR_CUR_X" "5"
 SYSTEM_CONSTANT "OTSCD_TIATSCOR_CUR_X" "5"
 SYSTEM_CONSTANT "OTSCD_TIMAXDYNTST_CUR_X" "10"
 SYSTEM_CONSTANT "OTSCD_TLIN_CUR_X" "25"
 SYSTEM_CONSTANT "OTSCD_TOIL_CUR_X" "13"
 SYSTEM_CONSTANT "OVRMON_ACTVTIME_MAX" "30000"
 SYSTEM_CONSTANT "OVRMON_FACBATTCOR_CUR_X" "4"
 SYSTEM_CONSTANT "OVRMON_MTRQLIM_CUR_X" "16"
 SYSTEM_CONSTANT "OVRMON_QLIMENH_CUR_X" "25"
 SYSTEM_CONSTANT "OVRMON_TILIMET_MAP_X" "10"
 SYSTEM_CONSTANT "OVRMON_TILIMET_MAP_Y" "13"
 SYSTEM_CONSTANT "OXICAT_CAPACITY_NRM" "100"
 SYSTEM_CONSTANT "OXICAT_DIFFTEMPPFLTPST_NRM" "10"
 SYSTEM_CONSTANT "OXICAT_DMHCERRCALC_NRM" "1000"
 SYSTEM_CONSTANT "OXICAT_EGSYSAPRX_NRM" "1000000"
 SYSTEM_CONSTANT "OXICAT_ENERGY_NRM" "360000"
 SYSTEM_CONSTANT "OXICAT_ENVERRCALC_NRM" "10"
 SYSTEM_CONSTANT "OXICAT_FACSTATERR_CUR_X" "8"
 SYSTEM_CONSTANT "OXICAT_HEATFLOW_INTER_RES" "360"
 SYSTEM_CONSTANT "OXICAT_HEATFLOW_RES" "100000"
 SYSTEM_CONSTANT "OXICAT_HEAT_CAPACITY_FACT1_NRM" "100"
 SYSTEM_CONSTANT "OXICAT_HEAT_CAPACITY_FACT_NRM" "81.92"
 SYSTEM_CONSTANT "OXICAT_HEAT_CAPACITY_NRM" "360000"
 SYSTEM_CONSTANT "OXICAT_SOOTERRCALC_NRM" "100"
 SYSTEM_CONSTANT "OXICAT_SOOTMASSCALC_NRM" "10.8010801080108"
 SYSTEM_CONSTANT "OXICAT_STRTERRCALC_NRM" "1"
 SYSTEM_CONSTANT "OXICAT_STRTSOOTERR_NRM" "10"
 SYSTEM_CONSTANT "OXICAT_SWT_DISABLED" "0"
 SYSTEM_CONSTANT "OXICAT_SWT_ENABLED" "1"
 SYSTEM_CONSTANT "OXICAT_SWT_VAL" "0"
 SYSTEM_CONSTANT "OXICCD_TLINPRE_CUR_X" "25"
 SYSTEM_CONSTANT "PARTS_PER_MILLION_NULL" "0"
 SYSTEM_CONSTANT "PARTS_PER_MILLION_RES" "0.5"
 SYSTEM_CONSTANT "PARTS_PER_MILLION_RES_FL" "0.5"
 SYSTEM_CONSTANT "PCRRGNLVL_NUM" "3"
 SYSTEM_CONSTANT "PCR_BALGVNR_DISABLE" "0"
 SYSTEM_CONSTANT "PCR_BALGVNR_ENABLE" "1"
 SYSTEM_CONSTANT "PCR_BALGVNR_SEL_SWT" "0"
 SYSTEM_CONSTANT "PCR_CURLIM" "0"
 SYSTEM_CONSTANT "PCR_DNMAXCOR_MAP_X" "10"
 SYSTEM_CONSTANT "PCR_DNMAXCOR_MAP_Y" "9"
 SYSTEM_CONSTANT "PCR_DT1_MAP_X" "10"
 SYSTEM_CONSTANT "PCR_DT1_MAP_Y" "10"
 SYSTEM_CONSTANT "PCR_FACAT_CUR_X" "16"
 SYSTEM_CONSTANT "PCR_FACBALGVNRCORR_MAP_X" "9"
 SYSTEM_CONSTANT "PCR_FACBALGVNRCORR_MAP_Y" "9"
 SYSTEM_CONSTANT "PCR_FACBALGVNRI_MAP_X" "9"
 SYSTEM_CONSTANT "PCR_FACBALGVNRI_MAP_Y" "9"
 SYSTEM_CONSTANT "PCR_FACBALGVNRP_MAP_X" "9"
 SYSTEM_CONSTANT "PCR_FACBALGVNRP_MAP_Y" "9"
 SYSTEM_CONSTANT "PCR_FACBPALTCORR_CUR_X" "10"
 SYSTEM_CONSTANT "PCR_FACBPALTMAX_MAP_X" "16"
 SYSTEM_CONSTANT "PCR_FACBPALTMAX_MAP_Y" "16"
 SYSTEM_CONSTANT "PCR_FACCTLAT_CUR_X" "25"
 SYSTEM_CONSTANT "PCR_FACCTLBAS_CUR_X" "7"
 SYSTEM_CONSTANT "PCR_FACCTLRGN1_CUR_X" "2"
 SYSTEM_CONSTANT "PCR_FACCTLRGN2_CUR_X" "2"
 SYSTEM_CONSTANT "PCR_FACCTLRGN3_CUR_X" "2"
 SYSTEM_CONSTANT "PCR_FACCTQ_MAP_X" "8"
 SYSTEM_CONSTANT "PCR_FACCTQ_MAP_Y" "8"
 SYSTEM_CONSTANT "PCR_FACDESBAS_CUR_X" "10"
 SYSTEM_CONSTANT "PCR_FACDESRGN1_CUR_X" "2"
 SYSTEM_CONSTANT "PCR_FACDESRGN2_CUR_X" "2"
 SYSTEM_CONSTANT "PCR_FACDESRGN3_CUR_X" "2"
 SYSTEM_CONSTANT "PCR_FACDT1_MAP_X" "10"
 SYSTEM_CONSTANT "PCR_FACDT1_MAP_Y" "10"
 SYSTEM_CONSTANT "PCR_FACD_MAP_X" "10"
 SYSTEM_CONSTANT "PCR_FACD_MAP_Y" "10"
 SYSTEM_CONSTANT "PCR_FACEAT_CUR_X" "6"
 SYSTEM_CONSTANT "PCR_FACI_MAP_X" "10"
 SYSTEM_CONSTANT "PCR_FACI_MAP_Y" "10"
 SYSTEM_CONSTANT "PCR_FACP_MAP_X" "10"
 SYSTEM_CONSTANT "PCR_FACP_MAP_Y" "10"
 SYSTEM_CONSTANT "PCR_FACSHFTUPCOR_MAP_X" "10"
 SYSTEM_CONSTANT "PCR_FACSHFTUPCOR_MAP_Y" "10"
 SYSTEM_CONSTANT "PCR_MAPLIM" "1"
 SYSTEM_CONSTANT "PCR_NBALGOVDEVMAX_CUR_X" "2"
 SYSTEM_CONSTANT "PCR_NS_MAP_X" "6"
 SYSTEM_CONSTANT "PCR_NS_MAP_Y" "6"
 SYSTEM_CONSTANT "PCR_NTRBN2_MAP_X" "16"
 SYSTEM_CONSTANT "PCR_NTRBN2_MAP_Y" "16"
 SYSTEM_CONSTANT "PCR_NTRBNMAX_CUR_X" "8"
 SYSTEM_CONSTANT "PCR_NTRBN_MAP_X" "16"
 SYSTEM_CONSTANT "PCR_NTRBN_MAP_Y" "16"
 SYSTEM_CONSTANT "PCR_PAPQCMPN_MAP_X" "9"
 SYSTEM_CONSTANT "PCR_PAPQCMPN_MAP_Y" "9"
 SYSTEM_CONSTANT "PCR_PBDESBAS2_MAP_X" "16"
 SYSTEM_CONSTANT "PCR_PBDESBAS2_MAP_Y" "10"
 SYSTEM_CONSTANT "PCR_PBDESBAS_MAP_X" "16"
 SYSTEM_CONSTANT "PCR_PBDESBAS_MAP_Y" "10"
 SYSTEM_CONSTANT "PCR_PBDESMAXAP_MAP_X" "16"
 SYSTEM_CONSTANT "PCR_PBDESMAXAP_MAP_Y" "10"
 SYSTEM_CONSTANT "PCR_PBDESRGN1A_MAP_X" "10"
 SYSTEM_CONSTANT "PCR_PBDESRGN1A_MAP_Y" "10"
 SYSTEM_CONSTANT "PCR_PBDESRGN1B_MAP_X" "12"
 SYSTEM_CONSTANT "PCR_PBDESRGN1B_MAP_Y" "12"
 SYSTEM_CONSTANT "PCR_PBDESRGN2A_MAP_X" "10"
 SYSTEM_CONSTANT "PCR_PBDESRGN2A_MAP_Y" "10"
 SYSTEM_CONSTANT "PCR_PBDESRGN2B_MAP_X" "12"
 SYSTEM_CONSTANT "PCR_PBDESRGN2B_MAP_Y" "12"
 SYSTEM_CONSTANT "PCR_PBDESRGN3_MAP_X" "16"
 SYSTEM_CONSTANT "PCR_PBDESRGN3_MAP_Y" "16"
 SYSTEM_CONSTANT "PCR_PBDESRGNCOR1_MAP_X" "2"
 SYSTEM_CONSTANT "PCR_PBDESRGNCOR1_MAP_Y" "2"
 SYSTEM_CONSTANT "PCR_PBDESRGNCOR2_MAP_X" "2"
 SYSTEM_CONSTANT "PCR_PBDESRGNCOR2_MAP_Y" "2"
 SYSTEM_CONSTANT "PCR_PBDESRGNCOR3_MAP_X" "2"
 SYSTEM_CONSTANT "PCR_PBDESRGNCOR3_MAP_Y" "2"
 SYSTEM_CONSTANT "PCR_PBGDEVMAX_CUR_X" "10"
 SYSTEM_CONSTANT "PCR_PNQCTCMPN_MAP_X" "8"
 SYSTEM_CONSTANT "PCR_PNQCTCMPN_MAP_Y" "8"
 SYSTEM_CONSTANT "PCR_QCTL_QACT" "0"
 SYSTEM_CONSTANT "PCR_QCTL_QRAW" "1"
 SYSTEM_CONSTANT "PCR_QMINBPGOVFLT_CUR_X" "5"
 SYSTEM_CONSTANT "PCR_QNTLIM_NAVRG" "0"
 SYSTEM_CONSTANT "PCR_QRGTOFF1_CUR_X" "5"
 SYSTEM_CONSTANT "PCR_QRGTOFF2_CUR_X" "5"
 SYSTEM_CONSTANT "PCR_QRGTOFF3_CUR_X" "5"
 SYSTEM_CONSTANT "PCR_QRGTOFFRGN_CUR_X" "10"
 SYSTEM_CONSTANT "PCR_QRGTOFF_CUR_X" "25"
 SYSTEM_CONSTANT "PCR_QRGTON1_CUR_X" "5"
 SYSTEM_CONSTANT "PCR_QRGTON2_CUR_X" "5"
 SYSTEM_CONSTANT "PCR_QRGTON3_CUR_X" "5"
 SYSTEM_CONSTANT "PCR_QRGTONRGN_CUR_X" "10"
 SYSTEM_CONSTANT "PCR_QRGTON_CUR_X" "25"
 SYSTEM_CONSTANT "PCR_Q_QCURR" "0"
 SYSTEM_CONSTANT "PCR_Q_QRAW" "1"
 SYSTEM_CONSTANT "PCR_RBALGVNRMAX_MAP_X" "9"
 SYSTEM_CONSTANT "PCR_RBALGVNRMAX_MAP_Y" "9"
 SYSTEM_CONSTANT "PCR_RBALGVNRMIN_MAP_X" "9"
 SYSTEM_CONSTANT "PCR_RBALGVNRMIN_MAP_Y" "9"
 SYSTEM_CONSTANT "PCR_RBALGVNRST_MAP_X" "9"
 SYSTEM_CONSTANT "PCR_RBALGVNRST_MAP_Y" "9"
 SYSTEM_CONSTANT "PCR_RBPCTLBAS2_MAP_X" "16"
 SYSTEM_CONSTANT "PCR_RBPCTLBAS2_MAP_Y" "13"
 SYSTEM_CONSTANT "PCR_RBPCTLBAS_MAP_X" "16"
 SYSTEM_CONSTANT "PCR_RBPCTLBAS_MAP_Y" "13"
 SYSTEM_CONSTANT "PCR_RBPCTLGEAR_MAP_X" "16"
 SYSTEM_CONSTANT "PCR_RBPCTLGEAR_MAP_Y" "10"
 SYSTEM_CONSTANT "PCR_RBPCTLRGN1_MAP_X" "16"
 SYSTEM_CONSTANT "PCR_RBPCTLRGN1_MAP_Y" "10"
 SYSTEM_CONSTANT "PCR_RBPCTLRGN2_MAP_X" "16"
 SYSTEM_CONSTANT "PCR_RBPCTLRGN2_MAP_Y" "10"
 SYSTEM_CONSTANT "PCR_RBPCTLRGN3_MAP_X" "16"
 SYSTEM_CONSTANT "PCR_RBPCTLRGN3_MAP_Y" "10"
 SYSTEM_CONSTANT "PCR_RBPCTLRGNCOR1_MAP_X" "2"
 SYSTEM_CONSTANT "PCR_RBPCTLRGNCOR1_MAP_Y" "2"
 SYSTEM_CONSTANT "PCR_RBPCTLRGNCOR2_MAP_X" "2"
 SYSTEM_CONSTANT "PCR_RBPCTLRGNCOR2_MAP_Y" "2"
 SYSTEM_CONSTANT "PCR_RBPCTLRGNCOR3_MAP_X" "2"
 SYSTEM_CONSTANT "PCR_RBPCTLRGNCOR3_MAP_Y" "2"
 SYSTEM_CONSTANT "PCR_RBPGOVLIN2_CUR_X" "21"
 SYSTEM_CONSTANT "PCR_RBPGOVLIN_CUR_X" "21"
 SYSTEM_CONSTANT "PCR_RBPGOVMAX_CUR_MAP_X" "16"
 SYSTEM_CONSTANT "PCR_RBPGOVMAX_MAP_X" "16"
 SYSTEM_CONSTANT "PCR_RBPGOVMAX_MAP_Y" "10"
 SYSTEM_CONSTANT "PCR_RBPGOVMIN_MAP_X" "16"
 SYSTEM_CONSTANT "PCR_RBPGOVMIN_MAP_Y" "10"
 SYSTEM_CONSTANT "PCR_RCTLAPCMPN_MAP_X" "9"
 SYSTEM_CONSTANT "PCR_RCTLAPCMPN_MAP_Y" "9"
 SYSTEM_CONSTANT "PCR_RELABS_ABS" "0"
 SYSTEM_CONSTANT "PCR_RELABS_REL" "1"
 SYSTEM_CONSTANT "PCR_STTRQFLTACTV_MAP_X" "10"
 SYSTEM_CONSTANT "PCR_STTRQFLTACTV_MAP_Y" "10"
 SYSTEM_CONSTANT "PCR_SWTLIMMPCR_TYPE" "0"
 SYSTEM_CONSTANT "PCR_SWTLIMMPCR_VAL" "1"
 SYSTEM_CONSTANT "PCR_SWTQCTL_TYPE" "2"
 SYSTEM_CONSTANT "PCR_SWTQCTL_VAL" "1"
 SYSTEM_CONSTANT "PCR_SWTQ_TYPE" "2"
 SYSTEM_CONSTANT "PCR_SWTQ_VAL" "1"
 SYSTEM_CONSTANT "PCR_SWTRELABS_TYPE" "2"
 SYSTEM_CONSTANT "PCR_SWTRELABS_VAL" "0"
 SYSTEM_CONSTANT "PCR_SWT_ADD" "1"
 SYSTEM_CONSTANT "PCR_SWT_CORR" "1"
 SYSTEM_CONSTANT "PCR_SWT_MUL" "2"
 SYSTEM_CONSTANT "PCR_TICOSTRT_CUR_X" "30"
 SYSTEM_CONSTANT "PDIFF_OFFSET_ZERO" "0"
 SYSTEM_CONSTANT "PERIOD_DASM_MAX" "22.2"
 SYSTEM_CONSTANT "PERIOD_DASM_MIN" "1.1"
 SYSTEM_CONSTANT "PERIOD_PWM_MAX" "11.7"
 SYSTEM_CONSTANT "PERIOD_PWM_MIN" "1.1"
 SYSTEM_CONSTANT "PERIOD_RES" "100"
 SYSTEM_CONSTANT "PERIOD_TPU_MAX" "15.3"
 SYSTEM_CONSTANT "PERIOD_TPU_MIN" "1.1"
 SYSTEM_CONSTANT "PER_CNT_MAX" "1000000"
 SYSTEM_CONSTANT "PER_DUR_ONE" "256"
 SYSTEM_CONSTANT "PER_DUR_RES" "1"
 SYSTEM_CONSTANT "PER_DUR_RES_NS" "1"
 SYSTEM_CONSTANT "PER_DUR_SHIFT" "256"
 SYSTEM_CONSTANT "PFLTCD_PLINDIFF_CUR_X" "25"
 SYSTEM_CONSTANT "PFLTCD_SWTSIGPDIFF_ADC" "0"
 SYSTEM_CONSTANT "PFLTCD_SWTSIGPDIFF_CAN" "1"
 SYSTEM_CONSTANT "PFLTCD_SWTSIGPDIFF_TYPE" "2"
 SYSTEM_CONSTANT "PFLTCD_SWTSIGPDIFF_VAL" "0"
 SYSTEM_CONSTANT "PFLTCD_TLINPRE2_CUR_X" "2"
 SYSTEM_CONSTANT "PFLTCD_TLINPRE_CUR_X" "40"
 SYSTEM_CONSTANT "PFLTCD_TLINPST_CUR_X" "40"
 SYSTEM_CONSTANT "PFLT_CPEGOXI_MAP_X" "6"
 SYSTEM_CONSTANT "PFLT_CPEGOXI_MAP_Y" "6"
 SYSTEM_CONSTANT "PFLT_CPEG_MAP_X" "6"
 SYSTEM_CONSTANT "PFLT_CPEG_MAP_Y" "6"
 SYSTEM_CONSTANT "PFLT_DMNOXENGBAS_MAP_X" "16"
 SYSTEM_CONSTANT "PFLT_DMNOXENGBAS_MAP_Y" "12"
 SYSTEM_CONSTANT "PFLT_DMNOXENGEGROFF_MAP_X" "8"
 SYSTEM_CONSTANT "PFLT_DMNOXENGEGROFF_MAP_Y" "8"
 SYSTEM_CONSTANT "PFLT_DMO2COR_CUR_X" "12"
 SYSTEM_CONSTANT "PFLT_DMSOTSIMBAS_MAP_X" "8"
 SYSTEM_CONSTANT "PFLT_DMSOTSIMBAS_MAP_Y" "8"
 SYSTEM_CONSTANT "PFLT_DMSOTSIMDYN_CUR_X" "8"
 SYSTEM_CONSTANT "PFLT_DMSOTSIMEGROFF_MAP_X" "8"
 SYSTEM_CONSTANT "PFLT_DMSOTSIMEGROFF_MAP_Y" "8"
 SYSTEM_CONSTANT "PFLT_DMSOTSIMLMBD_MAP_X" "8"
 SYSTEM_CONSTANT "PFLT_DMSOTSIMLMBD_MAP_Y" "8"
 SYSTEM_CONSTANT "PFLT_DMSOTSIMRGNBAS_CUR_X" "8"
 SYSTEM_CONSTANT "PFLT_DRSOTRATPT1_CUR_X" "5"
 SYSTEM_CONSTANT "PFLT_FACASHMS2LD_MAP_X" "5"
 SYSTEM_CONSTANT "PFLT_FACASHMS2LD_MAP_Y" "5"
 SYSTEM_CONSTANT "PFLT_FACCNVCATNO2COR_CUR_X" "16"
 SYSTEM_CONSTANT "PFLT_FACCNVCATNO2_CUR_X" "12"
 SYSTEM_CONSTANT "PFLT_FACCNVCAT_CUR_X" "8"
 SYSTEM_CONSTANT "PFLT_FACDPN_MAP_X" "8"
 SYSTEM_CONSTANT "PFLT_FACDPN_MAP_Y" "8"
 SYSTEM_CONSTANT "PFLT_FACDVOLNO2_CUR_X" "8"
 SYSTEM_CONSTANT "PFLT_FACDYNVISC_CUR_X" "8"
 SYSTEM_CONSTANT "PFLT_FACFLTEMP_CUR_X" "2"
 SYSTEM_CONSTANT "PFLT_FACFLTFUL_CUR_X" "2"
 SYSTEM_CONSTANT "PFLT_FACHTTRANSNOLIN_CUR_X" "2"
 SYSTEM_CONSTANT "PFLT_FACMFLO2SIMRGN_CUR_X" "8"
 SYSTEM_CONSTANT "PFLT_FACMLTCOR_CUR_X" "8"
 SYSTEM_CONSTANT "PFLT_FACSOTSIMDYNCOR_CUR_X" "8"
 SYSTEM_CONSTANT "PFLT_FACSOTSIMLMBD_X" "2"
 SYSTEM_CONSTANT "PFLT_FACSOTSIMRGNCRT_CUR_X" "8"
 SYSTEM_CONSTANT "PFLT_FACSOTSIMRGNNO2_CUR_X" "12"
 SYSTEM_CONSTANT "PFLT_FACSOTSIM_CUR_X" "2"
 SYSTEM_CONSTANT "PFLT_FACTEMPCRT_CUR_X" "8"
 SYSTEM_CONSTANT "PFLT_FACTEMPNO2_CUR_X" "12"
 SYSTEM_CONSTANT "PFLT_FACTEMPSIMRGN_CUR_X" "8"
 SYSTEM_CONSTANT "PFLT_FACTOXICRIT_CUR_X" "8"
 SYSTEM_CONSTANT "PFLT_HTG_ON" "1"
 SYSTEM_CONSTANT "PFLT_LSUMMAX_CUR_X" "4"
 SYSTEM_CONSTANT "PFLT_MASHADI_CUR_X" "6"
 SYSTEM_CONSTANT "PFLT_MASHOIL_CUR_X" "6"
 SYSTEM_CONSTANT "PFLT_MIN_ONE" "1"
 SYSTEM_CONSTANT "PFLT_MSOTMEAS_CUR_X" "8"
 SYSTEM_CONSTANT "PFLT_MSOTMEAS_MAP_X" "16"
 SYSTEM_CONSTANT "PFLT_MSOTMEAS_MAP_Y" "16"
 SYSTEM_CONSTANT "PFLT_NUMENGPOPDEL_CA_X" "12"
 SYSTEM_CONSTANT "PFLT_NUMENGPOPDEL_CA_Y" "7"
 SYSTEM_CONSTANT "PFLT_NUMENGPOP_CA_X" "8"
 SYSTEM_CONSTANT "PFLT_NUMENGPOP_CA_Y" "8"
 SYSTEM_CONSTANT "PFLT_NUMFLTEMPEU_CUR_X" "16"
 SYSTEM_CONSTANT "PFLT_NUMFLTEMPRE_MAP_X" "8"
 SYSTEM_CONSTANT "PFLT_NUMFLTEMPRE_MAP_Y" "8"
 SYSTEM_CONSTANT "PFLT_NUMFLTFULEU_CUR_X" "16"
 SYSTEM_CONSTANT "PFLT_NUMFLTFULRE_MAP_X" "8"
 SYSTEM_CONSTANT "PFLT_NUMFLTFULRE_MAP_Y" "8"
 SYSTEM_CONSTANT "PFLT_PDIFFCHARMONMIN_CUR_X" "5"
 SYSTEM_CONSTANT "PFLT_PDIFFSTY_MIN" "1000"
 SYSTEM_CONSTANT "PFLT_PENGPRTMAX_MAP_X" "2"
 SYSTEM_CONSTANT "PFLT_PENGPRTMAX_MAP_Y" "2"
 SYSTEM_CONSTANT "PFLT_PENGPRTMIN_MAP_X" "4"
 SYSTEM_CONSTANT "PFLT_PENGPRTMIN_MAP_Y" "4"
 SYSTEM_CONSTANT "PFLT_PFLTEMP_MAP_X" "2"
 SYSTEM_CONSTANT "PFLT_PFLTEMP_MAP_Y" "2"
 SYSTEM_CONSTANT "PFLT_PFLTFUL_MAP_X" "2"
 SYSTEM_CONSTANT "PFLT_PFLTFUL_MAP_Y" "2"
 SYSTEM_CONSTANT "PFLT_QACTTHRES7_CUR_X" "8"
 SYSTEM_CONSTANT "PFLT_QACTUPLIM7_CUR_X" "8"
 SYSTEM_CONSTANT "PFLT_RASHMS2LDBST_CUR_X" "5"
 SYSTEM_CONSTANT "PFLT_RASHMS2LDWRST_CUR_X" "5"
 SYSTEM_CONSTANT "PFLT_REACSPDCRVBRD" "30"
 SYSTEM_CONSTANT "PFLT_RESFLOWADIOFS_MAP_X" "8"
 SYSTEM_CONSTANT "PFLT_RESFLOWADIOFS_MAP_Y" "8"
 SYSTEM_CONSTANT "PFLT_RESFLOWMEASINV_MAP_X" "16"
 SYSTEM_CONSTANT "PFLT_RESFLOWMEASINV_MAP_Y" "16"
 SYSTEM_CONSTANT "PFLT_RESFLOWOILOFS_MAP_X" "8"
 SYSTEM_CONSTANT "PFLT_RESFLOWOILOFS_MAP_Y" "8"
 SYSTEM_CONSTANT "PFLT_RESFLOW_MAP_X" "8"
 SYSTEM_CONSTANT "PFLT_RESFLOW_MAP_Y" "8"
 SYSTEM_CONSTANT "PFLT_RLMBDSTAT_MAP_X" "16"
 SYSTEM_CONSTANT "PFLT_RLMBDSTAT_MAP_Y" "16"
 SYSTEM_CONSTANT "PFLT_RSOTSIMPRESHIGH1_CUR_X" "5"
 SYSTEM_CONSTANT "PFLT_RSOTSIMPRESHIGH2_CUR_X" "5"
 SYSTEM_CONSTANT "PFLT_RSOTSIMPRESHIGH3_CUR_X" "5"
 SYSTEM_CONSTANT "PFLT_RSOTSIMPRESHIGH4_CUR_X" "5"
 SYSTEM_CONSTANT "PFLT_RSOTSIMPRESLOW1_CUR_X" "5"
 SYSTEM_CONSTANT "PFLT_RSOTSIMPRESLOW2_CUR_X" "5"
 SYSTEM_CONSTANT "PFLT_RSOTSIMPRESLOW3_CUR_X" "5"
 SYSTEM_CONSTANT "PFLT_RSOTSIMPRESLOW4_CUR_X" "5"
 SYSTEM_CONSTANT "PFLT_RSOTSIM_MAP_X" "10"
 SYSTEM_CONSTANT "PFLT_RSOTSIM_MAP_Y" "10"
 SYSTEM_CONSTANT "PFLT_R_MO2AIR" "233"
 SYSTEM_CONSTANT "PFLT_TADDPOI1_MAP_X" "2"
 SYSTEM_CONSTANT "PFLT_TADDPOI1_MAP_Y" "2"
 SYSTEM_CONSTANT "PFLT_TADDPOI2_MAP_X" "8"
 SYSTEM_CONSTANT "PFLT_TADDPOI2_MAP_Y" "8"
 SYSTEM_CONSTANT "PFLT_TADDPOL2_MAP_X" "2"
 SYSTEM_CONSTANT "PFLT_TADDPOL2_MAP_Y" "2"
 SYSTEM_CONSTANT "PFLT_TDIFFAFTFLT_MAP_X" "6"
 SYSTEM_CONSTANT "PFLT_TDIFFAFTFLT_MAP_Y" "6"
 SYSTEM_CONSTANT "PFLT_TDIFFPREOXICNEG_CUR_X" "4"
 SYSTEM_CONSTANT "PFLT_TDIFFPREOXICPOS_CUR_X" "4"
 SYSTEM_CONSTANT "PFLT_TDIFFPREPFLTNEG_CUR_X" "4"
 SYSTEM_CONSTANT "PFLT_TDIFFPREPFLTPOS_CUR_X" "4"
 SYSTEM_CONSTANT "PFLT_TDIFFPRETRBNNEG_CUR_X" "4"
 SYSTEM_CONSTANT "PFLT_TDIFFPRETRBNPOS_CUR_X" "4"
 SYSTEM_CONSTANT "PFLT_TEXHGSDEL_CUR_X" "2"
 SYSTEM_CONSTANT "PFLT_TEXHGSSTY_MAP_X" "2"
 SYSTEM_CONSTANT "PFLT_TEXHGSSTY_MAP_Y" "2"
 SYSTEM_CONSTANT "PFLT_TEXOINCROXICATRGN1_MAP_X" "8"
 SYSTEM_CONSTANT "PFLT_TEXOINCROXICATRGN1_MAP_Y" "8"
 SYSTEM_CONSTANT "PFLT_TEXOINCROXICATRGN2_MAP_X" "8"
 SYSTEM_CONSTANT "PFLT_TEXOINCROXICATRGN2_MAP_Y" "8"
 SYSTEM_CONSTANT "PFLT_TEXOINCROXICATRGNPOI21_MAP_X" "8"
 SYSTEM_CONSTANT "PFLT_TEXOINCROXICATRGNPOI21_MAP_Y" "8"
 SYSTEM_CONSTANT "PFLT_TEXOINCROXICATRGNPOI22_MAP_X" "8"
 SYSTEM_CONSTANT "PFLT_TEXOINCROXICATRGNPOI22_MAP_Y" "8"
 SYSTEM_CONSTANT "PFLT_TICHKTEMPPLAUSMAX_CUR_X" "8"
 SYSTEM_CONSTANT "PFLT_TIEXHGSDEL_CUR_X" "8"
 SYSTEM_CONSTANT "PFLT_TIHTTRANSDT1_CUR_X" "2"
 SYSTEM_CONSTANT "PFLT_TIHTTRFOXI_MAP_X" "4"
 SYSTEM_CONSTANT "PFLT_TIHTTRFOXI_MAP_Y" "4"
 SYSTEM_CONSTANT "PFLT_TIHTTRF_MAP_X" "4"
 SYSTEM_CONSTANT "PFLT_TIHTTRF_MAP_Y" "4"
 SYSTEM_CONSTANT "PFLT_TILCKRGNERR_CA_X" "7"
 SYSTEM_CONSTANT "PFLT_TILCKRGN_CA_X" "7"
 SYSTEM_CONSTANT "PFLT_TINO2RGNDEL_MAP_X" "8"
 SYSTEM_CONSTANT "PFLT_TINO2RGNDEL_MAP_Y" "8"
 SYSTEM_CONSTANT "PFLT_TIOXIPREDEBPT1_CUR_X" "5"
 SYSTEM_CONSTANT "PFLT_TIPREDEBPT1_CUR_X" "5"
 SYSTEM_CONSTANT "PFLT_TIRGNMAX_CA_X" "7"
 SYSTEM_CONSTANT "PFLT_TIRGNSTG0_CUR_X" "5"
 SYSTEM_CONSTANT "PFLT_TIRGNSTG1_CUR_X" "5"
 SYSTEM_CONSTANT "PFLT_TIRGNSTG2_CUR_X" "5"
 SYSTEM_CONSTANT "PFLT_TIRGNSTG3_CUR_X" "5"
 SYSTEM_CONSTANT "PFLT_TIRGNSTG4_CUR_X" "5"
 SYSTEM_CONSTANT "PFLT_TIRGNSTG5_CUR_X" "5"
 SYSTEM_CONSTANT "PFLT_TIRGNSTG6_CUR_X" "5"
 SYSTEM_CONSTANT "PFLT_TISOTRATPT1_CUR_X" "5"
 SYSTEM_CONSTANT "PFLT_TITHRESNORM_MAP_X" "2"
 SYSTEM_CONSTANT "PFLT_TITHRESNORM_MAP_Y" "2"
 SYSTEM_CONSTANT "PFLT_TIVELVEH_CUR_X" "4"
 SYSTEM_CONSTANT "PFLT_TOXIEXOINCR_MAP_X" "5"
 SYSTEM_CONSTANT "PFLT_TOXIEXOINCR_MAP_Y" "5"
 SYSTEM_CONSTANT "PFLT_TOXIHTDPN_MAP_X" "6"
 SYSTEM_CONSTANT "PFLT_TOXIHTDPN_MAP_Y" "6"
 SYSTEM_CONSTANT "PFLT_TOXIPREHTLOSS_MAP_X" "4"
 SYSTEM_CONSTANT "PFLT_TOXIPREHTLOSS_MAP_Y" "5"
 SYSTEM_CONSTANT "PFLT_TOXIPSTHTLOSS_MAP_X" "4"
 SYSTEM_CONSTANT "PFLT_TOXIPSTHTLOSS_MAP_Y" "5"
 SYSTEM_CONSTANT "PFLT_TPREHTLOSS_MAP_X" "4"
 SYSTEM_CONSTANT "PFLT_TPREHTLOSS_MAP_Y" "5"
 SYSTEM_CONSTANT "PFLT_TPSTHTLOSS_MAP_X" "4"
 SYSTEM_CONSTANT "PFLT_TPSTHTLOSS_MAP_Y" "5"
 SYSTEM_CONSTANT "PFLT_TPSTSIMRGN5_MAP_X" "16"
 SYSTEM_CONSTANT "PFLT_TPSTSIMRGN5_MAP_Y" "16"
 SYSTEM_CONSTANT "PFLT_TPSTSIMRGN7_MAP_X" "16"
 SYSTEM_CONSTANT "PFLT_TPSTSIMRGN7_MAP_Y" "16"
 SYSTEM_CONSTANT "PFLT_TRQINRRGNLOWMAX1_CUR_X" "12"
 SYSTEM_CONSTANT "PFLT_TRQINRRGNLOWMAX2_CUR_X" "12"
 SYSTEM_CONSTANT "PFLT_TRQINRRGNUPPMAX1_CUR_X" "12"
 SYSTEM_CONSTANT "PFLT_TRQINRRGNUPPMAX2_CUR_X" "12"
 SYSTEM_CONSTANT "PFLT_TTHRESPRE1_MAP_X" "8"
 SYSTEM_CONSTANT "PFLT_TTHRESPRE1_MAP_Y" "8"
 SYSTEM_CONSTANT "PFLT_TTHRESPRE2_MAP_X" "8"
 SYSTEM_CONSTANT "PFLT_TTHRESPRE2_MAP_Y" "8"
 SYSTEM_CONSTANT "PHASE_PERIOD_RES" "10"
 SYSTEM_CONSTANT "PHI_INJBEG_UIS_EARL" "50"
 SYSTEM_CONSTANT "PHI_INJBEG_UIS_LATE" "-60"
 SYSTEM_CONSTANT "PHI_INT_MAIN" "54"
 SYSTEM_CONSTANT "PHI_INT_PILOT" "120"
 SYSTEM_CONSTANT "PHI_INT_SEGMENT" "144"
 SYSTEM_CONSTANT "PHI_INT_UPDATE_A" "180"
 SYSTEM_CONSTANT "PHI_INT_UPDATE_B" "180"
 SYSTEM_CONSTANT "PHI_INT_UPDATE_C" "180"
 SYSTEM_CONSTANT "PHI_INT_UPDATE_D" "180"
 SYSTEM_CONSTANT "PHI_INT_UPDATE_E" "180"
 SYSTEM_CONSTANT "PHI_INT_UPDATE_F" "180"
 SYSTEM_CONSTANT "PHI_INT_UPDATE_G" "180"
 SYSTEM_CONSTANT "PHI_POLLING" "60"
 SYSTEM_CONSTANT "PHI_POLLING_LONG" "90"
 SYSTEM_CONSTANT "PHI_STEER_MAX" "1433.5"
 SYSTEM_CONSTANT "PHI_STEER_MIN" "-1433.6"
 SYSTEM_CONSTANT "PHI_STEER_RES" "0.1"
 SYSTEM_CONSTANT "PHI_STEER_RES_REV" "10"
 SYSTEM_CONSTANT "PHI_TEMPGVNR_MAX" "200"
 SYSTEM_CONSTANT "PHI_TEMPGVNR_MIN" "-200"
 SYSTEM_CONSTANT "PHI_TIME_BY_N" "3906.25"
 SYSTEM_CONSTANT "PHI_ZERO" "0"
 SYSTEM_CONSTANT "PI" "3.14159265359"
 SYSTEM_CONSTANT "PMP_QNT_MAX" "1500"
 SYSTEM_CONSTANT "PMP_QNT_RES" "0.1"
 SYSTEM_CONSTANT "PMP_QNT_ZERO" "0"
 SYSTEM_CONSTANT "PRC2DTYCYC" "1"
 SYSTEM_CONSTANT "PRCPERTIME_MAX" "3.2767"
 SYSTEM_CONSTANT "PRCPERTIME_MIN" "-3.2768"
 SYSTEM_CONSTANT "PRCPERTIME_RES" "0.0001"
 SYSTEM_CONSTANT "PRCPERTIME_RES_INV" "10000"
 SYSTEM_CONSTANT "PRC_100" "100"
 SYSTEM_CONSTANT "PRC_100U_RES" "0.0001"
 SYSTEM_CONSTANT "PRC_100U_RES_REV" "10000"
 SYSTEM_CONSTANT "PRC_100_FL" "100"
 SYSTEM_CONSTANT "PRC_50" "50"
 SYSTEM_CONSTANT "PRC_94" "94"
 SYSTEM_CONSTANT "PRC_D4MS_FRMMNG" "25"
 SYSTEM_CONSTANT "PRC_FRMMNG" "0.4"
 SYSTEM_CONSTANT "PRC_HIGH_RES" "0.001"
 SYSTEM_CONSTANT "PRC_HIGH_RES_REV" "1000"
 SYSTEM_CONSTANT "PRC_LOW_RES" "0.02"
 SYSTEM_CONSTANT "PRC_LOW_RES_REV" "50"
 SYSTEM_CONSTANT "PRC_ONE" "1"
 SYSTEM_CONSTANT "PRC_RES" "0.01"
 SYSTEM_CONSTANT "PRC_RES_FL" "0.01"
 SYSTEM_CONSTANT "PRC_RES_REV" "100"
 SYSTEM_CONSTANT "PRC_SCAL_FAC" "10000"
 SYSTEM_CONSTANT "PRC_SCAL_NRM_EXP" "13"
 SYSTEM_CONSTANT "PRC_SOOT_400" "0.78125"
 SYSTEM_CONSTANT "PRC_SOOT_EXP" "9"
 SYSTEM_CONSTANT "PRC_SOOT_MAX" "0.123046875"
 SYSTEM_CONSTANT "PRC_SOOT_RES" "0.001953125"
 SYSTEM_CONSTANT "PRC_SOOT_RES_REV" "512"
 SYSTEM_CONSTANT "PRC_SOOT_ZERO" "0"
 SYSTEM_CONSTANT "PRC_ZERO" "0"
 SYSTEM_CONSTANT "PRC_ZERO_FL" "0"
 SYSTEM_CONSTANT "PRECTL_FAC_BPSUM_RES_FL" "0.00048828125"
 SYSTEM_CONSTANT "PRECTL_FAC_BPSUM_RES_INV" "2048"
 SYSTEM_CONSTANT "PRECTL_FAC_LRNFLT_RES" "3.0517578125e-05"
 SYSTEM_CONSTANT "PRECTL_FAC_LRNFLT_RES_INV" "32768"
 SYSTEM_CONSTANT "PRECTL_INJ_MASS_EEP_RES_INV_FL" "6.25"
 SYSTEM_CONSTANT "PRECTL_INJ_MASS_RAM_RES" "0.0003125"
 SYSTEM_CONSTANT "PRECTL_INJ_MASS_RAM_RES_INV" "3200"
 SYSTEM_CONSTANT "PRECTL_INJ_MASS_RAM_RES_INV_FL" "3200"
 SYSTEM_CONSTANT "PREFILL_ONE" "1"
 SYSTEM_CONSTANT "PRESCALER" "16"
 SYSTEM_CONSTANT "PRESPERSEC_RES" "10"
 SYSTEM_CONSTANT "PRESPERSEC_RES_REV" "0.1"
 SYSTEM_CONSTANT "PRES_AC_HPA_RES" "2"
 SYSTEM_CONSTANT "PRES_AC_HPA_RES_REV" "0.5"
 SYSTEM_CONSTANT "PRES_AIR_MAX" "3500"
 SYSTEM_CONSTANT "PRES_AIR_MIN" "0"
 SYSTEM_CONSTANT "PRES_BAR_RES" "0.0625"
 SYSTEM_CONSTANT "PRES_BAR_REV" "16"
 SYSTEM_CONSTANT "PRES_FACT_HPA_BAR" "1000"
 SYSTEM_CONSTANT "PRES_HPA_2_RMP_PRES_HPA_LOW" "10000000"
 SYSTEM_CONSTANT "PRES_HPA_BAR" "1000"
 SYSTEM_CONSTANT "PRES_HPA_NORM" "1013"
 SYSTEM_CONSTANT "PRES_HPA_RES" "1"
 SYSTEM_CONSTANT "PRES_HPA_RES_FL" "1"
 SYSTEM_CONSTANT "PRES_HPA_RES_INV" "1"
 SYSTEM_CONSTANT "PRES_RAIL_RES" "100"
 SYSTEM_CONSTANT "PRES_SI_RES" "100"
 SYSTEM_CONSTANT "PRPCTL_FACGOVINIT_CUR_X" "6"
 SYSTEM_CONSTANT "PRPCTL_SWT_ACC" "0"
 SYSTEM_CONSTANT "PRPCTL_SWT_ACCFILT1" "1"
 SYSTEM_CONSTANT "PRPCTL_SWT_ACCRAW" "2"
 SYSTEM_CONSTANT "PRPCTL_TRQAWDLIM_CUR_X" "25"
 SYSTEM_CONSTANT "PRPCTL_TRQNIVEAULIM_CUR_X" "25"
 SYSTEM_CONSTANT "PRP_CCON_OFF" "0"
 SYSTEM_CONSTANT "PRP_CCON_ON" "1"
 SYSTEM_CONSTANT "PRP_CCSEL_ACC" "1"
 SYSTEM_CONSTANT "PRP_CCSEL_CRCTL" "0"
 SYSTEM_CONSTANT "PRP_RENGLOW_CUR_X" "16"
 SYSTEM_CONSTANT "PRP_RENGLOW_MAP_X" "16"
 SYSTEM_CONSTANT "PRP_RENGLOW_MAP_Y" "16"
 SYSTEM_CONSTANT "PRP_RENGRELLOW_MAP_X" "2"
 SYSTEM_CONSTANT "PRP_RENGRELLOW_MAP_Y" "2"
 SYSTEM_CONSTANT "PRP_RENGREL_MAP_X" "2"
 SYSTEM_CONSTANT "PRP_RENGREL_MAP_Y" "2"
 SYSTEM_CONSTANT "PRP_RENG_CUR_X" "16"
 SYSTEM_CONSTANT "PRP_RENG_MAP_X" "16"
 SYSTEM_CONSTANT "PRP_RENG_MAP_Y" "16"
 SYSTEM_CONSTANT "PRP_SWTCCON_TYPE" "1"
 SYSTEM_CONSTANT "PRP_SWTCCON_VAL" "0"
 SYSTEM_CONSTANT "PRP_SWTCCSEL_TYPE" "1"
 SYSTEM_CONSTANT "PRP_SWTCCSEL_VAL" "0"
 SYSTEM_CONSTANT "PRP_TRQTHRESENG_CUR_X" "25"
 SYSTEM_CONSTANT "PWR_HIGH_RES" "0.1"
 SYSTEM_CONSTANT "PWR_HIRES" "0.5"
 SYSTEM_CONSTANT "PWR_HIRES_ZERO" "0"
 SYSTEM_CONSTANT "PWR_J_SEC_RES" "100"
 SYSTEM_CONSTANT "PWR_J_SEC_RES_FL" "10"
 SYSTEM_CONSTANT "PWR_KW_RES" "0.01"
 SYSTEM_CONSTANT "PWR_KW_RES_INV" "100"
 SYSTEM_CONSTANT "PWR_MAX" "300000"
 SYSTEM_CONSTANT "PWR_RES" "9.42477796077"
 SYSTEM_CONSTANT "PWR_ZERO" "0"
 SYSTEM_CONSTANT "QLAMBDA_RES_REV" "1000"
 SYSTEM_CONSTANT "RAIL_P_MAX" "1800000"
 SYSTEM_CONSTANT "RAIL_P_MIN" "0"
 SYSTEM_CONSTANT "RAIL_P_ZERO" "0"
 SYSTEM_CONSTANT "RAMPTIME_SLOPE" "6553.6"
 SYSTEM_CONSTANT "RATAM_RES" "0.01"
 SYSTEM_CONSTANT "RATAM_RES_FL" "0.01"
 SYSTEM_CONSTANT "RATAM_RES_REV" "100"
 SYSTEM_CONSTANT "RATFM_ONE" "1"
 SYSTEM_CONSTANT "RATFM_RES" "0.01"
 SYSTEM_CONSTANT "RATFM_ZERO" "0"
 SYSTEM_CONSTANT "RATIO_US_TO_HIGH" "10"
 SYSTEM_CONSTANT "RESIST_RES" "0.1"
 SYSTEM_CONSTANT "RESIST_ZERO" "0"
 SYSTEM_CONSTANT "RES_FACT_256" "256"
 SYSTEM_CONSTANT "RES_T_P_DV" "10000"
 SYSTEM_CONSTANT "REV_RES_US" "1000000"
 SYSTEM_CONSTANT "REYNOLDS_NUM_RES" "10000"
 SYSTEM_CONSTANT "RHO_FUEL" "830"
 SYSTEM_CONSTANT "RHO_FUEL_RES" "0.1"
 SYSTEM_CONSTANT "RHO_FUEL_RES_REV" "10"
 SYSTEM_CONSTANT "RMPACCCAN_ONE" "1"
 SYSTEM_CONSTANT "RMPACC_ONE" "1"
 SYSTEM_CONSTANT "RMPACC_RES" "0.01"
 SYSTEM_CONSTANT "RMPACC_RES_INV" "100"
 SYSTEM_CONSTANT "RMPDTYCYC_MAX" "100"
 SYSTEM_CONSTANT "RMPDTYCYC_MIN" "0"
 SYSTEM_CONSTANT "RMPTRQPRPLOW_RES" "1"
 SYSTEM_CONSTANT "RMP_AMPT_LOW_RES" "1"
 SYSTEM_CONSTANT "RMP_AMPT_LOW_RES_REV" "1"
 SYSTEM_CONSTANT "RMP_ENGN_NRM_EXP_2" "7"
 SYSTEM_CONSTANT "RMP_ENG_N_LOW_RES" "1"
 SYSTEM_CONSTANT "RMP_ENG_N_LOW_RES_REV" "1"
 SYSTEM_CONSTANT "RMP_FANCTL_NRM" "65536"
 SYSTEM_CONSTANT "RMP_GOV_RES_REV" "1024"
 SYSTEM_CONSTANT "RMP_INJ_MASS_LOW_RES" "0.1"
 SYSTEM_CONSTANT "RMP_INJ_MASS_LOW_RES_REV" "10"
 SYSTEM_CONSTANT "RMP_INTMIN_DT10" "6554"
 SYSTEM_CONSTANT "RMP_INTMIN_DT100" "656"
 SYSTEM_CONSTANT "RMP_INTMIN_DT20" "3277"
 SYSTEM_CONSTANT "RMP_NRM_EXP" "16"
 SYSTEM_CONSTANT "RMP_NRM_EXP16" "9"
 SYSTEM_CONSTANT "RMP_PRES_HPA_LOW_RES" "0.1"
 SYSTEM_CONSTANT "RMP_PRES_HPA_LOW_RES_REV" "10"
 SYSTEM_CONSTANT "RMP_RES" "0.0152587890625"
 SYSTEM_CONSTANT "RMP_RES16" "1.953125"
 SYSTEM_CONSTANT "RMP_RES_1" "0.001"
 SYSTEM_CONSTANT "RMP_RES_2" "0.1"
 SYSTEM_CONSTANT "RMP_RES_2_INV" "10"
 SYSTEM_CONSTANT "RMP_RES_INV" "65.536"
 SYSTEM_CONSTANT "RMP_RES_LIGOV" "0.00217982700892857"
 SYSTEM_CONSTANT "ROOM_RES" "256"
 SYSTEM_CONSTANT "RTRQCAN_ZERO" "0"
 SYSTEM_CONSTANT "RTRQ_CAN_RES" "0.392157"
 SYSTEM_CONSTANT "RTRQ_CAN_RES_REV" "2.54999910750031"
 SYSTEM_CONSTANT "R_ADD_MAX" "65.535"
 SYSTEM_CONSTANT "R_ADD_MIN" "0"
 SYSTEM_CONSTANT "R_STOICH_FL" "14.5"
 SYSTEM_CONSTANT "SCAL_16TO32_EXP" "4"
 SYSTEM_CONSTANT "SCAL_16TO32_FAC" "16"
 SYSTEM_CONSTANT "SEC_RES" "1"
 SYSTEM_CONSTANT "SHTRP_AFSCDRESET" "1"
 SYSTEM_CONSTANT "SHTRP_AFSCD_NMAX" "12"
 SYSTEM_CONSTANT "SHTRP_DFP" "10"
 SYSTEM_CONSTANT "SHTRP_LSU_NMAX" "6"
 SYSTEM_CONSTANT "SHTRP_MAX_FREE_TST_TOG" "31"
 SYSTEM_CONSTANT "SHTRP_RGN_STG_MAX" "6"
 SYSTEM_CONSTANT "SHTRP_RGN_STG_MIN" "0"
 SYSTEM_CONSTANT "SHTRP_T3_MAX" "4"
 SYSTEM_CONSTANT "SHTRP_TEST" "16"
 SYSTEM_CONSTANT "SHTRP_TESTVALUES" "3"
 SYSTEM_CONSTANT "SHTRP_TSTTOG" "11"
 SYSTEM_CONSTANT "SHTRP_TST_ADDPCD" "5"
 SYSTEM_CONSTANT "SHTRP_TST_AFSCD" "9"
 SYSTEM_CONSTANT "SHTRP_TST_BIP" "6"
 SYSTEM_CONSTANT "SHTRP_TST_EGRBA" "10"
 SYSTEM_CONSTANT "SHTRP_TST_EGRCBV" "2"
 SYSTEM_CONSTANT "SHTRP_TST_EGRCD" "12"
 SYSTEM_CONSTANT "SHTRP_TST_EGRGOVDEV" "1"
 SYSTEM_CONSTANT "SHTRP_TST_FREETSTTOG" "15"
 SYSTEM_CONSTANT "SHTRP_TST_GLWCTL" "7"
 SYSTEM_CONSTANT "SHTRP_TST_LSU" "14"
 SYSTEM_CONSTANT "SHTRP_TST_MISFIRE" "8"
 SYSTEM_CONSTANT "SHTRP_TST_PCRBA" "11"
 SYSTEM_CONSTANT "SHTRP_TST_PSP" "4"
 SYSTEM_CONSTANT "SHTRP_TST_T3GOV" "13"
 SYSTEM_CONSTANT "SHTRP_TST_VSA" "3"
 SYSTEM_CONSTANT "SIXTY" "600"
 SYSTEM_CONSTANT "SLPTIME_NORM" "10000"
 SYSTEM_CONSTANT "SLP_RES" "0.1"
 SYSTEM_CONSTANT "SLP_RES_REV" "10"
 SYSTEM_CONSTANT "SMPH_RES" "0.01"
 SYSTEM_CONSTANT "SMPH_RES_REV" "100"
 SYSTEM_CONSTANT "SMPS_FINE_RES" "1e-06"
 SYSTEM_CONSTANT "SMPS_FINE_RES_REV" "1000000"
 SYSTEM_CONSTANT "SOOT_GPERLTR_FINE_RES" "0.0001"
 SYSTEM_CONSTANT "SOOT_GPERLTR_FINE_RES_REV" "10000"
 SYSTEM_CONSTANT "SOOT_GPERLTR_RES" "0.01"
 SYSTEM_CONSTANT "SOOT_GPERLTR_RES_REV" "100"
 SYSTEM_CONSTANT "SPECIFICHEAT_RES" "0.0001"
 SYSTEM_CONSTANT "SPECIFICHEAT_RES_FL" "0.0001"
 SYSTEM_CONSTANT "SPECIFIC_RES_TO_IMPT_RES_FACT" "1"
 SYSTEM_CONSTANT "SPECIFIC_RES_TO_SPEC_HEAT_FLOW_RES_FACT" "1000"
 SYSTEM_CONSTANT "SPECIFIC_RES_TO_TEMP_RES_2_FACT" "0.01"
 SYSTEM_CONSTANT "SPECIFIC_RES_TO_TEMP_RES_2_FACT_INV" "100"
 SYSTEM_CONSTANT "SPECIFIC_RES_TO_TEMP_RES_FACT" "0.1"
 SYSTEM_CONSTANT "SPECIFIC_RES_TO_TEMP_RES_FACT_INV" "10"
 SYSTEM_CONSTANT "SPEC_HEAT_FLOW_RES" "0.01"
 SYSTEM_CONSTANT "SPEC_HEAT_FLOW_RES_FL" "0.01"
 SYSTEM_CONSTANT "SQRT_NUM_RES" "10000"
 SYSTEM_CONSTANT "SQRT_TWO_INV" "7071"
 SYSTEM_CONSTANT "SQRVLTG_S_RES" "0.1"
 SYSTEM_CONSTANT "SRVPMP_PWRPHISTEER_MAP_X" "8"
 SYSTEM_CONSTANT "SRVPMP_PWRPHISTEER_MAP_Y" "11"
 SYSTEM_CONSTANT "STROKE_MAX" "3276.7"
 SYSTEM_CONSTANT "STROKE_MIN" "0"
 SYSTEM_CONSTANT "STRTCD_ULINOFFRLY_CUR_X" "2"
 SYSTEM_CONSTANT "STRTCD_ULINONRLY_CUR_X" "2"
 SYSTEM_CONSTANT "STR_PER_VOL" "0.1"
 SYSTEM_CONSTANT "STR_PER_VOL_REZ" "10"
 SYSTEM_CONSTANT "STSYSCTL_NTHRESENGT_CUR_X" "7"
 SYSTEM_CONSTANT "STSYSCTL_TITHRESENGT_CUR_X" "7"
 SYSTEM_CONSTANT "STSYSCTL_TMAXNRM_MAP_X" "10"
 SYSTEM_CONSTANT "STSYSCTL_TMAXNRM_MAP_Y" "10"
 SYSTEM_CONSTANT "STSYS_NSTRTCUTOUT_MAP_X" "6"
 SYSTEM_CONSTANT "STSYS_NSTRTCUTOUT_MAP_Y" "4"
 SYSTEM_CONSTANT "STSYS_NTHRESTENG_CUR_X" "5"
 SYSTEM_CONSTANT "STSYS_NUPLITHRESTENG_CUR_X" "5"
 SYSTEM_CONSTANT "STSYS_TISHUTOFF_CUR_X" "10"
 SYSTEM_CONSTANT "STSYS_TISHUTOFF_MAP_X" "10"
 SYSTEM_CONSTANT "STSYS_TISHUTOFF_MAP_Y" "4"
 SYSTEM_CONSTANT "STSYS_TRQSTRTBAS_MAP_X" "9"
 SYSTEM_CONSTANT "STSYS_TRQSTRTBAS_MAP_Y" "10"
 SYSTEM_CONSTANT "STSYS_TRQSTRT_MAP_X" "9"
 SYSTEM_CONSTANT "STSYS_TRQSTRT_MAP_Y" "10"
 SYSTEM_CONSTANT "ST_RES_MAX" "25"
 SYSTEM_CONSTANT "ST_RES_MIN" "0"
 SYSTEM_CONSTANT "ST_RES_RES" "0.001"
 SYSTEM_CONSTANT "ST_RES_RES_INV" "1000"
 SYSTEM_CONSTANT "SVLPCD_LFILLLVL_CUR_X" "13"
 SYSTEM_CONSTANT "SVLPCD_LOILWRN_MAP_X" "13"
 SYSTEM_CONSTANT "SVLPCD_LOILWRN_MAP_Y" "13"
 SYSTEM_CONSTANT "SVLP_DOILLOAD_MAP_X" "8"
 SYSTEM_CONSTANT "SVLP_DOILLOAD_MAP_Y" "8"
 SYSTEM_CONSTANT "SVLP_DSOOTLOAD_MAP_X" "8"
 SYSTEM_CONSTANT "SVLP_DSOOTLOAD_MAP_Y" "8"
 SYSTEM_CONSTANT "SVLP_FACQI_MAP_X" "9"
 SYSTEM_CONSTANT "SVLP_FACQI_MAP_Y" "9"
 SYSTEM_CONSTANT "SVLP_LSOOTLOAD_MAP_X" "9"
 SYSTEM_CONSTANT "SVLP_LSOOTLOAD_MAP_Y" "9"
 SYSTEM_CONSTANT "SVLP_PRESENT_NO" "0"
 SYSTEM_CONSTANT "SVLP_PRESENT_YES" "1"
 SYSTEM_CONSTANT "SVLP_SWTPRESENT_TYPE" "2"
 SYSTEM_CONSTANT "SVLP_SWTPRESENT_VAL" "1"
 SYSTEM_CONSTANT "SWT_DISABLED" "0"
 SYSTEM_CONSTANT "SWT_ENABLED" "1"
 SYSTEM_CONSTANT "SWT_SIG_CAN" "1"
 SYSTEM_CONSTANT "SWT_SIG_CANEPB" "2"
 SYSTEM_CONSTANT "SWT_SIG_HW" "0"
 SYSTEM_CONSTANT "SWT_TYPE_APPL" "2"
 SYSTEM_CONSTANT "SWT_TYPE_DATASET" "0"
 SYSTEM_CONSTANT "SWT_TYPE_EEP" "1"
 SYSTEM_CONSTANT "SYS_TICK_DURATION" "286.000286000286"
 SYSTEM_CONSTANT "SY_CANCELLED_AFTERRUN" "0"
 SYSTEM_CONSTANT "SY_CLASS_TAB_SIZE" "26"
 SYSTEM_CONSTANT "SY_D2CNT_SIZE" "0"
 SYSTEM_CONSTANT "SY_DFPMENV" "8"
 SYSTEM_CONSTANT "SY_DFPMFFS" "20"
 SYSTEM_CONSTANT "SY_DFPMTIM" "2"
 SYSTEM_CONSTANT "SY_DFPM_HLC_BEHAVIOUR" "1"
 SYSTEM_CONSTANT "SY_DFP_FCM_BEHAVIOUR" "1"
 SYSTEM_CONSTANT "SY_DFP_FCM_PRIO_HANDLE" "0"
 SYSTEM_CONSTANT "SY_DFP_FILLFRZ_IN_FCM_BEHAVIOUR" "0"
 SYSTEM_CONSTANT "SY_DIUMPR_AFSCD_ENABLE" "0"
 SYSTEM_CONSTANT "SY_DIUMPR_ENABLE" "1"
 SYSTEM_CONSTANT "SY_DIUMPR_MODE7_VISIBILITY" "0"
 SYSTEM_CONSTANT "SY_DIUMPR_ST_SIGACTV_ENABLE" "0"
 SYSTEM_CONSTANT "SY_DSCHED_DFP_DEF_TAB_SIZE" "10"
 SYSTEM_CONSTANT "SY_DSCHED_DFP_OK_TAB_SIZE" "20"
 SYSTEM_CONSTANT "SY_DSCHED_ENABLE" "0"
 SYSTEM_CONSTANT "SY_DSMEX" "12"
 SYSTEM_CONSTANT "SY_DSMFA" "8"
 SYSTEM_CONSTANT "SY_DSMMAST" "16"
 SYSTEM_CONSTANT "SY_DSMSLP" "8"
 SYSTEM_CONSTANT "SY_DSM_BE_LOCK_ERROR" "0"
 SYSTEM_CONSTANT "SY_DSM_BLK_CODE_ENABLE" "0"
 SYSTEM_CONSTANT "SY_DSM_CHECKSUM_ACT" "0"
 SYSTEM_CONSTANT "SY_DSM_DC_BEHAVIOUR" "1"
 SYSTEM_CONSTANT "SY_DSM_DIS_AT_EOLTESTER" "0"
 SYSTEM_CONSTANT "SY_DSM_DTR_NUMBER_OF_ELEMENTS" "18"
 SYSTEM_CONSTANT "SY_DSM_DUR_FCM_ENABLE" "1"
 SYSTEM_CONSTANT "SY_DSM_DUR_GLOBAL_ENABLE" "1"
 SYSTEM_CONSTANT "SY_DSM_FA_FADEMSK_ENABLE" "1"
 SYSTEM_CONSTANT "SY_DSM_FRZFRM_INC_ENABLE" "1"
 SYSTEM_CONSTANT "SY_DSM_FRZFRM_TS_ENABLE" "1"
 SYSTEM_CONSTANT "SY_DSM_HISTORYSIZE" "8"
 SYSTEM_CONSTANT "SY_DSM_INHIBIT_DELAY" "0"
 SYSTEM_CONSTANT "SY_DSM_INHIBIT_DELAY_LAMP_ENABLE" "0"
 SYSTEM_CONSTANT "SY_DSM_ISO14229_ENABLE" "0"
 SYSTEM_CONSTANT "SY_DSM_MASTER_SLAVE_ENABLE" "0"
 SYSTEM_CONSTANT "SY_DSM_MAST_SLA_COMP" "1"
 SYSTEM_CONSTANT "SY_DSM_NONCONT_MON_RDY" "0"
 SYSTEM_CONSTANT "SY_DSM_NUM_COLL_MP" "26"
 SYSTEM_CONSTANT "SY_DSM_NUM_FID_COLL_MP" "30"
 SYSTEM_CONSTANT "SY_DSM_OUTPUT_PRIORITY_SUPPORT" "1"
 SYSTEM_CONSTANT "SY_DSM_PROTECT_FCM" "1"
 SYSTEM_CONSTANT "SY_DSM_RDY_ACC" "1"
 SYSTEM_CONSTANT "SY_DSM_SHADOW_CLEAR" "1"
 SYSTEM_CONSTANT "SY_DSM_SHADOW_ENABLE" "0"
 SYSTEM_CONSTANT "SY_DSM_SHADOW_INH_BEHAVIOUR" "1"
 SYSTEM_CONSTANT "SY_DSM_SHADOW_TIMAX" "0"
 SYSTEM_CONSTANT "SY_DSM_SIMCOND_PHYAPPVAL" "1"
 SYSTEM_CONSTANT "SY_DSM_SIZE_FCM_ENTRY" "58"
 SYSTEM_CONSTANT "SY_DSM_SUPP_16BIT_DFP" "1"
 SYSTEM_CONSTANT "SY_DSM_SYSLMP_BLK" "0"
 SYSTEM_CONSTANT "SY_DSM_VALID_PRESENT" "0"
 SYSTEM_CONSTANT "SY_DSM_VISIBILITY_SUPPORT" "0"
 SYSTEM_CONSTANT "SY_DTR_ENABLE" "1"
 SYSTEM_CONSTANT "SY_ENABLE_CALC_MESSGRP_RATIO" "1"
 SYSTEM_CONSTANT "SY_ENABLE_D2CNT" "0"
 SYSTEM_CONSTANT "SY_ENABLE_ENG_RUN_HOUR_CNT" "0"
 SYSTEM_CONSTANT "SY_ENVBLOK" "2"
 SYSTEM_CONSTANT "SY_ENV_BYTE" "0"
 SYSTEM_CONSTANT "SY_ENV_WORD" "1"
 SYSTEM_CONSTANT "SY_FAULT_TYPE_CONV" "1"
 SYSTEM_CONSTANT "SY_FCMSIZE" "8"
 SYSTEM_CONSTANT "SY_FFESIZE" "7"
 SYSTEM_CONSTANT "SY_INH_POINT_APPLIC" "0"
 SYSTEM_CONSTANT "SY_NOCLR_RDY" "1"
 SYSTEM_CONSTANT "SY_SUPPORT_TRIGGER_ACTION" "0"
 SYSTEM_CONSTANT "SY_TIMEBASED_CANCELLEDAFTERRUN" "0"
 SYSTEM_CONSTANT "SY_WTTLEN" "20"
 SYSTEM_CONSTANT "T15CD_ULIN_CUR_X" "5"
 SYSTEM_CONSTANT "T50CD_DIGIN_PRESENT_NO" "0"
 SYSTEM_CONSTANT "T50CD_DIGIN_PRESENT_YES" "1"
 SYSTEM_CONSTANT "T50CD_RXDIGIN_PRESENT_NO" "0"
 SYSTEM_CONSTANT "T50CD_RXDIGIN_PRESENT_YES" "1"
 SYSTEM_CONSTANT "T50CD_SWTDIGIN_PRESENT_TYPE" "2"
 SYSTEM_CONSTANT "T50CD_SWTDIGIN_PRESENT_VAL" "1"
 SYSTEM_CONSTANT "T50CD_SWTRXDIGIN_P_TYPE" "2"
 SYSTEM_CONSTANT "T50CD_SWTRXDIGIN_P_VAL" "1"
 SYSTEM_CONSTANT "TAA_CFG_SPDRNG" "1"
 SYSTEM_CONSTANT "TAA_ENTRY_PHIDVT" "84"
 SYSTEM_CONSTANT "TAA_ENTRY_TINC" "60"
 SYSTEM_CONSTANT "TAA_INCS_CMB" "30"
 SYSTEM_CONSTANT "TAA_INC_GAPHDL" "5"
 SYSTEM_CONSTANT "TAA_MAX_INCS" "60"
 SYSTEM_CONSTANT "TAA_NUM_MAXGAPS" "3"
 SYSTEM_CONSTANT "TAA_NUM_SPDRNG" "3"
 SYSTEM_CONSTANT "TAA_PHIMAX" "2.5"
 SYSTEM_CONSTANT "TEGCO_Q_CNV" "128"
 SYSTEM_CONSTANT "TEGMOD_ALPHAEGPIPE_RES" "1280"
 SYSTEM_CONSTANT "TEGMOD_ALPHAPIPEENV_RES" "52428.8"
 SYSTEM_CONSTANT "TEGMOD_AREAPIPE_RES" "201.06192982976"
 SYSTEM_CONSTANT "TEGMOD_CMPRPWR_RES" "76747.2972710018"
 SYSTEM_CONSTANT "TEGMOD_DELTATEMPLOW_RES" "10"
 SYSTEM_CONSTANT "TEGMOD_DELTATEMP_RES" "100"
 SYSTEM_CONSTANT "TEGMOD_FACPT1_RES" "2812.5"
 SYSTEM_CONSTANT "TEGMOD_HEATFLOWKW_RES" "100000"
 SYSTEM_CONSTANT "TEGMOD_HEATFLOW_INTER_RES" "360"
 SYSTEM_CONSTANT "TEGMOD_HEATFLOW_RES" "1000"
 SYSTEM_CONSTANT "TEGMOD_HEATKJ_RES" "100"
 SYSTEM_CONSTANT "TEGMOD_HEATRANSOXICAT_INTER1_RES" "100"
 SYSTEM_CONSTANT "TEGMOD_HEATRANSOXICAT_INTER2_RES" "0.1"
 SYSTEM_CONSTANT "TEGMOD_HEATRANSOXICAT_INTER3_RES" "10"
 SYSTEM_CONSTANT "TEGMOD_HEATRANSOXICAT_RES" "1000"
 SYSTEM_CONSTANT "TEGMOD_HEATRANS_INTER_RES" "819.2"
 SYSTEM_CONSTANT "TEGMOD_HEATRANS_RES" "100"
 SYSTEM_CONSTANT "TEGMOD_HUBPERSEC_RES" "120"
 SYSTEM_CONSTANT "TEGMOD_INJMASSKGH_RES" "377.48736"
 SYSTEM_CONSTANT "TEGMOD_INTER1_RES" "0.01"
 SYSTEM_CONSTANT "TEGMOD_INTER2_RES" "0.001"
 SYSTEM_CONSTANT "TEGMOD_INTER_RES" "1"
 SYSTEM_CONSTANT "TEGMOD_LAMBDA_RES" "8827.58620689655"
 SYSTEM_CONSTANT "TEGMOD_PT1TIMECONST_RES" "335.54432"
 SYSTEM_CONSTANT "TEGMOD_REPIPEENV_RES" "1456.35555555556"
 SYSTEM_CONSTANT "TEGMOD_REPIPE_RES" "370.857896905592"
 SYSTEM_CONSTANT "TEGMOD_SIZE_TMEM" "24"
 SYSTEM_CONSTANT "TEGMOD_TEMPEG_INTER_RES" "3600"
 SYSTEM_CONSTANT "TEGMOD_TEMPEG_RES" "100"
 SYSTEM_CONSTANT "TEGMOD_TEMPTRBN_INTER_RES" "10485.76"
 SYSTEM_CONSTANT "TEGMOD_TEMPTRBN_RES" "9424.77796077"
 SYSTEM_CONSTANT "TEGMOD_TEMP_RES" "819.2"
 SYSTEM_CONSTANT "TEMP_CELS_OFFSET" "0"
 SYSTEM_CONSTANT "TEMP_CELS_RES" "0.1"
 SYSTEM_CONSTANT "TEMP_CELS_RES_FL" "0.1"
 SYSTEM_CONSTANT "TEMP_HIGH_RES" "0.01"
 SYSTEM_CONSTANT "TEMP_KELV_ZERO" "0"
 SYSTEM_CONSTANT "TEMP_LOW_RES" "1"
 SYSTEM_CONSTANT "TEMP_NULL_C" "-273.14"
 SYSTEM_CONSTANT "TEMP_NULL_F" "-459.652"
 SYSTEM_CONSTANT "TEMP_RATE_TCLNT_MOD_MAX" "0.7999755859375"
 SYSTEM_CONSTANT "TEMP_RATE_TCLNT_MOD_MIN" "0"
 SYSTEM_CONSTANT "TEMP_RES" "0.1"
 SYSTEM_CONSTANT "TEMP_RES_FL" "0.1"
 SYSTEM_CONSTANT "TEMP_RES_INV" "10"
 SYSTEM_CONSTANT "TEMP_RES_REV" "10"
 SYSTEM_CONSTANT "TEMP_RES_TCLNT_MOD" "2.44140625e-05"
 SYSTEM_CONSTANT "TEMP_RES_TCLNT_MOD_REV" "40960"
 SYSTEM_CONSTANT "TEMP_ZERO_DEG_C" "0"
 SYSTEM_CONSTANT "TFCT_NRM_EXP" "12"
 SYSTEM_CONSTANT "THERMAL_COEFF_RES" "0.1"
 SYSTEM_CONSTANT "THREE_PI" "942.477796077"
 SYSTEM_CONSTANT "THRVLV_FACPSADAPT_CUR_X" "11"
 SYSTEM_CONSTANT "THRVLV_IEFF_CUR_X" "8"
 SYSTEM_CONSTANT "THRVLV_RGVNRMAX_CUR_X" "3"
 SYSTEM_CONSTANT "THRVLV_RLINTVA_CUR_X" "8"
 SYSTEM_CONSTANT "TIHR_NRM_EXP" "8"
 SYSTEM_CONSTANT "TIMEDELAY32TO15_FACT" "8"
 SYSTEM_CONSTANT "TIMEDELAY_ADC_FILTER" "2684.35456"
 SYSTEM_CONSTANT "TIMEDELAY_MAX" "4294"
 SYSTEM_CONSTANT "TIMEDELAY_MIN" "0.001"
 SYSTEM_CONSTANT "TIMEDELAY_S_1_MIN" "4e-05"
 SYSTEM_CONSTANT "TIMEDELAY_S_1_NRM" "12"
 SYSTEM_CONSTANT "TIMEDELAY_S_2_MIN" "0.001"
 SYSTEM_CONSTANT "TIMEDELAY_S_2_NRM" "8"
 SYSTEM_CONSTANT "TIMEDELAY_S_LIN_16_3_MAX" "250"
 SYSTEM_CONSTANT "TIMEDELAY_S_LIN_16_3_RES" "0.0076296273689993"
 SYSTEM_CONSTANT "TIMEDELAY_S_LIN_16_MAX" "5"
 SYSTEM_CONSTANT "TIMEDELAY_S_LIN_16_MAX_ASDDC" "1.5"
 SYSTEM_CONSTANT "TIMEDELAY_S_LIN_16_MAX_ASDRF" "1.5"
 SYSTEM_CONSTANT "TIMEDELAY_S_LIN_16_REC_RES" "4294.967296"
 SYSTEM_CONSTANT "TIMEDELAY_S_LIN_16_RES" "0.000152592547379986"
 SYSTEM_CONSTANT "TIMEDELAY_S_LIN_16_RES_FL" "0.000152592547379986"
 SYSTEM_CONSTANT "TIMEDELAY_S_LIN_MAXSINT16_MAX" "32767"
 SYSTEM_CONSTANT "TIMEDELAY_S_LIN_MAXSINT16_RES" "1"
 SYSTEM_CONSTANT "TIMEDELAY_S_NRM1" "4294967296"
 SYSTEM_CONSTANT "TIMEDELAY_S_NRM2" "10000"
 SYSTEM_CONSTANT "TIMEDELAY_S_NRM3" "1000000"
 SYSTEM_CONSTANT "TIMERMPINV_RES" "1.52587890625e-05"
 SYSTEM_CONSTANT "TIMETICK_VAL" "10"
 SYSTEM_CONSTANT "TIME_100ms_CYCLE" "100000"
 SYSTEM_CONSTANT "TIME_10ms_CYCLE" "10000"
 SYSTEM_CONSTANT "TIME_200ms_CYCLE" "200"
 SYSTEM_CONSTANT "TIME_20ms_CYCLE" "20000"
 SYSTEM_CONSTANT "TIME_2MS_CYCLE" "2000"
 SYSTEM_CONSTANT "TIME_40ms_CYCLE" "40000"
 SYSTEM_CONSTANT "TIME_4US_RES" "4"
 SYSTEM_CONSTANT "TIME_5S_RES" "5"
 SYSTEM_CONSTANT "TIME_ADCFILT_RES" "0.003906"
 SYSTEM_CONSTANT "TIME_BIPDVT_HIGH_RES" "0.1"
 SYSTEM_CONSTANT "TIME_CALC_INV" "0.65536"
 SYSTEM_CONSTANT "TIME_CONV_TICK" "8192"
 SYSTEM_CONSTANT "TIME_DEB_MAX" "30"
 SYSTEM_CONSTANT "TIME_DEB_RES" "10"
 SYSTEM_CONSTANT "TIME_DT_10MS" "10000"
 SYSTEM_CONSTANT "TIME_DT_1MS" "1000"
 SYSTEM_CONSTANT "TIME_DT_1SEC" "1000000"
 SYSTEM_CONSTANT "TIME_DT_MS_RES" "0.001"
 SYSTEM_CONSTANT "TIME_DT_RES" "1"
 SYSTEM_CONSTANT "TIME_DT_RES_FL" "1"
 SYSTEM_CONSTANT "TIME_ENGSPD_FLT_RES" "0.1"
 SYSTEM_CONSTANT "TIME_ENG_ON_RES" "1"
 SYSTEM_CONSTANT "TIME_HIGHRES_MAX" "8191.875"
 SYSTEM_CONSTANT "TIME_HIGH_RES" "0.125"
 SYSTEM_CONSTANT "TIME_HIGH_RES_REV" "8"
 SYSTEM_CONSTANT "TIME_MIN_RES" "1"
 SYSTEM_CONSTANT "TIME_MS_100MS_RES" "100"
 SYSTEM_CONSTANT "TIME_MS_10MS" "10"
 SYSTEM_CONSTANT "TIME_MS_10MS_RES" "10"
 SYSTEM_CONSTANT "TIME_MS_20MS_RES" "20"
 SYSTEM_CONSTANT "TIME_MS_40MS_RES" "40"
 SYSTEM_CONSTANT "TIME_MS_MAX" "655140"
 SYSTEM_CONSTANT "TIME_MS_MAX32" "42949672740"
 SYSTEM_CONSTANT "TIME_MS_MIN" "60000"
 SYSTEM_CONSTANT "TIME_MS_ZERO" "0"
 SYSTEM_CONSTANT "TIME_ONE_US" "1"
 SYSTEM_CONSTANT "TIME_PWM_HIGH_RES" "1e-07"
 SYSTEM_CONSTANT "TIME_RECOVERBUSOFF_MIN" "150"
 SYSTEM_CONSTANT "TIME_RED_MAX" "3600"
 SYSTEM_CONSTANT "TIME_RED_NRM" "4"
 SYSTEM_CONSTANT "TIME_RED_RES" "0.16"
 SYSTEM_CONSTANT "TIME_RES_FL" "1e-06"
 SYSTEM_CONSTANT "TIME_RMP_RES" "53687091.2"
 SYSTEM_CONSTANT "TIME_RTMHIGH_RES" "0.001"
 SYSTEM_CONSTANT "TIME_RTMHIGH_RES_REV" "1000"
 SYSTEM_CONSTANT "TIME_RTMLOW_RES" "0.1"
 SYSTEM_CONSTANT "TIME_RTMLOW_RES_REV" "10"
 SYSTEM_CONSTANT "TIME_S_100US_RES" "0.0001"
 SYSTEM_CONSTANT "TIME_S_100US_RES_REV" "10000"
 SYSTEM_CONSTANT "TIME_S_MAX" "655.14"
 SYSTEM_CONSTANT "TIME_S_MAX32" "42949672.74"
 SYSTEM_CONSTANT "TIME_S_ZERO" "0"
 SYSTEM_CONSTANT "TIME_TICK" "10"
 SYSTEM_CONSTANT "TIME_TICK_1" "1"
 SYSTEM_CONSTANT "TIME_TICK_RES" "10"
 SYSTEM_CONSTANT "TIME_TICK_S" "0.01"
 SYSTEM_CONSTANT "TIME_TICK_SEC_INV" "100"
 SYSTEM_CONSTANT "TIME_TINC_USEC_REV" "10"
 SYSTEM_CONSTANT "TIME_US_RES" "1"
 SYSTEM_CONSTANT "TIME_US_ZERO" "0"
 SYSTEM_CONSTANT "TI_BIP_MAX" "13000"
 SYSTEM_CONSTANT "TI_BIP_MIN" "0"
 SYSTEM_CONSTANT "TI_MULTIINJCOR_MAX" "-500"
 SYSTEM_CONSTANT "TMR_SHIFT_EXP" "13"
 SYSTEM_CONSTANT "TOXICATMOD_HEATFLOWHCCNV_RES" "10"
 SYSTEM_CONSTANT "TOXICATMOD_HEATFLOW_RES" "0.277777777777778"
 SYSTEM_CONSTANT "TOXICATMOD_INTER1_RES" "29"
 SYSTEM_CONSTANT "TOXICATMOD_INTER2_RES" "10"
 SYSTEM_CONSTANT "TOXICATMOD_INTER3_RES" "36"
 SYSTEM_CONSTANT "TOXICATMOD_INTER_RES" "2"
 SYSTEM_CONSTANT "TRANS_R_MAX" "32767"
 SYSTEM_CONSTANT "TRANS_R_ONE" "1"
 SYSTEM_CONSTANT "TRANS_R_RES" "0.01"
 SYSTEM_CONSTANT "TRANS_R_RES_REV" "100"
 SYSTEM_CONSTANT "TRBCH_SPEED" "40000"
 SYSTEM_CONSTANT "TRNVRSACC_RES" "0.01"
 SYSTEM_CONSTANT "TRNVRSACC_RES_REV" "100"
 SYSTEM_CONSTANT "TRQBRK_MIN" "0"
 SYSTEM_CONSTANT "TRQDHIGH_RES" "960"
 SYSTEM_CONSTANT "TRQHIGH_RES" "5"
 SYSTEM_CONSTANT "TRQINNFACT_MAX" "2"
 SYSTEM_CONSTANT "TRQINNFACT_MIN" "0"
 SYSTEM_CONSTANT "TRQPRPHIGH_MAX" "52427.2"
 SYSTEM_CONSTANT "TRQPRPHIGH_MIN" "-52428.8"
 SYSTEM_CONSTANT "TRQPRPHIGH_RES" "0.1"
 SYSTEM_CONSTANT "TRQPRPHIGH_RES_REV" "10"
 SYSTEM_CONSTANT "TRQPRPHIGH_ZERO" "0"
 SYSTEM_CONSTANT "TRQPRP_MAX" "52427.2"
 SYSTEM_CONSTANT "TRQPRP_MIN" "-52428.8"
 SYSTEM_CONSTANT "TRQPRP_NRM" "4"
 SYSTEM_CONSTANT "TRQPRP_RES" "1.6"
 SYSTEM_CONSTANT "TRQPRP_RES_REV" "0.625"
 SYSTEM_CONSTANT "TRQPRP_RMP_RES" "6553.6"
 SYSTEM_CONSTANT "TRQPRP_ZERO" "0"
 SYSTEM_CONSTANT "TRQXDHIGH_RES" "256"
 SYSTEM_CONSTANT "TRQ_FRC_INI" "-50"
 SYSTEM_CONSTANT "TRQ_INT_RES" "5"
 SYSTEM_CONSTANT "TRQ_INT_RES2" "1"
 SYSTEM_CONSTANT "TRQ_MAX" "1000"
 SYSTEM_CONSTANT "TRQ_MIN" "-500"
 SYSTEM_CONSTANT "TRQ_ONE" "1"
 SYSTEM_CONSTANT "TRQ_RES" "0.1"
 SYSTEM_CONSTANT "TRQ_RES_FL" "0.1"
 SYSTEM_CONSTANT "TRQ_RES_REV" "10"
 SYSTEM_CONSTANT "TRQ_RES_REZ" "10"
 SYSTEM_CONSTANT "TRQ_ZERO" "0"
 SYSTEM_CONSTANT "TR_POINT" "5"
 SYSTEM_CONSTANT "TSTTOG_K2SigBlkVal1_MAP_X" "4"
 SYSTEM_CONSTANT "TSTTOG_K2SigBlkVal2_MAP_X" "4"
 SYSTEM_CONSTANT "TSTTOG_K2SigBlkVal_MAP_X" "4"
 SYSTEM_CONSTANT "TSTTOG_NROUT" "35"
 SYSTEM_CONSTANT "TURBO_N_RES" "10"
 SYSTEM_CONSTANT "TURBO_N_RES_FL" "10"
 SYSTEM_CONSTANT "TVACD_ACTSEL_SWT" "3"
 SYSTEM_CONSTANT "TVACD_DCYCCONV_CUR_X" "25"
 SYSTEM_CONSTANT "TVACD_DIAG_SWT" "1"
 SYSTEM_CONSTANT "TVACD_SWT_COMPL" "2"
 SYSTEM_CONSTANT "TVACD_SWT_COMPL_V2" "3"
 SYSTEM_CONSTANT "TVACD_SWT_DIAGCJ220" "0"
 SYSTEM_CONSTANT "TVACD_SWT_DIAGCJ945" "1"
 SYSTEM_CONSTANT "TVACD_SWT_DIAGNOTUSED" "255"
 SYSTEM_CONSTANT "TVACD_SWT_NOGVNR" "0"
 SYSTEM_CONSTANT "TVACD_SWT_POSGVNR" "1"
 SYSTEM_CONSTANT "TVASCD_OFS_CUR_X" "2"
 SYSTEM_CONSTANT "TVASCD_RLIN_CUR_X" "25"
 SYSTEM_CONSTANT "TWO_PI" "628.318530718"
 SYSTEM_CONSTANT "TWO_R32" "2"
 SYSTEM_CONSTANT "T_AIR_MAX" "199.86"
 SYSTEM_CONSTANT "T_AIR_MIN" "-50.14"
 SYSTEM_CONSTANT "T_CLNT_DIFF_MAX" "200"
 SYSTEM_CONSTANT "T_CLNT_DIFF_MIN" "0"
 SYSTEM_CONSTANT "T_CLNT_MAX" "149.86"
 SYSTEM_CONSTANT "T_CLNT_MIN" "-50.14"
 SYSTEM_CONSTANT "T_COREGTGVNR_MAX" "0"
 SYSTEM_CONSTANT "T_COREGTGVNR_MIN" "-1500"
 SYSTEM_CONSTANT "T_CORRTEXHGS_MAX" "0"
 SYSTEM_CONSTANT "T_CORRTEXHGS_MIN" "-1000"
 SYSTEM_CONSTANT "T_EGAS_MAX" "1273"
 SYSTEM_CONSTANT "T_EGAS_MIN" "-50.14"
 SYSTEM_CONSTANT "T_EGTGVNR" "25"
 SYSTEM_CONSTANT "T_EGTGVNR_MIN" "0"
 SYSTEM_CONSTANT "T_EGT_CORMAX_C" "0.5"
 SYSTEM_CONSTANT "T_EGT_CORMIN_C" "0"
 SYSTEM_CONSTANT "T_ENGOIL_MAX" "276.86"
 SYSTEM_CONSTANT "T_ENGOIL_MIN" "-53.14"
 SYSTEM_CONSTANT "T_ENG_MAX" "199.86"
 SYSTEM_CONSTANT "T_ENG_MIN" "-50.14"
 SYSTEM_CONSTANT "T_EXHGS_MAX" "1050"
 SYSTEM_CONSTANT "T_EXHGS_MIN" "-45"
 SYSTEM_CONSTANT "T_FUEL_MAX" "149.86"
 SYSTEM_CONSTANT "T_FUEL_MIN" "-50.14"
 SYSTEM_CONSTANT "T_GVNRIO_MAX" "1500"
 SYSTEM_CONSTANT "T_GVNRIO_MIN" "-100"
 SYSTEM_CONSTANT "T_GVNR_MAX" "1500"
 SYSTEM_CONSTANT "T_GVNR_MIN" "-100"
 SYSTEM_CONSTANT "T_LAMBDA_MAX" "-143.14"
 SYSTEM_CONSTANT "T_LAMBDA_MIN" "-263.14"
 SYSTEM_CONSTANT "T_PFLT_MAX" "999.86"
 SYSTEM_CONSTANT "T_PFLT_MIN" "-50.14"
 SYSTEM_CONSTANT "T_SURF_MAX" "800"
 SYSTEM_CONSTANT "T_SURF_MIN" "100"
 SYSTEM_CONSTANT "UACC_AdjValK2SigBlkVal_MAP_X" "5"
 SYSTEM_CONSTANT "UACC_AdjValK2SigBlkVal_MAP_Y" "25"
 SYSTEM_CONSTANT "UACC_APPLSIGBLK_MAP_X" "4"
 SYSTEM_CONSTANT "UACC_APPLSIGBLK_MAP_Y" "6"
 SYSTEM_CONSTANT "UACC_DATATEXT_LIMIT" "28"
 SYSTEM_CONSTANT "UACC_EOPDK2SigBlkVal_MAP_X" "5"
 SYSTEM_CONSTANT "UACC_EOPDK2SigBlkVal_MAP_Y" "25"
 SYSTEM_CONSTANT "UACC_NUMECU_CA_X" "32"
 SYSTEM_CONSTANT "UACC_RSIGBLKGRP_MAP_X" "4"
 SYSTEM_CONSTANT "UACC_SIGNAL_MAX" "561"
 SYSTEM_CONSTANT "UACC_SUPFUNC_CA" "20"
 SYSTEM_CONSTANT "UBATT_ADC_REF" "20782"
 SYSTEM_CONSTANT "UBATT_MAX" "20782"
 SYSTEM_CONSTANT "UBATT_RES_REV" "49.2252911173131"
 SYSTEM_CONSTANT "UI_CURR_ADCMAX" "34060.61"
 SYSTEM_CONSTANT "UI_CURR_HOLD_MAX" "11989.1"
 SYSTEM_CONSTANT "UI_CURR_HOLD_MIN" "8991.83"
 SYSTEM_CONSTANT "UI_CURR_HOLD_P1" "11989.1"
 SYSTEM_CONSTANT "UI_CURR_HOLD_PWMREF" "34059.95"
 SYSTEM_CONSTANT "UI_CURR_HWOFF" "27997.28"
 SYSTEM_CONSTANT "UKEY_NUMCHANNEL_CA_Y" "16"
 SYSTEM_CONSTANT "UKEY_NUMPASSWD_CA_X" "10"
 SYSTEM_CONSTANT "USAP_CODETABLE_CA_X" "32"
 SYSTEM_CONSTANT "USAP_MSKDATVAR" "8388607"
 SYSTEM_CONSTANT "U_ADC_MAX" "5200"
 SYSTEM_CONSTANT "U_ADC_MIN" "0"
 SYSTEM_CONSTANT "U_ADC_REF" "5000"
 SYSTEM_CONSTANT "U_ADC_REF_APP" "5000"
 SYSTEM_CONSTANT "U_MAX" "5200"
 SYSTEM_CONSTANT "U_MIN" "0"
 SYSTEM_CONSTANT "U_RATED" "14000"
 SYSTEM_CONSTANT "U_RATED_PASS" "14000"
 SYSTEM_CONSTANT "U_RATED_TRUCK" "28000"
 SYSTEM_CONSTANT "U_RES" "5.0830889540567"
 SYSTEM_CONSTANT "U_TO_RESIST_RES" "0.001"
 SYSTEM_CONSTANT "U_TO_RESIST_REV_RES" "1000"
 SYSTEM_CONSTANT "V2N_NORM" "1000"
 SYSTEM_CONSTANT "V2N_RES" "1e-05"
 SYSTEM_CONSTANT "V2N_RES_REV" "100000"
 SYSTEM_CONSTANT "V2N_ZERO" "0"
 SYSTEM_CONSTANT "VEH_MASS_MAX" "3200"
 SYSTEM_CONSTANT "VEH_MASS_RES" "0.1"
 SYSTEM_CONSTANT "VEH_MASS_RES_REV" "10"
 SYSTEM_CONSTANT "VEH_MASS_ZERO" "0"
 SYSTEM_CONSTANT "VEL2NM_RES" "400"
 SYSTEM_CONSTANT "VEL2TRQPRP_CONV" "8192"
 SYSTEM_CONSTANT "VEL2TRQPRP_EXT" "8192"
 SYSTEM_CONSTANT "VEL2TRQPRP_RES" "0.01953125"
 SYSTEM_CONSTANT "VELKMPH_FAC" "88.4194128288249"
 SYSTEM_CONSTANT "VEL_MAX" "300"
 SYSTEM_CONSTANT "VEL_MIN" "0"
 SYSTEM_CONSTANT "VEL_RES" "0.01"
 SYSTEM_CONSTANT "VEL_RES_REV" "100"
 SYSTEM_CONSTANT "VEL_RES_SI" "0.00277777777777778"
 SYSTEM_CONSTANT "VEL_THRES" "360000000"
 SYSTEM_CONSTANT "VEL_ZERO" "0"
 SYSTEM_CONSTANT "VLV_VEL_RES" "0.1"
 SYSTEM_CONSTANT "VN_GEAR_MAX" "6"
 SYSTEM_CONSTANT "VN_GEAR_MIN" "0"
 SYSTEM_CONSTANT "VOLCYL_RES" "1"
 SYSTEM_CONSTANT "VOLCYL_RES_REV" "1"
 SYSTEM_CONSTANT "VOLT_BATT_RES_REV" "0.0492252911173131"
 SYSTEM_CONSTANT "VOLT_MAX" "20000"
 SYSTEM_CONSTANT "VOLT_ZERO" "0"
 SYSTEM_CONSTANT "VOL_ADD_MAX" "3276.7"
 SYSTEM_CONSTANT "VOL_ADD_MAX_FINE" "2100"
 SYSTEM_CONSTANT "VOL_ADD_MAX_FIRST" "200"
 SYSTEM_CONSTANT "VOL_ADD_MAX_TEST" "2"
 SYSTEM_CONSTANT "VOL_ADD_MIN" "0"
 SYSTEM_CONSTANT "VOL_ADD_MIN_FINE" "0"
 SYSTEM_CONSTANT "VOL_ADD_RES" "0.1"
 SYSTEM_CONSTANT "VOL_ADD_RES_1ML" "1"
 SYSTEM_CONSTANT "VOL_ADD_RES_1ML_REV" "1"
 SYSTEM_CONSTANT "VOL_ADD_RES_FINE" "0.001"
 SYSTEM_CONSTANT "VOL_ADD_RES_FINE_REV" "1000"
 SYSTEM_CONSTANT "VOL_ADD_RES_FINE_REZ" "1000"
 SYSTEM_CONSTANT "VOL_ADD_RES_REZ" "10"
 SYSTEM_CONSTANT "VOL_FILLLVL_RES" "1"
 SYSTEM_CONSTANT "VOL_FILLLVL_RES_REV" "1"
 SYSTEM_CONSTANT "VOL_FL_L_TO_FL_2" "1000"
 SYSTEM_CONSTANT "VOL_FL_RES_FINE" "0.001"
 SYSTEM_CONSTANT "VOL_FL_RES_FINE_REV" "1000"
 SYSTEM_CONSTANT "VOL_PFLT_MAX" "100"
 SYSTEM_CONSTANT "VOL_PFLT_MIN" "0.01"
 SYSTEM_CONSTANT "VOL_RES" "0.01"
 SYSTEM_CONSTANT "VOL_RES_REV" "100"
 SYSTEM_CONSTANT "VSACD_ANARESP" "2"
 SYSTEM_CONSTANT "VSACD_DCYCCONV_CUR_X" "25"
 SYSTEM_CONSTANT "VSACD_DIAG" "1"
 SYSTEM_CONSTANT "VSACD_NODIAG" "0"
 SYSTEM_CONSTANT "VSACD_RLRNLMS" "84"
 SYSTEM_CONSTANT "VSACD_RLRNUMS" "16"
 SYSTEM_CONSTANT "VSACD_RVSAOFF" "12"
 SYSTEM_CONSTANT "VSACD_SWT_SEL" "0"
 SYSTEM_CONSTANT "VSASCD_RDEVTEMPEXCMAX" "90.5"
 SYSTEM_CONSTANT "VSASCD_RDEVTEMPEXCMIN" "89.5"
 SYSTEM_CONSTANT "VSASCD_RLMSLRNDEFMAX" "89"
 SYSTEM_CONSTANT "VSASCD_RLMSLRNDEFMIN" "87"
 SYSTEM_CONSTANT "VSASCD_RLMSLRNOKMAX" "85"
 SYSTEM_CONSTANT "VSASCD_RLMSLRNOKMIN" "83"
 SYSTEM_CONSTANT "VSASCD_RPWMDEFMAX" "9"
 SYSTEM_CONSTANT "VSASCD_RPWMDEFMIN" "7"
 SYSTEM_CONSTANT "VSASCD_RUMSLRNDEFMAX" "13"
 SYSTEM_CONSTANT "VSASCD_RUMSLRNDEFMIN" "11"
 SYSTEM_CONSTANT "VSASCD_RUMSLRNOKMAX" "17"
 SYSTEM_CONSTANT "VSASCD_RUMSLRNOKMIN" "15"
 SYSTEM_CONSTANT "VSASCD_RVSAMAX" "81"
 SYSTEM_CONSTANT "VSASCD_RVSAMIN" "19"
 SYSTEM_CONSTANT "VSSCD_CT_VRAW" "5"
 SYSTEM_CONSTANT "VSSCD_CT_VRAW_MIN" "1"
 SYSTEM_CONSTANT "VSSCD_SIG_CAN_BRK1" "1"
 SYSTEM_CONSTANT "VSSCD_SIG_CAN_DSP1" "5"
 SYSTEM_CONSTANT "VSSCD_SIG_HW" "0"
 SYSTEM_CONSTANT "VSSCD_SWTSIG_TYPE" "2"
 SYSTEM_CONSTANT "VSSCD_SWTSIG_VAL" "0"
 SYSTEM_CONSTANT "VSSCD_SWTSIG_VAL_MAX" "5"
 SYSTEM_CONSTANT "VSSCD_TIACCFLT_X" "8"
 SYSTEM_CONSTANT "VSSCD_TIPER_MAX" "13421772.8"
 SYSTEM_CONSTANT "V_PHI_STEER_MAX" "1433.5"
 SYSTEM_CONSTANT "V_PHI_STEER_MIN" "-1433.6"
 SYSTEM_CONSTANT "V_PHI_STEER_RES" "0.1"
 SYSTEM_CONSTANT "V_PHI_STEER_RES_REV" "10"
 SYSTEM_CONSTANT "ZERO_R32" "0"
 SYSTEM_CONSTANT "_PA_BRANCHTAB" "65792" /end MOD_PAR
/begin MOD_COMMON "" BYTE_ORDER MSB_FIRST ALIGNMENT_BYTE 1 ALIGNMENT_WORD 2 ALIGNMENT_LONG 4 ALIGNMENT_FLOAT32_IEEE 4 /end MOD_COMMON
/begin IF_DATA ASAP1B_Bypass
 /begin TP_BLOB 0x100 /* Bypass version */ 0x100 /end TP_BLOB
/end IF_DATA
/begin IF_DATA ASAP1B_CCP
 /begin SOURCE "segment synchronous event channel" 103 1 /begin QP_BLOB 0 LENGTH 8 CAN_ID_FIXED 0x7C7 FIRST_PID 0 RASTER 0 /end QP_BLOB /end SOURCE
 /begin SOURCE "10ms time synchronous event channel" 4 1 /begin QP_BLOB 1 LENGTH 12 CAN_ID_FIXED 0x7C5 FIRST_PID 8 RASTER 1 /end QP_BLOB /end SOURCE
 /begin SOURCE "100ms time synchronous event channel" 4 10 /begin QP_BLOB 2 LENGTH 4 CAN_ID_FIXED 0x7C6 FIRST_PID 20 RASTER 2 /end QP_BLOB /end SOURCE
 /begin RASTER "segment synchronous event channel" "seg_sync" 0 103 1 /end RASTER
 /begin RASTER "10ms time synchronous event channel" "10_ms" 1 4 1 /end RASTER
 /begin RASTER "100ms time synchronous event channel" "100_ms" 2 4 10 /end RASTER
 /begin SEED_KEY /* seed&key dll for CAL privilege */ "" /* seed&key dll for DAQ privilege */ "" /* seed&key dll for PGM privilege */ "" /end SEED_KEY
 /begin TP_BLOB /* CCP version */ 0x201 0x202 /* CAN msg ID - send */ 0x7C3 /* CAN msg ID - recv */ 0x7C4 /* station address */ 0x1234 /* byte order */ 1
  /begin CAN_PARAM /* crystal frequency */ 0x1F4 /* timing register 0 */ 0x41 /* timing register 1 */ 0x14 /end CAN_PARAM
  DAQ_MODE BURST CONSISTENCY DAQ
  /begin CHECKSUM_PARAM /* algorithm */ 0xC001 /* limit */ 0xFFFFFFFF CHECKSUM_CALCULATION ACTIVE_PAGE /end CHECKSUM_PARAM
  /begin DEFINED_PAGES 1 "reference page" /* address ext. */ 0x00 /* base address */ 0x1C1C54 /* page length */ 0x317C4 ROM /end DEFINED_PAGES
  /begin DEFINED_PAGES 2 "working page" /* address ext. */ 0x00 /* base address */ 0x801C1C54 /* page length */ 0x317C4 RAM RAM_INIT_BY_ECU /end DEFINED_PAGES
  OPTIONAL_CMD 0x11 /* SELECT_CAL_PAGE */ OPTIONAL_CMD 0xE /* BUILD_CHKSUM */ OPTIONAL_CMD 0x19 /* MOVE */ OPTIONAL_CMD 0x9 /* GET_ACTIVE_CAL_PAGE */ OPTIONAL_CMD 0xC /* SET_S_STATUS */ OPTIONAL_CMD 0xD /* GET_S_STATUS */ OPTIONAL_CMD 0x12 /* GET_SEED */ OPTIONAL_CMD 0x13 /* UNLOCK */ /end TP_BLOB
/end IF_DATA
/begin IF_DATA ETK
 /begin SOURCE "segment synchronous raster" 103 1 QP_BLOB 1 /* MAXNUM_A */ 200 /* DISTAB_A */ 0x11C0188 /* CHNL_A */ 0x9FE0DC /* TRG_ID_A */ 0x9FE088 /* TrgRate */ 0 0 0x0 /end SOURCE
 /begin SOURCE "10ms time synchronous raster" 4 1 QP_BLOB 2 /* MAXNUM_B */ 200 /* DISTAB_B */ 0x11C04B0 /* CHNL_B */ 0x9FE1A4 /* TRG_ID_B */ 0x9FE08C /* TrgRate */ 20 0 0x0 /end SOURCE
 /begin SOURCE "100ms time synchronous raster" 5 1 QP_BLOB 3 /* MAXNUM_C */ 100 /* DISTAB_C */ 0x11C07D8 /* CHNL_C */ 0x9FE26C /* TRG_ID_C */ 0x9FE090 100 0 0x0 /end SOURCE
 /begin SOURCE "bypass segment sync. raster" 103 1 QP_BLOB 4 /* BPMAX_S */ 28 /* BYPASS_S */ 0x11C0058 /* CHNL_S */ 0x9FE094 /* TRGID_S */ 0x9FE080 0 /* BPMAX_T */ 28 /* CHNL_T */ 0x11C0970 /end SOURCE
 /begin SOURCE "bypass 10ms time sync. raster" 4 1 QP_BLOB 5 /* BPMAX_X */ 44 /* BYPASS_X */ 0x11C00D0 /* CHNL_X */ 0x9FE0B0 /* TRGID_X */ 0x9FE084 20 /* BPMAX_Y */ 44 /* CHNL_Y */ 0x11C09B0 /end SOURCE
 /begin TP_BLOB 0x1000001 /* PBA */ 0x0 /* RESET_CFG */ 0x800
  /begin DISTAB_CFG /* DSPTAB */ 13 /* DAT_MOD */ 1 /* RFG */ 1 /* TRGSEGAD */ 0x9FE000 /* TRG_CFG */ 0x1010100 TRG_MOD 0 255 /end DISTAB_CFG
  CODE_CHK /* ChkSumData */ 0x11FDF74 /* PrgDataLen */ 0x4 /* ChkSumExtRam */ 0x9FFFF8 /* PrgExtRamLen */ 0x4 ETK_CFG 0x03 0xD2 0x4D 0xFF 0xEF 0x4E 0xDF 0xEF 0x4E 0xFF 0xFB 0xFE 0xFF 0xFF 0xFE 0xFF 0xFF 0xF0 0x0F 0xFF 0x03 0xCD 0xFF 0xFF RESERVED 0x11C0058 0xAE0 EXTERN -1 -1 -1 -1 -1 /end TP_BLOB
/end IF_DATA
/begin IF_DATA ASAP1B_KWP2000
 /begin SOURCE "timeslot" 4 1 QP_BLOB 0 BLOCKMODE 0xF0 0 20 /end SOURCE
 /begin TP_BLOB 0x101 /* ECU address on k line */ 0x10 /* requ. tester address */ 0xF1 /* ECU stimulation mode */ WuP /* byte order */ MSB_FIRST 1 DATA_ACCESS /* Flash address */ 0x000000 /* RAM address */ 0x000000 /* Data Read */ 1 /* Code Verify */ 0 /* Code Read */ 0 /* Load mode */ 1 /begin CHECKSUM 0x010201 1 1 RequestRoutineResults RNC_RESULT 0x23 /end CHECKSUM
  /begin FLASH_COPY NOFLASHBACK 3 RequestRoutineResults RAM_InitByECU 0x86 COPY_FRAME 1 RNC_RESULT 0x23 0xFB 0xFC /end FLASH_COPY
  /begin DIAG_BAUD 38400 0x86 BD_PARA 0x50 /end DIAG_BAUD
  /begin DIAG_BAUD 10400 0x86 BD_PARA 0x14 /end DIAG_BAUD
  /begin DIAG_BAUD 57600 0x86 BD_PARA 0x64 /end DIAG_BAUD
  /begin DIAG_BAUD 125000 0x86 BD_PARA 0x87 /end DIAG_BAUD
  /* Timing Parameter: p1Max p2Min p2Max p3Min p3Max p4Min */ TIME_DEF 0x0014 0x0000 0x0032 0x0003 0x0200 0x0000 TIME_DEF 0x0014 0x0000 0x0032 0x0003 0x0200 0x0001 TIME_DEF 20 0 2000 0 5000 65440 /* Seed&Key Parameter: AccMode CalcMethod Delay */ SECURITY_ACCESS 3 1 0 SECURITY_ACCESS 9 1 0 /begin PAGE_SWITCH ESCAPE_CODE ESCAPE_CODE_PARA 0x90 PAGE_CODE 0x00 0x01 /end PAGE_SWITCH /end TP_BLOB
/end IF_DATA
/begin IF_DATA ASAP1B_MCMESS
 /begin SOURCE "segment synchronous raster" 103 1 QP_BLOB ANGLE 20 /* max. number of bytes (BLKZ_W) */ /end SOURCE
 /begin SOURCE "10ms time synchronous raster" 103 1 QP_BLOB TIME 20 /* max. number of bytes (BLKZ_Z) */ /end SOURCE
 /begin SOURCE "handshake" 103 1 QP_BLOB HANDSHAKE 20 /* max. number of bytes: 0 */ /end SOURCE
 /begin TP_BLOB 0x101 KOMKEN 11 /* communication identifier */ MCTGT 0x10 /* target address */ MCINI KW2000 /* wake up method */
  /begin CHECKSUM_PARAM /* type qualifier */ 0x8001 CHECKSUM_CALCULATION ACTIVE_PAGE /end CHECKSUM_PARAM
  /begin DEFINED_PAGES 1 "reference page" FLASH NO_FLASH_BACK DEFAULT /end DEFINED_PAGES
  BYTE_ORDER MSB_FIRST THREE_BYTE_ADDRESSES /end TP_BLOB
/end IF_DATA
/begin CHARACTERISTIC ACCCD_aDesLimNeg_CUR "Kennlinie zur Negative Grenze für Beschleuningungssollwer" CURVE 0x1C245C Kl_Xs16_Ws16 6.000000 Acc -3.000000 3.000000 FORMAT "%8.6" EXTENDED_LIMITS -32.76800 32.76700
 /begin AXIS_DESCR STD_AXIS VSSCD_v Vel 5 20.00000 200.0000 FORMAT "%8.4" EXTENDED_LIMITS -327.6800 327.6700 DEPOSIT ABSOLUTE /end AXIS_DESCR
/end CHARACTERISTIC
/begin CHARACTERISTIC ACCCD_aDesLimPos_CUR "Kennlinie zur Positive Grenze für Beschleuningungssollwert" CURVE 0x1C2472 Kl_Xs16_Ws16 6.000000 Acc -3.000000 3.000000 FORMAT "%8.6" EXTENDED_LIMITS -32.76800 32.76700
 /begin AXIS_DESCR STD_AXIS VSSCD_v Vel 5 20.00000 200.0000 FORMAT "%8.4" EXTENDED_LIMITS -327.6800 327.6700 DEPOSIT ABSOLUTE /end AXIS_DESCR
/end CHARACTERISTIC
/begin CHARACTERISTIC ACCCD_tiaDesMaxDebDef_C "Defektzeit für Max-Fehler von Dfp_ACCCD_mp" VALUE 0x1C2488 Kw_Wu16 655350.0 Time_ms 0.00 655350.0 FORMAT "%8.1" /end CHARACTERISTIC
/begin CHARACTERISTIC ACCCD_tiaDesMaxDebOk_C "Heilzeit für Max-Fehler von Dfp_ACCCD_mp" VALUE 0x1C248A Kw_Wu16 655350.0 Time_ms 0.00 655350.0 FORMAT "%8.1" /end CHARACTERISTIC
/begin CHARACTERISTIC ACCCD_tiaDesMinDebDef_C "Defektzeit für Min-Fehler von Dfp_ACCCD_mp" VALUE 0x1C248C Kw_Wu16 655350.0 Time_ms 0.00 655350.0 FORMAT "%8.1" /end CHARACTERISTIC
/begin CHARACTERISTIC ACCCD_tiaDesMinDebOk_C "Heilzeit für Min-Fehler von Dfp_ACCCD_mp" VALUE 0x1C248E Kw_Wu16 655350.0 Time_ms 0.00 655350.0 FORMAT "%8.1" /end CHARACTERISTIC
/begin CHARACTERISTIC ACCCD_aDesNegOffset_C "Offset auf Negative Beschleuningungsbegrenzung" VALUE 0x1C2490 Kw_Ws16 6.400000 Acc -3.200000 3.200000 FORMAT "%8.6" EXTENDED_LIMITS -32.76800 32.76700 /end CHARACTERISTIC
/begin CHARACTERISTIC ACCCD_tiaDesDebDef_C "Entprellzeit Regelfehler Beschleunigung" VALUE 0x1C2492 Kw_Wu16 655350.0 Time_ms 0.00 655350.0 FORMAT "%8.1" /end CHARACTERISTIC
/begin CHARACTERISTIC ACCCD_tiaDesDebOk_C "Heilungszeit Regelfehler Beschleunigung" VALUE 0x1C2494 Kw_Wu16 655350.0 Time_ms 0.00 655350.0 FORMAT "%8.1" /end CHARACTERISTIC
/begin CHARACTERISTIC ACCCD_aDrvDem0_C "Fahrerwunschbeschleunigung bei kleinen Geschwindigkeiten bzw. im Stand" VALUE 0x1C2496 Kw_Ws16 65.53500 Acc -32.76800 32.76700 FORMAT "%8.5" /end CHARACTERISTIC
/begin CHARACTERISTIC ACCCD_aDrvDemOfs_C "Offset in Berechnung der Fahrerwunschbeschleunigung" VALUE 0x1C2498 Kw_Ws16 6.400000 Acc -3.200000 3.200000 FORMAT "%8.6" EXTENDED_LIMITS -32.76800 32.76700 /end CHARACTERISTIC
/begin CHARACTERISTIC ACCCD_daGRADwn_C "Rampensteigung für Reduzierung der Beschleunigung bei aktivierter GRA" VALUE 0x1C249C Kw_Wu32 65535.9999847 RmpAcc 0.00 65535.9999847 FORMAT "%13.7" /end CHARACTERISTIC
/begin CHARACTERISTIC ACCCD_daGRAUp_C "Rampensteigung für Erhöhung der Beschleunigung bei aktivierter GRA" VALUE 0x1C24A0 Kw_Wu32 65535.9999847 RmpAcc 0.00 65535.9999847 FORMAT "%13.7" /end CHARACTERISTIC
/begin CHARACTERISTIC ACCCD_daMin_C "minimale Rampensteigung für Beschleunigung bei aktivierter ACC" VALUE 0x1C24A4 Kw_Wu32 65535.9999847 RmpAcc 0.00 65535.9999847 FORMAT "%13.7" /end CHARACTERISTIC
/begin CHARACTERISTIC ACCCD_dfacKpCorr_C "Offset pro Sekunde für Änderungsbegrenzung von ACCCD_facKpCorr_mp" VALUE 0x1C24A8 Kw_Ws16 4.000000 Fact 0.00 4.000000 FORMAT "%8.6" EXTENDED_LIMITS -4.000000 3.999878 /end CHARACTERISTIC
/begin CHARACTERISTIC ACCCD_dtrqBrkNeg_C "Differenzoffset für minimale Drehmomentgrenze Berechnung" VALUE 0x1C24AC Kw_Ws32 104856.000000 TrqPrpHigh -52428.8000000 52427.2000000 FORMAT "%13.7" EXTENDED_LIMITS -214748364.800 214748364.700 /end CHARACTERISTIC
/begin CHARACTERISTIC ACCCD_facBrkComp_C "Anteil des Momentensprungs, der beim Schubabschalten des Motors durch die Bremse kompensiert werden soll" VALUE 0x1C26F8 Kw_Ws16 1.000000 Fact 0.00 1.000000 FORMAT "%8.6" EXTENDED_LIMITS -4.000000 3.999878 /end CHARACTERISTIC
/begin CHARACTERISTIC ACCCD_facDrvDem_C "Factor in Berechnung der Fahrerwunschbeschleunigung" VALUE 0x1C24B0 Kw_Ws16 4.000000 Fact 0.00 4.000000 FORMAT "%8.6" EXTENDED_LIMITS -4.000000 3.999878 /end CHARACTERISTIC
/begin CHARACTERISTIC ACCCD_facKiCorr_CUR "Kennlinie zur Korrektur faktor für I-Wert" CURVE 0x1C24B2 Kl_Xs16_Ws16 1.000000 Fact 0.00 1.000000 FORMAT "%8.6" EXTENDED_LIMITS -4.000000 3.999878
 /begin AXIS_DESCR STD_AXIS ACCCD_trqBrkRawMAP_mp TrqPrp 6 -52428.80 52427.20 FORMAT "%8.2" DEPOSIT ABSOLUTE /end AXIS_DESCR
/end CHARACTERISTIC
/begin CHARACTERISTIC ACCCD_facKiPosCorr_CUR "Korrekturfaktor für Integralfaktor für Zugbetrieb" CURVE 0x1C24CC Kl_Xs16_Ws16 1.000000 Fact 0.00 1.000000 FORMAT "%8.6" EXTENDED_LIMITS -4.000000 3.999878
 /begin AXIS_DESCR STD_AXIS ACCCD_trqDev_mp TrqPrp 6 -52428.80 52427.20 FORMAT "%8.2" DEPOSIT ABSOLUTE /end AXIS_DESCR
/end CHARACTERISTIC
/begin CHARACTERISTIC ACCCD_facKpCorr_CUR "Kennlinie zur Korrektur faktor für P-Wert" CURVE 0x1C24E6 Kl_Xs16_Ws16 1.000000 Fact 0.00 1.000000 FORMAT "%8.6" EXTENDED_LIMITS -4.000000 3.999878
 /begin AXIS_DESCR STD_AXIS ACCCD_trqBrkRawMAP_mp TrqPrp 6 -52428.80 52427.20 FORMAT "%8.2" DEPOSIT ABSOLUTE /end AXIS_DESCR
/end CHARACTERISTIC
/begin CHARACTERISTIC ACCCD_facKpPosCorr_CUR "Korrekturfaktor für proportionalfaktor für Zugbetrieb" CURVE 0x1C2500 Kl_Xs16_Ws16 1.000000 Fact 0.00 1.000000 FORMAT "%8.6" EXTENDED_LIMITS -4.000000 3.999878
 /begin AXIS_DESCR STD_AXIS ACCCD_trqDev_mp TrqPrp 6 -52428.80 52427.20 FORMAT "%8.2" DEPOSIT ABSOLUTE /end AXIS_DESCR
/end CHARACTERISTIC
/begin CHARACTERISTIC ACCCD_facTrqDrvMin_C "Faktor für Schleppbereich in Berechnung der Fahrerwunschbeschleunigung" VALUE 0x1C251A Kw_Ws16 4.000000 Fact 0.00 4.000000 FORMAT "%8.6" EXTENDED_LIMITS -4.000000 3.999878 /end CHARACTERISTIC
/begin CHARACTERISTIC ACCCD_IKiBrk_CUR "Kennlinie zur Integralfaktor, Basiswert für Bremseingriff" CURVE 0x1C251C Kl_Xs16_Ws16 250.0000 Ki 0.00 250.0000 FORMAT "%8.4" EXTENDED_LIMITS -7.629395 7.629162
 /begin AXIS_DESCR STD_AXIS ACCCD_trqDev_mp TrqPrp 6 -52428.80 52427.20 FORMAT "%8.2" DEPOSIT ABSOLUTE /end AXIS_DESCR
/end CHARACTERISTIC
/begin CHARACTERISTIC ACCCD_IKiPos_MAP "Kennfeld zur Integralfaktor, Basiswert für Zugbetrieb" MAP 0x1C2536 Kf_Xs16_Ys16_Ws16 250.0000 Ki 0.00 250.0000 FORMAT "%8.4" EXTENDED_LIMITS -7.629395 7.629162
 /begin AXIS_DESCR STD_AXIS DrvTrn_rTransDT TransR 6 0.00 100.0000 FORMAT "%8.4" EXTENDED_LIMITS -327.6800 327.6700 DEPOSIT ABSOLUTE /end AXIS_DESCR
 /begin AXIS_DESCR STD_AXIS Eng_nAvrg EngN 8 0.00 6000.000 FORMAT "%8.3" EXTENDED_LIMITS -32768.00 32767.00 DEPOSIT ABSOLUTE /end AXIS_DESCR
/end CHARACTERISTIC
/begin CHARACTERISTIC ACCCD_mVehTare_C "Leergewicht plus Fahrer und Kraftstoff" VALUE 0x1C23BC Kw_Ws16 3200.000 VehMass 0.00 3200.000 FORMAT "%8.3" EXTENDED_LIMITS -3276.800 3276.700 /end CHARACTERISTIC
/begin CHARACTERISTIC ACCCD_mVehTrail_C "Applicationwert für Anhängermasse" VALUE 0x1C23BE Kw_Ws16 3200.000 VehMass 0.00 3200.000 FORMAT "%8.3" EXTENDED_LIMITS -3276.800 3276.700 /end CHARACTERISTIC
/begin CHARACTERISTIC ACCCD_phiRoadMax_C "Maximale plausible Fahrbahnsteigung" VALUE 0x1C244E Kw_Ws16 6.280000 AngleRad -3.140000 3.140000 FORMAT "%8.6" EXTENDED_LIMITS -3.276800 3.276700 /end CHARACTERISTIC
/begin CHARACTERISTIC ACCCD_PKpBrkLim_CUR "Additiver P-Faktor bei Überschreitung des Verzögerungsgrenzwerts" CURVE 0x1C25BE Kl_Xs16_Ws16 3.999878 Kp_ACC 0.00 3.999878 FORMAT "%8.6" EXTENDED_LIMITS -4.000000 3.999878
 /begin AXIS_DESCR STD_AXIS ACCCD_aDiffLim_mp Acc 5 0.00 1.000000 FORMAT "%8.6" EXTENDED_LIMITS -32.76800 32.76700 DEPOSIT ABSOLUTE /end AXIS_DESCR
/end CHARACTERISTIC
/begin CHARACTERISTIC ACCCD_PKpBrk_CUR "Kennlinie zur Proportionalfaktor für Regler, Basiswert für Bremseingriff" CURVE 0x1C25D4 Kl_Xs16_Ws16 3.999878 Kp_ACC 0.00 3.999878 FORMAT "%8.6" EXTENDED_LIMITS -4.000000 3.999878
 /begin AXIS_DESCR STD_AXIS ACCCD_trqDev_mp TrqPrp 6 -52428.80 52427.20 FORMAT "%8.2" DEPOSIT ABSOLUTE /end AXIS_DESCR
/end CHARACTERISTIC
/begin CHARACTERISTIC ACCCD_PKpPos_MAP "Kennfeld zur Proportionalfaktor für Regler, Basiswert für Zugbetrieb" MAP 0x1C25EE Kf_Xs16_Ys16_Ws16 3.999878 Kp_ACC 0.00 3.999878 FORMAT "%8.6" EXTENDED_LIMITS -4.000000 3.999878
 /begin AXIS_DESCR STD_AXIS DrvTrn_rTransDT TransR 6 0.00 100.0000 FORMAT "%8.4" EXTENDED_LIMITS -327.6800 327.6700 DEPOSIT ABSOLUTE /end AXIS_DESCR
 /begin AXIS_DESCR STD_AXIS Eng_nAvrg EngN 8 0.00 6000.000 FORMAT "%8.3" EXTENDED_LIMITS -32768.00 32767.00 DEPOSIT ABSOLUTE /end AXIS_DESCR
/end CHARACTERISTIC
/begin CHARACTERISTIC ACCCD_tiSensErrDebDef_C "Entprellzeit für Sensorfehler" VALUE 0x1C21D8 Kw_Wu16 655350.0 Time_ms 0.00 655350.0 FORMAT "%8.1" /end CHARACTERISTIC
/begin CHARACTERISTIC ACCCD_tiSensErrDebOk_C "Heilungzeit für Sensorfehler" VALUE 0x1C21DA Kw_Wu16 655350.0 Time_ms 0.00 655350.0 FORMAT "%8.1" /end CHARACTERISTIC
/begin CHARACTERISTIC ACCCD_stBrkMsk_C "Mask for BAB, FDR and EDS Eingriff status from FrmMng" VALUE 0x1C2670 Kw_Wu8 255.0 OneToOne 0.00 255.0 FORMAT "%5.1" /end CHARACTERISTIC
/begin CHARACTERISTIC ACCCD_stBrkNotAvMsk_C "Applicable mask to enable or desable the effect of brake error on brake status" VALUE 0x1C21E0 Kw_Wu8 255.0 OneToOne 0.00 255.0 FORMAT "%5.1" /end CHARACTERISTIC
/begin CHARACTERISTIC ACCCD_stCANErrMsk_C "Maske für Unentprellte Fehler das CAN-Botschaften ACCA" VALUE 0x1C21E2 Kw_Wu8 255.0 OneToOne 0.00 255.0 FORMAT "%5.1" /end CHARACTERISTIC
/begin CHARACTERISTIC ACCCD_stClthMsk_C "Maske für ConvCD_stClth" VALUE 0x1C2671 Kw_Wu8 255.0 OneToOne 0.00 255.0 FORMAT "%5.1" /end CHARACTERISTIC
/begin CHARACTERISTIC ACCCD_stTSCMsk_C "Maske für FrmMng_stTSC" VALUE 0x1C2672 Kw_Wu16 65535.00 OneToOne 0.00 65535.00 FORMAT "%8.2" /end CHARACTERISTIC
/begin CHARACTERISTIC ACCCD_swtCodeChk_C "Schalter zur Auswahl des Plausibilitätstests für AUDI und ACC/GRA mit Beschleunigungsschnittstelle" VALUE 0x1C21E9 Kw_Wu8 1.000 OneToOne 0.00 1.000 FORMAT "%5.3" EXTENDED_LIMITS 0.00 255.0 /end CHARACTERISTIC
/begin CHARACTERISTIC ACCCD_swtKpIni0_C "Applikationsschalter zur Initialisierung des Sollbeschleunigungsfilter auf aktuelle Istbeschleunigung" VALUE 0x1C2678 Kw_Wu8 1.000 OneToOne 0.00 1.000 FORMAT "%5.3" EXTENDED_LIMITS 0.00 255.0 /end CHARACTERISTIC
/begin CHARACTERISTIC ACCCD_swtSpdLimEna_C "Freischaltung der Beschleunigungskoordination für Speedli-miter" VALUE 0x1C2679 Kw_Wu8 1.000 OneToOne 0.00 1.000 FORMAT "%5.3" EXTENDED_LIMITS 0.00 255.0 /end CHARACTERISTIC
/begin CHARACTERISTIC ACCCD_swtVehMassAdpt_C "Variantenumscahlter für Beladungserkennung" VALUE 0x1C2451 Kw_Wu8 2.000 OneToOne 0.00 2.000 FORMAT "%5.3" EXTENDED_LIMITS 0.00 255.0 /end CHARACTERISTIC
/begin CHARACTERISTIC ACCCD_tiAccDragFlt_MAP "Filterzeit für Beschleunigungssollwertfilterung" MAP 0x1C267A Kf_Xs16_Ys16_Ws16 39.99000 Time_s 0.01000000 40.00000 FORMAT "%8.5" EXTENDED_LIMITS -327.6800 327.6700
 /begin AXIS_DESCR STD_AXIS ACCCD_aDevRaw_mp Acc 6 -3.200000 3.200000 FORMAT "%8.6" EXTENDED_LIMITS -32.76800 32.76700 DEPOSIT ABSOLUTE /end AXIS_DESCR
 /begin AXIS_DESCR STD_AXIS ACCCD_trqBrkRawMAP_mp TrqPrp 6 -52428.80 52427.20 FORMAT "%8.2" DEPOSIT ABSOLUTE /end AXIS_DESCR
/end CHARACTERISTIC
/begin CHARACTERISTIC ACCCD_tiDebClth_C "Debounce-Zeit für Kupplungsstatus" VALUE 0x1C26DE Kw_Wu16 655350.0 Time_ms 0.00 655350.0 FORMAT "%8.1" /end CHARACTERISTIC
/begin CHARACTERISTIC ACCCD_tiPreFill_C "Prefillzeit der Bremse, während der der I-Anteil des Reglers in negative Richtung angehalten wird" VALUE 0x1C26E0 Kw_Wu16 655350.0 Time_ms 0.00 655350.0 FORMAT "%8.1" /end CHARACTERISTIC
/begin CHARACTERISTIC ACCCD_tiPT1Trans_C "PT1-Filterzeitkonstante für Querbeschleunigung" VALUE 0x1C2458 Kw_Wu32 4294.9673 TimeDelay_s 0.0000010000000 4294.9673 FORMAT "%9.4" /end CHARACTERISTIC
/begin CHARACTERISTIC ACCCD_tiSwtOffRmp_C "Rampenzeit für die Rampe beim Erreichen des States INACTIVE" VALUE 0x1C21EC Kw_Wu16 655.3500 Time_s 0.00 655.3500 FORMAT "%8.4" /end CHARACTERISTIC
/begin CHARACTERISTIC ACCCD_trqBrkMin2_C "Anteil des minimalen Bremsmoments, das durch ""Überlappung"" vom Motor kompensiert wird" VALUE 0x1C2708 Kw_Ws32 52428.8000000 TrqPrpHigh -52428.8000000 0.00 FORMAT "%13.7" EXTENDED_LIMITS -214748364.800 214748364.700 /end CHARACTERISTIC
/begin CHARACTERISTIC ACCCD_trqBrkMin3_C "Verschiebung der Schubabschalthysterese entsprechend dem minimalen Bremsmoment" VALUE 0x1C270C Kw_Ws32 52428.8000000 TrqPrpHigh -52428.8000000 0.00 FORMAT "%13.7" EXTENDED_LIMITS -214748364.800 214748364.700 /end CHARACTERISTIC
/begin CHARACTERISTIC ACCCD_trqBrkZero_CUR "Kennlinie für die Berechnung des Schwellenwertes für den Bremsmoment im ACC-Modus" CURVE 0x1C2716 Kl_Xs16_Ws16 1500.800 TrqPrp -500.8000 1000.000 FORMAT "%8.3" EXTENDED_LIMITS -52428.80 52427.20
 /begin AXIS_DESCR STD_AXIS VSSCD_v Vel 5 0.00 300.0000 FORMAT "%8.4" EXTENDED_LIMITS -327.6800 327.6700 DEPOSIT ABSOLUTE /end AXIS_DESCR
/end CHARACTERISTIC
/begin CHARACTERISTIC ACCCD_trqDragOffSet_C "to be translated" VALUE 0x1C26EC Kw_Ws32 104856.000000 TrqPrpHigh -52428.8000000 52427.2000000 FORMAT "%13.7" EXTENDED_LIMITS -214748364.800 214748364.700 /end CHARACTERISTIC
/begin CHARACTERISTIC ACCCD_trqNoCut_C "Schwelle für Wiedereinsetzen, abhängig vom minimal" VALUE 0x1C2730 Kw_Ws16 1000.000 Trq 0.00 1000.000 FORMAT "%8.3" EXTENDED_LIMITS -3276.800 3276.700 /end CHARACTERISTIC
/begin CHARACTERISTIC ACCCD_vAccDrvMin_C "Untere Grenze für Beschleunigungsregelung" VALUE 0x1C26F0 Kw_Ws16 300.0000 Vel 0.00 300.0000 FORMAT "%8.4" EXTENDED_LIMITS -327.6800 327.6700 /end CHARACTERISTIC
/begin CHARACTERISTIC ACCCD_vAccMin_C "Untere Grenze für Beschleunigungsregelung" VALUE 0x1C26F2 Kw_Ws16 20.00000 Vel 0.00 20.00000 FORMAT "%8.5" EXTENDED_LIMITS -327.6800 327.6700 /end CHARACTERISTIC
/begin CHARACTERISTIC ACCCD_vDiffThres_C "Geschwindigkeitsverlustschwelle für Erkennung auf Über-bremsen" VALUE 0x1C26F4 Kw_Ws16 300.0000 Vel 0.00 300.0000 FORMAT "%8.4" EXTENDED_LIMITS -327.6800 327.6700 /end CHARACTERISTIC
/begin CHARACTERISTIC ACCD_ctPwrStgOnMax_C "maximale Anzahl von Endstufen-Einschaltungen pro Fahrzyklus bei SCB oder Übertemperatur" VALUE 0x1C2738 Kw_Wu16 65535.00 OneToOne 0.00 65535.00 FORMAT "%8.2" /end CHARACTERISTIC
/begin CHARACTERISTIC ACCD_DebNoLoadDef_C "Defektzeit für Fehler ""Endstufe im Leerlauf""" VALUE 0x1C273A Kw_Wu16 655350.0 Time_ms 0.00 655350.0 FORMAT "%8.1" READ_ONLY /end CHARACTERISTIC
/begin CHARACTERISTIC ACCD_DebNoLoadOk_C "Heilungszeit für Fehler ""Endstufe im Leerlauf""" VALUE 0x1C273C Kw_Wu16 655350.0 Time_ms 0.00 655350.0 FORMAT "%8.1" READ_ONLY /end CHARACTERISTIC
/begin CHARACTERISTIC ACCD_DebShortCircBatDef_C "Defektzeit für Fehler ""Kurzschluß nach BATT""" VALUE 0x1C2742 Kw_Wu16 655350.0 Time_ms 0.00 655350.0 FORMAT "%8.1" /end CHARACTERISTIC
/begin CHARACTERISTIC ACCD_DebShortCircBatOk_C "Heilungszeit für Fehler ""Kurzschluß nach BATT""" VALUE 0x1C2744 Kw_Wu16 655350.0 Time_ms 0.00 655350.0 FORMAT "%8.1" /end CHARACTERISTIC
/begin CHARACTERISTIC ACCD_DebShortCircGndDef_C "Defektzeit für Fehler ""Kurzschluß nach Masse""" VALUE 0x1C2746 Kw_Wu16 655350.0 Time_ms 0.00 655350.0 FORMAT "%8.1" /end CHARACTERISTIC
/begin CHARACTERISTIC ACCD_DebShortCircGndOk_C "Heilungszeit für Fehler ""Kurzschluß nach Masse""" VALUE 0x1C2748 Kw_Wu16 655350.0 Time_ms 0.00 655350.0 FORMAT "%8.1" /end CHARACTERISTIC
/begin CHARACTERISTIC ACCD_tiMnSwtDebNeg_C "Entprellzeit für negativen Zustand" VALUE 0x1C274A Kw_Wu16 655350.0 TimeDeb 0.00 655350.0 FORMAT "%8.1" /end CHARACTERISTIC
/begin CHARACTERISTIC ACCD_tiMnSwtDebPos_C "Entprellzeit für positiven Zustand" VALUE 0x1C274C Kw_Wu16 655350.0 TimeDeb 0.00 655350.0 FORMAT "%8.1" /end CHARACTERISTIC
/begin CHARACTERISTIC ACCD_stSensIDWord_C "Kennzahl zur Festlegung des Fehlerverhaltens des Klimadrucks" VALUE 0x1C2764 Kw_Wu16 65535.00 OneToOne 0.00 65535.00 FORMAT "%8.2" /end CHARACTERISTIC
/begin CHARACTERISTIC ACCD_pDfl_C "Klimadruck-Vorgabewert" VALUE 0x1C2766 Kw_Ws16 131070.0 PresAC_hPa -65536.00 65534.00 FORMAT "%8.2" /end CHARACTERISTIC
/begin CHARACTERISTIC ACCD_stMnSwtInvIn_C "Dig. Eingang inventieren? (JA/NEIN)" VALUE 0x1C2780 Kw_Wu8 1.000 OneToOne 0.00 1.000 FORMAT "%5.3" EXTENDED_LIMITS 0.00 255.0 /end CHARACTERISTIC
/begin CHARACTERISTIC ACCD_stSPICtl_C "Parameter zur Anzeige der verwendeten Endstufenart ( 1 = SPI kontrollierbare Endstufe, 0 = nicht SPI-Endstufe )" VALUE 0x1C2781 Kw_Wu8 1.000 OneToOne 0.00 1.000 FORMAT "%5.3" EXTENDED_LIMITS 0.00 255.0 /end CHARACTERISTIC
/begin CHARACTERISTIC ACCD_swtACtypeType_C "Type des Softwareschalters Klimavariante" VALUE 0x1C2783 Kw_Wu8 0.00 OneToOne 2.000 2.000 FORMAT "%5.3" EXTENDED_LIMITS 0.00 255.0 /end CHARACTERISTIC
/begin CHARACTERISTIC ACCD_tiBtwTst_C "Zeitabstand, in dem die Endstufe im Fehlerfall getestet wird" VALUE 0x1C2786 Kw_Wu16 29900.00 Time_ms 100.0000 30000.00 FORMAT "%8.2" EXTENDED_LIMITS 0.00 655350.0 /end CHARACTERISTIC
/begin CHARACTERISTIC ACCD_tiPwrStgOn_C "Zeit, für welche die Endstufe beim Fall der nicht-SPI-Endstufe eingeschaltet wird." VALUE 0x1C278A Kw_Wu16 500.0000 Time_ms 0.00 500.0000 FORMAT "%8.4" EXTENDED_LIMITS 0.00 655350.0 /end CHARACTERISTIC
/begin CHARACTERISTIC ACCtl_tAirMin_C "Minimum environment air temperature to activate AC anti-clunk" VALUE 0x1C3ACA Kw_Ws16 250.0000 Temp_Cels -50.14000 199.8600 FORMAT "%8.4" EXTENDED_LIMITS -3549.940 3003.560 /end CHARACTERISTIC
/begin CHARACTERISTIC ACC_aDevCnclOvr_C "Positive Regelabweichungs-Schwellezum Abbruch des Übertretens durch das ACC" VALUE 0x1C203C Kw_Ws16 1.000000 Acc 0.00 1.000000 FORMAT "%8.6" EXTENDED_LIMITS -32.76800 32.76700 /end CHARACTERISTIC
/begin CHARACTERISTIC ACC_aOff_C "Beschleunigungssollwert für das Getriebe bei deaktivierter ACC - ACC_aSetGearbox" VALUE 0x1C203E Kw_Ws16 10.00000 Acc 0.00 10.00000 FORMAT "%8.5" EXTENDED_LIMITS -32.76800 32.76700 /end CHARACTERISTIC
/begin CHARACTERISTIC ACC_aStopMin_C "Beschleunigungsgrenze für den Übergang ins Halten für Soft-Stop-Funktion" VALUE 0x1C2040 Kw_Ws16 6.400000 Acc -3.200000 3.200000 FORMAT "%8.6" EXTENDED_LIMITS -32.76800 32.76700 /end CHARACTERISTIC
/begin CHARACTERISTIC ACC_tiDebStEPBInAct_C "Entprellzeit (fallende Flanke) für Entprellung der Statusmeldung der elektrischen Parkbremse (EPB)" VALUE 0x1C2042 Kw_Wu16 655350.0 TimeDeb 0.00 655350.0 FORMAT "%8.1" /end CHARACTERISTIC
/begin CHARACTERISTIC ACC_tiDebStEPBAct_C "Entprellzeit (steigende Flanke) für Entprellung der Statusmeldung der elektrischen Parkbremse (EPB)" VALUE 0x1C2044 Kw_Wu16 655350.0 TimeDeb 0.00 655350.0 FORMAT "%8.1" /end CHARACTERISTIC
/begin CHARACTERISTIC ACC_tiDebSwtPlInAct_C "Entprellung für die fallende Flanke of CC-Panel Main switch" VALUE 0x1C2046 Kw_Wu16 655350.0 TimeDeb 0.00 655350.0 FORMAT "%8.1" /end CHARACTERISTIC
/begin CHARACTERISTIC ACC_tiDebSwtPlAct_C "Entprellung für die steigende Flanke der CC - Panel Main switch Plausibilität" VALUE 0x1C2048 Kw_Wu16 655350.0 TimeDeb 0.00 655350.0 FORMAT "%8.1" /end CHARACTERISTIC
/begin CHARACTERISTIC ACC_dtrqBrkEngSlp_C "Rampensteigung für die Berechnung des Motor/Bremsmoments im State INACTIVE" VALUE 0x1C204C Kw_Wu32 6553594.99817 RmpTrqPrpHigh 5.00030517578 6553599.99847 FORMAT "%13.5" EXTENDED_LIMITS 0.00 6553599.99847 /end CHARACTERISTIC
/begin CHARACTERISTIC ACC_dtrqBrkHold_CUR "Bremsmomentengradient beim Übergang ins Halten" CURVE 0x1C2050 Kl_Xs16_Ws16 65535.00 RmpTrqPrpLow -32768.00 32767.00 FORMAT "%8.2"
 /begin AXIS_DESCR STD_AXIS LASCD_aLong Acc 9 -15.00000 15.00000 FORMAT "%8.5" EXTENDED_LIMITS -32.76800 32.76700 DEPOSIT ABSOLUTE /end AXIS_DESCR
/end CHARACTERISTIC
/begin CHARACTERISTIC ACC_dtrqBrkLow_CUR "Bremsmomentengradient beim Reduzieren vor dem Halten" CURVE 0x1C2076 Kl_Xs16_Ws16 65535.00 RmpTrqPrpLow -32768.00 32767.00 FORMAT "%8.2"
 /begin AXIS_DESCR STD_AXIS LASCD_aLong Acc 9 -15.00000 15.00000 FORMAT "%8.5" EXTENDED_LIMITS -32.76800 32.76700 DEPOSIT ABSOLUTE /end AXIS_DESCR
/end CHARACTERISTIC
/begin CHARACTERISTIC ACC_dtrqBrkUpSlpMin_C "Minimun Up slope for ramping of brake torque" VALUE 0x1C209C Kw_Wu32 6553594.99817 RmpTrqPrpHigh 5.00030517578 6553599.99847 FORMAT "%13.5" EXTENDED_LIMITS 0.00 6553599.99847 /end CHARACTERISTIC
/begin CHARACTERISTIC ACC_dtrqClthCls_C "Rampensteigung zu verwenden, um aufwärts zu rampen,  wenn die Kupplung geschlossen ist" VALUE 0x1C20A0 Kw_Wu32 6553598.99902 RmpTrqPrpHigh 0.999450683594 6553599.99847 FORMAT "%13.5" EXTENDED_LIMITS 0.00 6553599.99847 /end CHARACTERISTIC
/begin CHARACTERISTIC ACC_dtrqClthOpn_C "Rampensteigung zu verwenden, um abwärts zu rampen, wenn die Kupplung offen ist" VALUE 0x1C20A4 Kw_Wu32 6553598.99902 RmpTrqPrpHigh 0.999450683594 6553599.99847 FORMAT "%13.5" EXTENDED_LIMITS 0.00 6553599.99847 /end CHARACTERISTIC
/begin CHARACTERISTIC ACC_dtrqEngDwnSlpMin_C "Minimum Down slope of ramp for engine torque" VALUE 0x1C20A8 Kw_Wu32 6553594.99817 RmpTrqPrpHigh 5.00030517578 6553599.99847 FORMAT "%13.5" EXTENDED_LIMITS 0.00 6553599.99847 /end CHARACTERISTIC
/begin CHARACTERISTIC ACC_dtrqNoOverride_C "Momentenoffset für ""Fahrer übertritt nicht""" VALUE 0x1C20AC Kw_Ws32 429496729.500 TrqPrpHigh -214748364.800 214748364.700 FORMAT "%13.3" /end CHARACTERISTIC
/begin CHARACTERISTIC ACC_dtrqNoSoftStop_C "Bremsmomentengradient bei normaler Bremsung" VALUE 0x1C20B0 Kw_Wu32 6553594.99817 RmpTrqPrpHigh 5.00030517578 6553599.99847 FORMAT "%13.5" EXTENDED_LIMITS 0.00 6553599.99847 /end CHARACTERISTIC
/begin CHARACTERISTIC ACC_dtrqOverride_C "Momentenoffset für ""Fahrer übertritt""" VALUE 0x1C20B4 Kw_Ws32 429496729.500 TrqPrpHigh -214748364.800 214748364.700 FORMAT "%13.3" /end CHARACTERISTIC
/begin CHARACTERISTIC ACC_facTrqActvMin_C "Faktor für Momentenabsenkung" VALUE 0x1C20B8 Kw_Ws16 4.000000 Fact 0.00 4.000000 FORMAT "%8.6" EXTENDED_LIMITS -4.000000 3.999878 /end CHARACTERISTIC
/begin CHARACTERISTIC ACC_factrqMin_C "Faktor fuer das ACC-Moment bei gedrückter Kupplung" VALUE 0x1C20BA Kw_Wu16 65.53500 Fact1000 0.00 65.53500 FORMAT "%8.5" /end CHARACTERISTIC
/begin CHARACTERISTIC ACC_nShutOffMin_C "Minimaldrehzahl des Motors für Schnittstellenfunktion" VALUE 0x1C20BC Kw_Ws16 65535.00 EngN -32768.00 32767.00 FORMAT "%8.2" /end CHARACTERISTIC
/begin CHARACTERISTIC ACC_rBrk_CUR "Kennlinie zur Bremsstellgröße" CURVE 0x1C20BE Kl_Xs16_Ws16 100.0000 Prc 0.00 100.0000 FORMAT "%8.4" EXTENDED_LIMITS -327.6800 327.6700
 /begin AXIS_DESCR STD_AXIS ACC_trqBrkLowRes_mp TrqPrp 8 -1500.800 0.00 FORMAT "%8.3" EXTENDED_LIMITS -52428.80 52427.20 DEPOSIT ABSOLUTE /end AXIS_DESCR
/end CHARACTERISTIC
/begin CHARACTERISTIC ACC_rPedThres_C "Grenze zur Erkennung der Fahrpedalbetätigung" VALUE 0x1C20E0 Kw_Ws16 100.0000 Prc 0.00 100.0000 FORMAT "%8.4" EXTENDED_LIMITS -327.6800 327.6700 /end CHARACTERISTIC
/begin CHARACTERISTIC ACC_stClthMsk_C "Maske für Kupplungssignal" VALUE 0x1C20E2 Kw_Wu8 255.0 OneToOne 0.00 255.0 FORMAT "%5.1" /end CHARACTERISTIC
/begin CHARACTERISTIC ACC_stGearMin_C "Handschalter: Mindestgang für Aktivierung ACC/GRA" VALUE 0x1C20E3 Kw_Wu8 7.000 OneToOne 0.00 7.000 FORMAT "%5.3" EXTENDED_LIMITS 0.00 255.0 /end CHARACTERISTIC
/begin CHARACTERISTIC ACC_swtACCCnclOvr_C "Schalter für Freigabe für ACC durch ausreichend positive Sollbeschleunigung Übertreten zu beenden" VALUE 0x1C20E4 Kw_Wu8 1.000 OneToOne 0.00 1.000 FORMAT "%5.3" EXTENDED_LIMITS 0.00 255.0 /end CHARACTERISTIC
/begin CHARACTERISTIC ACC_swtAccSrc_C "Auswahlschalter für den Beschleunigungssollwert für das Getriebe" VALUE 0x1C20E5 Kw_Wu8 1.000 OneToOne 0.00 1.000 FORMAT "%5.3" EXTENDED_LIMITS 0.00 255.0 /end CHARACTERISTIC
/begin CHARACTERISTIC ACC_swtActvBrkBstr_C "Applikationsschalter zur Auswahl von ACC mit oder ohne aktiven Bremsverstärker" VALUE 0x1C20E6 Kw_Wu8 1.000 OneToOne 0.00 1.000 FORMAT "%5.3" EXTENDED_LIMITS 0.00 255.0 /end CHARACTERISTIC
/begin CHARACTERISTIC ACC_swtDrvBrkCond_C "Applikationsschalter zum Abbruch der Inactive Ramp wenn ""Fahrer bremst""" VALUE 0x1C20E7 Kw_Wu8 1.000 OneToOne 0.00 1.000 FORMAT "%5.3" EXTENDED_LIMITS 0.00 255.0 /end CHARACTERISTIC
/begin CHARACTERISTIC ACC_swtInvClthRawVal_C "Schalter für Invertierung des Kupplungssignalrohwertes" VALUE 0x1C20E8 Kw_Wu8 1.000 OneToOne 0.00 1.000 FORMAT "%5.3" EXTENDED_LIMITS 0.00 255.0 /end CHARACTERISTIC
/begin CHARACTERISTIC ACC_swtNoEngFault_C "Schalter für Zustand ENGFAULT bei GRA unterdrücken" VALUE 0x1C20E9 Kw_Wu8 1.000 OneToOne 0.00 1.000 FORMAT "%5.3" EXTENDED_LIMITS 0.00 255.0 /end CHARACTERISTIC
/begin CHARACTERISTIC ACC_swtOff4Clth_C "Applikationsschalter, zur Auswahl / Entlassen der Auswirkung der Bremse, wenn Kupplung offen ist" VALUE 0x1C20EA Kw_Wu8 1.000 OneToOne 0.00 1.000 FORMAT "%5.3" EXTENDED_LIMITS 0.00 255.0 /end CHARACTERISTIC
/begin CHARACTERISTIC ACC_swtPrcChkdVal_C "Abschaltrampe beenden bei PWG-Betätigung" VALUE 0x1C20EB Kw_Wu8 1.000 OneToOne 0.00 1.000 FORMAT "%5.3" EXTENDED_LIMITS 0.00 255.0 /end CHARACTERISTIC
/begin CHARACTERISTIC ACC_swtSelClthVal_C "Schalter für Auswahl des Kupplungssignals" VALUE 0x1C20EC Kw_Wu8 1.000 OneToOne 0.00 1.000 FORMAT "%5.3" EXTENDED_LIMITS 0.00 255.0 /end CHARACTERISTIC
/begin CHARACTERISTIC ACC_swtStopEna_C "Freigabe der Soft-Stop-Funktion" VALUE 0x1C20ED Kw_Wu8 1.000 OneToOne 0.00 1.000 FORMAT "%5.3" EXTENDED_LIMITS 0.00 255.0 /end CHARACTERISTIC
/begin CHARACTERISTIC ACC_tiACCCnclOvrDly_C "Verzögerung des Abbruchs von Override durch ausreichend positive Sollbeschleunigung" VALUE 0x1C20EE Kw_Wu16 655350.0 TimeDeb 0.00 655350.0 FORMAT "%8.1" /end CHARACTERISTIC
/begin CHARACTERISTIC ACC_tiBattShutOff_C "Entprellzeit für Batteriespannung-Low" VALUE 0x1C20F0 Kw_Wu16 655350.0 Time_ms 0.00 655350.0 FORMAT "%8.1" /end CHARACTERISTIC
/begin CHARACTERISTIC ACC_tiBrkDrvCut_C "Zeit für Fahrebremsung um ACC abzuschalten" VALUE 0x1C20F2 Kw_Wu16 655350.0 Time_ms 0.00 655350.0 FORMAT "%8.1" /end CHARACTERISTIC
/begin CHARACTERISTIC ACC_tiBrkDrvDef_C "Zeit für Fahrerbremsung um ACC zu sperren" VALUE 0x1C20F4 Kw_Wu16 655350.0 Time_ms 0.00 655350.0 FORMAT "%8.1" /end CHARACTERISTIC
/begin CHARACTERISTIC ACC_tiBrkRmpOvr_C "Zeit für Abrampen der Bremse beim Übertreten" VALUE 0x1C20F6 Kw_Wu16 655350.0 Time_ms 0.00 655350.0 FORMAT "%8.1" /end CHARACTERISTIC
/begin CHARACTERISTIC ACC_tiClthOpn_C "Verzögerungszeit für Kupplung getrennt (Handschalter)" VALUE 0x1C20F8 Kw_Wu16 655.3500 Time_s 0.00 655.3500 FORMAT "%8.4" /end CHARACTERISTIC
/begin CHARACTERISTIC ACC_tiDebBrkAct_C "Verzögerung für den Bremsen-Schalter" VALUE 0x1C20FA Kw_Wu16 655350.0 Time_ms 0.00 655350.0 FORMAT "%8.1" /end CHARACTERISTIC
/begin CHARACTERISTIC ACC_tiDebLockOffAct_C "Verzögerung für den CC Lock-Off button" VALUE 0x1C20FC Kw_Wu16 655350.0 Time_ms 0.00 655350.0 FORMAT "%8.1" /end CHARACTERISTIC
/begin CHARACTERISTIC ACC_tiDelayClth_C "Zeit fuer die ein anderes Moment verwendet wird" VALUE 0x1C20FE Kw_Wu16 500.0000 Time_ms 0.00 500.0000 FORMAT "%8.4" EXTENDED_LIMITS 0.00 655350.0 /end CHARACTERISTIC
/begin CHARACTERISTIC ACC_tiSoftBrkLow_CUR "Verzögerungszeit für Übergang auf Haltemoment bei Soft-Stop" CURVE 0x1C2100 Kl_Xs16_Ws16 655350.0 Time_ms -327680.0 327670.0 FORMAT "%8.1"
 /begin AXIS_DESCR STD_AXIS LASCD_aLong Acc 9 -15.00000 15.00000 FORMAT "%8.5" EXTENDED_LIMITS -32.76800 32.76700 DEPOSIT ABSOLUTE /end AXIS_DESCR
/end CHARACTERISTIC
/begin CHARACTERISTIC ACC_tiStrtDlyPlausChk_C "Zeit zum Aktivwerden von ACC_stIRevShOff.5 nach Kl15 EIN oder MSG-Recovery" VALUE 0x1C2126 Kw_Wu16 655350.0 Time_ms 0.00 655350.0 FORMAT "%8.1" /end CHARACTERISTIC
/begin CHARACTERISTIC ACC_trqBrkHold_CUR "Haltemoment der Soft-Stop Funktion" CURVE 0x1C2128 Kl_Xs16_Ws16 104856.0 TrqPrp -52428.80 52427.20 FORMAT "%8.2"
 /begin AXIS_DESCR STD_AXIS LASCD_aLong Acc 9 -15.00000 15.00000 FORMAT "%8.5" EXTENDED_LIMITS -32.76800 32.76700 DEPOSIT ABSOLUTE /end AXIS_DESCR
/end CHARACTERISTIC
/begin CHARACTERISTIC ACC_trqBrkLow_CUR "Reduziertes Moment der Soft-Stop Funktion" CURVE 0x1C214E Kl_Xs16_Ws16 104856.0 TrqPrp -52428.80 52427.20 FORMAT "%8.2"
 /begin AXIS_DESCR STD_AXIS LASCD_aLong Acc 9 -15.00000 15.00000 FORMAT "%8.5" EXTENDED_LIMITS -32.76800 32.76700 DEPOSIT ABSOLUTE /end AXIS_DESCR
/end CHARACTERISTIC
/begin CHARACTERISTIC ACC_trqCorr_CUR "Korrekturkennlinie für die Berechnung des Bremsmoments im ACC-Betrieb" CURVE 0x1C2174 Kl_Xs16_Ws16 15000.00 TrqPrp -15000.00 0.00 FORMAT "%8.2" EXTENDED_LIMITS -52428.80 52427.20
 /begin AXIS_DESCR STD_AXIS ACC_trqBrkLowRes_mp TrqPrp 6 -10000.00 0.00 FORMAT "%8.2" EXTENDED_LIMITS -52428.80 52427.20 DEPOSIT ABSOLUTE /end AXIS_DESCR
/end CHARACTERISTIC
/begin CHARACTERISTIC ACC_trqDesMax_C "ACC-Momentenbegrenzung bei ACC-Bremsung" VALUE 0x1C2190 Kw_Ws32 104856.000000 TrqPrpHigh -52428.8000000 52427.2000000 FORMAT "%13.7" EXTENDED_LIMITS -214748364.800 214748364.700 /end CHARACTERISTIC
/begin CHARACTERISTIC ACC_trqDesOffset_C "Schwelle für die Erkennung auf ""Übertreten""" VALUE 0x1C2194 Kw_Ws32 429496729.500 TrqPrpHigh -214748364.800 214748364.700 FORMAT "%13.3" /end CHARACTERISTIC
/begin CHARACTERISTIC ACC_trqNoOvr2_C "Momentenoffset für Maximalgrenze-Momentenwert des Reglerausgangs" VALUE 0x1C2198 Kw_Ws32 429496729.500 TrqPrpHigh -214748364.800 214748364.700 FORMAT "%13.3" /end CHARACTERISTIC
/begin CHARACTERISTIC ACC_dtrqRmpSlpUp_C "Positive Steigung fuer die Momentenberechnung" VALUE 0x1C219C Kw_Wu32 6553598.99902 RmpTrqPrpHigh 0.999450683594 6553599.99847 FORMAT "%13.5" EXTENDED_LIMITS 0.00 6553599.99847 /end CHARACTERISTIC
/begin CHARACTERISTIC ACC_dtrqRmpSlpDwn_C "Negative Steigung fuer die Momentenberechnung" VALUE 0x1C21A0 Kw_Wu32 6553598.99902 RmpTrqPrpHigh 0.999450683594 6553599.99847 FORMAT "%13.5" EXTENDED_LIMITS 0.00 6553599.99847 /end CHARACTERISTIC
/begin CHARACTERISTIC ACC_uBattShutOff_C "Untere Schwelle der Batteriespannung-Low" VALUE 0x1C21A4 Kw_Ws16 20782.00 Volt_Batt 0.00 20782.00 FORMAT "%8.2" EXTENDED_LIMITS -665674.1 665653.8 /end CHARACTERISTIC
/begin CHARACTERISTIC ACC_vBrkSoftLo_C "Geschwindigkeitsgrenze für den Übergang ins Halten bei Soft-Stop-Funktion" VALUE 0x1C21A6 Kw_Ws16 300.0000 Vel 0.00 300.0000 FORMAT "%8.4" EXTENDED_LIMITS -327.6800 327.6700 /end CHARACTERISTIC
/begin CHARACTERISTIC ACC_vSoftBrkHi_CUR "Obere Geschwindigkeitsgrenze für Soft-Stop-Funktion" CURVE 0x1C21A8 Kl_Xs16_Ws16 655.3500 Vel -327.6800 327.6700 FORMAT "%8.4"
 /begin AXIS_DESCR STD_AXIS LASCD_aLong Acc 9 -15.00000 15.00000 FORMAT "%8.5" EXTENDED_LIMITS -32.76800 32.76700 DEPOSIT ABSOLUTE /end AXIS_DESCR
/end CHARACTERISTIC
/begin CHARACTERISTIC FrmMng_tiACCBrkRls_C "Verzögerungszeit zum Rücksetzten des Bremseingrifffreigabebits nach Übertreten während ACC-Betriebs" VALUE 0x1D7F1A Kw_Wu16 655350.0 Time_ms 0.00 655350.0 FORMAT "%8.1" /end CHARACTERISTIC
/begin CHARACTERISTIC FrmMng_tiPreFill_C "Zeit für Vorbefüllen/Andocken der Bremse" VALUE 0x1D7F1C Kw_Wu16 655350.0 Time_ms 0.00 655350.0 FORMAT "%8.1" /end CHARACTERISTIC
/begin CHARACTERISTIC FrmMng_trqBrkNoStandby_C "Obere Schwelle der Hysterese" VALUE 0x1D7F20 Kw_Ws32 429496729.500 TrqPrpHigh -214748364.800 214748364.700 FORMAT "%13.3" /end CHARACTERISTIC
/begin CHARACTERISTIC FrmMng_trqBrkStandby_C "Untere Schwelle der Hysterese" VALUE 0x1D7F24 Kw_Ws32 429496729.500 TrqPrpHigh -214748364.800 214748364.700 FORMAT "%13.3" /end CHARACTERISTIC
/begin CHARACTERISTIC LIGov_nLimBasAdjRmp_C "Drehzahlschwelle, bei der bei beendeten Grundeinstellungstest das Integral-Moment und die Drehzahlrampen initialisert werden" VALUE 0x1E7E4A Kw_Ws16 35768.00 EngN -32768.00 3000.000 FORMAT "%8.2" EXTENDED_LIMITS -32768.00 32767.00 /end CHARACTERISTIC
/begin COMPU_METHOD Acc "Fahrzeugbeschleunigung" RAT_FUNC "%6.5" "[m/s^2]" COEFFS 0 1000 0 0 0 1 /end COMPU_METHOD
/begin COMPU_METHOD AngleRad "Winkelanzeige in Radians" RAT_FUNC "%7.6" "[rad]" COEFFS 0 10000 0 0 0 1 /end COMPU_METHOD
/begin COMPU_METHOD EngN "Motordrehzahl" RAT_FUNC "%6.2" "[rpm]" COEFFS 0 1 0 0 0 1 /end COMPU_METHOD
/begin COMPU_METHOD Fact "Faktor mit Auflösung 1 / 8192, hauptsächlich für einen Faktorenbereich 0...1 verwendet" RAT_FUNC "%6.5" "[-]" COEFFS 0 8192 0 0 0 1 /end COMPU_METHOD
/begin COMPU_METHOD Fact1000 "Faktor mit einer Auflösung von 0.001" RAT_FUNC "%6.5" "-" COEFFS 0 1000 0 0 0 1 /end COMPU_METHOD
/begin COMPU_METHOD Ki "Integrale Verstärkung Ki (gleiche Einheit/Umrechnungsregel an Ein- und Ausgang)" RAT_FUNC "%6.5" "[1/s]" COEFFS 0 4294.967296 0 0 0 1 /end COMPU_METHOD
/begin COMPU_METHOD Kp_ACC "Umrechnung für P-Parameter in ACC-und ACCCD-Modul" RAT_FUNC "%6.5" "[1/1]" COEFFS 0 8192 0 0 0 1 /end COMPU_METHOD
/begin COMPU_METHOD OneToOne "eins zu eins (physikalischer Wert ist gleich dem internen Wert)" RAT_FUNC "%6.2" "[-]" COEFFS 0 1 0 0 0 1 /end COMPU_METHOD
/begin COMPU_METHOD Prc "Prozent, gleiche interne Auflösung wie Fact, aber Darstellung in Prozent (0...100%)" RAT_FUNC "%6.4" "[%]" COEFFS 0 100 0 0 0 1 /end COMPU_METHOD
/begin COMPU_METHOD PresAC_hPa "Druck (Klimatisierung) angezeigt in [hPa]" RAT_FUNC "%6.2" "[hPa]" COEFFS 0 0.5 0 0 0 1 /end COMPU_METHOD
/begin COMPU_METHOD RmpAcc "Beschleunigungsrampe - Gradient" RAT_FUNC "%7.6" "[m/s^2/s]" COEFFS 0 65536 0 0 0 1 /end COMPU_METHOD
/begin COMPU_METHOD RmpTrqPrpHigh "Rampenanstieg für Vortriebsmoment [Nm/s]" RAT_FUNC "%6.4" "[Nm/s]" COEFFS 0 655.36 0 0 0 1 /end COMPU_METHOD
/begin COMPU_METHOD RmpTrqPrpLow "Rampenanstieg für Vortriebsmoment [Nm/s]" RAT_FUNC "%6.2" "[Nm/s]" COEFFS 0 1 0 0 0 1 /end COMPU_METHOD
/begin COMPU_METHOD Temp_Cels "Temperatur dargestellt in °C (gleiche interne Darstellung wie Temp_Kelv)" RAT_FUNC "%6.1" "[deg C]" COEFFS 0 10 2731.4 0 0 1 /end COMPU_METHOD
/begin COMPU_METHOD TimeDeb "Entprellzeit in Millisekunden für Libraryfunktion Debounce" RAT_FUNC "%6.1" "[ms]" COEFFS 0 0.1 0 0 0 1 /end COMPU_METHOD
/begin COMPU_METHOD TimeDelay_s "Zeitkonstante T1 (in s) für PT1, DT1, etc." RAT_FUNC "%9.3" "[s]" COEFFS 0 0 1 0 0.00023283064365387 0 /end COMPU_METHOD
/begin COMPU_METHOD Time_ms "Zeit in ms für Fehlerentprellung (DSM) und SW-Timer" RAT_FUNC "%6.1" "[ms]" COEFFS 0 0.1 0 0 0 1 /end COMPU_METHOD
/begin COMPU_METHOD Time_s "Zeit in s für Fehlerentprellung (DSM) und SW-Timer" RAT_FUNC "%6.4" "[s]" COEFFS 0 100 0 0 0 1 /end COMPU_METHOD
/begin COMPU_METHOD TransR "Übersetzungsverhältnis (Getriebe etc.)" RAT_FUNC "%6.4" "[-]" COEFFS 0 100 0 0 0 1 /end COMPU_METHOD
/begin COMPU_METHOD Trq "Motormoment" RAT_FUNC "%6.3" "[Nm]" COEFFS 0 10 0 0 0 1 /end COMPU_METHOD
/begin COMPU_METHOD TrqPrp "Vortriebsmoment" RAT_FUNC "%6.2" "[Nm]" COEFFS 0 0.625 0 0 0 1 /end COMPU_METHOD
/begin COMPU_METHOD TrqPrpHigh "vortriebsmoment" RAT_FUNC "%6.3" "[Nm]" COEFFS 0 10 0 0 0 1 /end COMPU_METHOD
/begin COMPU_METHOD VehMass "Fahrzeugmasse in Kg" RAT_FUNC "%6.3" "[Kg]" COEFFS 0 10 0 0 0 1 /end COMPU_METHOD
/begin COMPU_METHOD Vel "Fahrzeuggeschwindigkeit, gleiche interne Auflösung wie Vel_SI" RAT_FUNC "%6.4" "[km/h]" COEFFS 0 100 0 0 0 1 /end COMPU_METHOD
/begin COMPU_METHOD Volt_Batt "Batteriespannung" RAT_FUNC "%6.1" "[mV]" COEFFS 0 0.0492252911173131 0 0 0 1 /end COMPU_METHOD
/begin RECORD_LAYOUT Kf_Xs16_Ys16_Ws16 NO_AXIS_PTS_X 1 SWORD NO_AXIS_PTS_Y 2 SWORD AXIS_PTS_X 3 SWORD INDEX_INCR DIRECT AXIS_PTS_Y 4 SWORD INDEX_INCR DIRECT FNC_VALUES 5 SWORD COLUMN_DIR DIRECT /end RECORD_LAYOUT
/begin RECORD_LAYOUT Kl_Xs16_Ws16 NO_AXIS_PTS_X 1 SWORD AXIS_PTS_X 2 SWORD INDEX_INCR DIRECT FNC_VALUES 3 SWORD COLUMN_DIR DIRECT /end RECORD_LAYOUT
/begin RECORD_LAYOUT Kw_Ws16 FNC_VALUES 1 SWORD COLUMN_DIR DIRECT /end RECORD_LAYOUT
/begin RECORD_LAYOUT Kw_Ws32 FNC_VALUES 1 SLONG COLUMN_DIR DIRECT /end RECORD_LAYOUT
/begin RECORD_LAYOUT Kw_Wu16 FNC_VALUES 1 UWORD COLUMN_DIR DIRECT /end RECORD_LAYOUT
/begin RECORD_LAYOUT Kw_Wu32 FNC_VALUES 1 ULONG COLUMN_DIR DIRECT /end RECORD_LAYOUT
/begin RECORD_LAYOUT Kw_Wu8 FNC_VALUES 1 UBYTE COLUMN_DIR DIRECT /end RECORD_LAYOUT
/begin FUNCTION ACCD_DigOut "Klimakompressoransteuerung"
 /begin DEF_CHARACTERISTIC ACCD_DebNoLoadDef_C ACCD_DebNoLoadOk_C ACCD_DebShortCircBatDef_C ACCD_DebShortCircBatOk_C ACCD_DebShortCircGndDef_C ACCD_DebShortCircGndOk_C ACCD_stSPICtl_C ACCD_tiBtwTst_C ACCD_tiPwrStgOn_C LIGov_nLimBasAdjRmp_C /end DEF_CHARACTERISTIC
/end FUNCTION
/begin FUNCTION ACCD_MNSwt "Klimahauptschalter"
 /begin DEF_CHARACTERISTIC ACCD_stMnSwtInvIn_C ACCD_swtACtypeType_C ACCD_tiMnSwtDebNeg_C ACCD_tiMnSwtDebPos_C /end DEF_CHARACTERISTIC
/end FUNCTION
/begin FUNCTION ACCD_Pres "Klimakompressordruckerfassung" /begin DEF_CHARACTERISTIC ACCD_ctPwrStgOnMax_C ACCD_pDfl_C ACCD_stSensIDWord_C /end DEF_CHARACTERISTIC /end FUNCTION
/begin FUNCTION ACC_State "Zustandsautomat der adaptiven Fahrgeschwindigkeitsregelung"
 /begin DEF_CHARACTERISTIC ACCCD_IKiBrk_CUR ACCCD_IKiPos_MAP ACCCD_PKpBrkLim_CUR ACCCD_PKpBrk_CUR ACCCD_PKpPos_MAP ACCCD_aDesLimNeg_CUR ACCCD_aDesLimPos_CUR ACCCD_aDesNegOffset_C ACCCD_aDrvDem0_C ACCCD_aDrvDemOfs_C ACCCD_daGRADwn_C ACCCD_daGRAUp_C ACCCD_daMin_C ACCCD_dfacKpCorr_C ACCCD_dtrqBrkNeg_C ACCCD_facBrkComp_C ACCCD_facDrvDem_C ACCCD_facKiCorr_CUR ACCCD_facKiPosCorr_CUR ACCCD_facKpCorr_CUR ACCCD_facKpPosCorr_CUR ACCCD_facTrqDrvMin_C ACCCD_mVehTare_C ACCCD_mVehTrail_C ACCCD_phiRoadMax_C ACCCD_stBrkMsk_C ACCCD_stBrkNotAvMsk_C ACCCD_stCANErrMsk_C ACCCD_stClthMsk_C ACCCD_stTSCMsk_C ACCCD_swtCodeChk_C ACCCD_swtKpIni0_C ACCCD_swtSpdLimEna_C ACCCD_swtVehMassAdpt_C ACCCD_tiAccDragFlt_MAP ACCCD_tiDebClth_C ACCCD_tiPT1Trans_C ACCCD_tiPreFill_C ACCCD_tiSensErrDebDef_C ACCCD_tiSensErrDebOk_C ACCCD_tiSwtOffRmp_C ACCCD_tiaDesDebDef_C ACCCD_tiaDesDebOk_C ACCCD_tiaDesMaxDebDef_C ACCCD_tiaDesMaxDebOk_C ACCCD_tiaDesMinDebDef_C ACCCD_tiaDesMinDebOk_C ACCCD_trqBrkMin2_C ACCCD_trqBrkMin3_C ACCCD_trqDragOffSet_C ACCCD_trqNoCut_C ACCCD_vAccDrvMin_C ACCCD_vAccMin_C ACCCD_vDiffThres_C ACC_aDevCnclOvr_C ACC_aOff_C ACC_aStopMin_C ACC_dtrqBrkEngSlp_C ACC_dtrqBrkHold_CUR ACC_dtrqBrkLow_CUR ACC_dtrqBrkUpSlpMin_C ACC_dtrqClthCls_C ACC_dtrqClthOpn_C ACC_dtrqEngDwnSlpMin_C ACC_dtrqNoOverride_C ACC_dtrqNoSoftStop_C ACC_dtrqOverride_C ACC_dtrqRmpSlpDwn_C ACC_dtrqRmpSlpUp_C ACC_facTrqActvMin_C ACC_factrqMin_C ACC_nShutOffMin_C ACC_rBrk_CUR ACC_rPedThres_C ACC_stClthMsk_C ACC_stGearMin_C ACC_swtACCCnclOvr_C ACC_swtAccSrc_C ACC_swtActvBrkBstr_C ACC_swtDrvBrkCond_C ACC_swtInvClthRawVal_C ACC_swtNoEngFault_C ACC_swtOff4Clth_C ACC_swtPrcChkdVal_C ACC_swtSelClthVal_C ACC_swtStopEna_C ACC_tiACCCnclOvrDly_C ACC_tiBattShutOff_C ACC_tiBrkDrvCut_C ACC_tiBrkDrvDef_C ACC_tiBrkRmpOvr_C ACC_tiClthOpn_C ACC_tiDebBrkAct_C ACC_tiDebLockOffAct_C ACC_tiDebStEPBAct_C ACC_tiDebStEPBInAct_C ACC_tiDebSwtPlAct_C ACC_tiDebSwtPlInAct_C ACC_tiDelayClth_C ACC_tiSoftBrkLow_CUR ACC_tiStrtDlyPlausChk_C ACC_trqBrkHold_CUR ACC_trqBrkLow_CUR ACC_trqDesMax_C ACC_trqDesOffset_C ACC_trqNoOvr2_C ACC_uBattShutOff_C ACC_vBrkSoftLo_C ACC_vSoftBrkHi_CUR FrmMng_tiACCBrkRls_C FrmMng_tiPreFill_C FrmMng_trqBrkNoStandby_C FrmMng_trqBrkStandby_C /end DEF_CHARACTERISTIC
/end FUNCTION
/begin FUNCTION ACC_TrqIntv "Momenteneingriff des Abstandregeltempomats (ART)" /begin DEF_CHARACTERISTIC ACCCD_trqBrkZero_CUR ACC_trqCorr_CUR /end DEF_CHARACTERISTIC /end FUNCTION
/begin FUNCTION ACCtl "Klimaregelung" /begin SUB_FUNCTION ACCtl_Logic ACTrqC /end SUB_FUNCTION /end FUNCTION
/begin FUNCTION ACCtl_AntiClunk "Customer specific Anti clunk feature for AC Control" /begin DEF_CHARACTERISTIC ACCtl_tAirMin_C /end DEF_CHARACTERISTIC /end FUNCTION
/end MODULE
/end PROJECT
