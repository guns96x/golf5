ASAP2_VERSION 1 3
/begin PROJECT X447 "EDC16U34"
/begin HEADER "" VERSION "VAA1" PROJECT_NO X447 /end HEADER
/begin MODULE DIM ""
/begin MOD_COMMON "" BYTE_ORDER MSB_FIRST ALIGNMENT_BYTE 1 ALIGNMENT_WORD 2 ALIGNMENT_LONG 4 ALIGNMENT_FLOAT32_IEEE 4 /end MOD_COMMON
/begin CHARACTERISTIC DSM_EnvDfp_ACCCD_C "Fehlerpfad spezifische Umweltbedingungen fuer Fehlerpfad Dfp_ACCCD" VAL_BLK 0x1CF42C Kwb_Wu16 1152.00000000 SigName 0.00 1152.00000000 FORMAT "%13.8" NUMBER 8 /end CHARACTERISTIC
/begin CHARACTERISTIC DSM_EnvDfp_ACCCDBrkErr_C "Fehlerpfad spezifische Umweltbedingungen fuer Fehlerpfad Dfp_ACCCDBrkErr" VAL_BLK 0x1CF43C Kwb_Wu16 1152.00000000 SigName 0.00 1152.00000000 FORMAT "%13.8" NUMBER 8 /end CHARACTERISTIC
/begin CHARACTERISTIC DSM_EnvDfp_ACCCDBrkNPL_C "Fehlerpfad spezifische Umweltbedingungen fuer Fehlerpfad Dfp_ACCCDBrkNPL" VAL_BLK 0x1CF44C Kwb_Wu16 1152.00000000 SigName 0.00 1152.00000000 FORMAT "%13.8" NUMBER 8 /end CHARACTERISTIC
/begin CHARACTERISTIC DSM_EnvDfp_ACCCDSensErr_C "Fehlerpfad spezifische Umweltbedingungen fuer Fehlerpfad Dfp_ACCCDSensErr" VAL_BLK 0x1CF45C Kwb_Wu16 1152.00000000 SigName 0.00 1152.00000000 FORMAT "%13.8" NUMBER 8 /end CHARACTERISTIC
/begin CHARACTERISTIC DSM_EnvDfp_ACCCDWrongCoded_C "Fehlerpfad spezifische Umweltbedingungen fuer Fehlerpfad Dfp_ACCCDWrongCoded" VAL_BLK 0x1CF46C Kwb_Wu16 1152.00000000 SigName 0.00 1152.00000000 FORMAT "%13.8" NUMBER 8 /end CHARACTERISTIC
/begin CHARACTERISTIC DSM_EnvDfp_ACCD_C "Fehlerpfad spezifische Umweltbedingungen fuer Fehlerpfad Dfp_ACCD" VAL_BLK 0x1CF47C Kwb_Wu16 1152.00000000 SigName 0.00 1152.00000000 FORMAT "%13.8" NUMBER 8 /end CHARACTERISTIC
/begin CHARACTERISTIC DSM_EnvDfp_ACCD_PAC_C "Fehlerpfad spezifische Umweltbedingungen fuer Fehlerpfad Dfp_ACCD_PAC" VAL_BLK 0x1CF48C Kwb_Wu16 1152.00000000 SigName 0.00 1152.00000000 FORMAT "%13.8" NUMBER 8 /end CHARACTERISTIC
/begin CHARACTERISTIC DSM_EnvDfp_ACCD_pCAN_C "Fehlerpfad spezifische Umweltbedingungen fuer Fehlerpfad Dfp_ACCD_pCAN" VAL_BLK 0x1CF49C Kwb_Wu16 1152.00000000 SigName 0.00 1152.00000000 FORMAT "%13.8" NUMBER 8 /end CHARACTERISTIC
/begin CHARACTERISTIC DSM_EnvDfp_ACCD_trqCAN_C "Fehlerpfad spezifische Umweltbedingungen fuer Fehlerpfad Dfp_ACCD_trqCAN" VAL_BLK 0x1CF4AC Kwb_Wu16 1152.00000000 SigName 0.00 1152.00000000 FORMAT "%13.8" NUMBER 8 /end CHARACTERISTIC
/begin CHARACTERISTIC DSM_EnvDfp_ACCIRevPanErr_C "Fehlerpfad spezifische Umweltbedingungen fuer Fehlerpfad Dfp_ACCIRevPanErr" VAL_BLK 0x1CF4BC Kwb_Wu16 1152.00000000 SigName 0.00 1152.00000000 FORMAT "%13.8" NUMBER 8 /end CHARACTERISTIC
/begin CHARACTERISTIC DSM_EnvDfp_ACCIRevShOff_C "Fehlerpfad spezifische Umweltbedingungen fuer Fehlerpfad Dfp_ACCIRevShOff" VAL_BLK 0x1CF4CC Kwb_Wu16 1152.00000000 SigName 0.00 1152.00000000 FORMAT "%13.8" NUMBER 8 /end CHARACTERISTIC
/begin CHARACTERISTIC DSM_EnvDfp_ACCnotPlaus_C "Fehlerpfad spezifische Umweltbedingungen fuer Fehlerpfad Dfp_ACCnotPlaus" VAL_BLK 0x1CF4DC Kwb_Wu16 1152.00000000 SigName 0.00 1152.00000000 FORMAT "%13.8" NUMBER 8 /end CHARACTERISTIC
/begin CHARACTERISTIC DSM_EnvDfp_ADCMon_C "Fehlerpfad spezifische Umweltbedingungen fuer Fehlerpfad Dfp_ADCMon" VAL_BLK 0x1CF4EC Kwb_Wu16 1152.00000000 SigName 0.00 1152.00000000 FORMAT "%13.8" NUMBER 8 /end CHARACTERISTIC
/begin CHARACTERISTIC DSM_EnvDfp_AFSCD_PlOffsDrft_C "Fehlerpfad spezifische Umweltbedingungen fuer Fehlerpfad Dfp_AFSCD_PlOffsDrft" VAL_BLK 0x1CF4FC Kwb_Wu16 1152.00000000 SigName 0.00 1152.00000000 FORMAT "%13.8" NUMBER 8 /end CHARACTERISTIC
/begin CHARACTERISTIC DSM_EnvDfp_AFSCD_PlSetyDrft_C "Fehlerpfad spezifische Umweltbedingungen fuer Fehlerpfad Dfp_AFSCD_PlSetyDrft" VAL_BLK 0x1CF50C Kwb_Wu16 1152.00000000 SigName 0.00 1152.00000000 FORMAT "%13.8" NUMBER 8 /end CHARACTERISTIC
/begin CHARACTERISTIC DSM_EnvDfp_AFSCD_SRCAirm_C "Fehlerpfad spezifische Umweltbedingungen fuer Fehlerpfad Dfp_AFSCD_SRCAirm" VAL_BLK 0x1CF51C Kwb_Wu16 1152.00000000 SigName 0.00 1152.00000000 FORMAT "%13.8" NUMBER 8 /end CHARACTERISTIC
/begin CHARACTERISTIC DSM_EnvDfp_AFVCD_Actr_C "Fehlerpfad spezifische Umweltbedingungen fuer Fehlerpfad Dfp_AFVCD_Actr" VAL_BLK 0x1CF52C Kwb_Wu16 1152.00000000 SigName 0.00 1152.00000000 FORMAT "%13.8" NUMBER 8 /end CHARACTERISTIC
/begin CHARACTERISTIC DSM_EnvDfp_AOHtCDHt1_C "Fehlerpfad spezifische Umweltbedingungen fuer Fehlerpfad Dfp_AOHtCDHt1" VAL_BLK 0x1CF53C Kwb_Wu16 1152.00000000 SigName 0.00 1152.00000000 FORMAT "%13.8" NUMBER 8 /end CHARACTERISTIC
/begin CHARACTERISTIC DSM_EnvDfp_AOHtCDHt2_C "Fehlerpfad spezifische Umweltbedingungen fuer Fehlerpfad Dfp_AOHtCDHt2" VAL_BLK 0x1CF54C Kwb_Wu16 1152.00000000 SigName 0.00 1152.00000000 FORMAT "%13.8" NUMBER 8 /end CHARACTERISTIC
/begin CHARACTERISTIC DSM_EnvDfp_AOHtCDHt3_C "Fehlerpfad spezifische Umweltbedingungen fuer Fehlerpfad Dfp_AOHtCDHt3" VAL_BLK 0x1CF55C Kwb_Wu16 1152.00000000 SigName 0.00 1152.00000000 FORMAT "%13.8" NUMBER 8 /end CHARACTERISTIC
/begin CHARACTERISTIC DSM_EnvDfp_APP1_C "Fehlerpfad spezifische Umweltbedingungen fuer Fehlerpfad Dfp_APP1" VAL_BLK 0x1CF56C Kwb_Wu16 1152.00000000 SigName 0.00 1152.00000000 FORMAT "%13.8" NUMBER 8 /end CHARACTERISTIC
/begin CHARACTERISTIC DSM_EnvDfp_APP2_C "Fehlerpfad spezifische Umweltbedingungen fuer Fehlerpfad Dfp_APP2" VAL_BLK 0x1CF57C Kwb_Wu16 1152.00000000 SigName 0.00 1152.00000000 FORMAT "%13.8" NUMBER 8 /end CHARACTERISTIC
/begin CHARACTERISTIC DSM_EnvDfp_APPCD_KickDown_C "Fehlerpfad spezifische Umweltbedingungen fuer Fehlerpfad Dfp_APPCD_KickDown" VAL_BLK 0x1CF58C Kwb_Wu16 1152.00000000 SigName 0.00 1152.00000000 FORMAT "%13.8" NUMBER 8 /end CHARACTERISTIC
/begin CHARACTERISTIC DSM_EnvDfp_APPCD_PWGDrft_C "Fehlerpfad spezifische Umweltbedingungen fuer Fehlerpfad Dfp_APPCD_PWGDrft" VAL_BLK 0x1CF59C Kwb_Wu16 1152.00000000 SigName 0.00 1152.00000000 FORMAT "%13.8" NUMBER 8 /end CHARACTERISTIC
/begin CHARACTERISTIC DSM_EnvDfp_APPSync_C "Fehlerpfad spezifische Umweltbedingungen fuer Fehlerpfad Dfp_APPSync" VAL_BLK 0x1CF5AC Kwb_Wu16 1152.00000000 SigName 0.00 1152.00000000 FORMAT "%13.8" NUMBER 8 /end CHARACTERISTIC
/begin CHARACTERISTIC DSM_EnvDfp_APP_Npl_C "Fehlerpfad spezifische Umweltbedingungen fuer Fehlerpfad Dfp_APP_Npl" VAL_BLK 0x1CF5BC Kwb_Wu16 1152.00000000 SigName 0.00 1152.00000000 FORMAT "%13.8" NUMBER 8 /end CHARACTERISTIC
/begin CHARACTERISTIC DSM_EnvDfp_APSCD_C "Fehlerpfad spezifische Umweltbedingungen fuer Fehlerpfad Dfp_APSCD" VAL_BLK 0x1CF5CC Kwb_Wu16 1152.00000000 SigName 0.00 1152.00000000 FORMAT "%13.8" NUMBER 8 /end CHARACTERISTIC
/begin CHARACTERISTIC DSM_EnvDfp_AccPedPlausBrk_C "Fehlerpfad spezifische Umweltbedingungen fuer Fehlerpfad Dfp_AccPedPlausBrk" VAL_BLK 0x1CF5DC Kwb_Wu16 1152.00000000 SigName 0.00 1152.00000000 FORMAT "%13.8" NUMBER 8 /end CHARACTERISTIC
/begin CHARACTERISTIC DSM_EnvDfp_AirCtl_GovDevMax_C "Fehlerpfad spezifische Umweltbedingungen fuer Fehlerpfad Dfp_AirCtl_GovDevMax" VAL_BLK 0x1CF5EC Kwb_Wu16 1152.00000000 SigName 0.00 1152.00000000 FORMAT "%13.8" NUMBER 8 /end CHARACTERISTIC
/begin CHARACTERISTIC DSM_EnvDfp_AirCtl_GovDevMin_C "Fehlerpfad spezifische Umweltbedingungen fuer Fehlerpfad Dfp_AirCtl_GovDevMin" VAL_BLK 0x1CF5FC Kwb_Wu16 1152.00000000 SigName 0.00 1152.00000000 FORMAT "%13.8" NUMBER 8 /end CHARACTERISTIC
/begin CHARACTERISTIC DSM_EnvDfp_AirCtl_GovDevRgnMax_C "Fehlerpfad spezifische Umweltbedingungen fuer Fehlerpfad Dfp_AirCtl_GovDevRgnMax" VAL_BLK 0x1CF60C Kwb_Wu16 1152.00000000 SigName 0.00 1152.00000000 FORMAT "%13.8" NUMBER 8 /end CHARACTERISTIC
/begin CHARACTERISTIC DSM_EnvDfp_AirCtl_GovDevRgnMin_C "Fehlerpfad spezifische Umweltbedingungen fuer Fehlerpfad Dfp_AirCtl_GovDevRgnMin" VAL_BLK 0x1CF61C Kwb_Wu16 1152.00000000 SigName 0.00 1152.00000000 FORMAT "%13.8" NUMBER 8 /end CHARACTERISTIC
/begin CHARACTERISTIC DSM_EnvDfp_AirbCDCrash_C "Fehlerpfad spezifische Umweltbedingungen fuer Fehlerpfad Dfp_AirbCDCrash" VAL_BLK 0x1CF62C Kwb_Wu16 1152.00000000 SigName 0.00 1152.00000000 FORMAT "%13.8" NUMBER 8 /end CHARACTERISTIC
/begin CHARACTERISTIC DSM_EnvDfp_AirbCDCrashCrCtl_C "Fehlerpfad spezifische Umweltbedingungen fuer Fehlerpfad Dfp_AirbCDCrashCrCtl" VAL_BLK 0x1CF63C Kwb_Wu16 1152.00000000 SigName 0.00 1152.00000000 FORMAT "%13.8" NUMBER 8 /end CHARACTERISTIC
/begin CHARACTERISTIC DSM_EnvDfp_AirbCDCrashPSP_C "Fehlerpfad spezifische Umweltbedingungen fuer Fehlerpfad Dfp_AirbCDCrashPSP" VAL_BLK 0x1CF64C Kwb_Wu16 1152.00000000 SigName 0.00 1152.00000000 FORMAT "%13.8" NUMBER 8 /end CHARACTERISTIC
/begin CHARACTERISTIC DSM_EnvDfp_AltCDExc_C "Fehlerpfad spezifische Umweltbedingungen fuer Fehlerpfad Dfp_AltCDExc" VAL_BLK 0x1CF65C Kwb_Wu16 1152.00000000 SigName 0.00 1152.00000000 FORMAT "%13.8" NUMBER 8 /end CHARACTERISTIC
/begin CHARACTERISTIC DSM_EnvDfp_AltCD_Load_C "Fehlerpfad spezifische Umweltbedingungen fuer Fehlerpfad Dfp_AltCD_Load" VAL_BLK 0x1CF66C Kwb_Wu16 1152.00000000 SigName 0.00 1152.00000000 FORMAT "%13.8" NUMBER 8 /end CHARACTERISTIC
/begin CHARACTERISTIC DSM_EnvDfp_AltPwrCan_C "Fehlerpfad spezifische Umweltbedingungen fuer Fehlerpfad Dfp_AltPwrCan" VAL_BLK 0x1CF67C Kwb_Wu16 1152.00000000 SigName 0.00 1152.00000000 FORMAT "%13.8" NUMBER 8 /end CHARACTERISTIC
/begin CHARACTERISTIC DSM_EnvDfp_BIP01_C "Fehlerpfad spezifische Umweltbedingungen fuer Fehlerpfad Dfp_BIP01" VAL_BLK 0x1CF68C Kwb_Wu16 1152.00000000 SigName 0.00 1152.00000000 FORMAT "%13.8" NUMBER 8 /end CHARACTERISTIC
/begin CHARACTERISTIC DSM_EnvDfp_BIP02_C "Fehlerpfad spezifische Umweltbedingungen fuer Fehlerpfad Dfp_BIP02" VAL_BLK 0x1CF69C Kwb_Wu16 1152.00000000 SigName 0.00 1152.00000000 FORMAT "%13.8" NUMBER 8 /end CHARACTERISTIC
/begin CHARACTERISTIC DSM_EnvDfp_BIP03_C "Fehlerpfad spezifische Umweltbedingungen fuer Fehlerpfad Dfp_BIP03" VAL_BLK 0x1CF6AC Kwb_Wu16 1152.00000000 SigName 0.00 1152.00000000 FORMAT "%13.8" NUMBER 8 /end CHARACTERISTIC
/begin CHARACTERISTIC DSM_EnvDfp_BIP04_C "Fehlerpfad spezifische Umweltbedingungen fuer Fehlerpfad Dfp_BIP04" VAL_BLK 0x1CF6BC Kwb_Wu16 1152.00000000 SigName 0.00 1152.00000000 FORMAT "%13.8" NUMBER 8 /end CHARACTERISTIC
/begin CHARACTERISTIC DSM_EnvDfp_BIP05_C "Fehlerpfad spezifische Umweltbedingungen fuer Fehlerpfad Dfp_BIP05" VAL_BLK 0x1CF6CC Kwb_Wu16 1152.00000000 SigName 0.00 1152.00000000 FORMAT "%13.8" NUMBER 8 /end CHARACTERISTIC
/begin CHARACTERISTIC DSM_EnvDfp_BIP06_C "Fehlerpfad spezifische Umweltbedingungen fuer Fehlerpfad Dfp_BIP06" VAL_BLK 0x1CF6DC Kwb_Wu16 1152.00000000 SigName 0.00 1152.00000000 FORMAT "%13.8" NUMBER 8 /end CHARACTERISTIC
/begin CHARACTERISTIC DSM_EnvDfp_BIP07_C "Fehlerpfad spezifische Umweltbedingungen fuer Fehlerpfad Dfp_BIP07" VAL_BLK 0x1CF6EC Kwb_Wu16 1152.00000000 SigName 0.00 1152.00000000 FORMAT "%13.8" NUMBER 8 /end CHARACTERISTIC
/begin CHARACTERISTIC DSM_EnvDfp_BIP08_C "Fehlerpfad spezifische Umweltbedingungen fuer Fehlerpfad Dfp_BIP08" VAL_BLK 0x1CF6FC Kwb_Wu16 1152.00000000 SigName 0.00 1152.00000000 FORMAT "%13.8" NUMBER 8 /end CHARACTERISTIC
/begin CHARACTERISTIC DSM_EnvDfp_BIP09_C "Fehlerpfad spezifische Umweltbedingungen fuer Fehlerpfad Dfp_BIP09" VAL_BLK 0x1CF70C Kwb_Wu16 1152.00000000 SigName 0.00 1152.00000000 FORMAT "%13.8" NUMBER 8 /end CHARACTERISTIC
/begin CHARACTERISTIC DSM_EnvDfp_BIP10_C "Fehlerpfad spezifische Umweltbedingungen fuer Fehlerpfad Dfp_BIP10" VAL_BLK 0x1CF71C Kwb_Wu16 1152.00000000 SigName 0.00 1152.00000000 FORMAT "%13.8" NUMBER 8 /end CHARACTERISTIC
/begin CHARACTERISTIC DSM_EnvDfp_BIP11_C "Fehlerpfad spezifische Umweltbedingungen fuer Fehlerpfad Dfp_BIP11" VAL_BLK 0x1CF72C Kwb_Wu16 1152.00000000 SigName 0.00 1152.00000000 FORMAT "%13.8" NUMBER 8 /end CHARACTERISTIC
/begin CHARACTERISTIC DSM_EnvDfp_BIP12_C "Fehlerpfad spezifische Umweltbedingungen fuer Fehlerpfad Dfp_BIP12" VAL_BLK 0x1CF73C Kwb_Wu16 1152.00000000 SigName 0.00 1152.00000000 FORMAT "%13.8" NUMBER 8 /end CHARACTERISTIC
/begin CHARACTERISTIC DSM_EnvDfp_BIP_Con_C "Fehlerpfad spezifische Umweltbedingungen fuer Fehlerpfad Dfp_BIP_Con" VAL_BLK 0x1CF74C Kwb_Wu16 1152.00000000 SigName 0.00 1152.00000000 FORMAT "%13.8" NUMBER 8 /end CHARACTERISTIC
/begin CHARACTERISTIC DSM_EnvDfp_BPACD_Max_C "Fehlerpfad spezifische Umweltbedingungen fuer Fehlerpfad Dfp_BPACD_Max" VAL_BLK 0x1CF75C Kwb_Wu16 1152.00000000 SigName 0.00 1152.00000000 FORMAT "%13.8" NUMBER 8 /end CHARACTERISTIC
/begin CHARACTERISTIC DSM_EnvDfp_BPACD_Max2_C "Fehlerpfad spezifische Umweltbedingungen fuer Fehlerpfad Dfp_BPACD_Max2" VAL_BLK 0x1CF76C Kwb_Wu16 1152.00000000 SigName 0.00 1152.00000000 FORMAT "%13.8" NUMBER 8 /end CHARACTERISTIC
/begin CHARACTERISTIC DSM_EnvDfp_BPACD_Min_C "Fehlerpfad spezifische Umweltbedingungen fuer Fehlerpfad Dfp_BPACD_Min" VAL_BLK 0x1CF77C Kwb_Wu16 1152.00000000 SigName 0.00 1152.00000000 FORMAT "%13.8" NUMBER 8 /end CHARACTERISTIC
/begin CHARACTERISTIC DSM_EnvDfp_BPACD_Min2_C "Fehlerpfad spezifische Umweltbedingungen fuer Fehlerpfad Dfp_BPACD_Min2" VAL_BLK 0x1CF78C Kwb_Wu16 1152.00000000 SigName 0.00 1152.00000000 FORMAT "%13.8" NUMBER 8 /end CHARACTERISTIC
/begin CHARACTERISTIC DSM_EnvDfp_BPACD_SigNpl_C "Fehlerpfad spezifische Umweltbedingungen fuer Fehlerpfad Dfp_BPACD_SigNpl" VAL_BLK 0x1CF79C Kwb_Wu16 1152.00000000 SigName 0.00 1152.00000000 FORMAT "%13.8" NUMBER 8 /end CHARACTERISTIC
/begin CHARACTERISTIC DSM_EnvDfp_BPACD_SigNpl2_C "Fehlerpfad spezifische Umweltbedingungen fuer Fehlerpfad Dfp_BPACD_SigNpl2" VAL_BLK 0x1CF7AC Kwb_Wu16 1152.00000000 SigName 0.00 1152.00000000 FORMAT "%13.8" NUMBER 8 /end CHARACTERISTIC
/begin CHARACTERISTIC DSM_EnvDfp_BPASCD_C "Fehlerpfad spezifische Umweltbedingungen fuer Fehlerpfad Dfp_BPASCD" VAL_BLK 0x1CF7BC Kwb_Wu16 1152.00000000 SigName 0.00 1152.00000000 FORMAT "%13.8" NUMBER 8 /end CHARACTERISTIC
/begin CHARACTERISTIC DSM_EnvDfp_BPSCD_C "Fehlerpfad spezifische Umweltbedingungen fuer Fehlerpfad Dfp_BPSCD" VAL_BLK 0x1CF7CC Kwb_Wu16 1152.00000000 SigName 0.00 1152.00000000 FORMAT "%13.8" NUMBER 8 /end CHARACTERISTIC
/begin CHARACTERISTIC DSM_EnvDfp_BattCD_C "Fehlerpfad spezifische Umweltbedingungen fuer Fehlerpfad Dfp_BattCD" VAL_BLK 0x1CF7EC Kwb_Wu16 1152.00000000 SigName 0.00 1152.00000000 FORMAT "%13.8" NUMBER 8 /end CHARACTERISTIC
/begin CHARACTERISTIC DSM_EnvDfp_BrkCD_C "Fehlerpfad spezifische Umweltbedingungen fuer Fehlerpfad Dfp_BrkCD" VAL_BLK 0x1CF7FC Kwb_Wu16 1152.00000000 SigName 0.00 1152.00000000 FORMAT "%13.8" NUMBER 8 /end CHARACTERISTIC
/begin CHARACTERISTIC DSM_EnvDfp_BrkCDBPTInvld_C "Fehlerpfad spezifische Umweltbedingungen fuer Fehlerpfad Dfp_BrkCDBPTInvld" VAL_BLK 0x1CF80C Kwb_Wu16 1152.00000000 SigName 0.00 1152.00000000 FORMAT "%13.8" NUMBER 8 /end CHARACTERISTIC
/begin CHARACTERISTIC DSM_EnvDfp_BrkCDdynPl_C "Fehlerpfad spezifische Umweltbedingungen fuer Fehlerpfad Dfp_BrkCDdynPl" VAL_BLK 0x1CF81C Kwb_Wu16 1152.00000000 SigName 0.00 1152.00000000 FORMAT "%13.8" NUMBER 8 /end CHARACTERISTIC
/begin CHARACTERISTIC DSM_EnvDfp_CANA_C "Fehlerpfad spezifische Umweltbedingungen fuer Fehlerpfad Dfp_CANA" VAL_BLK 0x1CF82C Kwb_Wu16 1152.00000000 SigName 0.00 1152.00000000 FORMAT "%13.8" NUMBER 8 /end CHARACTERISTIC
/begin CHARACTERISTIC DSM_EnvDfp_CANB_C "Fehlerpfad spezifische Umweltbedingungen fuer Fehlerpfad Dfp_CANB" VAL_BLK 0x1CF83C Kwb_Wu16 1152.00000000 SigName 0.00 1152.00000000 FORMAT "%13.8" NUMBER 8 /end CHARACTERISTIC
/begin CHARACTERISTIC DSM_EnvDfp_CANBus1_C "Fehlerpfad spezifische Umweltbedingungen fuer Fehlerpfad Dfp_CANBus1" VAL_BLK 0x1CF84C Kwb_Wu16 1152.00000000 SigName 0.00 1152.00000000 FORMAT "%13.8" NUMBER 8 /end CHARACTERISTIC
/begin CHARACTERISTIC DSM_EnvDfp_CANBus2_C "Fehlerpfad spezifische Umweltbedingungen fuer Fehlerpfad Dfp_CANBus2" VAL_BLK 0x1CF85C Kwb_Wu16 1152.00000000 SigName 0.00 1152.00000000 FORMAT "%13.8" NUMBER 8 /end CHARACTERISTIC
/begin CHARACTERISTIC DSM_EnvDfp_CANBus3_C "Fehlerpfad spezifische Umweltbedingungen fuer Fehlerpfad Dfp_CANBus3" VAL_BLK 0x1CF86C Kwb_Wu16 1152.00000000 SigName 0.00 1152.00000000 FORMAT "%13.8" NUMBER 8 /end CHARACTERISTIC
/begin CHARACTERISTIC DSM_EnvDfp_CANC_C "Fehlerpfad spezifische Umweltbedingungen fuer Fehlerpfad Dfp_CANC" VAL_BLK 0x1CF87C Kwb_Wu16 1152.00000000 SigName 0.00 1152.00000000 FORMAT "%13.8" NUMBER 8 /end CHARACTERISTIC
/begin CHARACTERISTIC DSM_EnvDfp_CANErrActA_C "Fehlerpfad spezifische Umweltbedingungen fuer Fehlerpfad Dfp_CANErrActA" VAL_BLK 0x1CF88C Kwb_Wu16 1152.00000000 SigName 0.00 1152.00000000 FORMAT "%13.8" NUMBER 8 /end CHARACTERISTIC
/begin CHARACTERISTIC DSM_EnvDfp_CANErrActB_C "Fehlerpfad spezifische Umweltbedingungen fuer Fehlerpfad Dfp_CANErrActB" VAL_BLK 0x1CF89C Kwb_Wu16 1152.00000000 SigName 0.00 1152.00000000 FORMAT "%13.8" NUMBER 8 /end CHARACTERISTIC
/begin CHARACTERISTIC DSM_EnvDfp_CANErrActC_C "Fehlerpfad spezifische Umweltbedingungen fuer Fehlerpfad Dfp_CANErrActC" VAL_BLK 0x1CF8AC Kwb_Wu16 1152.00000000 SigName 0.00 1152.00000000 FORMAT "%13.8" NUMBER 8 /end CHARACTERISTIC
/begin CHARACTERISTIC DSM_EnvDfp_COTSCD_C "Fehlerpfad spezifische Umweltbedingungen fuer Fehlerpfad Dfp_COTSCD" VAL_BLK 0x1CF8BC Kwb_Wu16 1152.00000000 SigName 0.00 1152.00000000 FORMAT "%13.8" NUMBER 8 /end CHARACTERISTIC
/begin CHARACTERISTIC DSM_EnvDfp_CTSCD_C "Fehlerpfad spezifische Umweltbedingungen fuer Fehlerpfad Dfp_CTSCD" VAL_BLK 0x1CF8CC Kwb_Wu16 1152.00000000 SigName 0.00 1152.00000000 FORMAT "%13.8" NUMBER 8 /end CHARACTERISTIC
/begin CHARACTERISTIC DSM_EnvDfp_CTSCDCanInac_C "Fehlerpfad spezifische Umweltbedingungen fuer Fehlerpfad Dfp_CTSCDCanInac" VAL_BLK 0x1CF8DC Kwb_Wu16 1152.00000000 SigName 0.00 1152.00000000 FORMAT "%13.8" NUMBER 8 /end CHARACTERISTIC
/begin CHARACTERISTIC DSM_EnvDfp_CTSCDCanSig_C "Fehlerpfad spezifische Umweltbedingungen fuer Fehlerpfad Dfp_CTSCDCanSig" VAL_BLK 0x1CF8EC Kwb_Wu16 1152.00000000 SigName 0.00 1152.00000000 FORMAT "%13.8" NUMBER 8 /end CHARACTERISTIC
/begin CHARACTERISTIC DSM_EnvDfp_Clg_DynTst_C "Fehlerpfad spezifische Umweltbedingungen fuer Fehlerpfad Dfp_Clg_DynTst" VAL_BLK 0x1CF8FC Kwb_Wu16 1152.00000000 SigName 0.00 1152.00000000 FORMAT "%13.8" NUMBER 8 /end CHARACTERISTIC
/begin CHARACTERISTIC DSM_EnvDfp_CmbChbMisfire1_C "Fehlerpfad spezifische Umweltbedingungen fuer Fehlerpfad Dfp_CmbChbMisfire1" VAL_BLK 0x1CF90C Kwb_Wu16 1152.00000000 SigName 0.00 1152.00000000 FORMAT "%13.8" NUMBER 8 /end CHARACTERISTIC
/begin CHARACTERISTIC DSM_EnvDfp_CmbChbMisfire2_C "Fehlerpfad spezifische Umweltbedingungen fuer Fehlerpfad Dfp_CmbChbMisfire2" VAL_BLK 0x1CF91C Kwb_Wu16 1152.00000000 SigName 0.00 1152.00000000 FORMAT "%13.8" NUMBER 8 /end CHARACTERISTIC
/begin CHARACTERISTIC DSM_EnvDfp_CmbChbMisfire3_C "Fehlerpfad spezifische Umweltbedingungen fuer Fehlerpfad Dfp_CmbChbMisfire3" VAL_BLK 0x1CF92C Kwb_Wu16 1152.00000000 SigName 0.00 1152.00000000 FORMAT "%13.8" NUMBER 8 /end CHARACTERISTIC
/begin CHARACTERISTIC DSM_EnvDfp_CmbChbMisfire4_C "Fehlerpfad spezifische Umweltbedingungen fuer Fehlerpfad Dfp_CmbChbMisfire4" VAL_BLK 0x1CF93C Kwb_Wu16 1152.00000000 SigName 0.00 1152.00000000 FORMAT "%13.8" NUMBER 8 /end CHARACTERISTIC
/begin CHARACTERISTIC DSM_EnvDfp_CmbChbMisfire5_C "Fehlerpfad spezifische Umweltbedingungen fuer Fehlerpfad Dfp_CmbChbMisfire5" VAL_BLK 0x1CF94C Kwb_Wu16 1152.00000000 SigName 0.00 1152.00000000 FORMAT "%13.8" NUMBER 8 /end CHARACTERISTIC
/begin CHARACTERISTIC DSM_EnvDfp_CmbChbMisfire6_C "Fehlerpfad spezifische Umweltbedingungen fuer Fehlerpfad Dfp_CmbChbMisfire6" VAL_BLK 0x1CF95C Kwb_Wu16 1152.00000000 SigName 0.00 1152.00000000 FORMAT "%13.8" NUMBER 8 /end CHARACTERISTIC
/begin CHARACTERISTIC DSM_EnvDfp_CmbChbMisfireMul_C "Fehlerpfad spezifische Umweltbedingungen fuer Fehlerpfad Dfp_CmbChbMisfireMul" VAL_BLK 0x1CF96C Kwb_Wu16 1152.00000000 SigName 0.00 1152.00000000 FORMAT "%13.8" NUMBER 8 /end CHARACTERISTIC
/begin CHARACTERISTIC DSM_EnvDfp_CoVMDCSh_C "Fehlerpfad spezifische Umweltbedingungen fuer Fehlerpfad Dfp_CoVMDCSh" VAL_BLK 0x1CF98C Kwb_Wu16 1152.00000000 SigName 0.00 1152.00000000 FORMAT "%13.8" NUMBER 8 /end CHARACTERISTIC
/begin CHARACTERISTIC DSM_EnvDfp_CoVMDCSp_C "Fehlerpfad spezifische Umweltbedingungen fuer Fehlerpfad Dfp_CoVMDCSp" VAL_BLK 0x1CF99C Kwb_Wu16 1152.00000000 SigName 0.00 1152.00000000 FORMAT "%13.8" NUMBER 8 /end CHARACTERISTIC
/begin CHARACTERISTIC DSM_EnvDfp_CoVehLvl2_C "Fehlerpfad spezifische Umweltbedingungen fuer Fehlerpfad Dfp_CoVehLvl2" VAL_BLK 0x1CF9CC Kwb_Wu16 1152.00000000 SigName 0.00 1152.00000000 FORMAT "%13.8" NUMBER 8 /end CHARACTERISTIC
/begin CHARACTERISTIC DSM_EnvDfp_ConvCD_C "Fehlerpfad spezifische Umweltbedingungen fuer Fehlerpfad Dfp_ConvCD" VAL_BLK 0x1CF9DC Kwb_Wu16 1152.00000000 SigName 0.00 1152.00000000 FORMAT "%13.8" NUMBER 8 /end CHARACTERISTIC
/begin CHARACTERISTIC DSM_EnvDfp_ConvCD_ConvErr_C "Fehlerpfad spezifische Umweltbedingungen fuer Fehlerpfad Dfp_ConvCD_ConvErr" VAL_BLK 0x1CF9EC Kwb_Wu16 1152.00000000 SigName 0.00 1152.00000000 FORMAT "%13.8" NUMBER 8 /end CHARACTERISTIC
/begin CHARACTERISTIC DSM_EnvDfp_ConvCD_EPB1_C "Fehlerpfad spezifische Umweltbedingungen fuer Fehlerpfad Dfp_ConvCD_EPB1" VAL_BLK 0x1CF9FC Kwb_Wu16 1152.00000000 SigName 0.00 1152.00000000 FORMAT "%13.8" NUMBER 8 /end CHARACTERISTIC
/begin CHARACTERISTIC DSM_EnvDfp_CrCCDPanErrMSG_C "Fehlerpfad spezifische Umweltbedingungen fuer Fehlerpfad Dfp_CrCCDPanErrMSG" VAL_BLK 0x1CFA0C Kwb_Wu16 1152.00000000 SigName 0.00 1152.00000000 FORMAT "%13.8" NUMBER 8 /end CHARACTERISTIC
/begin CHARACTERISTIC DSM_EnvDfp_CrCCDPanErrSMLS_C "Fehlerpfad spezifische Umweltbedingungen fuer Fehlerpfad Dfp_CrCCDPanErrSMLS" VAL_BLK 0x1CFA1C Kwb_Wu16 1152.00000000 SigName 0.00 1152.00000000 FORMAT "%13.8" NUMBER 8 /end CHARACTERISTIC
/begin CHARACTERISTIC DSM_EnvDfp_CrCCDPanMainSwtErr_C "Fehlerpfad spezifische Umweltbedingungen fuer Fehlerpfad Dfp_CrCCDPanMainSwtErr" VAL_BLK 0x1CFA2C Kwb_Wu16 1152.00000000 SigName 0.00 1152.00000000 FORMAT "%13.8" NUMBER 8 /end CHARACTERISTIC
/begin CHARACTERISTIC DSM_EnvDfp_CrCtlDsplNotPlaus_C "Fehlerpfad spezifische Umweltbedingungen fuer Fehlerpfad Dfp_CrCtlDsplNotPlaus" VAL_BLK 0x1CFA4C Kwb_Wu16 1152.00000000 SigName 0.00 1152.00000000 FORMAT "%13.8" NUMBER 8 /end CHARACTERISTIC
/begin CHARACTERISTIC DSM_EnvDfp_CrCtlPECDErr_C "Fehlerpfad spezifische Umweltbedingungen fuer Fehlerpfad Dfp_CrCtlPECDErr" VAL_BLK 0x1CFA5C Kwb_Wu16 1152.00000000 SigName 0.00 1152.00000000 FORMAT "%13.8" NUMBER 8 /end CHARACTERISTIC
/begin CHARACTERISTIC DSM_EnvDfp_CrCtlPLmpDef_C "Fehlerpfad spezifische Umweltbedingungen fuer Fehlerpfad Dfp_CrCtlPLmpDef" VAL_BLK 0x1CFA6C Kwb_Wu16 1152.00000000 SigName 0.00 1152.00000000 FORMAT "%13.8" NUMBER 8 /end CHARACTERISTIC
/begin CHARACTERISTIC DSM_EnvDfp_CrCtlPShutOff_C "Fehlerpfad spezifische Umweltbedingungen fuer Fehlerpfad Dfp_CrCtlPShutOff" VAL_BLK 0x1CFA7C Kwb_Wu16 1152.00000000 SigName 0.00 1152.00000000 FORMAT "%13.8" NUMBER 8 /end CHARACTERISTIC
/begin CHARACTERISTIC DSM_EnvDfp_CrCtlPTlrDef_C "Fehlerpfad spezifische Umweltbedingungen fuer Fehlerpfad Dfp_CrCtlPTlrDef" VAL_BLK 0x1CFA8C Kwb_Wu16 1152.00000000 SigName 0.00 1152.00000000 FORMAT "%13.8" NUMBER 8 /end CHARACTERISTIC
/begin CHARACTERISTIC DSM_EnvDfp_CtApCD_C "Fehlerpfad spezifische Umweltbedingungen fuer Fehlerpfad Dfp_CtApCD" VAL_BLK 0x1CFAAC Kwb_Wu16 1152.00000000 SigName 0.00 1152.00000000 FORMAT "%13.8" NUMBER 8 /end CHARACTERISTIC
/begin CHARACTERISTIC DSM_EnvDfp_CtTCD_C "Fehlerpfad spezifische Umweltbedingungen fuer Fehlerpfad Dfp_CtTCD" VAL_BLK 0x1CFABC Kwb_Wu16 1152.00000000 SigName 0.00 1152.00000000 FORMAT "%13.8" NUMBER 8 /end CHARACTERISTIC
/begin CHARACTERISTIC DSM_EnvDfp_CtT_Mon_C "Fehlerpfad spezifische Umweltbedingungen fuer Fehlerpfad Dfp_CtT_Mon" VAL_BLK 0x1CFACC Kwb_Wu16 1152.00000000 SigName 0.00 1152.00000000 FORMAT "%13.8" NUMBER 8 /end CHARACTERISTIC
/begin CHARACTERISTIC DSM_EnvDfp_DifftrqLimErrPat_C "Fehlerpfad spezifische Umweltbedingungen fuer Fehlerpfad Dfp_DifftrqLimErrPat" VAL_BLK 0x1CFADC Kwb_Wu16 1152.00000000 SigName 0.00 1152.00000000 FORMAT "%13.8" NUMBER 8 /end CHARACTERISTIC
/begin CHARACTERISTIC DSM_EnvDfp_EATSCD_C "Fehlerpfad spezifische Umweltbedingungen fuer Fehlerpfad Dfp_EATSCD" VAL_BLK 0x1CFAEC Kwb_Wu16 1152.00000000 SigName 0.00 1152.00000000 FORMAT "%13.8" NUMBER 8 /end CHARACTERISTIC
/begin CHARACTERISTIC DSM_EnvDfp_EATSCDCanInac_C "Fehlerpfad spezifische Umweltbedingungen fuer Fehlerpfad Dfp_EATSCDCanInac" VAL_BLK 0x1CFAFC Kwb_Wu16 1152.00000000 SigName 0.00 1152.00000000 FORMAT "%13.8" NUMBER 8 /end CHARACTERISTIC
/begin CHARACTERISTIC DSM_EnvDfp_EATSCDCanSig_C "Fehlerpfad spezifische Umweltbedingungen fuer Fehlerpfad Dfp_EATSCDCanSig" VAL_BLK 0x1CFB0C Kwb_Wu16 1152.00000000 SigName 0.00 1152.00000000 FORMAT "%13.8" NUMBER 8 /end CHARACTERISTIC
/begin CHARACTERISTIC DSM_EnvDfp_EEPCDVarMng_C "Fehlerpfad spezifische Umweltbedingungen fuer Fehlerpfad Dfp_EEPCDVarMng" VAL_BLK 0x1CFB1C Kwb_Wu16 1152.00000000 SigName 0.00 1152.00000000 FORMAT "%13.8" NUMBER 8 /end CHARACTERISTIC
/begin CHARACTERISTIC DSM_EnvDfp_EGPpCDTPreTrbn_C "Fehlerpfad spezifische Umweltbedingungen fuer Fehlerpfad Dfp_EgPpCDTPreTrbn" VAL_BLK 0x1CFB2C Kwb_Wu16 1152.00000000 SigName 0.00 1152.00000000 FORMAT "%13.8" NUMBER 8 /end CHARACTERISTIC
/begin CHARACTERISTIC DSM_EnvDfp_EGRCD_CBV_C "Fehlerpfad spezifische Umweltbedingungen fuer Fehlerpfad Dfp_EGRCD_CBV" VAL_BLK 0x1CFB3C Kwb_Wu16 1152.00000000 SigName 0.00 1152.00000000 FORMAT "%13.8" NUMBER 8 /end CHARACTERISTIC
/begin CHARACTERISTIC DSM_EnvDfp_EGRCD_Max_C "Fehlerpfad spezifische Umweltbedingungen fuer Fehlerpfad Dfp_EGRCD_Max" VAL_BLK 0x1CFB4C Kwb_Wu16 1152.00000000 SigName 0.00 1152.00000000 FORMAT "%13.8" NUMBER 8 /end CHARACTERISTIC
/begin CHARACTERISTIC DSM_EnvDfp_EGRCD_Min_C "Fehlerpfad spezifische Umweltbedingungen fuer Fehlerpfad Dfp_EGRCD_Min" VAL_BLK 0x1CFB5C Kwb_Wu16 1152.00000000 SigName 0.00 1152.00000000 FORMAT "%13.8" NUMBER 8 /end CHARACTERISTIC
/begin CHARACTERISTIC DSM_EnvDfp_EGRCD_Sig_C "Fehlerpfad spezifische Umweltbedingungen fuer Fehlerpfad Dfp_EGRCD_Sig" VAL_BLK 0x1CFB6C Kwb_Wu16 1152.00000000 SigName 0.00 1152.00000000 FORMAT "%13.8" NUMBER 8 /end CHARACTERISTIC
/begin CHARACTERISTIC DSM_EnvDfp_EGRCD_SigNpl_C "Fehlerpfad spezifische Umweltbedingungen fuer Fehlerpfad Dfp_EGRCD_SigNpl" VAL_BLK 0x1CFB7C Kwb_Wu16 1152.00000000 SigName 0.00 1152.00000000 FORMAT "%13.8" NUMBER 8 /end CHARACTERISTIC
/begin CHARACTERISTIC DSM_EnvDfp_EGRSCD_C "Fehlerpfad spezifische Umweltbedingungen fuer Fehlerpfad Dfp_EGRSCD" VAL_BLK 0x1CFB8C Kwb_Wu16 1152.00000000 SigName 0.00 1152.00000000 FORMAT "%13.8" NUMBER 8 /end CHARACTERISTIC
/begin CHARACTERISTIC DSM_EnvDfp_EGRSCD_JamVlv_C "Fehlerpfad spezifische Umweltbedingungen fuer Fehlerpfad Dfp_EGRSCD_JamVlv" VAL_BLK 0x1CFB9C Kwb_Wu16 1152.00000000 SigName 0.00 1152.00000000 FORMAT "%13.8" NUMBER 8 /end CHARACTERISTIC
/begin CHARACTERISTIC DSM_EnvDfp_EGRSCD_LgTimeDrft_C "Fehlerpfad spezifische Umweltbedingungen fuer Fehlerpfad Dfp_EGRSCD_LgTimeDrft" VAL_BLK 0x1CFBAC Kwb_Wu16 1152.00000000 SigName 0.00 1152.00000000 FORMAT "%13.8" NUMBER 8 /end CHARACTERISTIC
/begin CHARACTERISTIC DSM_EnvDfp_EGRSCD_ShTimeDrft_C "Fehlerpfad spezifische Umweltbedingungen fuer Fehlerpfad Dfp_EGRSCD_ShTimeDrft" VAL_BLK 0x1CFBBC Kwb_Wu16 1152.00000000 SigName 0.00 1152.00000000 FORMAT "%13.8" NUMBER 8 /end CHARACTERISTIC
/begin CHARACTERISTIC DSM_EnvDfp_EGRVlvGvnrDvt_C "Fehlerpfad spezifische Umweltbedingungen fuer Fehlerpfad Dfp_EGRVlvGvnrDvt" VAL_BLK 0x1CFBCC Kwb_Wu16 1152.00000000 SigName 0.00 1152.00000000 FORMAT "%13.8" NUMBER 8 /end CHARACTERISTIC
/begin CHARACTERISTIC DSM_EnvDfp_EGRVlv_JamVlv_C "Fehlerpfad spezifische Umweltbedingungen fuer Fehlerpfad Dfp_EGRVlv_JamVlv" VAL_BLK 0x1CFBDC Kwb_Wu16 1152.00000000 SigName 0.00 1152.00000000 FORMAT "%13.8" NUMBER 8 /end CHARACTERISTIC
/begin CHARACTERISTIC DSM_EnvDfp_EMCCD_MLS1_C "Fehlerpfad spezifische Umweltbedingungen fuer Fehlerpfad Dfp_EMCCD_MLS1" VAL_BLK 0x1CFBEC Kwb_Wu16 1152.00000000 SigName 0.00 1152.00000000 FORMAT "%13.8" NUMBER 8 /end CHARACTERISTIC
/begin CHARACTERISTIC DSM_EnvDfp_EngMBackUp_C "Fehlerpfad spezifische Umweltbedingungen fuer Fehlerpfad Dfp_EngMBackUp" VAL_BLK 0x1CFBFC Kwb_Wu16 1152.00000000 SigName 0.00 1152.00000000 FORMAT "%13.8" NUMBER 8 /end CHARACTERISTIC
/begin CHARACTERISTIC DSM_EnvDfp_EngMCaS1_C "Fehlerpfad spezifische Umweltbedingungen fuer Fehlerpfad Dfp_EngMCaS1" VAL_BLK 0x1CFC0C Kwb_Wu16 1152.00000000 SigName 0.00 1152.00000000 FORMAT "%13.8" NUMBER 8 /end CHARACTERISTIC
/begin CHARACTERISTIC DSM_EnvDfp_EngMCaSDrv_C "Fehlerpfad spezifische Umweltbedingungen fuer Fehlerpfad Dfp_EngMCaSDrv" VAL_BLK 0x1CFC1C Kwb_Wu16 1152.00000000 SigName 0.00 1152.00000000 FORMAT "%13.8" NUMBER 8 /end CHARACTERISTIC
/begin CHARACTERISTIC DSM_EnvDfp_EngMCrS1_C "Fehlerpfad spezifische Umweltbedingungen fuer Fehlerpfad Dfp_EngMCrS1" VAL_BLK 0x1CFC2C Kwb_Wu16 1152.00000000 SigName 0.00 1152.00000000 FORMAT "%13.8" NUMBER 8 /end CHARACTERISTIC
/begin CHARACTERISTIC DSM_EnvDfp_EngMOfsCaSCrS_C "Fehlerpfad spezifische Umweltbedingungen fuer Fehlerpfad Dfp_EngMOfsCaSCrS" VAL_BLK 0x1CFC3C Kwb_Wu16 1152.00000000 SigName 0.00 1152.00000000 FORMAT "%13.8" NUMBER 8 /end CHARACTERISTIC
/begin CHARACTERISTIC DSM_EnvDfp_EngMonIrrCmb_C "Fehlerpfad spezifische Umweltbedingungen fuer Fehlerpfad Dfp_EngMonIrrCmb" VAL_BLK 0x1CFC4C Kwb_Wu16 1152.00000000 SigName 0.00 1152.00000000 FORMAT "%13.8" NUMBER 8 /end CHARACTERISTIC
/begin CHARACTERISTIC DSM_EnvDfp_EngPrt_C "Fehlerpfad spezifische Umweltbedingungen fuer Fehlerpfad Dfp_EngPrt" VAL_BLK 0x1CFC5C Kwb_Wu16 1152.00000000 SigName 0.00 1152.00000000 FORMAT "%13.8" NUMBER 8 /end CHARACTERISTIC
/begin CHARACTERISTIC DSM_EnvDfp_ErLpCDMILReqON_C "Fehlerpfad spezifische Umweltbedingungen fuer Fehlerpfad Dfp_ErLpCDMILReqON" VAL_BLK 0x1CFC6C Kwb_Wu16 1152.00000000 SigName 0.00 1152.00000000 FORMAT "%13.8" NUMBER 8 /end CHARACTERISTIC
/begin CHARACTERISTIC DSM_EnvDfp_FMAErrMod_C "Fehlerpfad spezifische Umweltbedingungen fuer Fehlerpfad Dfp_FMAErrMod" VAL_BLK 0x1CFC7C Kwb_Wu16 1152.00000000 SigName 0.00 1152.00000000 FORMAT "%13.8" NUMBER 8 /end CHARACTERISTIC
/begin CHARACTERISTIC DSM_EnvDfp_FMTC_NonMonotonMap_C "Fehlerpfad spezifische Umweltbedingungen fuer Fehlerpfad Dfp_FMTC_NonMonotonMap" VAL_BLK 0x1CFC8C Kwb_Wu16 1152.00000000 SigName 0.00 1152.00000000 FORMAT "%13.8" NUMBER 8 /end CHARACTERISTIC
/begin CHARACTERISTIC DSM_EnvDfp_FQTSCD_C "Fehlerpfad spezifische Umweltbedingungen fuer Fehlerpfad Dfp_FQTSCD" VAL_BLK 0x1CFC9C Kwb_Wu16 1152.00000000 SigName 0.00 1152.00000000 FORMAT "%13.8" NUMBER 8 /end CHARACTERISTIC
/begin CHARACTERISTIC DSM_EnvDfp_FQlSCD_C "Fehlerpfad spezifische Umweltbedingungen fuer Fehlerpfad Dfp_FQlSCD" VAL_BLK 0x1CFCAC Kwb_Wu16 1152.00000000 SigName 0.00 1152.00000000 FORMAT "%13.8" NUMBER 8 /end CHARACTERISTIC
/begin CHARACTERISTIC DSM_EnvDfp_FTSCD_C "Fehlerpfad spezifische Umweltbedingungen fuer Fehlerpfad Dfp_FTSCD" VAL_BLK 0x1CFCBC Kwb_Wu16 1152.00000000 SigName 0.00 1152.00000000 FORMAT "%13.8" NUMBER 8 /end CHARACTERISTIC
/begin CHARACTERISTIC DSM_EnvDfp_FTSCDNpl_C "Fehlerpfad spezifische Umweltbedingungen fuer Fehlerpfad Dfp_FTSCDNpl" VAL_BLK 0x1CFCCC Kwb_Wu16 1152.00000000 SigName 0.00 1152.00000000 FORMAT "%13.8" NUMBER 8 /end CHARACTERISTIC
/begin CHARACTERISTIC DSM_EnvDfp_FanCD_Fan1Ctlr1_C "Fehlerpfad spezifische Umweltbedingungen fuer Fehlerpfad Dfp_FanCD_Fan1Ctlr1" VAL_BLK 0x1CFCDC Kwb_Wu16 1152.00000000 SigName 0.00 1152.00000000 FORMAT "%13.8" NUMBER 8 /end CHARACTERISTIC
/begin CHARACTERISTIC DSM_EnvDfp_FanCD_Fan1Ctlr2_C "Fehlerpfad spezifische Umweltbedingungen fuer Fehlerpfad Dfp_FanCD_Fan1Ctlr2" VAL_BLK 0x1CFCEC Kwb_Wu16 1152.00000000 SigName 0.00 1152.00000000 FORMAT "%13.8" NUMBER 8 /end CHARACTERISTIC
/begin CHARACTERISTIC DSM_EnvDfp_FanCD_Fan2Ctlr1_C "Fehlerpfad spezifische Umweltbedingungen fuer Fehlerpfad Dfp_FanCD_Fan2Ctlr1" VAL_BLK 0x1CFCFC Kwb_Wu16 1152.00000000 SigName 0.00 1152.00000000 FORMAT "%13.8" NUMBER 8 /end CHARACTERISTIC
/begin CHARACTERISTIC DSM_EnvDfp_FanCD_Fan2Ctlr2_C "Fehlerpfad spezifische Umweltbedingungen fuer Fehlerpfad Dfp_FanCD_Fan2Ctlr2" VAL_BLK 0x1CFD0C Kwb_Wu16 1152.00000000 SigName 0.00 1152.00000000 FORMAT "%13.8" NUMBER 8 /end CHARACTERISTIC
/begin CHARACTERISTIC DSM_EnvDfp_FanCD_FanCtlr1_C "Fehlerpfad spezifische Umweltbedingungen fuer Fehlerpfad Dfp_FanCD_FanCtlr1" VAL_BLK 0x1CFD1C Kwb_Wu16 1152.00000000 SigName 0.00 1152.00000000 FORMAT "%13.8" NUMBER 8 /end CHARACTERISTIC
/begin CHARACTERISTIC DSM_EnvDfp_FanCD_FanCtlr2_C "Fehlerpfad spezifische Umweltbedingungen fuer Fehlerpfad Dfp_FanCD_FanCtlr2" VAL_BLK 0x1CFD2C Kwb_Wu16 1152.00000000 SigName 0.00 1152.00000000 FORMAT "%13.8" NUMBER 8 /end CHARACTERISTIC
/begin CHARACTERISTIC DSM_EnvDfp_FanCD_OutFanCtlr1_C "Fehlerpfad spezifische Umweltbedingungen fuer Fehlerpfad Dfp_FanCD_OutFanCtlr1" VAL_BLK 0x1CFD3C Kwb_Wu16 1152.00000000 SigName 0.00 1152.00000000 FORMAT "%13.8" NUMBER 8 /end CHARACTERISTIC
/begin CHARACTERISTIC DSM_EnvDfp_FanCD_OutFanCtlr2_C "Fehlerpfad spezifische Umweltbedingungen fuer Fehlerpfad Dfp_FanCD_OutFanCtlr2" VAL_BLK 0x1CFD4C Kwb_Wu16 1152.00000000 SigName 0.00 1152.00000000 FORMAT "%13.8" NUMBER 8 /end CHARACTERISTIC
/begin CHARACTERISTIC DSM_EnvDfp_FlPpCD_C "Fehlerpfad spezifische Umweltbedingungen fuer Fehlerpfad Dfp_FlPpCD" VAL_BLK 0x1CFD6C Kwb_Wu16 1152.00000000 SigName 0.00 1152.00000000 FORMAT "%13.8" NUMBER 8 /end CHARACTERISTIC
/begin CHARACTERISTIC DSM_EnvDfp_FlSCDT1_C "Fehlerpfad spezifische Umweltbedingungen fuer Fehlerpfad Dfp_FlSCDT1" VAL_BLK 0x1CFD7C Kwb_Wu16 1152.00000000 SigName 0.00 1152.00000000 FORMAT "%13.8" NUMBER 8 /end CHARACTERISTIC
/begin CHARACTERISTIC DSM_EnvDfp_FrmMngAAGNpl_C "Fehlerpfad spezifische Umweltbedingungen fuer Fehlerpfad Dfp_FrmMngAAGNpl" VAL_BLK 0x1CFD8C Kwb_Wu16 1152.00000000 SigName 0.00 1152.00000000 FORMAT "%13.8" NUMBER 8 /end CHARACTERISTIC
/begin CHARACTERISTIC DSM_EnvDfp_FrmMngAAGTO_C "Fehlerpfad spezifische Umweltbedingungen fuer Fehlerpfad Dfp_FrmMngAAGTO" VAL_BLK 0x1CFD9C Kwb_Wu16 1152.00000000 SigName 0.00 1152.00000000 FORMAT "%13.8" NUMBER 8 /end CHARACTERISTIC
/begin CHARACTERISTIC DSM_EnvDfp_FrmMngAC1Npl_C "Fehlerpfad spezifische Umweltbedingungen fuer Fehlerpfad Dfp_FrmMngAC1Npl" VAL_BLK 0x1CFDAC Kwb_Wu16 1152.00000000 SigName 0.00 1152.00000000 FORMAT "%13.8" NUMBER 8 /end CHARACTERISTIC
/begin CHARACTERISTIC DSM_EnvDfp_FrmMngAC1TO_C "Fehlerpfad spezifische Umweltbedingungen fuer Fehlerpfad Dfp_FrmMngAC1TO" VAL_BLK 0x1CFDBC Kwb_Wu16 1152.00000000 SigName 0.00 1152.00000000 FORMAT "%13.8" NUMBER 8 /end CHARACTERISTIC
/begin CHARACTERISTIC DSM_EnvDfp_FrmMngACCNpl_C "Fehlerpfad spezifische Umweltbedingungen fuer Fehlerpfad Dfp_FrmMngACCNpl" VAL_BLK 0x1CFDCC Kwb_Wu16 1152.00000000 SigName 0.00 1152.00000000 FORMAT "%13.8" NUMBER 8 /end CHARACTERISTIC
/begin CHARACTERISTIC DSM_EnvDfp_FrmMngACCTO_C "Fehlerpfad spezifische Umweltbedingungen fuer Fehlerpfad Dfp_FrmMngACCTO" VAL_BLK 0x1CFDDC Kwb_Wu16 1152.00000000 SigName 0.00 1152.00000000 FORMAT "%13.8" NUMBER 8 /end CHARACTERISTIC
/begin CHARACTERISTIC DSM_EnvDfp_FrmMngAIRBGNpl_C "Fehlerpfad spezifische Umweltbedingungen fuer Fehlerpfad Dfp_FrmMngAIRBGNpl" VAL_BLK 0x1CFDEC Kwb_Wu16 1152.00000000 SigName 0.00 1152.00000000 FORMAT "%13.8" NUMBER 8 /end CHARACTERISTIC
/begin CHARACTERISTIC DSM_EnvDfp_FrmMngAIRBGTO_C "Fehlerpfad spezifische Umweltbedingungen fuer Fehlerpfad Dfp_FrmMngAIRBGTO" VAL_BLK 0x1CFDFC Kwb_Wu16 1152.00000000 SigName 0.00 1152.00000000 FORMAT "%13.8" NUMBER 8 /end CHARACTERISTIC
/begin CHARACTERISTIC DSM_EnvDfp_FrmMngAWD1Npl_C "Fehlerpfad spezifische Umweltbedingungen fuer Fehlerpfad Dfp_FrmMngAWD1Npl" VAL_BLK 0x1CFE0C Kwb_Wu16 1152.00000000 SigName 0.00 1152.00000000 FORMAT "%13.8" NUMBER 8 /end CHARACTERISTIC
/begin CHARACTERISTIC DSM_EnvDfp_FrmMngAWD1TO_C "Fehlerpfad spezifische Umweltbedingungen fuer Fehlerpfad Dfp_FrmMngAWD1TO" VAL_BLK 0x1CFE1C Kwb_Wu16 1152.00000000 SigName 0.00 1152.00000000 FORMAT "%13.8" NUMBER 8 /end CHARACTERISTIC
/begin CHARACTERISTIC DSM_EnvDfp_FrmMngBEM1Npl_C "Fehlerpfad spezifische Umweltbedingungen für Fehlerpfad Dfp_FrmMngBEM1Npl" VAL_BLK 0x1CFE2C Kwb_Wu16 1152.00000000 SigName 0.00 1152.00000000 FORMAT "%13.8" NUMBER 8 /end CHARACTERISTIC
/begin CHARACTERISTIC DSM_EnvDfp_FrmMngBEM1TO_C "Fehlerpfad spezifische Umweltbedingungen fuer Fehlerpfad Dfp_FrmMngBEM1TO" VAL_BLK 0x1CFE3C Kwb_Wu16 1152.00000000 SigName 0.00 1152.00000000 FORMAT "%13.8" NUMBER 8 /end CHARACTERISTIC
/begin CHARACTERISTIC DSM_EnvDfp_FrmMngBRK1Npl_C "Fehlerpfad spezifische Umweltbedingungen fuer Fehlerpfad Dfp_FrmMngBRK1Npl" VAL_BLK 0x1CFE4C Kwb_Wu16 1152.00000000 SigName 0.00 1152.00000000 FORMAT "%13.8" NUMBER 8 /end CHARACTERISTIC
/begin CHARACTERISTIC DSM_EnvDfp_FrmMngBRK1TO_C "Fehlerpfad spezifische Umweltbedingungen fuer Fehlerpfad Dfp_FrmMngBRK1TO" VAL_BLK 0x1CFE5C Kwb_Wu16 1152.00000000 SigName 0.00 1152.00000000 FORMAT "%13.8" NUMBER 8 /end CHARACTERISTIC
/begin CHARACTERISTIC DSM_EnvDfp_FrmMngBRK2Npl_C "Fehlerpfad spezifische Umweltbedingungen fuer Fehlerpfad Dfp_FrmMngBRK2Npl" VAL_BLK 0x1CFE6C Kwb_Wu16 1152.00000000 SigName 0.00 1152.00000000 FORMAT "%13.8" NUMBER 8 /end CHARACTERISTIC
/begin CHARACTERISTIC DSM_EnvDfp_FrmMngBRK2TO_C "Fehlerpfad spezifische Umweltbedingungen fuer Fehlerpfad Dfp_FrmMngBRK2TO" VAL_BLK 0x1CFE7C Kwb_Wu16 1152.00000000 SigName 0.00 1152.00000000 FORMAT "%13.8" NUMBER 8 /end CHARACTERISTIC
/begin CHARACTERISTIC DSM_EnvDfp_FrmMngBRK8Npl_C "Fehlerpfad spezifische Umweltbedingungen fuer Fehlerpfad Dfp_FrmMngBRK8Npl" VAL_BLK 0x1CFE8C Kwb_Wu16 1152.00000000 SigName 0.00 1152.00000000 FORMAT "%13.8" NUMBER 8 /end CHARACTERISTIC
/begin CHARACTERISTIC DSM_EnvDfp_FrmMngBRK8TO_C "Fehlerpfad spezifische Umweltbedingungen fuer Fehlerpfad Dfp_FrmMngBRK8TO" VAL_BLK 0x1CFE9C Kwb_Wu16 1152.00000000 SigName 0.00 1152.00000000 FORMAT "%13.8" NUMBER 8 /end CHARACTERISTIC
/begin CHARACTERISTIC DSM_EnvDfp_FrmMngBSG3TO_C "Fehlerpfad spezifische Umweltbedingungen fuer Fehlerpfad Dfp_FrmMngBSG3TO" VAL_BLK 0x1CFEAC Kwb_Wu16 1152.00000000 SigName 0.00 1152.00000000 FORMAT "%13.8" NUMBER 8 /end CHARACTERISTIC
/begin CHARACTERISTIC DSM_EnvDfp_FrmMngCANVerErr_C "Fehlerpfad spezifische Umweltbedingungen fuer Fehlerpfad Dfp_FrmMngCANVerErr" VAL_BLK 0x1CFEBC Kwb_Wu16 1152.00000000 SigName 0.00 1152.00000000 FORMAT "%13.8" NUMBER 8 /end CHARACTERISTIC
/begin CHARACTERISTIC DSM_EnvDfp_FrmMngCCSel_C "Fehlerpfad spezifische Umweltbedingungen fuer Fehlerpfad Dfp_FrmMngCCSel_C" VAL_BLK 0x1CFECC Kwb_Wu16 1152.00000000 SigName 0.00 1152.00000000 FORMAT "%13.8" NUMBER 8 /end CHARACTERISTIC
/begin CHARACTERISTIC DSM_EnvDfp_FrmMngCCTLNpl_C "Fehlerpfad spezifische Umweltbedingungen fuer Fehlerpfad Dfp_FrmMngCCTLNpl" VAL_BLK 0x1CFEDC Kwb_Wu16 1152.00000000 SigName 0.00 1152.00000000 FORMAT "%13.8" NUMBER 8 /end CHARACTERISTIC
/begin CHARACTERISTIC DSM_EnvDfp_FrmMngCCTLTO_C "Fehlerpfad spezifische Umweltbedingungen fuer Fehlerpfad Dfp_FrmMngCCTLTO" VAL_BLK 0x1CFEEC Kwb_Wu16 1152.00000000 SigName 0.00 1152.00000000 FORMAT "%13.8" NUMBER 8 /end CHARACTERISTIC
/begin CHARACTERISTIC DSM_EnvDfp_FrmMngCHRGR1Npl_C "Fehlerpfad spezifische Umweltbedingungen fuer Fehlerpfad Dfp_FrmMngCHRGR1Npl" VAL_BLK 0x1CFEFC Kwb_Wu16 1152.00000000 SigName 0.00 1152.00000000 FORMAT "%13.8" NUMBER 8 /end CHARACTERISTIC
/begin CHARACTERISTIC DSM_EnvDfp_FrmMngCHRGR1TO_C "Fehlerpfad spezifische Umweltbedingungen fuer Fehlerpfad Dfp_FrmMngCHRGR1TO" VAL_BLK 0x1CFF0C Kwb_Wu16 1152.00000000 SigName 0.00 1152.00000000 FORMAT "%13.8" NUMBER 8 /end CHARACTERISTIC
/begin CHARACTERISTIC DSM_EnvDfp_FrmMngCHRGR2Npl_C "Fehlerpfad spezifische Umweltbedingungen fuer Fehlerpfad Dfp_FrmMngCHRGR2Npl" VAL_BLK 0x1CFF1C Kwb_Wu16 1152.00000000 SigName 0.00 1152.00000000 FORMAT "%13.8" NUMBER 8 /end CHARACTERISTIC
/begin CHARACTERISTIC DSM_EnvDfp_FrmMngCHRGR2TO_C "Fehlerpfad spezifische Umweltbedingungen fuer Fehlerpfad Dfp_FrmMngCHRGR2TO" VAL_BLK 0x1CFF2C Kwb_Wu16 1152.00000000 SigName 0.00 1152.00000000 FORMAT "%13.8" NUMBER 8 /end CHARACTERISTIC
/begin CHARACTERISTIC DSM_EnvDfp_FrmMngChrgr1A_C "Fehlerpfad spezifische Umweltbedingungen fuer Fehlerpfad Dfp_FrmMngChrgr1A" VAL_BLK 0x1CFF3C Kwb_Wu16 1152.00000000 SigName 0.00 1152.00000000 FORMAT "%13.8" NUMBER 8 /end CHARACTERISTIC
/begin CHARACTERISTIC DSM_EnvDfp_FrmMngChrgr1C_C "Fehlerpfad spezifische Umweltbedingungen fuer Fehlerpfad Dfp_FrmMngChrgr1C" VAL_BLK 0x1CFF4C Kwb_Wu16 1152.00000000 SigName 0.00 1152.00000000 FORMAT "%13.8" NUMBER 8 /end CHARACTERISTIC
/begin CHARACTERISTIC DSM_EnvDfp_FrmMngChrgr1N_C "Fehlerpfad spezifische Umweltbedingungen fuer Fehlerpfad Dfp_FrmMngChrgr1N" VAL_BLK 0x1CFF5C Kwb_Wu16 1152.00000000 SigName 0.00 1152.00000000 FORMAT "%13.8" NUMBER 8 /end CHARACTERISTIC
/begin CHARACTERISTIC DSM_EnvDfp_FrmMngChrgr1T_C "Fehlerpfad spezifische Umweltbedingungen fuer Fehlerpfad Dfp_FrmMngChrgr1T" VAL_BLK 0x1CFF6C Kwb_Wu16 1152.00000000 SigName 0.00 1152.00000000 FORMAT "%13.8" NUMBER 8 /end CHARACTERISTIC
/begin CHARACTERISTIC DSM_EnvDfp_FrmMngChrgr1V_C "Fehlerpfad spezifische Umweltbedingungen fuer Fehlerpfad Dfp_FrmMngChrgr1V" VAL_BLK 0x1CFF7C Kwb_Wu16 1152.00000000 SigName 0.00 1152.00000000 FORMAT "%13.8" NUMBER 8 /end CHARACTERISTIC
/begin CHARACTERISTIC DSM_EnvDfp_FrmMngChrgr2A_C "Fehlerpfad spezifische Umweltbedingungen fuer Fehlerpfad Dfp_FrmMngChrgr2A" VAL_BLK 0x1CFF8C Kwb_Wu16 1152.00000000 SigName 0.00 1152.00000000 FORMAT "%13.8" NUMBER 8 /end CHARACTERISTIC
/begin CHARACTERISTIC DSM_EnvDfp_FrmMngChrgr2C_C "Fehlerpfad spezifische Umweltbedingungen fuer Fehlerpfad Dfp_FrmMngChrgr2C" VAL_BLK 0x1CFF9C Kwb_Wu16 1152.00000000 SigName 0.00 1152.00000000 FORMAT "%13.8" NUMBER 8 /end CHARACTERISTIC
/begin CHARACTERISTIC DSM_EnvDfp_FrmMngChrgr2N_C "Fehlerpfad spezifische Umweltbedingungen fuer Fehlerpfad Dfp_FrmMngChrgr2N" VAL_BLK 0x1CFFAC Kwb_Wu16 1152.00000000 SigName 0.00 1152.00000000 FORMAT "%13.8" NUMBER 8 /end CHARACTERISTIC
/begin CHARACTERISTIC DSM_EnvDfp_FrmMngChrgr2T_C "Fehlerpfad spezifische Umweltbedingungen fuer Fehlerpfad Dfp_FrmMngChrgr2T" VAL_BLK 0x1CFFBC Kwb_Wu16 1152.00000000 SigName 0.00 1152.00000000 FORMAT "%13.8" NUMBER 8 /end CHARACTERISTIC
/begin CHARACTERISTIC DSM_EnvDfp_FrmMngChrgr2V_C "Fehlerpfad spezifische Umweltbedingungen fuer Fehlerpfad Dfp_FrmMngChrgr2V" VAL_BLK 0x1CFFCC Kwb_Wu16 1152.00000000 SigName 0.00 1152.00000000 FORMAT "%13.8" NUMBER 8 /end CHARACTERISTIC
/begin CHARACTERISTIC DSM_EnvDfp_FrmMngDIA1Npl_C "Fehlerpfad spezifische Umweltbedingungen fuer Fehlerpfad Dfp_FrmMngDIA1Npl" VAL_BLK 0x1CFFDC Kwb_Wu16 1152.00000000 SigName 0.00 1152.00000000 FORMAT "%13.8" NUMBER 8 /end CHARACTERISTIC
/begin CHARACTERISTIC DSM_EnvDfp_FrmMngDIA1TO_C "Fehlerpfad spezifische Umweltbedingungen fuer Fehlerpfad Dfp_FrmMngDIA1TO" VAL_BLK 0x1CFFEC Kwb_Wu16 1152.00000000 SigName 0.00 1152.00000000 FORMAT "%13.8" NUMBER 8 /end CHARACTERISTIC
/begin CHARACTERISTIC DSM_EnvDfp_FrmMngDSP1Npl_C "Fehlerpfad spezifische Umweltbedingungen fuer Fehlerpfad Dfp_FrmMngDSP1Npl" VAL_BLK 0x1CFFFC Kwb_Wu16 1152.00000000 SigName 0.00 1152.00000000 FORMAT "%13.8" NUMBER 8 /end CHARACTERISTIC
/begin CHARACTERISTIC DSM_EnvDfp_FrmMngDSP1TO_C "Fehlerpfad spezifische Umweltbedingungen fuer Fehlerpfad Dfp_FrmMngDSP1TO" VAL_BLK 0x1D000C Kwb_Wu16 1152.00000000 SigName 0.00 1152.00000000 FORMAT "%13.8" NUMBER 8 /end CHARACTERISTIC
/begin CHARACTERISTIC DSM_EnvDfp_FrmMngDSP2Npl_C "Fehlerpfad spezifische Umweltbedingungen fuer Fehlerpfad Dfp_FrmMngDSP2Npl" VAL_BLK 0x1D001C Kwb_Wu16 1152.00000000 SigName 0.00 1152.00000000 FORMAT "%13.8" NUMBER 8 /end CHARACTERISTIC
/begin CHARACTERISTIC DSM_EnvDfp_FrmMngDSP2TO_C "Fehlerpfad spezifische Umweltbedingungen fuer Fehlerpfad Dfp_FrmMngDSP2TO" VAL_BLK 0x1D002C Kwb_Wu16 1152.00000000 SigName 0.00 1152.00000000 FORMAT "%13.8" NUMBER 8 /end CHARACTERISTIC
/begin CHARACTERISTIC DSM_EnvDfp_FrmMngDSP3Npl_C "Fehlerpfad spezifische Umweltbedingungen fuer Fehlerpfad Dfp_FrmMngDSP3Npl" VAL_BLK 0x1D003C Kwb_Wu16 1152.00000000 SigName 0.00 1152.00000000 FORMAT "%13.8" NUMBER 8 /end CHARACTERISTIC
/begin CHARACTERISTIC DSM_EnvDfp_FrmMngDSP3TO_C "Fehlerpfad spezifische Umweltbedingungen fuer Fehlerpfad Dfp_FrmMngDSP3TO" VAL_BLK 0x1D004C Kwb_Wu16 1152.00000000 SigName 0.00 1152.00000000 FORMAT "%13.8" NUMBER 8 /end CHARACTERISTIC
/begin CHARACTERISTIC DSM_EnvDfp_FrmMngEPB1Npl_C "Fehlerpfad spezifische Umweltbedingungen fuer Fehlerpfad Dfp_FrmMngEPB1Npl" VAL_BLK 0x1D005C Kwb_Wu16 1152.00000000 SigName 0.00 1152.00000000 FORMAT "%13.8" NUMBER 8 /end CHARACTERISTIC
/begin CHARACTERISTIC DSM_EnvDfp_FrmMngEPB1TO_C "Fehlerpfad spezifische Umweltbedingungen fuer Fehlerpfad Dfp_FrmMngEPB1TO" VAL_BLK 0x1D006C Kwb_Wu16 1152.00000000 SigName 0.00 1152.00000000 FORMAT "%13.8" NUMBER 8 /end CHARACTERISTIC
/begin CHARACTERISTIC DSM_EnvDfp_FrmMngESCUNpl_C "Fehlerpfad spezifische Umweltbedingungen fuer Fehlerpfad Dfp_FrmMngESCUNpl" VAL_BLK 0x1D007C Kwb_Wu16 1152.00000000 SigName 0.00 1152.00000000 FORMAT "%13.8" NUMBER 8 /end CHARACTERISTIC
/begin CHARACTERISTIC DSM_EnvDfp_FrmMngESCUTO_C "Fehlerpfad spezifische Umweltbedingungen fuer Fehlerpfad Dfp_FrmMngESCUTO" VAL_BLK 0x1D008C Kwb_Wu16 1152.00000000 SigName 0.00 1152.00000000 FORMAT "%13.8" NUMBER 8 /end CHARACTERISTIC
/begin CHARACTERISTIC DSM_EnvDfp_FrmMngGW1Npl_C "Fehlerpfad spezifische Umweltbedingungen fuer Fehlerpfad Dfp_FrmMngGW1Npl" VAL_BLK 0x1D00AC Kwb_Wu16 1152.00000000 SigName 0.00 1152.00000000 FORMAT "%13.8" NUMBER 8 /end CHARACTERISTIC
/begin CHARACTERISTIC DSM_EnvDfp_FrmMngGW1TO_C "Fehlerpfad spezifische Umweltbedingungen fuer Fehlerpfad Dfp_FrmMngGW1TO" VAL_BLK 0x1D00BC Kwb_Wu16 1152.00000000 SigName 0.00 1152.00000000 FORMAT "%13.8" NUMBER 8 /end CHARACTERISTIC
/begin CHARACTERISTIC DSM_EnvDfp_FrmMngILMNpl_C "Fehlerpfad spezifische Umweltbedingungen fuer Fehlerpfad Dfp_FrmMngILMNpl" VAL_BLK 0x1D00CC Kwb_Wu16 1152.00000000 SigName 0.00 1152.00000000 FORMAT "%13.8" NUMBER 8 /end CHARACTERISTIC
/begin CHARACTERISTIC DSM_EnvDfp_FrmMngILMTO_C "Fehlerpfad spezifische Umweltbedingungen fuer Fehlerpfad Dfp_FrmMngILMTO" VAL_BLK 0x1D00DC Kwb_Wu16 1152.00000000 SigName 0.00 1152.00000000 FORMAT "%13.8" NUMBER 8 /end CHARACTERISTIC
/begin CHARACTERISTIC DSM_EnvDfp_FrmMngLICHT2TO_C "Fehlerpfad spezifische Umweltbedingungen fuer Fehlerpfad Dfp_FrmMngLICHT2TO" VAL_BLK 0x1D00FC Kwb_Wu16 1152.00000000 SigName 0.00 1152.00000000 FORMAT "%13.8" NUMBER 8 /end CHARACTERISTIC
/begin CHARACTERISTIC DSM_EnvDfp_FrmMngNIV1WrngCod_C "Fehlerpfad spezifische Umweltbedingungen fuer Fehlerpfad Dfp_FrmMngNIV1WrngCod" VAL_BLK 0x1D010C Kwb_Wu16 1152.00000000 SigName 0.00 1152.00000000 FORMAT "%13.8" NUMBER 8 /end CHARACTERISTIC
/begin CHARACTERISTIC DSM_EnvDfp_FrmMngNIVEAU1Npl_C "Fehlerpfad spezifische Umweltbedingungen fuer Fehlerpfad Dfp_FrmMngNIVEAU1Npl" VAL_BLK 0x1D011C Kwb_Wu16 1152.00000000 SigName 0.00 1152.00000000 FORMAT "%13.8" NUMBER 8 /end CHARACTERISTIC
/begin CHARACTERISTIC DSM_EnvDfp_FrmMngNIVEAU1TO_C "Fehlerpfad spezifische Umweltbedingungen fuer Fehlerpfad Dfp_FrmMngNIVEAU1TO" VAL_BLK 0x1D012C Kwb_Wu16 1152.00000000 SigName 0.00 1152.00000000 FORMAT "%13.8" NUMBER 8 /end CHARACTERISTIC
/begin CHARACTERISTIC DSM_EnvDfp_FrmMngSA1Npl_C "Fehlerpfad spezifische Umweltbedingungen fuer Fehlerpfad Dfp_FrmMngSA1Npl" VAL_BLK 0x1D013C Kwb_Wu16 1152.00000000 SigName 0.00 1152.00000000 FORMAT "%13.8" NUMBER 8 /end CHARACTERISTIC
/begin CHARACTERISTIC DSM_EnvDfp_FrmMngSA1TO_C "Fehlerpfad spezifische Umweltbedingungen fuer Fehlerpfad Dfp_FrmMngSA1TO" VAL_BLK 0x1D014C Kwb_Wu16 1152.00000000 SigName 0.00 1152.00000000 FORMAT "%13.8" NUMBER 8 /end CHARACTERISTIC
/begin CHARACTERISTIC DSM_EnvDfp_FrmMngSTIGNNpl_C "Fehlerpfad spezifische Umweltbedingungen fuer Fehlerpfad Dfp_FrmMngSTIGNNpl" VAL_BLK 0x1D015C Kwb_Wu16 1152.00000000 SigName 0.00 1152.00000000 FORMAT "%13.8" NUMBER 8 /end CHARACTERISTIC
/begin CHARACTERISTIC DSM_EnvDfp_FrmMngStIgnTO_C "Fehlerpfad spezifische Umweltbedingungen fuer Fehlerpfad Dfp_FrmMngStIgnTO" VAL_BLK 0x1D016C Kwb_Wu16 1152.00000000 SigName 0.00 1152.00000000 FORMAT "%13.8" NUMBER 8 /end CHARACTERISTIC
/begin CHARACTERISTIC DSM_EnvDfp_FrmMngTOSNpl_C "Fehlerpfad spezifische Umweltbedingungen fuer Fehlerpfad Dfp_FrmMngTOSNpl" VAL_BLK 0x1D017C Kwb_Wu16 1152.00000000 SigName 0.00 1152.00000000 FORMAT "%13.8" NUMBER 8 /end CHARACTERISTIC
/begin CHARACTERISTIC DSM_EnvDfp_FrmMngTOSTO_C "Fehlerpfad spezifische Umweltbedingungen fuer Fehlerpfad Dfp_FrmMngTOSTO" VAL_BLK 0x1D018C Kwb_Wu16 1152.00000000 SigName 0.00 1152.00000000 FORMAT "%13.8" NUMBER 8 /end CHARACTERISTIC
/begin CHARACTERISTIC DSM_EnvDfp_FrmMngTSC1Npl_C "Fehlerpfad spezifische Umweltbedingungen fuer Fehlerpfad Dfp_FrmMngTSC1Npl" VAL_BLK 0x1D019C Kwb_Wu16 1152.00000000 SigName 0.00 1152.00000000 FORMAT "%13.8" NUMBER 8 /end CHARACTERISTIC
/begin CHARACTERISTIC DSM_EnvDfp_FrmMngTSC1TO_C "Fehlerpfad spezifische Umweltbedingungen fuer Fehlerpfad Dfp_FrmMngTSC1TO" VAL_BLK 0x1D01AC Kwb_Wu16 1152.00000000 SigName 0.00 1152.00000000 FORMAT "%13.8" NUMBER 8 /end CHARACTERISTIC
/begin CHARACTERISTIC DSM_EnvDfp_FrmMngTSC2Npl_C "Fehlerpfad spezifische Umweltbedingungen fuer Fehlerpfad Dfp_FrmMngTSC2Npl" VAL_BLK 0x1D01BC Kwb_Wu16 1152.00000000 SigName 0.00 1152.00000000 FORMAT "%13.8" NUMBER 8 /end CHARACTERISTIC
/begin CHARACTERISTIC DSM_EnvDfp_FrmMngTSC2TO_C "Fehlerpfad spezifische Umweltbedingungen fuer Fehlerpfad Dfp_FrmMngTSC2TO" VAL_BLK 0x1D01CC Kwb_Wu16 1152.00000000 SigName 0.00 1152.00000000 FORMAT "%13.8" NUMBER 8 /end CHARACTERISTIC
/begin CHARACTERISTIC DSM_EnvDfp_FrmMngTSC3Npl_C "Fehlerpfad spezifische Umweltbedingungen fuer Fehlerpfad Dfp_FrmMngTSC3Npl" VAL_BLK 0x1D01DC Kwb_Wu16 1152.00000000 SigName 0.00 1152.00000000 FORMAT "%13.8" NUMBER 8 /end CHARACTERISTIC
/begin CHARACTERISTIC DSM_EnvDfp_FrmMngTSC3TO_C "Fehlerpfad spezifische Umweltbedingungen fuer Fehlerpfad Dfp_FrmMngTSC3TO" VAL_BLK 0x1D01EC Kwb_Wu16 1152.00000000 SigName 0.00 1152.00000000 FORMAT "%13.8" NUMBER 8 /end CHARACTERISTIC
/begin CHARACTERISTIC DSM_EnvDfp_FrmMngTSC6Npl_C "Fehlerpfad spezifische Umweltbedingungen fuer Fehlerpfad Dfp_FrmMngTSC6Npl" VAL_BLK 0x1D01FC Kwb_Wu16 1152.00000000 SigName 0.00 1152.00000000 FORMAT "%13.8" NUMBER 8 /end CHARACTERISTIC
/begin CHARACTERISTIC DSM_EnvDfp_FrmMngTSC6TO_C "Fehlerpfad spezifische Umweltbedingungen fuer Fehlerpfad Dfp_FrmMngTSC6TO" VAL_BLK 0x1D020C Kwb_Wu16 1152.00000000 SigName 0.00 1152.00000000 FORMAT "%13.8" NUMBER 8 /end CHARACTERISTIC
/begin CHARACTERISTIC DSM_EnvDfp_FrmMngTrbnSpdErr_C "Fehlerpfad spezifische Umweltbedingungen fuer Fehlerpfad Dfp_FrmMngTrbnSpdErr" VAL_BLK 0x1D021C Kwb_Wu16 1152.00000000 SigName 0.00 1152.00000000 FORMAT "%13.8" NUMBER 8 /end CHARACTERISTIC
/begin CHARACTERISTIC DSM_EnvDfp_FrmMngWIPERTO_C "Fehlerpfad spezifische Umweltbedingungen fuer Fehlerpfad Dfp_FrmMngWIPERTO" VAL_BLK 0x1D022C Kwb_Wu16 1152.00000000 SigName 0.00 1152.00000000 FORMAT "%13.8" NUMBER 8 /end CHARACTERISTIC
/begin CHARACTERISTIC DSM_EnvDfp_GbSSCD_C "Fehlerpfad spezifische Umweltbedingungen für Fehlerpfad Dfp_GbSSCD" VAL_BLK 0x1D023C Kwb_Wu16 1152.00000000 SigName 0.00 1152.00000000 FORMAT "%13.8" NUMBER 8 /end CHARACTERISTIC
/begin CHARACTERISTIC DSM_EnvDfp_GbSSCD_HW_C "Fehlerpfad spezifische Umweltbedingungen fuer Fehlerpfad Dfp_GbSSCD_HW" VAL_BLK 0x1D024C Kwb_Wu16 1152.00000000 SigName 0.00 1152.00000000 FORMAT "%13.8" NUMBER 8 /end CHARACTERISTIC
/begin CHARACTERISTIC DSM_EnvDfp_GearbxCVTnMax_C "Fehlerpfad spezifische Umweltbedingungen fuer Fehlerpfad Dfp_GearbxCVTnMax_mp" VAL_BLK 0x1D025C Kwb_Wu16 1152.00000000 SigName 0.00 1152.00000000 FORMAT "%13.8" NUMBER 8 /end CHARACTERISTIC
/begin CHARACTERISTIC DSM_EnvDfp_GearbxClthPlaus_C "Fehlerpfad spezifische Umweltbedingungen fuer Fehlerpfad Dfp_GearbxClthPlaus" VAL_BLK 0x1D026C Kwb_Wu16 1152.00000000 SigName 0.00 1152.00000000 FORMAT "%13.8" NUMBER 8 /end CHARACTERISTIC
/begin CHARACTERISTIC DSM_EnvDfp_GearbxINCCup_C "Fehlerpfad spezifische Umweltbedingungen fuer Fehlerpfad Dfp_GearbxINCCup" VAL_BLK 0x1D027C Kwb_Wu16 1152.00000000 SigName 0.00 1152.00000000 FORMAT "%13.8" NUMBER 8 /end CHARACTERISTIC
/begin CHARACTERISTIC DSM_EnvDfp_GearbxNMinMon_C "Fehlerpfad spezifische Umweltbedingungen fuer Fehlerpfad Dfp_GearbxNMinMon" VAL_BLK 0x1D028C Kwb_Wu16 1152.00000000 SigName 0.00 1152.00000000 FORMAT "%13.8" NUMBER 8 /end CHARACTERISTIC
/begin CHARACTERISTIC DSM_EnvDfp_GearbxTSC_C "Fehlerpfad spezifische Umweltbedingungen fuer Fehlerpfad Dfp_GearbxTSC" VAL_BLK 0x1D029C Kwb_Wu16 1152.00000000 SigName 0.00 1152.00000000 FORMAT "%13.8" NUMBER 8 /end CHARACTERISTIC
/begin CHARACTERISTIC DSM_EnvDfp_GearbxTransConv_C "Fehlerpfad spezifische Umweltbedingungen fuer Fehlerpfad Dfp_GearbxTransConv" VAL_BLK 0x1D02AC Kwb_Wu16 1152.00000000 SigName 0.00 1152.00000000 FORMAT "%13.8" NUMBER 8 /end CHARACTERISTIC
/begin CHARACTERISTIC DSM_EnvDfp_GearbxTypeMTErr_C "Fehlerpfad spezifische Umweltbedingungen fuer Fehlerpfad Dfp_GearbxTypeMTErr" VAL_BLK 0x1D02BC Kwb_Wu16 1152.00000000 SigName 0.00 1152.00000000 FORMAT "%13.8" NUMBER 8 /end CHARACTERISTIC
/begin CHARACTERISTIC DSM_EnvDfp_GlwCDDIAG_C "Fehlerpfad spezifische Umweltbedingungen fuer Fehlerpfad Dfp_GlwCDDIAG" VAL_BLK 0x1D02CC Kwb_Wu16 1152.00000000 SigName 0.00 1152.00000000 FORMAT "%13.8" NUMBER 8 /end CHARACTERISTIC
/begin CHARACTERISTIC DSM_EnvDfp_GlwCDErr1_C "Fehlerpfad spezifische Umweltbedingungen fuer Fehlerpfad Dfp_GlwCDErr1" VAL_BLK 0x1D02DC Kwb_Wu16 1152.00000000 SigName 0.00 1152.00000000 FORMAT "%13.8" NUMBER 8 /end CHARACTERISTIC
/begin CHARACTERISTIC DSM_EnvDfp_GlwCDErr2_C "Fehlerpfad spezifische Umweltbedingungen fuer Fehlerpfad Dfp_GlwCDErr2" VAL_BLK 0x1D02EC Kwb_Wu16 1152.00000000 SigName 0.00 1152.00000000 FORMAT "%13.8" NUMBER 8 /end CHARACTERISTIC
/begin CHARACTERISTIC DSM_EnvDfp_GlwCDEvalCod_C "Fehlerpfad spezifische Umweltbedingungen fuer Fehlerpfad Dfp_GlwCDEvalCod" VAL_BLK 0x1D02FC Kwb_Wu16 1152.00000000 SigName 0.00 1152.00000000 FORMAT "%13.8" NUMBER 8 /end CHARACTERISTIC
/begin CHARACTERISTIC DSM_EnvDfp_GlwCDGSK2_C "Fehlerpfad spezifische Umweltbedingungen fuer Fehlerpfad Dfp_GlwCDGSK2" VAL_BLK 0x1D030C Kwb_Wu16 1152.00000000 SigName 0.00 1152.00000000 FORMAT "%13.8" NUMBER 8 /end CHARACTERISTIC
/begin CHARACTERISTIC DSM_EnvDfp_GlwCDGSK3_C "Fehlerpfad spezifische Umweltbedingungen fuer Fehlerpfad Dfp_GlwCDGSK3" VAL_BLK 0x1D031C Kwb_Wu16 1152.00000000 SigName 0.00 1152.00000000 FORMAT "%13.8" NUMBER 8 /end CHARACTERISTIC
/begin CHARACTERISTIC DSM_EnvDfp_GlwCDLmp_C "Fehlerpfad spezifische Umweltbedingungen fuer Fehlerpfad Dfp_GlwCDLmp" VAL_BLK 0x1D032C Kwb_Wu16 1152.00000000 SigName 0.00 1152.00000000 FORMAT "%13.8" NUMBER 8 /end CHARACTERISTIC
/begin CHARACTERISTIC DSM_EnvDfp_GlwCDPLUG0_C "Fehlerpfad spezifische Umweltbedingungen fuer Fehlerpfad Dfp_GlwCDPLUG0" VAL_BLK 0x1D033C Kwb_Wu16 1152.00000000 SigName 0.00 1152.00000000 FORMAT "%13.8" NUMBER 8 /end CHARACTERISTIC
/begin CHARACTERISTIC DSM_EnvDfp_GlwCDPLUG1_C "Fehlerpfad spezifische Umweltbedingungen fuer Fehlerpfad Dfp_GlwCDPLUG1" VAL_BLK 0x1D034C Kwb_Wu16 1152.00000000 SigName 0.00 1152.00000000 FORMAT "%13.8" NUMBER 8 /end CHARACTERISTIC
/begin CHARACTERISTIC DSM_EnvDfp_GlwCDPLUG2_C "Fehlerpfad spezifische Umweltbedingungen fuer Fehlerpfad Dfp_GlwCDPLUG2" VAL_BLK 0x1D035C Kwb_Wu16 1152.00000000 SigName 0.00 1152.00000000 FORMAT "%13.8" NUMBER 8 /end CHARACTERISTIC
/begin CHARACTERISTIC DSM_EnvDfp_GlwCDPLUG3_C "Fehlerpfad spezifische Umweltbedingungen fuer Fehlerpfad Dfp_GlwCDPLUG3" VAL_BLK 0x1D036C Kwb_Wu16 1152.00000000 SigName 0.00 1152.00000000 FORMAT "%13.8" NUMBER 8 /end CHARACTERISTIC
/begin CHARACTERISTIC DSM_EnvDfp_GlwCDPLUG4_C "Fehlerpfad spezifische Umweltbedingungen fuer Fehlerpfad Dfp_GlwCDPLUG4" VAL_BLK 0x1D037C Kwb_Wu16 1152.00000000 SigName 0.00 1152.00000000 FORMAT "%13.8" NUMBER 8 /end CHARACTERISTIC
/begin CHARACTERISTIC DSM_EnvDfp_GlwCDPLUG5_C "Fehlerpfad spezifische Umweltbedingungen fuer Fehlerpfad Dfp_GlwCDPLUG5" VAL_BLK 0x1D038C Kwb_Wu16 1152.00000000 SigName 0.00 1152.00000000 FORMAT "%13.8" NUMBER 8 /end CHARACTERISTIC
/begin CHARACTERISTIC DSM_EnvDfp_GlwCD_LampCan_C "Fehlerpfad spezifische Umweltbedingungen fuer Fehlerpfad Dfp_GlwCD_LampCan" VAL_BLK 0x1D039C Kwb_Wu16 1152.00000000 SigName 0.00 1152.00000000 FORMAT "%13.8" NUMBER 8 /end CHARACTERISTIC
/begin CHARACTERISTIC DSM_EnvDfp_GlwCDsfd_C "Fehlerpfad spezifische Umweltbedingungen fuer Fehlerpfad Dfp_GlwCDsfd" VAL_BLK 0x1D03AC Kwb_Wu16 1152.00000000 SigName 0.00 1152.00000000 FORMAT "%13.8" NUMBER 8 /end CHARACTERISTIC
/begin CHARACTERISTIC DSM_EnvDfp_HDSCD_C "Fehlerpfad spezifische Umweltbedingungen fuer Fehlerpfad Dfp_HDSCD" VAL_BLK 0x1D03BC Kwb_Wu16 1152.00000000 SigName 0.00 1152.00000000 FORMAT "%13.8" NUMBER 8 /end CHARACTERISTIC
/begin CHARACTERISTIC DSM_EnvDfp_HWEMonCom_C "Fehlerpfad spezifische Umweltbedingungen fuer Fehlerpfad Dfp_HWEMonCom" VAL_BLK 0x1D03CC Kwb_Wu16 1152.00000000 SigName 0.00 1152.00000000 FORMAT "%13.8" NUMBER 8 /end CHARACTERISTIC
/begin CHARACTERISTIC DSM_EnvDfp_HWEMonEEPROM_C "Fehlerpfad spezifische Umweltbedingungen fuer Fehlerpfad Dfp_HWEMonEEPROM" VAL_BLK 0x1D03DC Kwb_Wu16 1152.00000000 SigName 0.00 1152.00000000 FORMAT "%13.8" NUMBER 8 /end CHARACTERISTIC
/begin CHARACTERISTIC DSM_EnvDfp_HWEMonRcyLocked_C "Fehlerpfad spezifische Umweltbedingungen fuer Fehlerpfad Dfp_HWEMonRcyLocked" VAL_BLK 0x1D03EC Kwb_Wu16 1152.00000000 SigName 0.00 1152.00000000 FORMAT "%13.8" NUMBER 8 /end CHARACTERISTIC
/begin CHARACTERISTIC DSM_EnvDfp_HWEMonRcySuppressed_C "Fehlerpfad spezifische Umweltbedingungen fuer Fehlerpfad Dfp_HWEMonRcySuppressed" VAL_BLK 0x1D03FC Kwb_Wu16 1152.00000000 SigName 0.00 1152.00000000 FORMAT "%13.8" NUMBER 8 /end CHARACTERISTIC
/begin CHARACTERISTIC DSM_EnvDfp_HWEMonRcyVisible_C "Fehlerpfad spezifische Umweltbedingungen fuer Fehlerpfad Dfp_HWEMonRcyVisible" VAL_BLK 0x1D040C Kwb_Wu16 1152.00000000 SigName 0.00 1152.00000000 FORMAT "%13.8" NUMBER 8 /end CHARACTERISTIC
/begin CHARACTERISTIC DSM_EnvDfp_HWEMonUMaxSupply_C "Fehlerpfad spezifische Umweltbedingungen fuer Fehlerpfad Dfp_HWEMonUMaxSupply" VAL_BLK 0x1D041C Kwb_Wu16 1152.00000000 SigName 0.00 1152.00000000 FORMAT "%13.8" NUMBER 8 /end CHARACTERISTIC
/begin CHARACTERISTIC DSM_EnvDfp_HWEMonUMinSupply_C "Fehlerpfad spezifische Umweltbedingungen fuer Fehlerpfad Dfp_HWEMonUMinSupply" VAL_BLK 0x1D042C Kwb_Wu16 1152.00000000 SigName 0.00 1152.00000000 FORMAT "%13.8" NUMBER 8 /end CHARACTERISTIC
/begin CHARACTERISTIC DSM_EnvDfp_IATSCD_C "Fehlerpfad spezifische Umweltbedingungen fuer Fehlerpfad Dfp_IATSCD" VAL_BLK 0x1D043C Kwb_Wu16 1152.00000000 SigName 0.00 1152.00000000 FORMAT "%13.8" NUMBER 8 /end CHARACTERISTIC
/begin CHARACTERISTIC DSM_EnvDfp_IFCD_C "Fehlerpfad spezifische Umweltbedingungen fuer Fehlerpfad Dfp_IFCD" VAL_BLK 0x1D044C Kwb_Wu16 1152.00000000 SigName 0.00 1152.00000000 FORMAT "%13.8" NUMBER 8 /end CHARACTERISTIC
/begin CHARACTERISTIC DSM_EnvDfp_ImmCtl_C "Fehlerpfad spezifische Umweltbedingungen fuer Fehlerpfad Dfp_ImmCtl" VAL_BLK 0x1D045C Kwb_Wu16 1152.00000000 SigName 0.00 1152.00000000 FORMAT "%13.8" NUMBER 8 /end CHARACTERISTIC
/begin CHARACTERISTIC DSM_EnvDfp_IndSysMonIntMnf_C "Fehlerpfad spezifische Umweltbedingungen fuer Fehlerpfad Dfp_IndSysMonIntMnf" VAL_BLK 0x1D046C Kwb_Wu16 1152.00000000 SigName 0.00 1152.00000000 FORMAT "%13.8" NUMBER 8 /end CHARACTERISTIC
/begin CHARACTERISTIC DSM_EnvDfp_InjVlvBnk1A_C "Fehlerpfad spezifische Umweltbedingungen fuer Fehlerpfad Dfp_InjVlvBnk1A" VAL_BLK 0x1D049C Kwb_Wu16 1152.00000000 SigName 0.00 1152.00000000 FORMAT "%13.8" NUMBER 8 /end CHARACTERISTIC
/begin CHARACTERISTIC DSM_EnvDfp_InjVlvBnk2A_C "Fehlerpfad spezifische Umweltbedingungen fuer Fehlerpfad Dfp_InjVlvBnk2A" VAL_BLK 0x1D04AC Kwb_Wu16 1152.00000000 SigName 0.00 1152.00000000 FORMAT "%13.8" NUMBER 8 /end CHARACTERISTIC
/begin CHARACTERISTIC DSM_EnvDfp_InjVlvCyl10A_C "Fehlerpfad spezifische Umweltbedingungen fuer Fehlerpfad Dfp_InjVlvCyl10A" VAL_BLK 0x1D04BC Kwb_Wu16 1152.00000000 SigName 0.00 1152.00000000 FORMAT "%13.8" NUMBER 8 /end CHARACTERISTIC
/begin CHARACTERISTIC DSM_EnvDfp_InjVlvCyl11A_C "Fehlerpfad spezifische Umweltbedingungen fuer Fehlerpfad Dfp_InjVlvCyl11A" VAL_BLK 0x1D04CC Kwb_Wu16 1152.00000000 SigName 0.00 1152.00000000 FORMAT "%13.8" NUMBER 8 /end CHARACTERISTIC
/begin CHARACTERISTIC DSM_EnvDfp_InjVlvCyl12A_C "Fehlerpfad spezifische Umweltbedingungen fuer Fehlerpfad Dfp_InjVlvCyl12A" VAL_BLK 0x1D04DC Kwb_Wu16 1152.00000000 SigName 0.00 1152.00000000 FORMAT "%13.8" NUMBER 8 /end CHARACTERISTIC
/begin CHARACTERISTIC DSM_EnvDfp_InjVlvCyl1A_C "Fehlerpfad spezifische Umweltbedingungen fuer Fehlerpfad Dfp_InjVlvCyl1A" VAL_BLK 0x1D04EC Kwb_Wu16 1152.00000000 SigName 0.00 1152.00000000 FORMAT "%13.8" NUMBER 8 /end CHARACTERISTIC
/begin CHARACTERISTIC DSM_EnvDfp_InjVlvCyl2A_C "Fehlerpfad spezifische Umweltbedingungen fuer Fehlerpfad Dfp_InjVlvCyl2A" VAL_BLK 0x1D04FC Kwb_Wu16 1152.00000000 SigName 0.00 1152.00000000 FORMAT "%13.8" NUMBER 8 /end CHARACTERISTIC
/begin CHARACTERISTIC DSM_EnvDfp_InjVlvCyl3A_C "Fehlerpfad spezifische Umweltbedingungen fuer Fehlerpfad Dfp_InjVlvCyl3A" VAL_BLK 0x1D050C Kwb_Wu16 1152.00000000 SigName 0.00 1152.00000000 FORMAT "%13.8" NUMBER 8 /end CHARACTERISTIC
/begin CHARACTERISTIC DSM_EnvDfp_InjVlvCyl4A_C "Fehlerpfad spezifische Umweltbedingungen fuer Fehlerpfad Dfp_InjVlvCyl4A" VAL_BLK 0x1D051C Kwb_Wu16 1152.00000000 SigName 0.00 1152.00000000 FORMAT "%13.8" NUMBER 8 /end CHARACTERISTIC
/begin CHARACTERISTIC DSM_EnvDfp_InjVlvCyl5A_C "Fehlerpfad spezifische Umweltbedingungen fuer Fehlerpfad Dfp_InjVlvCyl5A" VAL_BLK 0x1D052C Kwb_Wu16 1152.00000000 SigName 0.00 1152.00000000 FORMAT "%13.8" NUMBER 8 /end CHARACTERISTIC
/begin CHARACTERISTIC DSM_EnvDfp_InjVlvCyl6A_C "Fehlerpfad spezifische Umweltbedingungen fuer Fehlerpfad Dfp_InjVlvCyl6A" VAL_BLK 0x1D053C Kwb_Wu16 1152.00000000 SigName 0.00 1152.00000000 FORMAT "%13.8" NUMBER 8 /end CHARACTERISTIC
/begin CHARACTERISTIC DSM_EnvDfp_InjVlvCyl7A_C "Fehlerpfad spezifische Umweltbedingungen fuer Fehlerpfad Dfp_InjVlvCyl7A" VAL_BLK 0x1D054C Kwb_Wu16 1152.00000000 SigName 0.00 1152.00000000 FORMAT "%13.8" NUMBER 8 /end CHARACTERISTIC
/begin CHARACTERISTIC DSM_EnvDfp_InjVlvCyl8A_C "Fehlerpfad spezifische Umweltbedingungen fuer Fehlerpfad Dfp_InjVlvCyl8A" VAL_BLK 0x1D055C Kwb_Wu16 1152.00000000 SigName 0.00 1152.00000000 FORMAT "%13.8" NUMBER 8 /end CHARACTERISTIC
/begin CHARACTERISTIC DSM_EnvDfp_InjVlvCyl9A_C "Fehlerpfad spezifische Umweltbedingungen fuer Fehlerpfad Dfp_InjVlvCyl9A" VAL_BLK 0x1D056C Kwb_Wu16 1152.00000000 SigName 0.00 1152.00000000 FORMAT "%13.8" NUMBER 8 /end CHARACTERISTIC
/begin CHARACTERISTIC DSM_EnvDfp_LASCD_C "Fehlerpfad spezifische Umweltbedingungen fuer Fehlerpfad Dfp_LASCD" VAL_BLK 0x1D057C Kwb_Wu16 1152.00000000 SigName 0.00 1152.00000000 FORMAT "%13.8" NUMBER 8 /end CHARACTERISTIC
/begin CHARACTERISTIC DSM_EnvDfp_LSUCDCircNernst0_C "Fehlerpfad spezifische Umweltbedingungen fuer Fehlerpfad Dfp_LSUCDCircNernst0" VAL_BLK 0x1D058C Kwb_Wu16 1152.00000000 SigName 0.00 1152.00000000 FORMAT "%13.8" NUMBER 8 /end CHARACTERISTIC
/begin CHARACTERISTIC DSM_EnvDfp_LSUCDCircPumpCur0_C "Fehlerpfad spezifische Umweltbedingungen fuer Fehlerpfad Dfp_LSUCDCircPumpCur0" VAL_BLK 0x1D059C Kwb_Wu16 1152.00000000 SigName 0.00 1152.00000000 FORMAT "%13.8" NUMBER 8 /end CHARACTERISTIC
/begin CHARACTERISTIC DSM_EnvDfp_LSUCDCircVirtGnd0_C "Fehlerpfad spezifische Umweltbedingungen fuer Fehlerpfad Dfp_LSUCDCircVirtGnd0" VAL_BLK 0x1D05AC Kwb_Wu16 1152.00000000 SigName 0.00 1152.00000000 FORMAT "%13.8" NUMBER 8 /end CHARACTERISTIC
/begin CHARACTERISTIC DSM_EnvDfp_LSUCDHeater0_C "Fehlerpfad spezifische Umweltbedingungen fuer Fehlerpfad Dfp_LSUCDHeater0" VAL_BLK 0x1D05BC Kwb_Wu16 1152.00000000 SigName 0.00 1152.00000000 FORMAT "%13.8" NUMBER 8 /end CHARACTERISTIC
/begin CHARACTERISTIC DSM_EnvDfp_LSUCDHtCoup0_C "Fehlerpfad spezifische Umweltbedingungen fuer Fehlerpfad Dfp_LSUCDHtCoup0" VAL_BLK 0x1D05CC Kwb_Wu16 1152.00000000 SigName 0.00 1152.00000000 FORMAT "%13.8" NUMBER 8 /end CHARACTERISTIC
/begin CHARACTERISTIC DSM_EnvDfp_LSUCDO20_C "Fehlerpfad spezifische Umweltbedingungen fuer Fehlerpfad Dfp_LSUCDO20" VAL_BLK 0x1D05DC Kwb_Wu16 1152.00000000 SigName 0.00 1152.00000000 FORMAT "%13.8" NUMBER 8 /end CHARACTERISTIC
/begin CHARACTERISTIC DSM_EnvDfp_LSUCDO2Clb0_C "Fehlerpfad spezifische Umweltbedingungen fuer Fehlerpfad Dfp_LSUCDO2Clb0" VAL_BLK 0x1D05EC Kwb_Wu16 1152.00000000 SigName 0.00 1152.00000000 FORMAT "%13.8" NUMBER 8 /end CHARACTERISTIC
/begin CHARACTERISTIC DSM_EnvDfp_LSUCDRiClb0_C "Fehlerpfad spezifische Umweltbedingungen fuer Fehlerpfad Dfp_LSUCDRiClb0" VAL_BLK 0x1D05FC Kwb_Wu16 1152.00000000 SigName 0.00 1152.00000000 FORMAT "%13.8" NUMBER 8 /end CHARACTERISTIC
/begin CHARACTERISTIC DSM_EnvDfp_LSUCDSPI0_C "Fehlerpfad spezifische Umweltbedingungen fuer Fehlerpfad Dfp_LSUCDSPI0" VAL_BLK 0x1D060C Kwb_Wu16 1152.00000000 SigName 0.00 1152.00000000 FORMAT "%13.8" NUMBER 8 /end CHARACTERISTIC
/begin CHARACTERISTIC DSM_EnvDfp_LSUCDSPIBattLow0_C "Fehlerpfad spezifische Umweltbedingungen fuer Fehlerpfad Dfp_LSUCDSPIBattLow0" VAL_BLK 0x1D061C Kwb_Wu16 1152.00000000 SigName 0.00 1152.00000000 FORMAT "%13.8" NUMBER 8 /end CHARACTERISTIC
/begin CHARACTERISTIC DSM_EnvDfp_LSUCDWireIP0_C "Fehlerpfad spezifische Umweltbedingungen fuer Fehlerpfad Dfp_LSUCDWireIP0" VAL_BLK 0x1D062C Kwb_Wu16 1152.00000000 SigName 0.00 1152.00000000 FORMAT "%13.8" NUMBER 8 /end CHARACTERISTIC
/begin CHARACTERISTIC DSM_EnvDfp_LSUCtlRiExc0_C "Fehlerpfad spezifische Umweltbedingungen fuer Fehlerpfad Dfp_LSUCtlRiExc0" VAL_BLK 0x1D063C Kwb_Wu16 1152.00000000 SigName 0.00 1152.00000000 FORMAT "%13.8" NUMBER 8 /end CHARACTERISTIC
/begin CHARACTERISTIC DSM_EnvDfp_LSUMonDyn0_C "Fehlerpfad spezifische Umweltbedingungen fuer Fehlerpfad Dfp_LSUMonDyn0" VAL_BLK 0x1D064C Kwb_Wu16 1152.00000000 SigName 0.00 1152.00000000 FORMAT "%13.8" NUMBER 8 /end CHARACTERISTIC
/begin CHARACTERISTIC DSM_EnvDfp_LSUMonFullLd0_C "Fehlerpfad spezifische Umweltbedingungen fuer Fehlerpfad Dfp_LSUMonFullLd0" VAL_BLK 0x1D065C Kwb_Wu16 1152.00000000 SigName 0.00 1152.00000000 FORMAT "%13.8" NUMBER 8 /end CHARACTERISTIC
/begin CHARACTERISTIC DSM_EnvDfp_LSUMonOvrRun0_C "Fehlerpfad spezifische Umweltbedingungen fuer Fehlerpfad Dfp_LSUMonOvrRun0" VAL_BLK 0x1D066C Kwb_Wu16 1152.00000000 SigName 0.00 1152.00000000 FORMAT "%13.8" NUMBER 8 /end CHARACTERISTIC
/begin CHARACTERISTIC DSM_EnvDfp_LSUMonPartLd0_C "Fehlerpfad spezifische Umweltbedingungen fuer Fehlerpfad Dfp_LSUMonPartLd0" VAL_BLK 0x1D067C Kwb_Wu16 1152.00000000 SigName 0.00 1152.00000000 FORMAT "%13.8" NUMBER 8 /end CHARACTERISTIC
/begin CHARACTERISTIC DSM_EnvDfp_MIL_C "Fehlerpfad spezifische Umweltbedingungen fuer Fehlerpfad Dfp_MIL" VAL_BLK 0x1D068C Kwb_Wu16 1152.00000000 SigName 0.00 1152.00000000 FORMAT "%13.8" NUMBER 8 /end CHARACTERISTIC
/begin CHARACTERISTIC DSM_EnvDfp_MRlyCD_C "Fehlerpfad spezifische Umweltbedingungen fuer Fehlerpfad Dfp_MRlyCD" VAL_BLK 0x1D069C Kwb_Wu16 1152.00000000 SigName 0.00 1152.00000000 FORMAT "%13.8" NUMBER 8 /end CHARACTERISTIC
/begin CHARACTERISTIC DSM_EnvDfp_Montr_C "Fehlerpfad spezifische Umweltbedingungen fuer Fehlerpfad Dfp_Montr" VAL_BLK 0x1D06AC Kwb_Wu16 1152.00000000 SigName 0.00 1152.00000000 FORMAT "%13.8" NUMBER 8 /end CHARACTERISTIC
/begin CHARACTERISTIC DSM_EnvDfp_OTSCD_C "Fehlerpfad spezifische Umweltbedingungen fuer Fehlerpfad Dfp_OTSCD" VAL_BLK 0x1D06BC Kwb_Wu16 1152.00000000 SigName 0.00 1152.00000000 FORMAT "%13.8" NUMBER 8 /end CHARACTERISTIC
/begin CHARACTERISTIC DSM_EnvDfp_OTSCDCanInac_C "Fehlerpfad spezifische Umweltbedingungen fuer Fehlerpfad Dfp_OTSCDCanInac" VAL_BLK 0x1D06CC Kwb_Wu16 1152.00000000 SigName 0.00 1152.00000000 FORMAT "%13.8" NUMBER 8 /end CHARACTERISTIC
/begin CHARACTERISTIC DSM_EnvDfp_OTSCDCanSig_C "Fehlerpfad spezifische Umweltbedingungen fuer Fehlerpfad Dfp_OTSCDCanSig" VAL_BLK 0x1D06DC Kwb_Wu16 1152.00000000 SigName 0.00 1152.00000000 FORMAT "%13.8" NUMBER 8 /end CHARACTERISTIC
/begin CHARACTERISTIC DSM_EnvDfp_OvRMon_C "Fehlerpfad spezifische Umweltbedingungen fuer Fehlerpfad Dfp_OvRMon" VAL_BLK 0x1D06FC Kwb_Wu16 1152.00000000 SigName 0.00 1152.00000000 FORMAT "%13.8" NUMBER 8 /end CHARACTERISTIC
/begin CHARACTERISTIC DSM_EnvDfp_OvRMonCrCtlP_C "Fehlerpfad spezifische Umweltbedingungen fuer Fehlerpfad Dfp_OvRMonCrCtlP" VAL_BLK 0x1D070C Kwb_Wu16 1152.00000000 SigName 0.00 1152.00000000 FORMAT "%13.8" NUMBER 8 /end CHARACTERISTIC
/begin CHARACTERISTIC DSM_EnvDfp_OvRMonSigA_C "Fehlerpfad spezifische Umweltbedingungen fuer Fehlerpfad Dfp_OvRMonSigA" VAL_BLK 0x1D071C Kwb_Wu16 1152.00000000 SigName 0.00 1152.00000000 FORMAT "%13.8" NUMBER 8 /end CHARACTERISTIC
/begin CHARACTERISTIC DSM_EnvDfp_OxiCCDTPre_C "Fehlerpfad spezifische Umweltbedingungen fuer Fehlerpfad Dfp_OxiCCDTPre" VAL_BLK 0x1D072C Kwb_Wu16 1152.00000000 SigName 0.00 1152.00000000 FORMAT "%13.8" NUMBER 8 /end CHARACTERISTIC
/begin CHARACTERISTIC DSM_EnvDfp_OxiCCDTPre1_C "Fehlerpfad spezifische Umweltbedingungen fuer Fehlerpfad Dfp_OxiCCDTPre1" VAL_BLK 0x1D073C Kwb_Wu16 1152.00000000 SigName 0.00 1152.00000000 FORMAT "%13.8" NUMBER 8 /end CHARACTERISTIC
/begin CHARACTERISTIC DSM_EnvDfp_PCR_BalGovDev_C "Fehlerpfad spezifische Umweltbedingungen fuer Fehlerpfad Dfp_PCR_BalGovDev" VAL_BLK 0x1D074C Kwb_Wu16 1152.00000000 SigName 0.00 1152.00000000 FORMAT "%13.8" NUMBER 8 /end CHARACTERISTIC
/begin CHARACTERISTIC DSM_EnvDfp_PCR_GovDev_C "Fehlerpfad spezifische Umweltbedingungen fuer Fehlerpfad Dfp_PCR_GovDev" VAL_BLK 0x1D075C Kwb_Wu16 1152.00000000 SigName 0.00 1152.00000000 FORMAT "%13.8" NUMBER 8 /end CHARACTERISTIC
/begin CHARACTERISTIC DSM_EnvDfp_PFltAPSens_C "Fehlerpfad spezifische Umweltbedingungen fuer Fehlerpfad Dfp_PFltAPSens" VAL_BLK 0x1D076C Kwb_Wu16 1152.00000000 SigName 0.00 1152.00000000 FORMAT "%13.8" NUMBER 8 /end CHARACTERISTIC
/begin CHARACTERISTIC DSM_EnvDfp_PFltCDHtg_C "Fehlerpfad spezifische Umweltbedingungen fuer Fehlerpfad Dfp_PFltCDHtg" VAL_BLK 0x1D077C Kwb_Wu16 1152.00000000 SigName 0.00 1152.00000000 FORMAT "%13.8" NUMBER 8 /end CHARACTERISTIC
/begin CHARACTERISTIC DSM_EnvDfp_PFltCDHtg1_C "Fehlerpfad spezifische Umweltbedingungen fuer Fehlerpfad Dfp_PFltCDHtg1" VAL_BLK 0x1D078C Kwb_Wu16 1152.00000000 SigName 0.00 1152.00000000 FORMAT "%13.8" NUMBER 8 /end CHARACTERISTIC
/begin CHARACTERISTIC DSM_EnvDfp_PFltCDPDiff_C "Fehlerpfad spezifische Umweltbedingungen fuer Fehlerpfad Dfp_PFltCDPDiff" VAL_BLK 0x1D079C Kwb_Wu16 1152.00000000 SigName 0.00 1152.00000000 FORMAT "%13.8" NUMBER 8 /end CHARACTERISTIC
/begin CHARACTERISTIC DSM_EnvDfp_PFltCDTempPre_C "Fehlerpfad spezifische Umweltbedingungen fuer Fehlerpfad Dfp_PFltCDTempPre" VAL_BLK 0x1D07AC Kwb_Wu16 1152.00000000 SigName 0.00 1152.00000000 FORMAT "%13.8" NUMBER 8 /end CHARACTERISTIC
/begin CHARACTERISTIC DSM_EnvDfp_PFltCDTempPre1_C "Fehlerpfad spezifische Umweltbedingungen fuer Fehlerpfad Dfp_PFltCDTempPre1" VAL_BLK 0x1D07BC Kwb_Wu16 1152.00000000 SigName 0.00 1152.00000000 FORMAT "%13.8" NUMBER 8 /end CHARACTERISTIC
/begin CHARACTERISTIC DSM_EnvDfp_PFltCDTempPst_C "Fehlerpfad spezifische Umweltbedingungen fuer Fehlerpfad Dfp_PFltCDTempPst" VAL_BLK 0x1D07CC Kwb_Wu16 1152.00000000 SigName 0.00 1152.00000000 FORMAT "%13.8" NUMBER 8 /end CHARACTERISTIC
/begin CHARACTERISTIC DSM_EnvDfp_PFltChar_C "Fehlerpfad spezifische Umweltbedingungen fuer Fehlerpfad Dfp_PFltChar" VAL_BLK 0x1D07DC Kwb_Wu16 1152.00000000 SigName 0.00 1152.00000000 FORMAT "%13.8" NUMBER 8 /end CHARACTERISTIC
/begin CHARACTERISTIC DSM_EnvDfp_PFltEngPrt_C "Fehlerpfad spezifische Umweltbedingungen fuer Fehlerpfad Dfp_PFltEngPrt" VAL_BLK 0x1D07EC Kwb_Wu16 1152.00000000 SigName 0.00 1152.00000000 FORMAT "%13.8" NUMBER 8 /end CHARACTERISTIC
/begin CHARACTERISTIC DSM_EnvDfp_PFltPresDynPlaus_C "Fehlerpfad spezifische Umweltbedingungen fuer Fehlerpfad Dfp_PFltPresDynPlaus" VAL_BLK 0x1D07FC Kwb_Wu16 1152.00000000 SigName 0.00 1152.00000000 FORMAT "%13.8" NUMBER 8 /end CHARACTERISTIC
/begin CHARACTERISTIC DSM_EnvDfp_PFltPresHsChng_C "Fehlerpfad spezifische Umweltbedingungen fuer Fehlerpfad Dfp_PFltPresHsChng" VAL_BLK 0x1D080C Kwb_Wu16 1152.00000000 SigName 0.00 1152.00000000 FORMAT "%13.8" NUMBER 8 /end CHARACTERISTIC
/begin CHARACTERISTIC DSM_EnvDfp_PFltPresSens_C "Fehlerpfad spezifische Umweltbedingungen fuer Fehlerpfad Dfp_PFltPresSens" VAL_BLK 0x1D081C Kwb_Wu16 1152.00000000 SigName 0.00 1152.00000000 FORMAT "%13.8" NUMBER 8 /end CHARACTERISTIC
/begin CHARACTERISTIC DSM_EnvDfp_PFltPresSensFrz_C "Fehlerpfad spezifische Umweltbedingungen fuer Fehlerpfad Dfp_PFltPresSensFrz" VAL_BLK 0x1D082C Kwb_Wu16 1152.00000000 SigName 0.00 1152.00000000 FORMAT "%13.8" NUMBER 8 /end CHARACTERISTIC
/begin CHARACTERISTIC DSM_EnvDfp_PFltPresSensHsLn_C "Fehlerpfad spezifische Umweltbedingungen fuer Fehlerpfad Dfp_PFltPresSensHsLn" VAL_BLK 0x1D083C Kwb_Wu16 1152.00000000 SigName 0.00 1152.00000000 FORMAT "%13.8" NUMBER 8 /end CHARACTERISTIC
/begin CHARACTERISTIC DSM_EnvDfp_PFltPresSensSot_C "Fehlerpfad spezifische Umweltbedingungen fuer Fehlerpfad Dfp_PFltPresSensSot" VAL_BLK 0x1D084C Kwb_Wu16 1152.00000000 SigName 0.00 1152.00000000 FORMAT "%13.8" NUMBER 8 /end CHARACTERISTIC
/begin CHARACTERISTIC DSM_EnvDfp_PFltRgnLckPerm_C "Fehlerpfad spezifische Umweltbedingungen fuer Fehlerpfad Dfp_PFltRgnLckPerm" VAL_BLK 0x1D085C Kwb_Wu16 1152.00000000 SigName 0.00 1152.00000000 FORMAT "%13.8" NUMBER 8 /end CHARACTERISTIC
/begin CHARACTERISTIC DSM_EnvDfp_PFltRgnLckPermTstr_C "Fehlerpfad spezifische Umweltbedingungen fuer Fehlerpfad Dfp_PFltRgnLckPermTstr" VAL_BLK 0x1D086C Kwb_Wu16 1152.00000000 SigName 0.00 1152.00000000 FORMAT "%13.8" NUMBER 8 /end CHARACTERISTIC
/begin CHARACTERISTIC DSM_EnvDfp_PFltRgnPerm_C "Fehlerpfad spezifische Umweltbedingungen fuer Fehlerpfad Dfp_PFltRgnPerm" VAL_BLK 0x1D087C Kwb_Wu16 1152.00000000 SigName 0.00 1152.00000000 FORMAT "%13.8" NUMBER 8 /end CHARACTERISTIC
/begin CHARACTERISTIC DSM_EnvDfp_PFltSotSimPresPerm_C "Fehlerpfad spezifische Umweltbedingungen fuer Fehlerpfad Dfp_PFltSotSimPresPerm" VAL_BLK 0x1D088C Kwb_Wu16 1152.00000000 SigName 0.00 1152.00000000 FORMAT "%13.8" NUMBER 8 /end CHARACTERISTIC
/begin CHARACTERISTIC DSM_EnvDfp_PFltTempDwnStrm_C "Fehlerpfad spezifische Umweltbedingungen fuer Fehlerpfad Dfp_PFltTempDwnStrm" VAL_BLK 0x1D089C Kwb_Wu16 1152.00000000 SigName 0.00 1152.00000000 FORMAT "%13.8" NUMBER 8 /end CHARACTERISTIC
/begin CHARACTERISTIC DSM_EnvDfp_PFltTempDwnStrmMax_C "Fehlerpfad spezifische Umweltbedingungen fuer Fehlerpfad Dfp_PFltTempDwnStrmMax" VAL_BLK 0x1D08AC Kwb_Wu16 1152.00000000 SigName 0.00 1152.00000000 FORMAT "%13.8" NUMBER 8 /end CHARACTERISTIC
/begin CHARACTERISTIC DSM_EnvDfp_PFltTempDwnStrmMin_C "Fehlerpfad spezifische Umweltbedingungen fuer Fehlerpfad Dfp_PFltTempDwnStrmMin" VAL_BLK 0x1D08BC Kwb_Wu16 1152.00000000 SigName 0.00 1152.00000000 FORMAT "%13.8" NUMBER 8 /end CHARACTERISTIC
/begin CHARACTERISTIC DSM_EnvDfp_PFltTempPreOxiC_C "Fehlerpfad spezifische Umweltbedingungen fuer Fehlerpfad Dfp_PFltTempPreOxiC" VAL_BLK 0x1D08CC Kwb_Wu16 1152.00000000 SigName 0.00 1152.00000000 FORMAT "%13.8" NUMBER 8 /end CHARACTERISTIC
/begin CHARACTERISTIC DSM_EnvDfp_PFltTempPrePFlt_C "Fehlerpfad spezifische Umweltbedingungen fuer Fehlerpfad Dfp_PFltTempPrePFlt" VAL_BLK 0x1D08DC Kwb_Wu16 1152.00000000 SigName 0.00 1152.00000000 FORMAT "%13.8" NUMBER 8 /end CHARACTERISTIC
/begin CHARACTERISTIC DSM_EnvDfp_PFltTempPreTrbn_C "Fehlerpfad spezifische Umweltbedingungen fuer Fehlerpfad Dfp_PFltTempPreTrbn" VAL_BLK 0x1D08EC Kwb_Wu16 1152.00000000 SigName 0.00 1152.00000000 FORMAT "%13.8" NUMBER 8 /end CHARACTERISTIC
/begin CHARACTERISTIC DSM_EnvDfp_PFltTempPstPFlt_C "Fehlerpfad spezifische Umweltbedingungen fuer Fehlerpfad Dfp_PFltTempPstPFlt" VAL_BLK 0x1D090C Kwb_Wu16 1152.00000000 SigName 0.00 1152.00000000 FORMAT "%13.8" NUMBER 8 /end CHARACTERISTIC
/begin CHARACTERISTIC DSM_EnvDfp_PFltTempSens_C "Fehlerpfad spezifische Umweltbedingungen fuer Fehlerpfad Dfp_PFltTempSens" VAL_BLK 0x1D091C Kwb_Wu16 1152.00000000 SigName 0.00 1152.00000000 FORMAT "%13.8" NUMBER 8 /end CHARACTERISTIC
/begin CHARACTERISTIC DSM_EnvDfp_PFltTempSens2_C "Fehlerpfad spezifische Umweltbedingungen fuer Fehlerpfad Dfp_PFltTempSens2" VAL_BLK 0x1D092C Kwb_Wu16 1152.00000000 SigName 0.00 1152.00000000 FORMAT "%13.8" NUMBER 8 /end CHARACTERISTIC
/begin CHARACTERISTIC DSM_EnvDfp_PFltTempUpStrm_C "Fehlerpfad spezifische Umweltbedingungen fuer Fehlerpfad Dfp_PFltTempUpStrm" VAL_BLK 0x1D093C Kwb_Wu16 1152.00000000 SigName 0.00 1152.00000000 FORMAT "%13.8" NUMBER 8 /end CHARACTERISTIC
/begin CHARACTERISTIC DSM_EnvDfp_PFltTempUpStrmMax_C "Fehlerpfad spezifische Umweltbedingungen fuer Fehlerpfad Dfp_PFltTempUpStrmMax" VAL_BLK 0x1D094C Kwb_Wu16 1152.00000000 SigName 0.00 1152.00000000 FORMAT "%13.8" NUMBER 8 /end CHARACTERISTIC
/begin CHARACTERISTIC DSM_EnvDfp_PFltTempUpStrmMin_C "Fehlerpfad spezifische Umweltbedingungen fuer Fehlerpfad Dfp_PFltTempUpStrmMin" VAL_BLK 0x1D095C Kwb_Wu16 1152.00000000 SigName 0.00 1152.00000000 FORMAT "%13.8" NUMBER 8 /end CHARACTERISTIC
/begin CHARACTERISTIC DSM_EnvDfp_PSPCD_Actr_C "Fehlerpfad spezifische Umweltbedingungen fuer Fehlerpfad Dfp_PSPCD_Actr" VAL_BLK 0x1D096C Kwb_Wu16 1152.00000000 SigName 0.00 1152.00000000 FORMAT "%13.8" NUMBER 8 /end CHARACTERISTIC
/begin CHARACTERISTIC DSM_EnvDfp_PrpCtlvLimErrPat_C "Fehlerpfad spezifische Umweltbedingungen fuer Fehlerpfad Dfp_PrpCtlvLimErrPat" VAL_BLK 0x1D097C Kwb_Wu16 1152.00000000 SigName 0.00 1152.00000000 FORMAT "%13.8" NUMBER 8 /end CHARACTERISTIC
/begin CHARACTERISTIC DSM_EnvDfp_SOPTst_C "Fehlerpfad spezifische Umweltbedingungen fuer Fehlerpfad Dfp_SOPTst" VAL_BLK 0x1D098C Kwb_Wu16 1152.00000000 SigName 0.00 1152.00000000 FORMAT "%13.8" NUMBER 8 /end CHARACTERISTIC
/begin CHARACTERISTIC DSM_EnvDfp_SSpMon1_C "Fehlerpfad spezifische Umweltbedingungen fuer Fehlerpfad Dfp_SSpMon1" VAL_BLK 0x1D099C Kwb_Wu16 1152.00000000 SigName 0.00 1152.00000000 FORMAT "%13.8" NUMBER 8 /end CHARACTERISTIC
/begin CHARACTERISTIC DSM_EnvDfp_SSpMon2_C "Fehlerpfad spezifische Umweltbedingungen fuer Fehlerpfad Dfp_SSpMon2" VAL_BLK 0x1D09AC Kwb_Wu16 1152.00000000 SigName 0.00 1152.00000000 FORMAT "%13.8" NUMBER 8 /end CHARACTERISTIC
/begin CHARACTERISTIC DSM_EnvDfp_SSpMon3_C "Fehlerpfad spezifische Umweltbedingungen fuer Fehlerpfad Dfp_SSpMon3" VAL_BLK 0x1D09BC Kwb_Wu16 1152.00000000 SigName 0.00 1152.00000000 FORMAT "%13.8" NUMBER 8 /end CHARACTERISTIC
/begin CHARACTERISTIC DSM_EnvDfp_Shtrp_EGRBA_C "Fehlerpfad spezifische Umweltbedingungen fuer Fehlerpfad Dfp_Shtrp_EGRBA" VAL_BLK 0x1D09CC Kwb_Wu16 1152.00000000 SigName 0.00 1152.00000000 FORMAT "%13.8" NUMBER 8 /end CHARACTERISTIC
/begin CHARACTERISTIC DSM_EnvDfp_Shtrp_PCRBA_C "Fehlerpfad spezifische Umweltbedingungen fuer Fehlerpfad Dfp_Shtrp_PCRBA" VAL_BLK 0x1D09DC Kwb_Wu16 1152.00000000 SigName 0.00 1152.00000000 FORMAT "%13.8" NUMBER 8 /end CHARACTERISTIC
/begin CHARACTERISTIC DSM_EnvDfp_SrvPmpStSAEcu_C "Fehlerpfad spezifische Umweltbedingungen fuer Fehlerpfad Dfp_SrvPmpStSAEcu" VAL_BLK 0x1D09EC Kwb_Wu16 1152.00000000 SigName 0.00 1152.00000000 FORMAT "%13.8" NUMBER 8 /end CHARACTERISTIC
/begin CHARACTERISTIC DSM_EnvDfp_StSysCtlShCirBatt_C "Fehlerpfad spezifische Umweltbedingungen fuer Fehlerpfad Dfp_StSysCtlShCirBatt" VAL_BLK 0x1D09FC Kwb_Wu16 1152.00000000 SigName 0.00 1152.00000000 FORMAT "%13.8" NUMBER 8 /end CHARACTERISTIC
/begin CHARACTERISTIC DSM_EnvDfp_StrtCDOffRly_C "Fehlerpfad spezifische Umweltbedingungen für Fehlerpfad Dfp_StrtCDOffRly" VAL_BLK 0x1D0A0C Kwb_Wu16 1152.00000000 SigName 0.00 1152.00000000 FORMAT "%13.8" NUMBER 8 /end CHARACTERISTIC
/begin CHARACTERISTIC DSM_EnvDfp_StrtCDOnRly_C "Fehlerpfad spezifische Umweltbedingungen für Fehlerpfad Dfp_StrtCDOnRly" VAL_BLK 0x1D0A1C Kwb_Wu16 1152.00000000 SigName 0.00 1152.00000000 FORMAT "%13.8" NUMBER 8 /end CHARACTERISTIC
/begin CHARACTERISTIC DSM_EnvDfp_StrtCtlIlsNotPlaus_C "Fehlerpfad spezifische Umweltbedingungen für Fehlerpfad Dfp_StrtCtlIlsNotPlaus" VAL_BLK 0x1D0A2C Kwb_Wu16 1152.00000000 SigName 0.00 1152.00000000 FORMAT "%13.8" NUMBER 8 /end CHARACTERISTIC
/begin CHARACTERISTIC DSM_EnvDfp_StrtCtlT50ROneRly1_C "Fehlerpfad spezifische Umweltbedingungen fuer Fehlerpfad Dfp_StrtCtlT50ROneRly1" VAL_BLK 0x1D0A3C Kwb_Wu16 1152.00000000 SigName 0.00 1152.00000000 FORMAT "%13.8" NUMBER 8 /end CHARACTERISTIC
/begin CHARACTERISTIC DSM_EnvDfp_StrtCtlT50ROneRly2_C "Fehlerpfad spezifische Umweltbedingungen fuer Fehlerpfad Dfp_StrtCtlT50ROneRly2" VAL_BLK 0x1D0A4C Kwb_Wu16 1152.00000000 SigName 0.00 1152.00000000 FORMAT "%13.8" NUMBER 8 /end CHARACTERISTIC
/begin CHARACTERISTIC DSM_EnvDfp_StrtCtlT50RZero_C "Fehlerpfad spezifische Umweltbedingungen fuer Fehlerpfad Dfp_StrtCtlT50RZero" VAL_BLK 0x1D0A5C Kwb_Wu16 1152.00000000 SigName 0.00 1152.00000000 FORMAT "%13.8" NUMBER 8 /end CHARACTERISTIC
/begin CHARACTERISTIC DSM_EnvDfp_SysLamp_C "Fehlerpfad spezifische Umweltbedingungen fuer Fehlerpfad Dfp_SysLamp" VAL_BLK 0x1D0A6C Kwb_Wu16 1152.00000000 SigName 0.00 1152.00000000 FORMAT "%13.8" NUMBER 8 /end CHARACTERISTIC
/begin CHARACTERISTIC DSM_EnvDfp_T15CD_C "Fehlerpfad spezifische Umweltbedingungen fuer Fehlerpfad Dfp_T15CD" VAL_BLK 0x1D0A7C Kwb_Wu16 1152.00000000 SigName 0.00 1152.00000000 FORMAT "%13.8" NUMBER 8 /end CHARACTERISTIC
/begin CHARACTERISTIC DSM_EnvDfp_T50CD_C "Fehlerpfad spezifische Umweltbedingungen fuer Fehlerpfad Dfp_T50CD" VAL_BLK 0x1D0A8C Kwb_Wu16 1152.00000000 SigName 0.00 1152.00000000 FORMAT "%13.8" NUMBER 8 /end CHARACTERISTIC
/begin CHARACTERISTIC DSM_EnvDfp_TPUMon_C "Fehlerpfad spezifische Umweltbedingungen fuer Fehlerpfad Dfp_TPUMon" VAL_BLK 0x1D0A9C Kwb_Wu16 1152.00000000 SigName 0.00 1152.00000000 FORMAT "%13.8" NUMBER 8 /end CHARACTERISTIC
/begin CHARACTERISTIC DSM_EnvDfp_TVACD_Max_C "Fehlerpfad spezifische Umweltbedingungen fuer Fehlerpfad Dfp_TVACD_Max" VAL_BLK 0x1D0AAC Kwb_Wu16 1152.00000000 SigName 0.00 1152.00000000 FORMAT "%13.8" NUMBER 8 /end CHARACTERISTIC
/begin CHARACTERISTIC DSM_EnvDfp_TVACD_Min_C "Fehlerpfad spezifische Umweltbedingungen fuer Fehlerpfad Dfp_TVACD_Min" VAL_BLK 0x1D0ABC Kwb_Wu16 1152.00000000 SigName 0.00 1152.00000000 FORMAT "%13.8" NUMBER 8 /end CHARACTERISTIC
/begin CHARACTERISTIC DSM_EnvDfp_TVACD_Sig_C "Fehlerpfad spezifische Umweltbedingungen fuer Fehlerpfad Dfp_TVACD_Sig" VAL_BLK 0x1D0ACC Kwb_Wu16 1152.00000000 SigName 0.00 1152.00000000 FORMAT "%13.8" NUMBER 8 /end CHARACTERISTIC
/begin CHARACTERISTIC DSM_EnvDfp_TVACD_SigNpl_C "Fehlerpfad spezifische Umweltbedingungen fuer Fehlerpfad Dfp_TVACD_SigNpl" VAL_BLK 0x1D0ADC Kwb_Wu16 1152.00000000 SigName 0.00 1152.00000000 FORMAT "%13.8" NUMBER 8 /end CHARACTERISTIC
/begin CHARACTERISTIC DSM_EnvDfp_TVACD_stLineDef_C "Fehlerpfad spezifische Umweltbedingungen fuer Fehlerpfad Dfp_TVACD_stLineDef" VAL_BLK 0x1D0AEC Kwb_Wu16 1152.00000000 SigName 0.00 1152.00000000 FORMAT "%13.8" NUMBER 8 /end CHARACTERISTIC
/begin CHARACTERISTIC DSM_EnvDfp_TVASCD_C "Fehlerpfad spezifische Umweltbedingungen fuer Fehlerpfad Dfp_TVASCD" VAL_BLK 0x1D0AFC Kwb_Wu16 1152.00000000 SigName 0.00 1152.00000000 FORMAT "%13.8" NUMBER 8 /end CHARACTERISTIC
/begin CHARACTERISTIC DSM_EnvDfp_TVASCD_Drft_C "Fehlerpfad spezifische Umweltbedingungen fuer Fehlerpfad Dfp_TVASCD_Drft" VAL_BLK 0x1D0B0C Kwb_Wu16 1152.00000000 SigName 0.00 1152.00000000 FORMAT "%13.8" NUMBER 8 /end CHARACTERISTIC
/begin CHARACTERISTIC DSM_EnvDfp_ThrVlvGvnrDvt_C "Fehlerpfad spezifische Umweltbedingungen fuer Fehlerpfad Dfp_ThrVlvGvnrDvt" VAL_BLK 0x1D0B1C Kwb_Wu16 1152.00000000 SigName 0.00 1152.00000000 FORMAT "%13.8" NUMBER 8 /end CHARACTERISTIC
/begin CHARACTERISTIC DSM_EnvDfp_ThrVlvJamVlv_C "Fehlerpfad spezifische Umweltbedingungen fuer Fehlerpfad Dfp_ThrVlvJamVlv" VAL_BLK 0x1D0B2C Kwb_Wu16 1152.00000000 SigName 0.00 1152.00000000 FORMAT "%13.8" NUMBER 8 /end CHARACTERISTIC
/begin CHARACTERISTIC DSM_EnvDfp_UAcc_CodeBitErr_C "Fehlerpfad spezifische Umweltbedingungen fuer Fehlerpfad Dfp_UAcc_CodeBitErr" VAL_BLK 0x1D0B3C Kwb_Wu16 1152.00000000 SigName 0.00 1152.00000000 FORMAT "%13.8" NUMBER 8 /end CHARACTERISTIC
/begin CHARACTERISTIC DSM_EnvDfp_USAp_DataVariant_C "Fehlerpfad spezifische Umweltbedingungen fuer Fehlerpfad Dfp_USAp_DataVariant" VAL_BLK 0x1D0B4C Kwb_Wu16 1152.00000000 SigName 0.00 1152.00000000 FORMAT "%13.8" NUMBER 8 /end CHARACTERISTIC
/begin CHARACTERISTIC DSM_EnvDfp_USAp_FuncCodeRead_C "Fehlerpfad spezifische Umweltbedingungen fuer Fehlerpfad Dfp_USAp_FuncCodeRead" VAL_BLK 0x1D0B5C Kwb_Wu16 1152.00000000 SigName 0.00 1152.00000000 FORMAT "%13.8" NUMBER 8 /end CHARACTERISTIC
/begin CHARACTERISTIC DSM_EnvDfp_VSACD_Max_C "Fehlerpfad spezifische Umweltbedingungen fuer Fehlerpfad Dfp_VSACD_Max" VAL_BLK 0x1D0B6C Kwb_Wu16 1152.00000000 SigName 0.00 1152.00000000 FORMAT "%13.8" NUMBER 8 /end CHARACTERISTIC
/begin CHARACTERISTIC DSM_EnvDfp_VSACD_Min_C "Fehlerpfad spezifische Umweltbedingungen fuer Fehlerpfad Dfp_VSACD_Min" VAL_BLK 0x1D0B7C Kwb_Wu16 1152.00000000 SigName 0.00 1152.00000000 FORMAT "%13.8" NUMBER 8 /end CHARACTERISTIC
/begin CHARACTERISTIC DSM_EnvDfp_VSACD_SigNpl_C "Fehlerpfad spezifische Umweltbedingungen fuer Fehlerpfad Dfp_VSACD_SigNpl" VAL_BLK 0x1D0B8C Kwb_Wu16 1152.00000000 SigName 0.00 1152.00000000 FORMAT "%13.8" NUMBER 8 /end CHARACTERISTIC
/begin CHARACTERISTIC DSM_EnvDfp_VSSCD_C "Fehlerpfad spezifische Umweltbedingungen fuer Fehlerpfad Dfp_VSSCD" VAL_BLK 0x1D0B9C Kwb_Wu16 1152.00000000 SigName 0.00 1152.00000000 FORMAT "%13.8" NUMBER 8 /end CHARACTERISTIC
/begin CHARACTERISTIC DSM_EnvDfp_VSSCD1_C "Fehlerpfad spezifische Umweltbedingungen fuer Fehlerpfad Dfp_VSSCD1" VAL_BLK 0x1D0BAC Kwb_Wu16 1152.00000000 SigName 0.00 1152.00000000 FORMAT "%13.8" NUMBER 8 /end CHARACTERISTIC
/begin CHARACTERISTIC DSM_EnvDfp_VSSCD2_C "Fehlerpfad spezifische Umweltbedingungen fuer Fehlerpfad Dfp_VSSCD2" VAL_BLK 0x1D0BBC Kwb_Wu16 1152.00000000 SigName 0.00 1152.00000000 FORMAT "%13.8" NUMBER 8 /end CHARACTERISTIC
/begin CHARACTERISTIC DSM_EnvDfp_VSSCD4_C "Fehlerpfad spezifische Umweltbedingungen fuer Fehlerpfad Dfp_VSSCD4" VAL_BLK 0x1D0BCC Kwb_Wu16 1152.00000000 SigName 0.00 1152.00000000 FORMAT "%13.8" NUMBER 8 /end CHARACTERISTIC
/begin CHARACTERISTIC DSM_EnvDfp_VSSCDBrkLowVltg_C "Fehlerpfad spezifische Umweltbedingungen fuer Fehlerpfad Dfp_VSSCDBrkLowVltg" VAL_BLK 0x1D0BDC Kwb_Wu16 1152.00000000 SigName 0.00 1152.00000000 FORMAT "%13.8" NUMBER 8 /end CHARACTERISTIC
/begin CHARACTERISTIC DSM_EnvDfp_VSSCDCAN_C "Fehlerpfad spezifische Umweltbedingungen fuer Fehlerpfad Dfp_VSSCDCAN" VAL_BLK 0x1D0BEC Kwb_Wu16 1152.00000000 SigName 0.00 1152.00000000 FORMAT "%13.8" NUMBER 8 /end CHARACTERISTIC
/begin CHARACTERISTIC DSM_EnvDfp_VSSCDNpl_C "Fehlerpfad spezifische Umweltbedingungen fuer Fehlerpfad Dfp_VSSCDNpl" VAL_BLK 0x1D0BFC Kwb_Wu16 1152.00000000 SigName 0.00 1152.00000000 FORMAT "%13.8" NUMBER 8 /end CHARACTERISTIC
/begin CHARACTERISTIC DSM_EnvDfp_WdCom_C "Fehlerpfad spezifische Umweltbedingungen fuer Fehlerpfad Dfp_WdCom" VAL_BLK 0x1D0C1C Kwb_Wu16 1152.00000000 SigName 0.00 1152.00000000 FORMAT "%13.8" NUMBER 8 /end CHARACTERISTIC
/begin CHARACTERISTIC DSM_FMKDfp_ACCCD_C "Ausblendbedingungen fuer Fehlerpfad Dfp_ACCCD" VALUE 0x1CD92C Kw_Wu8 255.0 OneToOne 0.00 255.0 FORMAT "%5.1" /end CHARACTERISTIC
/begin CHARACTERISTIC DSM_FMKDfp_ACCCDBrkErr_C "Ausblendbedingungen fuer Fehlerpfad Dfp_ACCCDBrkErr" VALUE 0x1CD92D Kw_Wu8 255.0 OneToOne 0.00 255.0 FORMAT "%5.1" /end CHARACTERISTIC
/begin CHARACTERISTIC DSM_FMKDfp_ACCCDBrkNPL_C "Ausblendbedingungen fuer Fehlerpfad Dfp_ACCCDBrkNPL" VALUE 0x1CD92E Kw_Wu8 255.0 OneToOne 0.00 255.0 FORMAT "%5.1" /end CHARACTERISTIC
/begin CHARACTERISTIC DSM_FMKDfp_ACCCDSensErr_C "Ausblendbedingungen fuer Fehlerpfad Dfp_ACCCDSensErr" VALUE 0x1CD92F Kw_Wu8 255.0 OneToOne 0.00 255.0 FORMAT "%5.1" /end CHARACTERISTIC
/begin CHARACTERISTIC DSM_FMKDfp_ACCCDWrongCoded_C "Ausblendbedingungen fuer Fehlerpfad Dfp_ACCCDWrongCoded" VALUE 0x1CD930 Kw_Wu8 255.0 OneToOne 0.00 255.0 FORMAT "%5.1" /end CHARACTERISTIC
/begin CHARACTERISTIC DSM_FMKDfp_ACCD_C "Ausblendbedingungen fuer Fehlerpfad Dfp_ACCD" VALUE 0x1CD931 Kw_Wu8 255.0 OneToOne 0.00 255.0 FORMAT "%5.1" /end CHARACTERISTIC
/begin CHARACTERISTIC DSM_FMKDfp_ACCD_PAC_C "Ausblendbedingungen fuer Fehlerpfad Dfp_ACCD_PAC" VALUE 0x1CD932 Kw_Wu8 255.0 OneToOne 0.00 255.0 FORMAT "%5.1" /end CHARACTERISTIC
/begin CHARACTERISTIC DSM_FMKDfp_ACCD_pCAN_C "Ausblendbedingungen fuer Fehlerpfad Dfp_ACCD_pCAN" VALUE 0x1CD933 Kw_Wu8 255.0 OneToOne 0.00 255.0 FORMAT "%5.1" /end CHARACTERISTIC
/begin CHARACTERISTIC DSM_FMKDfp_ACCD_trqCAN_C "Ausblendbedingungen fuer Fehlerpfad Dfp_ACCD_trqCAN" VALUE 0x1CD934 Kw_Wu8 255.0 OneToOne 0.00 255.0 FORMAT "%5.1" /end CHARACTERISTIC
/begin CHARACTERISTIC DSM_FMKDfp_ACCIRevPanErr_C "Ausblendbedingungen fuer Fehlerpfad Dfp_ACCIRevPanErr" VALUE 0x1CD935 Kw_Wu8 255.0 OneToOne 0.00 255.0 FORMAT "%5.1" /end CHARACTERISTIC
/begin CHARACTERISTIC DSM_FMKDfp_ACCIRevShOff_C "Ausblendbedingungen fuer Fehlerpfad Dfp_ACCIRevShOff" VALUE 0x1CD936 Kw_Wu8 255.0 OneToOne 0.00 255.0 FORMAT "%5.1" /end CHARACTERISTIC
/begin CHARACTERISTIC DSM_FMKDfp_ACCnotPlaus_C "Ausblendbedingungen fuer Fehlerpfad Dfp_ACCnotPlaus" VALUE 0x1CD937 Kw_Wu8 255.0 OneToOne 0.00 255.0 FORMAT "%5.1" /end CHARACTERISTIC
/begin CHARACTERISTIC DSM_FMKDfp_ADCMon_C "Ausblendbedingungen fuer Fehlerpfad Dfp_ADCMon" VALUE 0x1CD938 Kw_Wu8 255.0 OneToOne 0.00 255.0 FORMAT "%5.1" /end CHARACTERISTIC
/begin CHARACTERISTIC DSM_FMKDfp_AFSCD_PlOffsDrft_C "Ausblendbedingungen fuer Fehlerpfad Dfp_AFSCD_PlOffsDrft" VALUE 0x1CD939 Kw_Wu8 255.0 OneToOne 0.00 255.0 FORMAT "%5.1" /end CHARACTERISTIC
/begin CHARACTERISTIC DSM_FMKDfp_AFSCD_PlSetyDrft_C "Ausblendbedingungen fuer Fehlerpfad Dfp_AFSCD_PlSetyDrft" VALUE 0x1CD93A Kw_Wu8 255.0 OneToOne 0.00 255.0 FORMAT "%5.1" /end CHARACTERISTIC
/begin CHARACTERISTIC DSM_FMKDfp_AFSCD_SRCAirm_C "Ausblendbedingungen fuer Fehlerpfad Dfp_AFSCD_SRCAirm" VALUE 0x1CD93B Kw_Wu8 255.0 OneToOne 0.00 255.0 FORMAT "%5.1" /end CHARACTERISTIC
/begin CHARACTERISTIC DSM_FMKDfp_AFVCD_Actr_C "Ausblendbedingungen fuer Fehlerpfad Dfp_AFVCD_Actr" VALUE 0x1CD93C Kw_Wu8 255.0 OneToOne 0.00 255.0 FORMAT "%5.1" /end CHARACTERISTIC
/begin CHARACTERISTIC DSM_FMKDfp_AOHtCDHt1_C "Ausblendbedingungen fuer Fehlerpfad Dfp_AOHtCDHt1" VALUE 0x1CD93D Kw_Wu8 255.0 OneToOne 0.00 255.0 FORMAT "%5.1" /end CHARACTERISTIC
/begin CHARACTERISTIC DSM_FMKDfp_AOHtCDHt2_C "Ausblendbedingungen fuer Fehlerpfad Dfp_AOHtCDHt2" VALUE 0x1CD93E Kw_Wu8 255.0 OneToOne 0.00 255.0 FORMAT "%5.1" /end CHARACTERISTIC
/begin CHARACTERISTIC DSM_FMKDfp_AOHtCDHt3_C "Ausblendbedingungen fuer Fehlerpfad Dfp_AOHtCDHt3" VALUE 0x1CD93F Kw_Wu8 255.0 OneToOne 0.00 255.0 FORMAT "%5.1" /end CHARACTERISTIC
/begin CHARACTERISTIC DSM_FMKDfp_APP1_C "Ausblendbedingungen fuer Fehlerpfad Dfp_APP1" VALUE 0x1CD940 Kw_Wu8 255.0 OneToOne 0.00 255.0 FORMAT "%5.1" /end CHARACTERISTIC
/begin CHARACTERISTIC DSM_FMKDfp_APP2_C "Ausblendbedingungen fuer Fehlerpfad Dfp_APP2" VALUE 0x1CD941 Kw_Wu8 255.0 OneToOne 0.00 255.0 FORMAT "%5.1" /end CHARACTERISTIC
/begin CHARACTERISTIC DSM_FMKDfp_APPCD_KickDown_C "Ausblendbedingungen fuer Fehlerpfad Dfp_APPCD_KickDown" VALUE 0x1CD942 Kw_Wu8 255.0 OneToOne 0.00 255.0 FORMAT "%5.1" /end CHARACTERISTIC
/begin CHARACTERISTIC DSM_FMKDfp_APPCD_PWGDrft_C "Ausblendbedingungen fuer Fehlerpfad Dfp_APPCD_PWGDrft" VALUE 0x1CD943 Kw_Wu8 255.0 OneToOne 0.00 255.0 FORMAT "%5.1" /end CHARACTERISTIC
/begin CHARACTERISTIC DSM_FMKDfp_APPSync_C "Ausblendbedingungen fuer Fehlerpfad Dfp_APPSync" VALUE 0x1CD944 Kw_Wu8 255.0 OneToOne 0.00 255.0 FORMAT "%5.1" /end CHARACTERISTIC
/begin CHARACTERISTIC DSM_FMKDfp_APP_Npl_C "Ausblendbedingungen fuer Fehlerpfad Dfp_APP_Npl" VALUE 0x1CD945 Kw_Wu8 255.0 OneToOne 0.00 255.0 FORMAT "%5.1" /end CHARACTERISTIC
/begin CHARACTERISTIC DSM_FMKDfp_APSCD_C "Ausblendbedingungen fuer Fehlerpfad Dfp_APSCD" VALUE 0x1CD946 Kw_Wu8 255.0 OneToOne 0.00 255.0 FORMAT "%5.1" /end CHARACTERISTIC
/begin CHARACTERISTIC DSM_FMKDfp_AccPedPlausBrk_C "Ausblendbedingungen fuer Fehlerpfad Dfp_AccPedPlausBrk" VALUE 0x1CD947 Kw_Wu8 255.0 OneToOne 0.00 255.0 FORMAT "%5.1" /end CHARACTERISTIC
/begin CHARACTERISTIC DSM_FMKDfp_AirCtl_GovDevMax_C "Ausblendbedingungen fuer Fehlerpfad Dfp_AirCtl_GovDevMax" VALUE 0x1CD948 Kw_Wu8 255.0 OneToOne 0.00 255.0 FORMAT "%5.1" /end CHARACTERISTIC
/begin CHARACTERISTIC DSM_FMKDfp_AirCtl_GovDevMin_C "Ausblendbedingungen fuer Fehlerpfad Dfp_AirCtl_GovDevMin" VALUE 0x1CD949 Kw_Wu8 255.0 OneToOne 0.00 255.0 FORMAT "%5.1" /end CHARACTERISTIC
/begin CHARACTERISTIC DSM_FMKDfp_AirCtl_GovDevRgnMax_C "Ausblendbedingungen fuer Fehlerpfad Dfp_AirCtl_GovDevRgnMax" VALUE 0x1CD94A Kw_Wu8 255.0 OneToOne 0.00 255.0 FORMAT "%5.1" /end CHARACTERISTIC
/begin CHARACTERISTIC DSM_FMKDfp_AirCtl_GovDevRgnMin_C "Ausblendbedingungen fuer Fehlerpfad Dfp_AirCtl_GovDevRgnMin" VALUE 0x1CD94B Kw_Wu8 255.0 OneToOne 0.00 255.0 FORMAT "%5.1" /end CHARACTERISTIC
/begin CHARACTERISTIC DSM_FMKDfp_AirbCDCrash_C "Ausblendbedingungen fuer Fehlerpfad Dfp_AirbCDCrash" VALUE 0x1CD94C Kw_Wu8 255.0 OneToOne 0.00 255.0 FORMAT "%5.1" /end CHARACTERISTIC
/begin CHARACTERISTIC DSM_FMKDfp_AirbCDCrashCrCtl_C "Ausblendbedingungen fuer Fehlerpfad Dfp_AirbCDCrashCrCtl" VALUE 0x1CD94D Kw_Wu8 255.0 OneToOne 0.00 255.0 FORMAT "%5.1" /end CHARACTERISTIC
/begin CHARACTERISTIC DSM_FMKDfp_AirbCDCrashPSP_C "Ausblendbedingungen fuer Fehlerpfad Dfp_AirbCDCrashPSP" VALUE 0x1CD94E Kw_Wu8 255.0 OneToOne 0.00 255.0 FORMAT "%5.1" /end CHARACTERISTIC
/begin CHARACTERISTIC DSM_FMKDfp_AltCDExc_C "Ausblendbedingungen fuer Fehlerpfad Dfp_AltCDExc" VALUE 0x1CD94F Kw_Wu8 255.0 OneToOne 0.00 255.0 FORMAT "%5.1" /end CHARACTERISTIC
/begin CHARACTERISTIC DSM_FMKDfp_AltCD_Load_C "Ausblendbedingungen fuer Fehlerpfad Dfp_AltCD_Load" VALUE 0x1CD950 Kw_Wu8 255.0 OneToOne 0.00 255.0 FORMAT "%5.1" /end CHARACTERISTIC
/begin CHARACTERISTIC DSM_FMKDfp_AltPwrCan_C "Ausblendbedingungen fuer Fehlerpfad Dfp_AltPwrCan" VALUE 0x1CD951 Kw_Wu8 255.0 OneToOne 0.00 255.0 FORMAT "%5.1" /end CHARACTERISTIC
/begin CHARACTERISTIC DSM_FMKDfp_BIP01_C "Ausblendbedingungen fuer Fehlerpfad Dfp_BIP01" VALUE 0x1CD952 Kw_Wu8 255.0 OneToOne 0.00 255.0 FORMAT "%5.1" /end CHARACTERISTIC
/begin CHARACTERISTIC DSM_FMKDfp_BIP02_C "Ausblendbedingungen fuer Fehlerpfad Dfp_BIP02" VALUE 0x1CD953 Kw_Wu8 255.0 OneToOne 0.00 255.0 FORMAT "%5.1" /end CHARACTERISTIC
/begin CHARACTERISTIC DSM_FMKDfp_BIP03_C "Ausblendbedingungen fuer Fehlerpfad Dfp_BIP03" VALUE 0x1CD954 Kw_Wu8 255.0 OneToOne 0.00 255.0 FORMAT "%5.1" /end CHARACTERISTIC
/begin CHARACTERISTIC DSM_FMKDfp_BIP04_C "Ausblendbedingungen fuer Fehlerpfad Dfp_BIP04" VALUE 0x1CD955 Kw_Wu8 255.0 OneToOne 0.00 255.0 FORMAT "%5.1" /end CHARACTERISTIC
/begin CHARACTERISTIC DSM_FMKDfp_BIP05_C "Ausblendbedingungen fuer Fehlerpfad Dfp_BIP05" VALUE 0x1CD956 Kw_Wu8 255.0 OneToOne 0.00 255.0 FORMAT "%5.1" /end CHARACTERISTIC
/begin CHARACTERISTIC DSM_FMKDfp_BIP06_C "Ausblendbedingungen fuer Fehlerpfad Dfp_BIP06" VALUE 0x1CD957 Kw_Wu8 255.0 OneToOne 0.00 255.0 FORMAT "%5.1" /end CHARACTERISTIC
/begin CHARACTERISTIC DSM_FMKDfp_BIP07_C "Ausblendbedingungen fuer Fehlerpfad Dfp_BIP07" VALUE 0x1CD958 Kw_Wu8 255.0 OneToOne 0.00 255.0 FORMAT "%5.1" /end CHARACTERISTIC
/begin CHARACTERISTIC DSM_FMKDfp_BIP08_C "Ausblendbedingungen fuer Fehlerpfad Dfp_BIP08" VALUE 0x1CD959 Kw_Wu8 255.0 OneToOne 0.00 255.0 FORMAT "%5.1" /end CHARACTERISTIC
/begin CHARACTERISTIC DSM_FMKDfp_BIP09_C "Ausblendbedingungen fuer Fehlerpfad Dfp_BIP09" VALUE 0x1CD95A Kw_Wu8 255.0 OneToOne 0.00 255.0 FORMAT "%5.1" /end CHARACTERISTIC
/begin CHARACTERISTIC DSM_FMKDfp_BIP10_C "Ausblendbedingungen fuer Fehlerpfad Dfp_BIP10" VALUE 0x1CD95B Kw_Wu8 255.0 OneToOne 0.00 255.0 FORMAT "%5.1" /end CHARACTERISTIC
/begin CHARACTERISTIC DSM_FMKDfp_BIP11_C "Ausblendbedingungen fuer Fehlerpfad Dfp_BIP11" VALUE 0x1CD95C Kw_Wu8 255.0 OneToOne 0.00 255.0 FORMAT "%5.1" /end CHARACTERISTIC
/begin CHARACTERISTIC DSM_FMKDfp_BIP12_C "Ausblendbedingungen fuer Fehlerpfad Dfp_BIP12" VALUE 0x1CD95D Kw_Wu8 255.0 OneToOne 0.00 255.0 FORMAT "%5.1" /end CHARACTERISTIC
/begin CHARACTERISTIC DSM_FMKDfp_BIP_Con_C "Ausblendbedingungen fuer Fehlerpfad Dfp_BIP_Con" VALUE 0x1CD95E Kw_Wu8 255.0 OneToOne 0.00 255.0 FORMAT "%5.1" /end CHARACTERISTIC
/begin CHARACTERISTIC DSM_FMKDfp_BPACD_Max_C "Ausblendbedingungen fuer Fehlerpfad Dfp_BPACD_Max" VALUE 0x1CD95F Kw_Wu8 255.0 OneToOne 0.00 255.0 FORMAT "%5.1" /end CHARACTERISTIC
/begin CHARACTERISTIC DSM_FMKDfp_BPACD_Max2_C "Ausblendbedingungen fuer Fehlerpfad Dfp_BPACD_Max2" VALUE 0x1CD960 Kw_Wu8 255.0 OneToOne 0.00 255.0 FORMAT "%5.1" /end CHARACTERISTIC
/begin CHARACTERISTIC DSM_FMKDfp_BPACD_Min_C "Ausblendbedingungen fuer Fehlerpfad Dfp_BPACD_Min" VALUE 0x1CD961 Kw_Wu8 255.0 OneToOne 0.00 255.0 FORMAT "%5.1" /end CHARACTERISTIC
/begin CHARACTERISTIC DSM_FMKDfp_BPACD_Min2_C "Ausblendbedingungen fuer Fehlerpfad Dfp_BPACD_Min2" VALUE 0x1CD962 Kw_Wu8 255.0 OneToOne 0.00 255.0 FORMAT "%5.1" /end CHARACTERISTIC
/begin CHARACTERISTIC DSM_FMKDfp_BPACD_SigNpl_C "Ausblendbedingungen fuer Fehlerpfad Dfp_BPACD_SigNpl" VALUE 0x1CD963 Kw_Wu8 255.0 OneToOne 0.00 255.0 FORMAT "%5.1" /end CHARACTERISTIC
/begin CHARACTERISTIC DSM_FMKDfp_BPACD_SigNpl2_C "Ausblendbedingungen fuer Fehlerpfad Dfp_BPACD_SigNpl2" VALUE 0x1CD964 Kw_Wu8 255.0 OneToOne 0.00 255.0 FORMAT "%5.1" /end CHARACTERISTIC
/begin CHARACTERISTIC DSM_FMKDfp_BPASCD_C "Ausblendbedingungen fuer Fehlerpfad Dfp_BPASCD" VALUE 0x1CD965 Kw_Wu8 255.0 OneToOne 0.00 255.0 FORMAT "%5.1" /end CHARACTERISTIC
/begin CHARACTERISTIC DSM_FMKDfp_BPSCD_C "Ausblendbedingungen fuer Fehlerpfad Dfp_BPSCD" VALUE 0x1CD966 Kw_Wu8 255.0 OneToOne 0.00 255.0 FORMAT "%5.1" /end CHARACTERISTIC
/begin CHARACTERISTIC DSM_FMKDfp_BattCD_C "Ausblendbedingungen fuer Fehlerpfad Dfp_BattCD" VALUE 0x1CD968 Kw_Wu8 255.0 OneToOne 0.00 255.0 FORMAT "%5.1" /end CHARACTERISTIC
/begin CHARACTERISTIC DSM_FMKDfp_BrkCD_C "Ausblendbedingungen fuer Fehlerpfad Dfp_BrkCD" VALUE 0x1CD969 Kw_Wu8 255.0 OneToOne 0.00 255.0 FORMAT "%5.1" /end CHARACTERISTIC
/begin CHARACTERISTIC DSM_FMKDfp_BrkCDBPTInvld_C "Ausblendbedingungen fuer Fehlerpfad Dfp_BrkCDBPTInvld" VALUE 0x1CD96A Kw_Wu8 255.0 OneToOne 0.00 255.0 FORMAT "%5.1" /end CHARACTERISTIC
/begin CHARACTERISTIC DSM_FMKDfp_BrkCDdynPl_C "Ausblendbedingungen fuer Fehlerpfad Dfp_BrkCDdynPl" VALUE 0x1CD96B Kw_Wu8 255.0 OneToOne 0.00 255.0 FORMAT "%5.1" /end CHARACTERISTIC
/begin CHARACTERISTIC DSM_FMKDfp_CANA_C "Ausblendbedingungen fuer Fehlerpfad Dfp_CANA" VALUE 0x1CD96C Kw_Wu8 255.0 OneToOne 0.00 255.0 FORMAT "%5.1" /end CHARACTERISTIC
/begin CHARACTERISTIC DSM_FMKDfp_CANB_C "Ausblendbedingungen fuer Fehlerpfad Dfp_CANB" VALUE 0x1CD96D Kw_Wu8 255.0 OneToOne 0.00 255.0 FORMAT "%5.1" /end CHARACTERISTIC
/begin CHARACTERISTIC DSM_FMKDfp_CANBus1_C "Ausblendbedingungen fuer Fehlerpfad Dfp_CANBus1" VALUE 0x1CD96E Kw_Wu8 255.0 OneToOne 0.00 255.0 FORMAT "%5.1" /end CHARACTERISTIC
/begin CHARACTERISTIC DSM_FMKDfp_CANBus2_C "Ausblendbedingungen fuer Fehlerpfad Dfp_CANBus2" VALUE 0x1CD96F Kw_Wu8 255.0 OneToOne 0.00 255.0 FORMAT "%5.1" /end CHARACTERISTIC
/begin CHARACTERISTIC DSM_FMKDfp_CANBus3_C "Ausblendbedingungen fuer Fehlerpfad Dfp_CANBus3" VALUE 0x1CD970 Kw_Wu8 255.0 OneToOne 0.00 255.0 FORMAT "%5.1" /end CHARACTERISTIC
/begin CHARACTERISTIC DSM_FMKDfp_CANC_C "Ausblendbedingungen fuer Fehlerpfad Dfp_CANC" VALUE 0x1CD971 Kw_Wu8 255.0 OneToOne 0.00 255.0 FORMAT "%5.1" /end CHARACTERISTIC
/begin CHARACTERISTIC DSM_FMKDfp_CANErrActA_C "Ausblendbedingungen fuer Fehlerpfad Dfp_CANErrActA" VALUE 0x1CD972 Kw_Wu8 255.0 OneToOne 0.00 255.0 FORMAT "%5.1" /end CHARACTERISTIC
/begin CHARACTERISTIC DSM_FMKDfp_CANErrActB_C "Ausblendbedingungen fuer Fehlerpfad Dfp_CANErrActB" VALUE 0x1CD973 Kw_Wu8 255.0 OneToOne 0.00 255.0 FORMAT "%5.1" /end CHARACTERISTIC
/begin CHARACTERISTIC DSM_FMKDfp_CANErrActC_C "Ausblendbedingungen fuer Fehlerpfad Dfp_CANErrActC" VALUE 0x1CD974 Kw_Wu8 255.0 OneToOne 0.00 255.0 FORMAT "%5.1" /end CHARACTERISTIC
/begin CHARACTERISTIC DSM_FMKDfp_COTSCD_C "Ausblendbedingungen fuer Fehlerpfad Dfp_COTSCD" VALUE 0x1CD975 Kw_Wu8 255.0 OneToOne 0.00 255.0 FORMAT "%5.1" /end CHARACTERISTIC
/begin CHARACTERISTIC DSM_FMKDfp_CTSCD_C "Ausblendbedingungen fuer Fehlerpfad Dfp_CTSCD" VALUE 0x1CD976 Kw_Wu8 255.0 OneToOne 0.00 255.0 FORMAT "%5.1" /end CHARACTERISTIC
/begin CHARACTERISTIC DSM_FMKDfp_CTSCDCanInac_C "Ausblendbedingungen fuer Fehlerpfad Dfp_CTSCDCanInac" VALUE 0x1CD977 Kw_Wu8 255.0 OneToOne 0.00 255.0 FORMAT "%5.1" /end CHARACTERISTIC
/begin CHARACTERISTIC DSM_FMKDfp_CTSCDCanSig_C "Ausblendbedingungen fuer Fehlerpfad Dfp_CTSCDCanSig" VALUE 0x1CD978 Kw_Wu8 255.0 OneToOne 0.00 255.0 FORMAT "%5.1" /end CHARACTERISTIC
/begin CHARACTERISTIC DSM_FMKDfp_Clg_DynTst_C "Ausblendbedingungen fuer Fehlerpfad Dfp_Clg_DynTst" VALUE 0x1CD979 Kw_Wu8 255.0 OneToOne 0.00 255.0 FORMAT "%5.1" /end CHARACTERISTIC
/begin CHARACTERISTIC DSM_FMKDfp_CmbChbMisfire1_C "Ausblendbedingungen fuer Fehlerpfad Dfp_CmbChbMisfire1" VALUE 0x1CD97A Kw_Wu8 255.0 OneToOne 0.00 255.0 FORMAT "%5.1" /end CHARACTERISTIC
/begin CHARACTERISTIC DSM_FMKDfp_CmbChbMisfire2_C "Ausblendbedingungen fuer Fehlerpfad Dfp_CmbChbMisfire2" VALUE 0x1CD97B Kw_Wu8 255.0 OneToOne 0.00 255.0 FORMAT "%5.1" /end CHARACTERISTIC
/begin CHARACTERISTIC DSM_FMKDfp_CmbChbMisfire3_C "Ausblendbedingungen fuer Fehlerpfad Dfp_CmbChbMisfire3" VALUE 0x1CD97C Kw_Wu8 255.0 OneToOne 0.00 255.0 FORMAT "%5.1" /end CHARACTERISTIC
/begin CHARACTERISTIC DSM_FMKDfp_CmbChbMisfire4_C "Ausblendbedingungen fuer Fehlerpfad Dfp_CmbChbMisfire4" VALUE 0x1CD97D Kw_Wu8 255.0 OneToOne 0.00 255.0 FORMAT "%5.1" /end CHARACTERISTIC
/begin CHARACTERISTIC DSM_FMKDfp_CmbChbMisfire5_C "Ausblendbedingungen fuer Fehlerpfad Dfp_CmbChbMisfire5" VALUE 0x1CD97E Kw_Wu8 255.0 OneToOne 0.00 255.0 FORMAT "%5.1" /end CHARACTERISTIC
/begin CHARACTERISTIC DSM_FMKDfp_CmbChbMisfire6_C "Ausblendbedingungen fuer Fehlerpfad Dfp_CmbChbMisfire6" VALUE 0x1CD97F Kw_Wu8 255.0 OneToOne 0.00 255.0 FORMAT "%5.1" /end CHARACTERISTIC
/begin CHARACTERISTIC DSM_FMKDfp_CmbChbMisfireMul_C "Ausblendbedingungen fuer Fehlerpfad Dfp_CmbChbMisfireMul" VALUE 0x1CD980 Kw_Wu8 255.0 OneToOne 0.00 255.0 FORMAT "%5.1" /end CHARACTERISTIC
/begin CHARACTERISTIC DSM_FMKDfp_CoVMDCSh_C "Ausblendbedingungen fuer Fehlerpfad Dfp_CoVMDCSh" VALUE 0x1CD982 Kw_Wu8 255.0 OneToOne 0.00 255.0 FORMAT "%5.1" /end CHARACTERISTIC
/begin CHARACTERISTIC DSM_FMKDfp_CoVMDCSp_C "Ausblendbedingungen fuer Fehlerpfad Dfp_CoVMDCSp" VALUE 0x1CD983 Kw_Wu8 255.0 OneToOne 0.00 255.0 FORMAT "%5.1" /end CHARACTERISTIC
/begin CHARACTERISTIC DSM_FMKDfp_CoVehLvl2_C "Ausblendbedingungen fuer Fehlerpfad Dfp_CoVehLvl2" VALUE 0x1CD986 Kw_Wu8 255.0 OneToOne 0.00 255.0 FORMAT "%5.1" /end CHARACTERISTIC
/begin CHARACTERISTIC DSM_FMKDfp_ConvCD_C "Ausblendbedingungen fuer Fehlerpfad Dfp_ConvCD" VALUE 0x1CD987 Kw_Wu8 255.0 OneToOne 0.00 255.0 FORMAT "%5.1" /end CHARACTERISTIC
/begin CHARACTERISTIC DSM_FMKDfp_ConvCD_ConvErr_C "Ausblendbedingungen fuer Fehlerpfad Dfp_ConvCD_ConvErr" VALUE 0x1CD988 Kw_Wu8 255.0 OneToOne 0.00 255.0 FORMAT "%5.1" /end CHARACTERISTIC
/begin CHARACTERISTIC DSM_FMKDfp_ConvCD_EPB1_C "Ausblendbedingungen fuer Fehlerpfad Dfp_ConvCD_EPB1" VALUE 0x1CD989 Kw_Wu8 255.0 OneToOne 0.00 255.0 FORMAT "%5.1" /end CHARACTERISTIC
/begin CHARACTERISTIC DSM_FMKDfp_CrCCDPanErrMSG_C "Ausblendbedingungen fuer Fehlerpfad Dfp_CrCCDPanErrMSG" VALUE 0x1CD98A Kw_Wu8 255.0 OneToOne 0.00 255.0 FORMAT "%5.1" /end CHARACTERISTIC
/begin CHARACTERISTIC DSM_FMKDfp_CrCCDPanErrSMLS_C "Ausblendbedingungen fuer Fehlerpfad Dfp_CrCCDPanErrSMLS" VALUE 0x1CD98B Kw_Wu8 255.0 OneToOne 0.00 255.0 FORMAT "%5.1" /end CHARACTERISTIC
/begin CHARACTERISTIC DSM_FMKDfp_CrCCDPanMainSwtErr_C "Ausblendbedingungen fuer Fehlerpfad Dfp_CrCCDPanMainSwtErr" VALUE 0x1CD98C Kw_Wu8 255.0 OneToOne 0.00 255.0 FORMAT "%5.1" /end CHARACTERISTIC
/begin CHARACTERISTIC DSM_FMKDfp_CrCtlDsplNotPlaus_C "Ausblendbedingungen fuer Fehlerpfad Dfp_CrCtlDsplNotPlaus" VALUE 0x1CD98E Kw_Wu8 255.0 OneToOne 0.00 255.0 FORMAT "%5.1" /end CHARACTERISTIC
/begin CHARACTERISTIC DSM_FMKDfp_CrCtlPECDErr_C "Ausblendbedingungen fuer Fehlerpfad Dfp_CrCtlPECDErr" VALUE 0x1CD98F Kw_Wu8 255.0 OneToOne 0.00 255.0 FORMAT "%5.1" /end CHARACTERISTIC
/begin CHARACTERISTIC DSM_FMKDfp_CrCtlPLmpDef_C "Ausblendbedingungen fuer Fehlerpfad Dfp_CrCtlPLmpDef" VALUE 0x1CD990 Kw_Wu8 255.0 OneToOne 0.00 255.0 FORMAT "%5.1" /end CHARACTERISTIC
/begin CHARACTERISTIC DSM_FMKDfp_CrCtlPShutOff_C "Ausblendbedingungen fuer Fehlerpfad Dfp_CrCtlPShutOff" VALUE 0x1CD991 Kw_Wu8 255.0 OneToOne 0.00 255.0 FORMAT "%5.1" /end CHARACTERISTIC
/begin CHARACTERISTIC DSM_FMKDfp_CrCtlPTlrDef_C "Ausblendbedingungen fuer Fehlerpfad Dfp_CrCtlPTlrDef" VALUE 0x1CD992 Kw_Wu8 255.0 OneToOne 0.00 255.0 FORMAT "%5.1" /end CHARACTERISTIC
/begin CHARACTERISTIC DSM_FMKDfp_CtApCD_C "Ausblendbedingungen fuer Fehlerpfad Dfp_CtApCD" VALUE 0x1CD994 Kw_Wu8 255.0 OneToOne 0.00 255.0 FORMAT "%5.1" /end CHARACTERISTIC
/begin CHARACTERISTIC DSM_FMKDfp_CtTCD_C "Ausblendbedingungen fuer Fehlerpfad Dfp_CtTCD" VALUE 0x1CD995 Kw_Wu8 255.0 OneToOne 0.00 255.0 FORMAT "%5.1" /end CHARACTERISTIC
/begin CHARACTERISTIC DSM_FMKDfp_CtT_Mon_C "Ausblendbedingungen fuer Fehlerpfad Dfp_CtT_Mon" VALUE 0x1CD996 Kw_Wu8 255.0 OneToOne 0.00 255.0 FORMAT "%5.1" /end CHARACTERISTIC
/begin CHARACTERISTIC DSM_FMKDfp_DifftrqLimErrPat_C "Ausblendbedingungen fuer Fehlerpfad Dfp_DifftrqLimErrPat" VALUE 0x1CD997 Kw_Wu8 255.0 OneToOne 0.00 255.0 FORMAT "%5.1" /end CHARACTERISTIC
/begin CHARACTERISTIC DSM_FMKDfp_EATSCD_C "Ausblendbedingungen fuer Fehlerpfad Dfp_EATSCD" VALUE 0x1CD998 Kw_Wu8 255.0 OneToOne 0.00 255.0 FORMAT "%5.1" /end CHARACTERISTIC
/begin CHARACTERISTIC DSM_FMKDfp_EATSCDCanInac_C "Ausblendbedingungen fuer Fehlerpfad Dfp_EATSCDCanInac" VALUE 0x1CD999 Kw_Wu8 255.0 OneToOne 0.00 255.0 FORMAT "%5.1" /end CHARACTERISTIC
/begin CHARACTERISTIC DSM_FMKDfp_EATSCDCanSig_C "Ausblendbedingungen fuer Fehlerpfad Dfp_EATSCDCanSig" VALUE 0x1CD99A Kw_Wu8 255.0 OneToOne 0.00 255.0 FORMAT "%5.1" /end CHARACTERISTIC
/begin CHARACTERISTIC DSM_FMKDfp_EEPCDVarMng_C "Ausblendbedingungen fuer Fehlerpfad Dfp_EEPCDVarMng" VALUE 0x1CD99B Kw_Wu8 255.0 OneToOne 0.00 255.0 FORMAT "%5.1" /end CHARACTERISTIC
/begin CHARACTERISTIC DSM_FMKDfp_EGPpCDTPreTrbn_C "Ausblendbedingungen fuer Fehlerpfad Dfp_EgPpCDTPreTrbn" VALUE 0x1CD99C Kw_Wu8 255.0 OneToOne 0.00 255.0 FORMAT "%5.1" /end CHARACTERISTIC
/begin CHARACTERISTIC DSM_FMKDfp_EGRCD_CBV_C "Ausblendbedingungen fuer Fehlerpfad Dfp_EGRCD_CBV" VALUE 0x1CD99D Kw_Wu8 255.0 OneToOne 0.00 255.0 FORMAT "%5.1" /end CHARACTERISTIC
/begin CHARACTERISTIC DSM_FMKDfp_EGRCD_Max_C "Ausblendbedingungen fuer Fehlerpfad Dfp_EGRCD_Max" VALUE 0x1CD99E Kw_Wu8 255.0 OneToOne 0.00 255.0 FORMAT "%5.1" /end CHARACTERISTIC
/begin CHARACTERISTIC DSM_FMKDfp_EGRCD_Min_C "Ausblendbedingungen fuer Fehlerpfad Dfp_EGRCD_Min" VALUE 0x1CD99F Kw_Wu8 255.0 OneToOne 0.00 255.0 FORMAT "%5.1" /end CHARACTERISTIC
/begin CHARACTERISTIC DSM_FMKDfp_EGRCD_Sig_C "Ausblendbedingungen fuer Fehlerpfad Dfp_EGRCD_Sig" VALUE 0x1CD9A0 Kw_Wu8 255.0 OneToOne 0.00 255.0 FORMAT "%5.1" /end CHARACTERISTIC
/begin CHARACTERISTIC DSM_FMKDfp_EGRCD_SigNpl_C "Ausblendbedingungen fuer Fehlerpfad Dfp_EGRCD_SigNpl" VALUE 0x1CD9A1 Kw_Wu8 255.0 OneToOne 0.00 255.0 FORMAT "%5.1" /end CHARACTERISTIC
/begin CHARACTERISTIC DSM_FMKDfp_EGRSCD_C "Ausblendbedingungen fuer Fehlerpfad Dfp_EGRSCD" VALUE 0x1CD9A2 Kw_Wu8 255.0 OneToOne 0.00 255.0 FORMAT "%5.1" /end CHARACTERISTIC
/begin CHARACTERISTIC DSM_FMKDfp_EGRSCD_JamVlv_C "Ausblendbedingungen fuer Fehlerpfad Dfp_EGRSCD_JamVlv" VALUE 0x1CD9A3 Kw_Wu8 255.0 OneToOne 0.00 255.0 FORMAT "%5.1" /end CHARACTERISTIC
/begin CHARACTERISTIC DSM_FMKDfp_EGRSCD_LgTimeDrft_C "Ausblendbedingungen fuer Fehlerpfad Dfp_EGRSCD_LgTimeDrft" VALUE 0x1CD9A4 Kw_Wu8 255.0 OneToOne 0.00 255.0 FORMAT "%5.1" /end CHARACTERISTIC
/begin CHARACTERISTIC DSM_FMKDfp_EGRSCD_ShTimeDrft_C "Ausblendbedingungen fuer Fehlerpfad Dfp_EGRSCD_ShTimeDrft" VALUE 0x1CD9A5 Kw_Wu8 255.0 OneToOne 0.00 255.0 FORMAT "%5.1" /end CHARACTERISTIC
/begin CHARACTERISTIC DSM_FMKDfp_EGRVlvGvnrDvt_C "Ausblendbedingungen fuer Fehlerpfad Dfp_EGRVlvGvnrDvt" VALUE 0x1CD9A6 Kw_Wu8 255.0 OneToOne 0.00 255.0 FORMAT "%5.1" /end CHARACTERISTIC
/begin CHARACTERISTIC DSM_FMKDfp_EGRVlv_JamVlv_C "Ausblendbedingungen fuer Fehlerpfad Dfp_EGRVlv_JamVlv" VALUE 0x1CD9A7 Kw_Wu8 255.0 OneToOne 0.00 255.0 FORMAT "%5.1" /end CHARACTERISTIC
/begin CHARACTERISTIC DSM_FMKDfp_EMCCD_MLS1_C "Ausblendbedingungen fuer Fehlerpfad Dfp_EMCCD_MLS1" VALUE 0x1CD9A8 Kw_Wu8 255.0 OneToOne 0.00 255.0 FORMAT "%5.1" /end CHARACTERISTIC
/begin CHARACTERISTIC DSM_FMKDfp_EngMBackUp_C "Ausblendbedingungen fuer Fehlerpfad Dfp_EngMBackUp" VALUE 0x1CD9A9 Kw_Wu8 255.0 OneToOne 0.00 255.0 FORMAT "%5.1" /end CHARACTERISTIC
/begin CHARACTERISTIC DSM_FMKDfp_EngMCaS1_C "Ausblendbedingungen fuer Fehlerpfad Dfp_EngMCaS1" VALUE 0x1CD9AA Kw_Wu8 255.0 OneToOne 0.00 255.0 FORMAT "%5.1" /end CHARACTERISTIC
/begin CHARACTERISTIC DSM_FMKDfp_EngMCaSDrv_C "Ausblendbedingungen fuer Fehlerpfad Dfp_EngMCaSDrv" VALUE 0x1CD9AB Kw_Wu8 255.0 OneToOne 0.00 255.0 FORMAT "%5.1" /end CHARACTERISTIC
/begin CHARACTERISTIC DSM_FMKDfp_EngMCrS1_C "Ausblendbedingungen fuer Fehlerpfad Dfp_EngMCrS1" VALUE 0x1CD9AC Kw_Wu8 255.0 OneToOne 0.00 255.0 FORMAT "%5.1" /end CHARACTERISTIC
/begin CHARACTERISTIC DSM_FMKDfp_EngMOfsCaSCrS_C "Ausblendbedingungen fuer Fehlerpfad Dfp_EngMOfsCaSCrS" VALUE 0x1CD9AD Kw_Wu8 255.0 OneToOne 0.00 255.0 FORMAT "%5.1" /end CHARACTERISTIC
/begin CHARACTERISTIC DSM_FMKDfp_EngMonIrrCmb_C "Ausblendbedingungen fuer Fehlerpfad Dfp_EngMonIrrCmb" VALUE 0x1CD9AE Kw_Wu8 255.0 OneToOne 0.00 255.0 FORMAT "%5.1" /end CHARACTERISTIC
/begin CHARACTERISTIC DSM_FMKDfp_EngPrt_C "Ausblendbedingungen fuer Fehlerpfad Dfp_EngPrt" VALUE 0x1CD9AF Kw_Wu8 255.0 OneToOne 0.00 255.0 FORMAT "%5.1" /end CHARACTERISTIC
/begin CHARACTERISTIC DSM_FMKDfp_ErLpCDMILReqON_C "Ausblendbedingungen fuer Fehlerpfad Dfp_ErLpCDMILReqON" VALUE 0x1CD9B0 Kw_Wu8 255.0 OneToOne 0.00 255.0 FORMAT "%5.1" /end CHARACTERISTIC
/begin CHARACTERISTIC DSM_FMKDfp_FMAErrMod_C "Ausblendbedingungen fuer Fehlerpfad Dfp_FMAErrMod" VALUE 0x1CD9B1 Kw_Wu8 255.0 OneToOne 0.00 255.0 FORMAT "%5.1" /end CHARACTERISTIC
/begin CHARACTERISTIC DSM_FMKDfp_FMTC_NonMonotonMap_C "Ausblendbedingungen fuer Fehlerpfad Dfp_FMTC_NonMonotonMap" VALUE 0x1CD9B2 Kw_Wu8 255.0 OneToOne 0.00 255.0 FORMAT "%5.1" /end CHARACTERISTIC
/begin CHARACTERISTIC DSM_FMKDfp_FQTSCD_C "Ausblendbedingungen fuer Fehlerpfad Dfp_FQTSCD" VALUE 0x1CD9B3 Kw_Wu8 255.0 OneToOne 0.00 255.0 FORMAT "%5.1" /end CHARACTERISTIC
/begin CHARACTERISTIC DSM_FMKDfp_FQlSCD_C "Ausblendbedingungen fuer Fehlerpfad Dfp_FQlSCD" VALUE 0x1CD9B4 Kw_Wu8 255.0 OneToOne 0.00 255.0 FORMAT "%5.1" /end CHARACTERISTIC
/begin CHARACTERISTIC DSM_FMKDfp_FTSCD_C "Ausblendbedingungen fuer Fehlerpfad Dfp_FTSCD" VALUE 0x1CD9B5 Kw_Wu8 255.0 OneToOne 0.00 255.0 FORMAT "%5.1" /end CHARACTERISTIC
/begin CHARACTERISTIC DSM_FMKDfp_FTSCDNpl_C "Ausblendbedingungen fuer Fehlerpfad Dfp_FTSCDNpl" VALUE 0x1CD9B6 Kw_Wu8 255.0 OneToOne 0.00 255.0 FORMAT "%5.1" /end CHARACTERISTIC
/begin CHARACTERISTIC DSM_FMKDfp_FanCD_Fan1Ctlr1_C "Ausblendbedingungen fuer Fehlerpfad Dfp_FanCD_Fan1Ctlr1" VALUE 0x1CD9B7 Kw_Wu8 255.0 OneToOne 0.00 255.0 FORMAT "%5.1" /end CHARACTERISTIC
/begin CHARACTERISTIC DSM_FMKDfp_FanCD_Fan1Ctlr2_C "Ausblendbedingungen fuer Fehlerpfad Dfp_FanCD_Fan1Ctlr2" VALUE 0x1CD9B8 Kw_Wu8 255.0 OneToOne 0.00 255.0 FORMAT "%5.1" /end CHARACTERISTIC
/begin CHARACTERISTIC DSM_FMKDfp_FanCD_Fan2Ctlr1_C "Ausblendbedingungen fuer Fehlerpfad Dfp_FanCD_Fan2Ctlr1" VALUE 0x1CD9B9 Kw_Wu8 255.0 OneToOne 0.00 255.0 FORMAT "%5.1" /end CHARACTERISTIC
/begin CHARACTERISTIC DSM_FMKDfp_FanCD_Fan2Ctlr2_C "Ausblendbedingungen fuer Fehlerpfad Dfp_FanCD_Fan2Ctlr2" VALUE 0x1CD9BA Kw_Wu8 255.0 OneToOne 0.00 255.0 FORMAT "%5.1" /end CHARACTERISTIC
/begin CHARACTERISTIC DSM_FMKDfp_FanCD_FanCtlr1_C "Ausblendbedingungen fuer Fehlerpfad Dfp_FanCD_FanCtlr1" VALUE 0x1CD9BB Kw_Wu8 255.0 OneToOne 0.00 255.0 FORMAT "%5.1" /end CHARACTERISTIC
/begin CHARACTERISTIC DSM_FMKDfp_FanCD_FanCtlr2_C "Ausblendbedingungen fuer Fehlerpfad Dfp_FanCD_FanCtlr2" VALUE 0x1CD9BC Kw_Wu8 255.0 OneToOne 0.00 255.0 FORMAT "%5.1" /end CHARACTERISTIC
/begin CHARACTERISTIC DSM_FMKDfp_FanCD_OutFanCtlr1_C "Ausblendbedingungen fuer Fehlerpfad Dfp_FanCD_OutFanCtlr1" VALUE 0x1CD9BD Kw_Wu8 255.0 OneToOne 0.00 255.0 FORMAT "%5.1" /end CHARACTERISTIC
/begin CHARACTERISTIC DSM_FMKDfp_FanCD_OutFanCtlr2_C "Ausblendbedingungen fuer Fehlerpfad Dfp_FanCD_OutFanCtlr2" VALUE 0x1CD9BE Kw_Wu8 255.0 OneToOne 0.00 255.0 FORMAT "%5.1" /end CHARACTERISTIC
/begin CHARACTERISTIC DSM_FMKDfp_FlPpCD_C "Ausblendbedingungen fuer Fehlerpfad Dfp_FlPpCD" VALUE 0x1CD9C0 Kw_Wu8 255.0 OneToOne 0.00 255.0 FORMAT "%5.1" /end CHARACTERISTIC
/begin CHARACTERISTIC DSM_FMKDfp_FlSCDT1_C "Ausblendbedingungen fuer Fehlerpfad Dfp_FlSCDT1" VALUE 0x1CD9C1 Kw_Wu8 255.0 OneToOne 0.00 255.0 FORMAT "%5.1" /end CHARACTERISTIC
/begin CHARACTERISTIC DSM_FMKDfp_FrmMngAAGNpl_C "Ausblendbedingungen fuer Fehlerpfad Dfp_FrmMngAAGNpl" VALUE 0x1CD9C2 Kw_Wu8 255.0 OneToOne 0.00 255.0 FORMAT "%5.1" /end CHARACTERISTIC
/begin CHARACTERISTIC DSM_FMKDfp_FrmMngAAGTO_C "Ausblendbedingungen fuer Fehlerpfad Dfp_FrmMngAAGTO" VALUE 0x1CD9C3 Kw_Wu8 255.0 OneToOne 0.00 255.0 FORMAT "%5.1" /end CHARACTERISTIC
/begin CHARACTERISTIC DSM_FMKDfp_FrmMngAC1Npl_C "Ausblendbedingungen fuer Fehlerpfad Dfp_FrmMngAC1Npl" VALUE 0x1CD9C4 Kw_Wu8 255.0 OneToOne 0.00 255.0 FORMAT "%5.1" /end CHARACTERISTIC
/begin CHARACTERISTIC DSM_FMKDfp_FrmMngAC1TO_C "Ausblendbedingungen fuer Fehlerpfad Dfp_FrmMngAC1TO" VALUE 0x1CD9C5 Kw_Wu8 255.0 OneToOne 0.00 255.0 FORMAT "%5.1" /end CHARACTERISTIC
/begin CHARACTERISTIC DSM_FMKDfp_FrmMngACCNpl_C "Ausblendbedingungen fuer Fehlerpfad Dfp_FrmMngACCNpl" VALUE 0x1CD9C6 Kw_Wu8 255.0 OneToOne 0.00 255.0 FORMAT "%5.1" /end CHARACTERISTIC
/begin CHARACTERISTIC DSM_FMKDfp_FrmMngACCTO_C "Ausblendbedingungen fuer Fehlerpfad Dfp_FrmMngACCTO" VALUE 0x1CD9C7 Kw_Wu8 255.0 OneToOne 0.00 255.0 FORMAT "%5.1" /end CHARACTERISTIC
/begin CHARACTERISTIC DSM_FMKDfp_FrmMngAIRBGNpl_C "Ausblendbedingungen fuer Fehlerpfad Dfp_FrmMngAIRBGNpl" VALUE 0x1CD9C8 Kw_Wu8 255.0 OneToOne 0.00 255.0 FORMAT "%5.1" /end CHARACTERISTIC
/begin CHARACTERISTIC DSM_FMKDfp_FrmMngAIRBGTO_C "Ausblendbedingungen fuer Fehlerpfad Dfp_FrmMngAIRBGTO" VALUE 0x1CD9C9 Kw_Wu8 255.0 OneToOne 0.00 255.0 FORMAT "%5.1" /end CHARACTERISTIC
/begin CHARACTERISTIC DSM_FMKDfp_FrmMngAWD1Npl_C "Ausblendbedingungen fuer Fehlerpfad Dfp_FrmMngAWD1Npl" VALUE 0x1CD9CA Kw_Wu8 255.0 OneToOne 0.00 255.0 FORMAT "%5.1" /end CHARACTERISTIC
/begin CHARACTERISTIC DSM_FMKDfp_FrmMngAWD1TO_C "Ausblendbedingungen fuer Fehlerpfad Dfp_FrmMngAWD1TO" VALUE 0x1CD9CB Kw_Wu8 255.0 OneToOne 0.00 255.0 FORMAT "%5.1" /end CHARACTERISTIC
/begin CHARACTERISTIC DSM_FMKDfp_FrmMngBEM1Npl_C "Ausblendbedingungen für Fehlerpfad Dfp_FrmMngBEM1Npl" VALUE 0x1CD9CC Kw_Wu8 255.0 OneToOne 0.00 255.0 FORMAT "%5.1" /end CHARACTERISTIC
/begin CHARACTERISTIC DSM_FMKDfp_FrmMngBEM1TO_C "Ausblendbedingungen fuer Fehlerpfad Dfp_FrmMngBEM1TO" VALUE 0x1CD9CD Kw_Wu8 255.0 OneToOne 0.00 255.0 FORMAT "%5.1" /end CHARACTERISTIC
/begin CHARACTERISTIC DSM_FMKDfp_FrmMngBRK1Npl_C "Ausblendbedingungen fuer Fehlerpfad Dfp_FrmMngBRK1Npl" VALUE 0x1CD9CE Kw_Wu8 255.0 OneToOne 0.00 255.0 FORMAT "%5.1" /end CHARACTERISTIC
/begin CHARACTERISTIC DSM_FMKDfp_FrmMngBRK1TO_C "Ausblendbedingungen fuer Fehlerpfad Dfp_FrmMngBRK1TO" VALUE 0x1CD9CF Kw_Wu8 255.0 OneToOne 0.00 255.0 FORMAT "%5.1" /end CHARACTERISTIC
/begin CHARACTERISTIC DSM_FMKDfp_FrmMngBRK2Npl_C "Ausblendbedingungen fuer Fehlerpfad Dfp_FrmMngBRK2Npl" VALUE 0x1CD9D0 Kw_Wu8 255.0 OneToOne 0.00 255.0 FORMAT "%5.1" /end CHARACTERISTIC
/begin CHARACTERISTIC DSM_FMKDfp_FrmMngBRK2TO_C "Ausblendbedingungen fuer Fehlerpfad Dfp_FrmMngBRK2TO" VALUE 0x1CD9D1 Kw_Wu8 255.0 OneToOne 0.00 255.0 FORMAT "%5.1" /end CHARACTERISTIC
/begin CHARACTERISTIC DSM_FMKDfp_FrmMngBRK8Npl_C "Ausblendbedingungen fuer Fehlerpfad Dfp_FrmMngBRK8Npl" VALUE 0x1CD9D2 Kw_Wu8 255.0 OneToOne 0.00 255.0 FORMAT "%5.1" /end CHARACTERISTIC
/begin CHARACTERISTIC DSM_FMKDfp_FrmMngBRK8TO_C "Ausblendbedingungen fuer Fehlerpfad Dfp_FrmMngBRK8TO" VALUE 0x1CD9D3 Kw_Wu8 255.0 OneToOne 0.00 255.0 FORMAT "%5.1" /end CHARACTERISTIC
/begin CHARACTERISTIC DSM_FMKDfp_FrmMngBSG3TO_C "Ausblendbedingungen fuer Fehlerpfad Dfp_FrmMngBSG3TO" VALUE 0x1CD9D4 Kw_Wu8 255.0 OneToOne 0.00 255.0 FORMAT "%5.1" /end CHARACTERISTIC
/begin CHARACTERISTIC DSM_FMKDfp_FrmMngCANVerErr_C "Ausblendbedingungen fuer Fehlerpfad Dfp_FrmMngCANVerErr" VALUE 0x1CD9D5 Kw_Wu8 255.0 OneToOne 0.00 255.0 FORMAT "%5.1" /end CHARACTERISTIC
/begin CHARACTERISTIC DSM_FMKDfp_FrmMngCCSel_C "Ausblendbedingungen fuer Fehlerpfad Dfp_FrmMngCCSel_C" VALUE 0x1CD9D6 Kw_Wu8 255.0 OneToOne 0.00 255.0 FORMAT "%5.1" /end CHARACTERISTIC
/begin CHARACTERISTIC DSM_FMKDfp_FrmMngCCTLNpl_C "Ausblendbedingungen fuer Fehlerpfad Dfp_FrmMngCCTLNpl" VALUE 0x1CD9D7 Kw_Wu8 255.0 OneToOne 0.00 255.0 FORMAT "%5.1" /end CHARACTERISTIC
/begin CHARACTERISTIC DSM_FMKDfp_FrmMngCCTLTO_C "Ausblendbedingungen fuer Fehlerpfad Dfp_FrmMngCCTLTO" VALUE 0x1CD9D8 Kw_Wu8 255.0 OneToOne 0.00 255.0 FORMAT "%5.1" /end CHARACTERISTIC
/begin CHARACTERISTIC DSM_FMKDfp_FrmMngCHRGR1Npl_C "Ausblendbedingungen fuer Fehlerpfad Dfp_FrmMngCHRGR1Npl" VALUE 0x1CD9D9 Kw_Wu8 255.0 OneToOne 0.00 255.0 FORMAT "%5.1" /end CHARACTERISTIC
/begin CHARACTERISTIC DSM_FMKDfp_FrmMngCHRGR1TO_C "Ausblendbedingungen fuer Fehlerpfad Dfp_FrmMngCHRGR1TO" VALUE 0x1CD9DA Kw_Wu8 255.0 OneToOne 0.00 255.0 FORMAT "%5.1" /end CHARACTERISTIC
/begin CHARACTERISTIC DSM_FMKDfp_FrmMngCHRGR2Npl_C "Ausblendbedingungen fuer Fehlerpfad Dfp_FrmMngCHRGR2Npl" VALUE 0x1CD9DB Kw_Wu8 255.0 OneToOne 0.00 255.0 FORMAT "%5.1" /end CHARACTERISTIC
/begin CHARACTERISTIC DSM_FMKDfp_FrmMngCHRGR2TO_C "Ausblendbedingungen fuer Fehlerpfad Dfp_FrmMngCHRGR2TO" VALUE 0x1CD9DC Kw_Wu8 255.0 OneToOne 0.00 255.0 FORMAT "%5.1" /end CHARACTERISTIC
/begin CHARACTERISTIC DSM_FMKDfp_FrmMngChrgr1A_C "Ausblendbedingungen fuer Fehlerpfad Dfp_FrmMngChrgr1A" VALUE 0x1CD9DD Kw_Wu8 255.0 OneToOne 0.00 255.0 FORMAT "%5.1" /end CHARACTERISTIC
/begin CHARACTERISTIC DSM_FMKDfp_FrmMngChrgr1C_C "Ausblendbedingungen fuer Fehlerpfad Dfp_FrmMngChrgr1C" VALUE 0x1CD9DE Kw_Wu8 255.0 OneToOne 0.00 255.0 FORMAT "%5.1" /end CHARACTERISTIC
/begin CHARACTERISTIC DSM_FMKDfp_FrmMngChrgr1N_C "Ausblendbedingungen fuer Fehlerpfad Dfp_FrmMngChrgr1N" VALUE 0x1CD9DF Kw_Wu8 255.0 OneToOne 0.00 255.0 FORMAT "%5.1" /end CHARACTERISTIC
/begin CHARACTERISTIC DSM_FMKDfp_FrmMngChrgr1T_C "Ausblendbedingungen fuer Fehlerpfad Dfp_FrmMngChrgr1T" VALUE 0x1CD9E0 Kw_Wu8 255.0 OneToOne 0.00 255.0 FORMAT "%5.1" /end CHARACTERISTIC
/begin CHARACTERISTIC DSM_FMKDfp_FrmMngChrgr1V_C "Ausblendbedingungen fuer Fehlerpfad Dfp_FrmMngChrgr1V" VALUE 0x1CD9E1 Kw_Wu8 255.0 OneToOne 0.00 255.0 FORMAT "%5.1" /end CHARACTERISTIC
/begin CHARACTERISTIC DSM_FMKDfp_FrmMngChrgr2A_C "Ausblendbedingungen fuer Fehlerpfad Dfp_FrmMngChrgr2A" VALUE 0x1CD9E2 Kw_Wu8 255.0 OneToOne 0.00 255.0 FORMAT "%5.1" /end CHARACTERISTIC
/begin CHARACTERISTIC DSM_FMKDfp_FrmMngChrgr2C_C "Ausblendbedingungen fuer Fehlerpfad Dfp_FrmMngChrgr2C" VALUE 0x1CD9E3 Kw_Wu8 255.0 OneToOne 0.00 255.0 FORMAT "%5.1" /end CHARACTERISTIC
/begin CHARACTERISTIC DSM_FMKDfp_FrmMngChrgr2N_C "Ausblendbedingungen fuer Fehlerpfad Dfp_FrmMngChrgr2N" VALUE 0x1CD9E4 Kw_Wu8 255.0 OneToOne 0.00 255.0 FORMAT "%5.1" /end CHARACTERISTIC
/begin CHARACTERISTIC DSM_FMKDfp_FrmMngChrgr2T_C "Ausblendbedingungen fuer Fehlerpfad Dfp_FrmMngChrgr2T" VALUE 0x1CD9E5 Kw_Wu8 255.0 OneToOne 0.00 255.0 FORMAT "%5.1" /end CHARACTERISTIC
/begin CHARACTERISTIC DSM_FMKDfp_FrmMngChrgr2V_C "Ausblendbedingungen fuer Fehlerpfad Dfp_FrmMngChrgr2V" VALUE 0x1CD9E6 Kw_Wu8 255.0 OneToOne 0.00 255.0 FORMAT "%5.1" /end CHARACTERISTIC
/begin CHARACTERISTIC DSM_FMKDfp_FrmMngDIA1Npl_C "Ausblendbedingungen fuer Fehlerpfad Dfp_FrmMngDIA1Npl" VALUE 0x1CD9E7 Kw_Wu8 255.0 OneToOne 0.00 255.0 FORMAT "%5.1" /end CHARACTERISTIC
/begin CHARACTERISTIC DSM_FMKDfp_FrmMngDIA1TO_C "Durch Fehlerpfad Dfp_FrmMngDIA1TO verriegelte Funktionsidentifier" VALUE 0x1CD9E8 Kw_Wu8 255.0 OneToOne 0.00 255.0 FORMAT "%5.1" /end CHARACTERISTIC
/begin CHARACTERISTIC DSM_FMKDfp_FrmMngDSP1Npl_C "Ausblendbedingungen fuer Fehlerpfad Dfp_FrmMngDSP1Npl" VALUE 0x1CD9E9 Kw_Wu8 255.0 OneToOne 0.00 255.0 FORMAT "%5.1" /end CHARACTERISTIC
/begin CHARACTERISTIC DSM_FMKDfp_FrmMngDSP1TO_C "Ausblendbedingungen fuer Fehlerpfad Dfp_FrmMngDSP1TO" VALUE 0x1CD9EA Kw_Wu8 255.0 OneToOne 0.00 255.0 FORMAT "%5.1" /end CHARACTERISTIC
/begin CHARACTERISTIC DSM_FMKDfp_FrmMngDSP2Npl_C "Ausblendbedingungen fuer Fehlerpfad Dfp_FrmMngDSP2Npl" VALUE 0x1CD9EB Kw_Wu8 255.0 OneToOne 0.00 255.0 FORMAT "%5.1" /end CHARACTERISTIC
/begin CHARACTERISTIC DSM_FMKDfp_FrmMngDSP2TO_C "Ausblendbedingungen fuer Fehlerpfad Dfp_FrmMngDSP2TO" VALUE 0x1CD9EC Kw_Wu8 255.0 OneToOne 0.00 255.0 FORMAT "%5.1" /end CHARACTERISTIC
/begin CHARACTERISTIC DSM_FMKDfp_FrmMngDSP3Npl_C "Ausblendbedingungen fuer Fehlerpfad Dfp_FrmMngDSP3Npl" VALUE 0x1CD9ED Kw_Wu8 255.0 OneToOne 0.00 255.0 FORMAT "%5.1" /end CHARACTERISTIC
/begin CHARACTERISTIC DSM_FMKDfp_FrmMngDSP3TO_C "Ausblendbedingungen fuer Fehlerpfad Dfp_FrmMngDSP3TO" VALUE 0x1CD9EE Kw_Wu8 255.0 OneToOne 0.00 255.0 FORMAT "%5.1" /end CHARACTERISTIC
/begin CHARACTERISTIC DSM_FMKDfp_FrmMngEPB1Npl_C "Ausblendbedingungen fuer Fehlerpfad Dfp_FrmMngEPB1Npl" VALUE 0x1CD9EF Kw_Wu8 255.0 OneToOne 0.00 255.0 FORMAT "%5.1" /end CHARACTERISTIC
/begin CHARACTERISTIC DSM_FMKDfp_FrmMngEPB1TO_C "Ausblendbedingungen fuer Fehlerpfad Dfp_FrmMngEPB1TO" VALUE 0x1CD9F0 Kw_Wu8 255.0 OneToOne 0.00 255.0 FORMAT "%5.1" /end CHARACTERISTIC
/begin CHARACTERISTIC DSM_FMKDfp_FrmMngESCUNpl_C "Ausblendbedingungen fuer Fehlerpfad Dfp_FrmMngESCUNpl" VALUE 0x1CD9F1 Kw_Wu8 255.0 OneToOne 0.00 255.0 FORMAT "%5.1" /end CHARACTERISTIC
/begin CHARACTERISTIC DSM_FMKDfp_FrmMngESCUTO_C "Ausblendbedingungen fuer Fehlerpfad Dfp_FrmMngESCUTO" VALUE 0x1CD9F2 Kw_Wu8 255.0 OneToOne 0.00 255.0 FORMAT "%5.1" /end CHARACTERISTIC
/begin CHARACTERISTIC DSM_FMKDfp_FrmMngGW1Npl_C "Ausblendbedingungen fuer Fehlerpfad Dfp_FrmMngGW1Npl" VALUE 0x1CD9F4 Kw_Wu8 255.0 OneToOne 0.00 255.0 FORMAT "%5.1" /end CHARACTERISTIC
/begin CHARACTERISTIC DSM_FMKDfp_FrmMngGW1TO_C "Ausblendbedingungen fuer Fehlerpfad Dfp_FrmMngGW1TO" VALUE 0x1CD9F5 Kw_Wu8 255.0 OneToOne 0.00 255.0 FORMAT "%5.1" /end CHARACTERISTIC
/begin CHARACTERISTIC DSM_FMKDfp_FrmMngILMNpl_C "Ausblendbedingungen fuer Fehlerpfad Dfp_FrmMngILMNpl" VALUE 0x1CD9F6 Kw_Wu8 255.0 OneToOne 0.00 255.0 FORMAT "%5.1" /end CHARACTERISTIC
/begin CHARACTERISTIC DSM_FMKDfp_FrmMngILMTO_C "Ausblendbedingungen fuer Fehlerpfad Dfp_FrmMngILMTO" VALUE 0x1CD9F7 Kw_Wu8 255.0 OneToOne 0.00 255.0 FORMAT "%5.1" /end CHARACTERISTIC
/begin CHARACTERISTIC DSM_FMKDfp_FrmMngLICHT2TO_C "Ausblendbedingungen fuer Fehlerpfad Dfp_FrmMngLICHT2TO" VALUE 0x1CD9F9 Kw_Wu8 255.0 OneToOne 0.00 255.0 FORMAT "%5.1" /end CHARACTERISTIC
/begin CHARACTERISTIC DSM_FMKDfp_FrmMngNIV1WrngCod_C "Ausblendbedingungen fuer Fehlerpfad Dfp_FrmMngNIV1WrngCod" VALUE 0x1CD9FA Kw_Wu8 255.0 OneToOne 0.00 255.0 FORMAT "%5.1" /end CHARACTERISTIC
/begin CHARACTERISTIC DSM_FMKDfp_FrmMngNIVEAU1Npl_C "Ausblendbedingungen fuer Fehlerpfad Dfp_FrmMngNIVEAU1Npl" VALUE 0x1CD9FB Kw_Wu8 255.0 OneToOne 0.00 255.0 FORMAT "%5.1" /end CHARACTERISTIC
/begin CHARACTERISTIC DSM_FMKDfp_FrmMngNIVEAU1TO_C "Ausblendbedingungen fuer Fehlerpfad Dfp_FrmMngNIVEAU1TO" VALUE 0x1CD9FC Kw_Wu8 255.0 OneToOne 0.00 255.0 FORMAT "%5.1" /end CHARACTERISTIC
/begin CHARACTERISTIC DSM_FMKDfp_FrmMngSA1Npl_C "Ausblendbedingungen fuer Fehlerpfad Dfp_FrmMngSA1Npl" VALUE 0x1CD9FD Kw_Wu8 255.0 OneToOne 0.00 255.0 FORMAT "%5.1" /end CHARACTERISTIC
/begin CHARACTERISTIC DSM_FMKDfp_FrmMngSA1TO_C "Ausblendbedingungen fuer Fehlerpfad Dfp_FrmMngSA1TO" VALUE 0x1CD9FE Kw_Wu8 255.0 OneToOne 0.00 255.0 FORMAT "%5.1" /end CHARACTERISTIC
/begin CHARACTERISTIC DSM_FMKDfp_FrmMngSTIGNNpl_C "Ausblendbedingungen fuer Fehlerpfad Dfp_FrmMngSTIGNNpl" VALUE 0x1CD9FF Kw_Wu8 255.0 OneToOne 0.00 255.0 FORMAT "%5.1" /end CHARACTERISTIC
/begin CHARACTERISTIC DSM_FMKDfp_FrmMngStIgnTO_C "Ausblendbedingungen fuer Fehlerpfad Dfp_FrmMngStIgnTO" VALUE 0x1CDA00 Kw_Wu8 255.0 OneToOne 0.00 255.0 FORMAT "%5.1" /end CHARACTERISTIC
/begin CHARACTERISTIC DSM_FMKDfp_FrmMngTOSNpl_C "Ausblendbedingungen fuer Fehlerpfad Dfp_FrmMngTOSNpl" VALUE 0x1CDA01 Kw_Wu8 255.0 OneToOne 0.00 255.0 FORMAT "%5.1" /end CHARACTERISTIC
/begin CHARACTERISTIC DSM_FMKDfp_FrmMngTOSTO_C "Ausblendbedingungen fuer Fehlerpfad Dfp_FrmMngTOSTO" VALUE 0x1CDA02 Kw_Wu8 255.0 OneToOne 0.00 255.0 FORMAT "%5.1" /end CHARACTERISTIC
/begin CHARACTERISTIC DSM_FMKDfp_FrmMngTSC1Npl_C "Ausblendbedingungen fuer Fehlerpfad Dfp_FrmMngTSC1Npl" VALUE 0x1CDA03 Kw_Wu8 255.0 OneToOne 0.00 255.0 FORMAT "%5.1" /end CHARACTERISTIC
/begin CHARACTERISTIC DSM_FMKDfp_FrmMngTSC1TO_C "Ausblendbedingungen fuer Fehlerpfad Dfp_FrmMngTSC1TO" VALUE 0x1CDA04 Kw_Wu8 255.0 OneToOne 0.00 255.0 FORMAT "%5.1" /end CHARACTERISTIC
/begin CHARACTERISTIC DSM_FMKDfp_FrmMngTSC2Npl_C "Ausblendbedingungen fuer Fehlerpfad Dfp_FrmMngTSC2Npl" VALUE 0x1CDA05 Kw_Wu8 255.0 OneToOne 0.00 255.0 FORMAT "%5.1" /end CHARACTERISTIC
/begin CHARACTERISTIC DSM_FMKDfp_FrmMngTSC2TO_C "Ausblendbedingungen fuer Fehlerpfad Dfp_FrmMngTSC2TO" VALUE 0x1CDA06 Kw_Wu8 255.0 OneToOne 0.00 255.0 FORMAT "%5.1" /end CHARACTERISTIC
/begin CHARACTERISTIC DSM_FMKDfp_FrmMngTSC3Npl_C "Ausblendbedingungen fuer Fehlerpfad Dfp_FrmMngTSC3Npl" VALUE 0x1CDA07 Kw_Wu8 255.0 OneToOne 0.00 255.0 FORMAT "%5.1" /end CHARACTERISTIC
/begin CHARACTERISTIC DSM_FMKDfp_FrmMngTSC3TO_C "Ausblendbedingungen fuer Fehlerpfad Dfp_FrmMngTSC3TO" VALUE 0x1CDA08 Kw_Wu8 255.0 OneToOne 0.00 255.0 FORMAT "%5.1" /end CHARACTERISTIC
/begin CHARACTERISTIC DSM_FMKDfp_FrmMngTSC6Npl_C "Ausblendbedingungen fuer Fehlerpfad Dfp_FrmMngTSC6Npl" VALUE 0x1CDA09 Kw_Wu8 255.0 OneToOne 0.00 255.0 FORMAT "%5.1" /end CHARACTERISTIC
/begin CHARACTERISTIC DSM_FMKDfp_FrmMngTSC6TO_C "Ausblendbedingungen fuer Fehlerpfad Dfp_FrmMngTSC6TO" VALUE 0x1CDA0A Kw_Wu8 255.0 OneToOne 0.00 255.0 FORMAT "%5.1" /end CHARACTERISTIC
/begin CHARACTERISTIC DSM_FMKDfp_FrmMngTrbnSpdErr_C "Ausblendbedingungen fuer Fehlerpfad Dfp_FrmMngTrbnSpdErr" VALUE 0x1CDA0B Kw_Wu8 255.0 OneToOne 0.00 255.0 FORMAT "%5.1" /end CHARACTERISTIC
/begin CHARACTERISTIC DSM_FMKDfp_FrmMngWIPERTO_C "Ausblendbedingungen fuer Fehlerpfad Dfp_FrmMngWIPERTO" VALUE 0x1CDA0C Kw_Wu8 255.0 OneToOne 0.00 255.0 FORMAT "%5.1" /end CHARACTERISTIC
/begin CHARACTERISTIC DSM_FMKDfp_GbSSCD_C "Ausblendbedingungen für Fehlerpfad Dfp_GbSSCD" VALUE 0x1CDA0D Kw_Wu8 255.0 OneToOne 0.00 255.0 FORMAT "%5.1" /end CHARACTERISTIC
/begin CHARACTERISTIC DSM_FMKDfp_GbSSCD_HW_C "Ausblendbedingungen fuer Fehlerpfad Dfp_GbSSCD_HW" VALUE 0x1CDA0E Kw_Wu8 255.0 OneToOne 0.00 255.0 FORMAT "%5.1" /end CHARACTERISTIC
/begin CHARACTERISTIC DSM_FMKDfp_GearbxCVTnMax_C "Ausblendbedingungen fuer Fehlerpfad Dfp_GearbxCVTnMax_mp" VALUE 0x1CDA0F Kw_Wu8 255.0 OneToOne 0.00 255.0 FORMAT "%5.1" /end CHARACTERISTIC
/begin CHARACTERISTIC DSM_FMKDfp_GearbxClthPlaus_C "Ausblendbedingungen fuer Fehlerpfad Dfp_GearbxClthPlaus" VALUE 0x1CDA10 Kw_Wu8 255.0 OneToOne 0.00 255.0 FORMAT "%5.1" /end CHARACTERISTIC
/begin CHARACTERISTIC DSM_FMKDfp_GearbxINCCup_C "Ausblendbedingungen fuer Fehlerpfad Dfp_GearbxINCCup" VALUE 0x1CDA11 Kw_Wu8 255.0 OneToOne 0.00 255.0 FORMAT "%5.1" /end CHARACTERISTIC
/begin CHARACTERISTIC DSM_FMKDfp_GearbxNMinMon_C "Ausblendbedingungen fuer Fehlerpfad Dfp_GearbxNMinMon" VALUE 0x1CDA12 Kw_Wu8 255.0 OneToOne 0.00 255.0 FORMAT "%5.1" /end CHARACTERISTIC
/begin CHARACTERISTIC DSM_FMKDfp_GearbxTSC_C "Ausblendbedingungen fuer Fehlerpfad Dfp_GearbxTSC" VALUE 0x1CDA13 Kw_Wu8 255.0 OneToOne 0.00 255.0 FORMAT "%5.1" /end CHARACTERISTIC
/begin CHARACTERISTIC DSM_FMKDfp_GearbxTransConv_C "Ausblendbedingungen fuer Fehlerpfad  Dfp_GearbxTransConv" VALUE 0x1CDA14 Kw_Wu8 255.0 OneToOne 0.00 255.0 FORMAT "%5.1" /end CHARACTERISTIC
/begin CHARACTERISTIC DSM_FMKDfp_GearbxTypeMTErr_C "Ausblendbedingungen fuer Fehlerpfad Dfp_GearbxTypeMTErr" VALUE 0x1CDA15 Kw_Wu8 255.0 OneToOne 0.00 255.0 FORMAT "%5.1" /end CHARACTERISTIC
/begin CHARACTERISTIC DSM_FMKDfp_GlwCDDIAG_C "Ausblendbedingungen fuer Fehlerpfad Dfp_GlwCDDIAG" VALUE 0x1CDA16 Kw_Wu8 255.0 OneToOne 0.00 255.0 FORMAT "%5.1" /end CHARACTERISTIC
/begin CHARACTERISTIC DSM_FMKDfp_GlwCDErr1_C "Ausblendbedingungen fuer Fehlerpfad Dfp_GlwCDErr1" VALUE 0x1CDA17 Kw_Wu8 255.0 OneToOne 0.00 255.0 FORMAT "%5.1" /end CHARACTERISTIC
/begin CHARACTERISTIC DSM_FMKDfp_GlwCDErr2_C "Ausblendbedingungen fuer Fehlerpfad Dfp_GlwCDErr2" VALUE 0x1CDA18 Kw_Wu8 255.0 OneToOne 0.00 255.0 FORMAT "%5.1" /end CHARACTERISTIC
/begin CHARACTERISTIC DSM_FMKDfp_GlwCDEvalCod_C "Ausblendbedingungen fuer Fehlerpfad Dfp_GlwCDEvalCod" VALUE 0x1CDA19 Kw_Wu8 255.0 OneToOne 0.00 255.0 FORMAT "%5.1" /end CHARACTERISTIC
/begin CHARACTERISTIC DSM_FMKDfp_GlwCDGSK2_C "Ausblendbedingungen fuer Fehlerpfad Dfp_GlwCDGSK2" VALUE 0x1CDA1A Kw_Wu8 255.0 OneToOne 0.00 255.0 FORMAT "%5.1" /end CHARACTERISTIC
/begin CHARACTERISTIC DSM_FMKDfp_GlwCDGSK3_C "Ausblendbedingungen fuer Fehlerpfad Dfp_GlwCDGSK3" VALUE 0x1CDA1B Kw_Wu8 255.0 OneToOne 0.00 255.0 FORMAT "%5.1" /end CHARACTERISTIC
/begin CHARACTERISTIC DSM_FMKDfp_GlwCDLmp_C "Ausblendbedingungen fuer Fehlerpfad Dfp_GlwCDLmp" VALUE 0x1CDA1C Kw_Wu8 255.0 OneToOne 0.00 255.0 FORMAT "%5.1" /end CHARACTERISTIC
/begin CHARACTERISTIC DSM_FMKDfp_GlwCDPLUG0_C "Ausblendbedingungen fuer Fehlerpfad Dfp_GlwCDPLUG0" VALUE 0x1CDA1D Kw_Wu8 255.0 OneToOne 0.00 255.0 FORMAT "%5.1" /end CHARACTERISTIC
/begin CHARACTERISTIC DSM_FMKDfp_GlwCDPLUG1_C "Ausblendbedingungen fuer Fehlerpfad Dfp_GlwCDPLUG1" VALUE 0x1CDA1E Kw_Wu8 255.0 OneToOne 0.00 255.0 FORMAT "%5.1" /end CHARACTERISTIC
/begin CHARACTERISTIC DSM_FMKDfp_GlwCDPLUG2_C "Ausblendbedingungen fuer Fehlerpfad Dfp_GlwCDPLUG2" VALUE 0x1CDA1F Kw_Wu8 255.0 OneToOne 0.00 255.0 FORMAT "%5.1" /end CHARACTERISTIC
/begin CHARACTERISTIC DSM_FMKDfp_GlwCDPLUG3_C "Ausblendbedingungen fuer Fehlerpfad Dfp_GlwCDPLUG3" VALUE 0x1CDA20 Kw_Wu8 255.0 OneToOne 0.00 255.0 FORMAT "%5.1" /end CHARACTERISTIC
/begin CHARACTERISTIC DSM_FMKDfp_GlwCDPLUG4_C "Ausblendbedingungen fuer Fehlerpfad Dfp_GlwCDPLUG4" VALUE 0x1CDA21 Kw_Wu8 255.0 OneToOne 0.00 255.0 FORMAT "%5.1" /end CHARACTERISTIC
/begin CHARACTERISTIC DSM_FMKDfp_GlwCDPLUG5_C "Ausblendbedingungen fuer Fehlerpfad Dfp_GlwCDPLUG5" VALUE 0x1CDA22 Kw_Wu8 255.0 OneToOne 0.00 255.0 FORMAT "%5.1" /end CHARACTERISTIC
/begin CHARACTERISTIC DSM_FMKDfp_GlwCD_LampCan_C "Ausblendbedingungen fuer Fehlerpfad Dfp_GlwCD_LampCan" VALUE 0x1CDA23 Kw_Wu8 255.0 OneToOne 0.00 255.0 FORMAT "%5.1" /end CHARACTERISTIC
/begin CHARACTERISTIC DSM_FMKDfp_GlwCDsfd_C "Ausblendbedingungen fuer Fehlerpfad Dfp_GlwCDsfd" VALUE 0x1CDA24 Kw_Wu8 255.0 OneToOne 0.00 255.0 FORMAT "%5.1" /end CHARACTERISTIC
/begin CHARACTERISTIC DSM_FMKDfp_HDSCD_C "Ausblendbedingungen fuer Fehlerpfad Dfp_HDSCD" VALUE 0x1CDA25 Kw_Wu8 255.0 OneToOne 0.00 255.0 FORMAT "%5.1" /end CHARACTERISTIC
/begin CHARACTERISTIC DSM_FMKDfp_HWEMonCom_C "Ausblendbedingungen fuer Fehlerpfad Dfp_HWEMonCom" VALUE 0x1CDA26 Kw_Wu8 255.0 OneToOne 0.00 255.0 FORMAT "%5.1" /end CHARACTERISTIC
/begin CHARACTERISTIC DSM_FMKDfp_HWEMonEEPROM_C "Ausblendbedingungen fuer Fehlerpfad Dfp_HWEMonEEPROM" VALUE 0x1CDA27 Kw_Wu8 255.0 OneToOne 0.00 255.0 FORMAT "%5.1" /end CHARACTERISTIC
/begin CHARACTERISTIC DSM_FMKDfp_HWEMonRcyLocked_C "Ausblendbedingungen fuer Fehlerpfad Dfp_HWEMonRcyLocked" VALUE 0x1CDA28 Kw_Wu8 255.0 OneToOne 0.00 255.0 FORMAT "%5.1" /end CHARACTERISTIC
/begin CHARACTERISTIC DSM_FMKDfp_HWEMonRcySuppressed_C "Ausblendbedingungen fuer Fehlerpfad Dfp_HWEMonRcySuppressed" VALUE 0x1CDA29 Kw_Wu8 255.0 OneToOne 0.00 255.0 FORMAT "%5.1" /end CHARACTERISTIC
/begin CHARACTERISTIC DSM_FMKDfp_HWEMonRcyVisible_C "Ausblendbedingungen fuer Fehlerpfad Dfp_HWEMonRcyVisible" VALUE 0x1CDA2A Kw_Wu8 255.0 OneToOne 0.00 255.0 FORMAT "%5.1" /end CHARACTERISTIC
/begin CHARACTERISTIC DSM_FMKDfp_HWEMonUMaxSupply_C "Ausblendbedingungen fuer Fehlerpfad Dfp_HWEMonUMaxSupply" VALUE 0x1CDA2B Kw_Wu8 255.0 OneToOne 0.00 255.0 FORMAT "%5.1" /end CHARACTERISTIC
/begin CHARACTERISTIC DSM_FMKDfp_HWEMonUMinSupply_C "Ausblendbedingungen fuer Fehlerpfad Dfp_HWEMonUMinSupply" VALUE 0x1CDA2C Kw_Wu8 255.0 OneToOne 0.00 255.0 FORMAT "%5.1" /end CHARACTERISTIC
/begin CHARACTERISTIC DSM_FMKDfp_IATSCD_C "Ausblendbedingungen fuer Fehlerpfad Dfp_IATSCD" VALUE 0x1CDA2D Kw_Wu8 255.0 OneToOne 0.00 255.0 FORMAT "%5.1" /end CHARACTERISTIC
/begin CHARACTERISTIC DSM_FMKDfp_IFCD_C "Ausblendbedingungen fuer Fehlerpfad Dfp_IFCD" VALUE 0x1CDA2E Kw_Wu8 255.0 OneToOne 0.00 255.0 FORMAT "%5.1" /end CHARACTERISTIC
/begin CHARACTERISTIC DSM_FMKDfp_ImmCtl_C "Ausblendbedingungen fuer Fehlerpfad Dfp_ImmCtl" VALUE 0x1CDA2F Kw_Wu8 255.0 OneToOne 0.00 255.0 FORMAT "%5.1" /end CHARACTERISTIC
/begin CHARACTERISTIC DSM_FMKDfp_IndSysMonIntMnf_C "Ausblendbedingungen fuer Fehlerpfad Dfp_IndSysMonIntMnf" VALUE 0x1CDA30 Kw_Wu8 255.0 OneToOne 0.00 255.0 FORMAT "%5.1" /end CHARACTERISTIC
/begin CHARACTERISTIC DSM_FMKDfp_InjVlvBnk1A_C "Ausblendbedingungen fuer Fehlerpfad Dfp_InjVlvBnk1A" VALUE 0x1CDA33 Kw_Wu8 255.0 OneToOne 0.00 255.0 FORMAT "%5.1" /end CHARACTERISTIC
/begin CHARACTERISTIC DSM_FMKDfp_InjVlvBnk2A_C "Ausblendbedingungen fuer Fehlerpfad Dfp_InjVlvBnk2A" VALUE 0x1CDA34 Kw_Wu8 255.0 OneToOne 0.00 255.0 FORMAT "%5.1" /end CHARACTERISTIC
/begin CHARACTERISTIC DSM_FMKDfp_InjVlvCyl10A_C "Ausblendbedingungen fuer Fehlerpfad Dfp_InjVlvCyl10A" VALUE 0x1CDA35 Kw_Wu8 255.0 OneToOne 0.00 255.0 FORMAT "%5.1" /end CHARACTERISTIC
/begin CHARACTERISTIC DSM_FMKDfp_InjVlvCyl11A_C "Ausblendbedingungen fuer Fehlerpfad Dfp_InjVlvCyl11A" VALUE 0x1CDA36 Kw_Wu8 255.0 OneToOne 0.00 255.0 FORMAT "%5.1" /end CHARACTERISTIC
/begin CHARACTERISTIC DSM_FMKDfp_InjVlvCyl12A_C "Ausblendbedingungen fuer Fehlerpfad Dfp_InjVlvCyl12A" VALUE 0x1CDA37 Kw_Wu8 255.0 OneToOne 0.00 255.0 FORMAT "%5.1" /end CHARACTERISTIC
/begin CHARACTERISTIC DSM_FMKDfp_InjVlvCyl1A_C "Ausblendbedingungen fuer Fehlerpfad Dfp_InjVlvCyl1A" VALUE 0x1CDA38 Kw_Wu8 255.0 OneToOne 0.00 255.0 FORMAT "%5.1" /end CHARACTERISTIC
/begin CHARACTERISTIC DSM_FMKDfp_InjVlvCyl2A_C "Ausblendbedingungen fuer Fehlerpfad Dfp_InjVlvCyl2A" VALUE 0x1CDA39 Kw_Wu8 255.0 OneToOne 0.00 255.0 FORMAT "%5.1" /end CHARACTERISTIC
/begin CHARACTERISTIC DSM_FMKDfp_InjVlvCyl3A_C "Ausblendbedingungen fuer Fehlerpfad Dfp_InjVlvCyl3A" VALUE 0x1CDA3A Kw_Wu8 255.0 OneToOne 0.00 255.0 FORMAT "%5.1" /end CHARACTERISTIC
/begin CHARACTERISTIC DSM_FMKDfp_InjVlvCyl4A_C "Ausblendbedingungen fuer Fehlerpfad Dfp_InjVlvCyl4A" VALUE 0x1CDA3B Kw_Wu8 255.0 OneToOne 0.00 255.0 FORMAT "%5.1" /end CHARACTERISTIC
/begin CHARACTERISTIC DSM_FMKDfp_InjVlvCyl5A_C "Ausblendbedingungen fuer Fehlerpfad Dfp_InjVlvCyl5A" VALUE 0x1CDA3C Kw_Wu8 255.0 OneToOne 0.00 255.0 FORMAT "%5.1" /end CHARACTERISTIC
/begin CHARACTERISTIC DSM_FMKDfp_InjVlvCyl6A_C "Ausblendbedingungen fuer Fehlerpfad Dfp_InjVlvCyl6A" VALUE 0x1CDA3D Kw_Wu8 255.0 OneToOne 0.00 255.0 FORMAT "%5.1" /end CHARACTERISTIC
/begin CHARACTERISTIC DSM_FMKDfp_InjVlvCyl7A_C "Ausblendbedingungen fuer Fehlerpfad Dfp_InjVlvCyl7A" VALUE 0x1CDA3E Kw_Wu8 255.0 OneToOne 0.00 255.0 FORMAT "%5.1" /end CHARACTERISTIC
/begin CHARACTERISTIC DSM_FMKDfp_InjVlvCyl8A_C "Ausblendbedingungen fuer Fehlerpfad Dfp_InjVlvCyl8A" VALUE 0x1CDA3F Kw_Wu8 255.0 OneToOne 0.00 255.0 FORMAT "%5.1" /end CHARACTERISTIC
/begin CHARACTERISTIC DSM_FMKDfp_InjVlvCyl9A_C "Ausblendbedingungen fuer Fehlerpfad Dfp_InjVlvCyl9A" VALUE 0x1CDA40 Kw_Wu8 255.0 OneToOne 0.00 255.0 FORMAT "%5.1" /end CHARACTERISTIC
/begin CHARACTERISTIC DSM_FMKDfp_LASCD_C "Ausblendbedingungen fuer Fehlerpfad Dfp_LASCD" VALUE 0x1CDA41 Kw_Wu8 255.0 OneToOne 0.00 255.0 FORMAT "%5.1" /end CHARACTERISTIC
/begin CHARACTERISTIC DSM_FMKDfp_LSUCDCircNernst0_C "Ausblendbedingungen fuer Fehlerpfad Dfp_LSUCDCircNernst0" VALUE 0x1CDA42 Kw_Wu8 255.0 OneToOne 0.00 255.0 FORMAT "%5.1" /end CHARACTERISTIC
/begin CHARACTERISTIC DSM_FMKDfp_LSUCDCircPumpCur0_C "Ausblendbedingungen fuer Fehlerpfad Dfp_LSUCDCircPumpCur0" VALUE 0x1CDA43 Kw_Wu8 255.0 OneToOne 0.00 255.0 FORMAT "%5.1" /end CHARACTERISTIC
/begin CHARACTERISTIC DSM_FMKDfp_LSUCDCircVirtGnd0_C "Ausblendbedingungen fuer Fehlerpfad Dfp_LSUCDCircVirtGnd0" VALUE 0x1CDA44 Kw_Wu8 255.0 OneToOne 0.00 255.0 FORMAT "%5.1" /end CHARACTERISTIC
/begin CHARACTERISTIC DSM_FMKDfp_LSUCDHeater0_C "Ausblendbedingungen fuer Fehlerpfad Dfp_LSUCDHeater0" VALUE 0x1CDA45 Kw_Wu8 255.0 OneToOne 0.00 255.0 FORMAT "%5.1" /end CHARACTERISTIC
/begin CHARACTERISTIC DSM_FMKDfp_LSUCDHtCoup0_C "Ausblendbedingungen fuer Fehlerpfad Dfp_LSUCDHtCoup0" VALUE 0x1CDA46 Kw_Wu8 255.0 OneToOne 0.00 255.0 FORMAT "%5.1" /end CHARACTERISTIC
/begin CHARACTERISTIC DSM_FMKDfp_LSUCDO20_C "Ausblendbedingungen fuer Fehlerpfad Dfp_LSUCDO20" VALUE 0x1CDA47 Kw_Wu8 255.0 OneToOne 0.00 255.0 FORMAT "%5.1" /end CHARACTERISTIC
/begin CHARACTERISTIC DSM_FMKDfp_LSUCDO2Clb0_C "Ausblendbedingungen fuer Fehlerpfad Dfp_LSUCDO2Clb0" VALUE 0x1CDA48 Kw_Wu8 255.0 OneToOne 0.00 255.0 FORMAT "%5.1" /end CHARACTERISTIC
/begin CHARACTERISTIC DSM_FMKDfp_LSUCDRiClb0_C "Ausblendbedingungen fuer Fehlerpfad Dfp_LSUCDRiClb0" VALUE 0x1CDA49 Kw_Wu8 255.0 OneToOne 0.00 255.0 FORMAT "%5.1" /end CHARACTERISTIC
/begin CHARACTERISTIC DSM_FMKDfp_LSUCDSPI0_C "Ausblendbedingungen fuer Fehlerpfad Dfp_LSUCDSPI0" VALUE 0x1CDA4A Kw_Wu8 255.0 OneToOne 0.00 255.0 FORMAT "%5.1" /end CHARACTERISTIC
/begin CHARACTERISTIC DSM_FMKDfp_LSUCDSPIBattLow0_C "Ausblendbedingungen fuer Fehlerpfad Dfp_LSUCDSPIBattLow0" VALUE 0x1CDA4B Kw_Wu8 255.0 OneToOne 0.00 255.0 FORMAT "%5.1" /end CHARACTERISTIC
/begin CHARACTERISTIC DSM_FMKDfp_LSUCDWireIP0_C "Ausblendbedingungen fuer Fehlerpfad Dfp_LSUCDWireIP0" VALUE 0x1CDA4C Kw_Wu8 255.0 OneToOne 0.00 255.0 FORMAT "%5.1" /end CHARACTERISTIC
/begin CHARACTERISTIC DSM_FMKDfp_LSUCtlRiExc0_C "Ausblendbedingungen fuer Fehlerpfad Dfp_LSUCtlRiExc0" VALUE 0x1CDA4D Kw_Wu8 255.0 OneToOne 0.00 255.0 FORMAT "%5.1" /end CHARACTERISTIC
/begin CHARACTERISTIC DSM_FMKDfp_LSUMonDyn0_C "Ausblendbedingungen fuer Fehlerpfad Dfp_LSUMonDyn0" VALUE 0x1CDA4E Kw_Wu8 255.0 OneToOne 0.00 255.0 FORMAT "%5.1" /end CHARACTERISTIC
/begin CHARACTERISTIC DSM_FMKDfp_LSUMonFullLd0_C "Ausblendbedingungen fuer Fehlerpfad Dfp_LSUMonFullLd0" VALUE 0x1CDA4F Kw_Wu8 255.0 OneToOne 0.00 255.0 FORMAT "%5.1" /end CHARACTERISTIC
/begin CHARACTERISTIC DSM_FMKDfp_LSUMonOvrRun0_C "Ausblendbedingungen fuer Fehlerpfad Dfp_LSUMonOvrRun0" VALUE 0x1CDA50 Kw_Wu8 255.0 OneToOne 0.00 255.0 FORMAT "%5.1" /end CHARACTERISTIC
/begin CHARACTERISTIC DSM_FMKDfp_LSUMonPartLd0_C "Ausblendbedingungen fuer Fehlerpfad Dfp_LSUMonPartLd0" VALUE 0x1CDA51 Kw_Wu8 255.0 OneToOne 0.00 255.0 FORMAT "%5.1" /end CHARACTERISTIC
/begin CHARACTERISTIC DSM_FMKDfp_MIL_C "Ausblendbedingungen fuer Fehlerpfad Dfp_MIL" VALUE 0x1CDA52 Kw_Wu8 255.0 OneToOne 0.00 255.0 FORMAT "%5.1" /end CHARACTERISTIC
/begin CHARACTERISTIC DSM_FMKDfp_MRlyCD_C "Ausblendbedingungen fuer Fehlerpfad Dfp_MRlyCD" VALUE 0x1CDA53 Kw_Wu8 255.0 OneToOne 0.00 255.0 FORMAT "%5.1" /end CHARACTERISTIC
/begin CHARACTERISTIC DSM_FMKDfp_Montr_C "Ausblendbedingungen fuer Fehlerpfad Dfp_Montr" VALUE 0x1CDA54 Kw_Wu8 255.0 OneToOne 0.00 255.0 FORMAT "%5.1" /end CHARACTERISTIC
/begin CHARACTERISTIC DSM_FMKDfp_OTSCD_C "Ausblendbedingungen fuer Fehlerpfad Dfp_OTSCD" VALUE 0x1CDA55 Kw_Wu8 255.0 OneToOne 0.00 255.0 FORMAT "%5.1" /end CHARACTERISTIC
/begin CHARACTERISTIC DSM_FMKDfp_OTSCDCanInac_C "Ausblendbedingungen fuer Fehlerpfad Dfp_OTSCDCanInac" VALUE 0x1CDA56 Kw_Wu8 255.0 OneToOne 0.00 255.0 FORMAT "%5.1" /end CHARACTERISTIC
/begin CHARACTERISTIC DSM_FMKDfp_OTSCDCanSig_C "Ausblendbedingungen fuer Fehlerpfad Dfp_OTSCDCanSig" VALUE 0x1CDA57 Kw_Wu8 255.0 OneToOne 0.00 255.0 FORMAT "%5.1" /end CHARACTERISTIC
/begin CHARACTERISTIC DSM_FMKDfp_OvRMon_C "Ausblendbedingungen fuer Fehlerpfad Dfp_OvRMon" VALUE 0x1CDA59 Kw_Wu8 255.0 OneToOne 0.00 255.0 FORMAT "%5.1" /end CHARACTERISTIC
/begin CHARACTERISTIC DSM_FMKDfp_OvRMonCrCtlP_C "Ausblendbedingungen fuer Fehlerpfad Dfp_OvRMonCrCtlP" VALUE 0x1CDA5A Kw_Wu8 255.0 OneToOne 0.00 255.0 FORMAT "%5.1" /end CHARACTERISTIC
/begin CHARACTERISTIC DSM_FMKDfp_OvRMonSigA_C "Ausblendbedingungen fuer Fehlerpfad Dfp_OvRMonSigA" VALUE 0x1CDA5B Kw_Wu8 255.0 OneToOne 0.00 255.0 FORMAT "%5.1" /end CHARACTERISTIC
/begin CHARACTERISTIC DSM_FMKDfp_OxiCCDTPre_C "Ausblendbedingungen fuer Fehlerpfad Dfp_OxiCCDTPre" VALUE 0x1CDA5C Kw_Wu8 255.0 OneToOne 0.00 255.0 FORMAT "%5.1" /end CHARACTERISTIC
/begin CHARACTERISTIC DSM_FMKDfp_OxiCCDTPre1_C "Ausblendbedingungen fuer Fehlerpfad Dfp_OxiCCDTPre1" VALUE 0x1CDA5D Kw_Wu8 255.0 OneToOne 0.00 255.0 FORMAT "%5.1" /end CHARACTERISTIC
/begin CHARACTERISTIC DSM_FMKDfp_PCR_BalGovDev_C "Ausblendbedingungen fuer Fehlerpfad Dfp_PCR_BalGovDev" VALUE 0x1CDA5E Kw_Wu8 255.0 OneToOne 0.00 255.0 FORMAT "%5.1" /end CHARACTERISTIC
/begin CHARACTERISTIC DSM_FMKDfp_PCR_GovDev_C "Ausblendbedingungen fuer Fehlerpfad Dfp_PCR_GovDev" VALUE 0x1CDA5F Kw_Wu8 255.0 OneToOne 0.00 255.0 FORMAT "%5.1" /end CHARACTERISTIC
/begin CHARACTERISTIC DSM_FMKDfp_PFltAPSens_C "Ausblendbedingungen fuer Fehlerpfad Dfp_PFltAPSens" VALUE 0x1CDA60 Kw_Wu8 255.0 OneToOne 0.00 255.0 FORMAT "%5.1" /end CHARACTERISTIC
/begin CHARACTERISTIC DSM_FMKDfp_PFltCDHtg_C "Ausblendbedingungen fuer Fehlerpfad Dfp_PFltCDHtg" VALUE 0x1CDA61 Kw_Wu8 255.0 OneToOne 0.00 255.0 FORMAT "%5.1" /end CHARACTERISTIC
/begin CHARACTERISTIC DSM_FMKDfp_PFltCDHtg1_C "Ausblendbedingungen fuer Fehlerpfad Dfp_PFltCDHtg1" VALUE 0x1CDA62 Kw_Wu8 255.0 OneToOne 0.00 255.0 FORMAT "%5.1" /end CHARACTERISTIC
/begin CHARACTERISTIC DSM_FMKDfp_PFltCDPDiff_C "Ausblendbedingungen fuer Fehlerpfad Dfp_PFltCDPDiff" VALUE 0x1CDA63 Kw_Wu8 255.0 OneToOne 0.00 255.0 FORMAT "%5.1" /end CHARACTERISTIC
/begin CHARACTERISTIC DSM_FMKDfp_PFltCDTempPre_C "Ausblendbedingungen fuer Fehlerpfad Dfp_PFltCDTempPre" VALUE 0x1CDA64 Kw_Wu8 255.0 OneToOne 0.00 255.0 FORMAT "%5.1" /end CHARACTERISTIC
/begin CHARACTERISTIC DSM_FMKDfp_PFltCDTempPre1_C "Ausblendbedingungen fuer Fehlerpfad Dfp_PFltCDTempPre1" VALUE 0x1CDA65 Kw_Wu8 255.0 OneToOne 0.00 255.0 FORMAT "%5.1" /end CHARACTERISTIC
/begin CHARACTERISTIC DSM_FMKDfp_PFltCDTempPst_C "Verblassen Sie aus Schablone für Fehlerweg Dfp_PFltCDTempPst" VALUE 0x1CDA66 Kw_Wu8 255.0 OneToOne 0.00 255.0 FORMAT "%5.1" /end CHARACTERISTIC
/begin CHARACTERISTIC DSM_FMKDfp_PFltChar_C "Ausblendbedingungen fuer Fehlerpfad Dfp_PFltChar" VALUE 0x1CDA67 Kw_Wu8 255.0 OneToOne 0.00 255.0 FORMAT "%5.1" /end CHARACTERISTIC
/begin CHARACTERISTIC DSM_FMKDfp_PFltEngPrt_C "Ausblendbedingungen fuer Fehlerpfad Dfp_PFltEngPrt" VALUE 0x1CDA68 Kw_Wu8 255.0 OneToOne 0.00 255.0 FORMAT "%5.1" /end CHARACTERISTIC
/begin CHARACTERISTIC DSM_FMKDfp_PFltPresDynPlaus_C "Ausblendbedingungen fuer Fehlerpfad Dfp_PFltPresDynPlaus" VALUE 0x1CDA69 Kw_Wu8 255.0 OneToOne 0.00 255.0 FORMAT "%5.1" /end CHARACTERISTIC
/begin CHARACTERISTIC DSM_FMKDfp_PFltPresHsChng_C "Ausblendbedingungen fuer Fehlerpfad Dfp_PFltPresHsChng" VALUE 0x1CDA6A Kw_Wu8 255.0 OneToOne 0.00 255.0 FORMAT "%5.1" /end CHARACTERISTIC
/begin CHARACTERISTIC DSM_FMKDfp_PFltPresSens_C "Ausblendbedingungen fuer Fehlerpfad Dfp_PFltPresSens" VALUE 0x1CDA6B Kw_Wu8 255.0 OneToOne 0.00 255.0 FORMAT "%5.1" /end CHARACTERISTIC
/begin CHARACTERISTIC DSM_FMKDfp_PFltPresSensFrz_C "Ausblendbedingungen fuer Fehlerpfad Dfp_PFltPresSensFrz" VALUE 0x1CDA6C Kw_Wu8 255.0 OneToOne 0.00 255.0 FORMAT "%5.1" /end CHARACTERISTIC
/begin CHARACTERISTIC DSM_FMKDfp_PFltPresSensHsLn_C "Ausblendbedingungen fuer Fehlerpfad Dfp_PFltPresSensHsLn" VALUE 0x1CDA6D Kw_Wu8 255.0 OneToOne 0.00 255.0 FORMAT "%5.1" /end CHARACTERISTIC
/begin CHARACTERISTIC DSM_FMKDfp_PFltPresSensSot_C "Ausblendbedingungen fuer Fehlerpfad Dfp_PFltPresSensSot" VALUE 0x1CDA6E Kw_Wu8 255.0 OneToOne 0.00 255.0 FORMAT "%5.1" /end CHARACTERISTIC
/begin CHARACTERISTIC DSM_FMKDfp_PFltRgnLckPerm_C "Ausblendbedingungen fuer Fehlerpfad Dfp_PFltRgnLckPerm" VALUE 0x1CDA6F Kw_Wu8 255.0 OneToOne 0.00 255.0 FORMAT "%5.1" /end CHARACTERISTIC
/begin CHARACTERISTIC DSM_FMKDfp_PFltRgnLckPermTstr_C "Ausblendbedingungen fuer Fehlerpfad Dfp_PFltRgnLckPermTstr" VALUE 0x1CDA70 Kw_Wu8 255.0 OneToOne 0.00 255.0 FORMAT "%5.1" /end CHARACTERISTIC
/begin CHARACTERISTIC DSM_FMKDfp_PFltRgnPerm_C "Ausblendbedingungen fuer Fehlerpfad Dfp_PFltRgnPerm" VALUE 0x1CDA71 Kw_Wu8 255.0 OneToOne 0.00 255.0 FORMAT "%5.1" /end CHARACTERISTIC
/begin CHARACTERISTIC DSM_FMKDfp_PFltSotSimPresPerm_C "Ausblendbedingungen fuer Fehlerpfad Dfp_PFltSotSimPresPerm" VALUE 0x1CDA72 Kw_Wu8 255.0 OneToOne 0.00 255.0 FORMAT "%5.1" /end CHARACTERISTIC
/begin CHARACTERISTIC DSM_FMKDfp_PFltTempDwnStrm_C "Ausblendbedingungen fuer Fehlerpfad Dfp_PFltTempDwnStrm" VALUE 0x1CDA73 Kw_Wu8 255.0 OneToOne 0.00 255.0 FORMAT "%5.1" /end CHARACTERISTIC
/begin CHARACTERISTIC DSM_FMKDfp_PFltTempDwnStrmMax_C "Ausblendbedingungen fuer Fehlerpfad Dfp_PFltTempDwnStrmMax" VALUE 0x1CDA74 Kw_Wu8 255.0 OneToOne 0.00 255.0 FORMAT "%5.1" /end CHARACTERISTIC
/begin CHARACTERISTIC DSM_FMKDfp_PFltTempDwnStrmMin_C "Ausblendbedingungen fuer Fehlerpfad Dfp_PFltTempDwnStrmMin" VALUE 0x1CDA75 Kw_Wu8 255.0 OneToOne 0.00 255.0 FORMAT "%5.1" /end CHARACTERISTIC
/begin CHARACTERISTIC DSM_FMKDfp_PFltTempPreOxiC_C "Ausblendbedingungen fuer Fehlerpfad Dfp_PFltTempPreOxiC" VALUE 0x1CDA76 Kw_Wu8 255.0 OneToOne 0.00 255.0 FORMAT "%5.1" /end CHARACTERISTIC
/begin CHARACTERISTIC DSM_FMKDfp_PFltTempPrePFlt_C "Ausblendbedingungen fuer Fehlerpfad Dfp_PFltTempPrePFlt" VALUE 0x1CDA77 Kw_Wu8 255.0 OneToOne 0.00 255.0 FORMAT "%5.1" /end CHARACTERISTIC
/begin CHARACTERISTIC DSM_FMKDfp_PFltTempPreTrbn_C "Ausblendbedingungen fuer Fehlerpfad Dfp_PFltTempPreTrbn" VALUE 0x1CDA78 Kw_Wu8 255.0 OneToOne 0.00 255.0 FORMAT "%5.1" /end CHARACTERISTIC
/begin CHARACTERISTIC DSM_FMKDfp_PFltTempPstPFlt_C "Ausblendbedingungen fuer Fehlerpfad Dfp_PFltTempPstPFlt" VALUE 0x1CDA7A Kw_Wu8 255.0 OneToOne 0.00 255.0 FORMAT "%5.1" /end CHARACTERISTIC
/begin CHARACTERISTIC DSM_FMKDfp_PFltTempSens_C "Ausblendbedingungen fuer Fehlerpfad Dfp_PFltTempSens" VALUE 0x1CDA7B Kw_Wu8 255.0 OneToOne 0.00 255.0 FORMAT "%5.1" /end CHARACTERISTIC
/begin CHARACTERISTIC DSM_FMKDfp_PFltTempSens2_C "Ausblendbedingungen fuer Fehlerpfad Dfp_PFltTempSens2" VALUE 0x1CDA7C Kw_Wu8 255.0 OneToOne 0.00 255.0 FORMAT "%5.1" /end CHARACTERISTIC
/begin CHARACTERISTIC DSM_FMKDfp_PFltTempUpStrm_C "Ausblendbedingungen fuer Fehlerpfad Dfp_PFltTempUpStrm" VALUE 0x1CDA7D Kw_Wu8 255.0 OneToOne 0.00 255.0 FORMAT "%5.1" /end CHARACTERISTIC
/begin CHARACTERISTIC DSM_FMKDfp_PFltTempUpStrmMax_C "Ausblendbedingungen fuer Fehlerpfad Dfp_PFltTempUpStrmMax" VALUE 0x1CDA7E Kw_Wu8 255.0 OneToOne 0.00 255.0 FORMAT "%5.1" /end CHARACTERISTIC
/begin CHARACTERISTIC DSM_FMKDfp_PFltTempUpStrmMin_C "Ausblendbedingungen fuer Fehlerpfad Dfp_PFltTempUpStrmMin" VALUE 0x1CDA7F Kw_Wu8 255.0 OneToOne 0.00 255.0 FORMAT "%5.1" /end CHARACTERISTIC
/begin CHARACTERISTIC DSM_FMKDfp_PSPCD_Actr_C "Ausblendbedingungen fuer Fehlerpfad Dfp_PSPCD_Actr" VALUE 0x1CDA80 Kw_Wu8 255.0 OneToOne 0.00 255.0 FORMAT "%5.1" /end CHARACTERISTIC
/begin CHARACTERISTIC DSM_FMKDfp_PrpCtlvLimErrPat_C "Ausblendbedingungen fuer Fehlerpfad Dfp_PrpCtlvLimErrPat" VALUE 0x1CDA81 Kw_Wu8 255.0 OneToOne 0.00 255.0 FORMAT "%5.1" /end CHARACTERISTIC
/begin CHARACTERISTIC DSM_FMKDfp_SOPTst_C "Ausblendbedingungen fuer Fehlerpfad Dfp_SOPTst" VALUE 0x1CDA82 Kw_Wu8 255.0 OneToOne 0.00 255.0 FORMAT "%5.1" /end CHARACTERISTIC
/begin CHARACTERISTIC DSM_FMKDfp_SSpMon1_C "Ausblendbedingungen fuer Fehlerpfad Dfp_SSpMon1" VALUE 0x1CDA83 Kw_Wu8 255.0 OneToOne 0.00 255.0 FORMAT "%5.1" /end CHARACTERISTIC
/begin CHARACTERISTIC DSM_FMKDfp_SSpMon2_C "Ausblendbedingungen fuer Fehlerpfad Dfp_SSpMon2" VALUE 0x1CDA84 Kw_Wu8 255.0 OneToOne 0.00 255.0 FORMAT "%5.1" /end CHARACTERISTIC
/begin CHARACTERISTIC DSM_FMKDfp_SSpMon3_C "Ausblendbedingungen fuer Fehlerpfad Dfp_SSpMon3" VALUE 0x1CDA85 Kw_Wu8 255.0 OneToOne 0.00 255.0 FORMAT "%5.1" /end CHARACTERISTIC
/begin CHARACTERISTIC DSM_FMKDfp_Shtrp_EGRBA_C "Ausblendbedingungen fuer Fehlerpfad Dfp_Shtrp_EGRBA" VALUE 0x1CDA86 Kw_Wu8 255.0 OneToOne 0.00 255.0 FORMAT "%5.1" /end CHARACTERISTIC
/begin CHARACTERISTIC DSM_FMKDfp_Shtrp_PCRBA_C "Ausblendbedingungen fuer Fehlerpfad Dfp_Shtrp_PCRBA" VALUE 0x1CDA87 Kw_Wu8 255.0 OneToOne 0.00 255.0 FORMAT "%5.1" /end CHARACTERISTIC
/begin CHARACTERISTIC DSM_FMKDfp_SrvPmpStSAEcu_C "Ausblendbedingungen fuer Fehlerpfad Dfp_SrvPmpStSAEcu" VALUE 0x1CDA88 Kw_Wu8 255.0 OneToOne 0.00 255.0 FORMAT "%5.1" /end CHARACTERISTIC
/begin CHARACTERISTIC DSM_FMKDfp_StSysCtlShCirBatt_C "Ausblendbedingungen fuer Fehlerpfad Dfp_StSysCtlShCirBatt" VALUE 0x1CDA89 Kw_Wu8 255.0 OneToOne 0.00 255.0 FORMAT "%5.1" /end CHARACTERISTIC
/begin CHARACTERISTIC DSM_FMKDfp_StrtCDOffRly_C "Ausblendbedingungen fuer Fehlerpfad Dfp_StrtCDOffRly" VALUE 0x1CDA8A Kw_Wu8 255.0 OneToOne 0.00 255.0 FORMAT "%5.1" /end CHARACTERISTIC
/begin CHARACTERISTIC DSM_FMKDfp_StrtCDOnRly_C "Ausblendbedingungen fuer Fehlerpfad Dfp_StrtCDOnRly" VALUE 0x1CDA8B Kw_Wu8 255.0 OneToOne 0.00 255.0 FORMAT "%5.1" /end CHARACTERISTIC
/begin CHARACTERISTIC DSM_FMKDfp_StrtCtlIlsNotPlaus_C "Ausblendbedingungen für Fehlerpfad Dfp_StrtCtlIlsNotPlaus" VALUE 0x1CDA8C Kw_Wu8 255.0 OneToOne 0.00 255.0 FORMAT "%5.1" /end CHARACTERISTIC
/begin CHARACTERISTIC DSM_FMKDfp_StrtCtlT50ROneRly1_C "Ausblendbedingungen fuer Fehlerpfad Dfp_StrtCtlT50ROneRly1" VALUE 0x1CDA8D Kw_Wu8 255.0 OneToOne 0.00 255.0 FORMAT "%5.1" /end CHARACTERISTIC
/begin CHARACTERISTIC DSM_FMKDfp_StrtCtlT50ROneRly2_C "Ausblendbedingungen fuer Fehlerpfad Dfp_StrtCtlT50ROneRly2" VALUE 0x1CDA8E Kw_Wu8 255.0 OneToOne 0.00 255.0 FORMAT "%5.1" /end CHARACTERISTIC
/begin CHARACTERISTIC DSM_FMKDfp_StrtCtlT50RZero_C "Ausblendbedingungen fuer Fehlerpfad Dfp_StrtCtlT50RZero" VALUE 0x1CDA8F Kw_Wu8 255.0 OneToOne 0.00 255.0 FORMAT "%5.1" /end CHARACTERISTIC
/begin CHARACTERISTIC DSM_FMKDfp_SysLamp_C "Ausblendbedingungen fuer Fehlerpfad Dfp_SysLamp" VALUE 0x1CDA90 Kw_Wu8 255.0 OneToOne 0.00 255.0 FORMAT "%5.1" /end CHARACTERISTIC
/begin CHARACTERISTIC DSM_FMKDfp_T15CD_C "Ausblendbedingungen fuer Fehlerpfad Dfp_T15CD" VALUE 0x1CDA91 Kw_Wu8 255.0 OneToOne 0.00 255.0 FORMAT "%5.1" /end CHARACTERISTIC
/begin CHARACTERISTIC DSM_FMKDfp_T50CD_C "Ausblendbedingungen für Fehlerpfad Dfp_T50CD" VALUE 0x1CDA92 Kw_Wu8 255.0 OneToOne 0.00 255.0 FORMAT "%5.1" /end CHARACTERISTIC
/begin CHARACTERISTIC DSM_FMKDfp_TPUMon_C "Ausblendbedingungen fuer Fehlerpfad Dfp_TPUMon" VALUE 0x1CDA93 Kw_Wu8 255.0 OneToOne 0.00 255.0 FORMAT "%5.1" /end CHARACTERISTIC
/begin CHARACTERISTIC DSM_FMKDfp_TVACD_Max_C "Ausblendbedingungen fuer Fehlerpfad Dfp_TVACD_Max" VALUE 0x1CDA94 Kw_Wu8 255.0 OneToOne 0.00 255.0 FORMAT "%5.1" /end CHARACTERISTIC
/begin CHARACTERISTIC DSM_FMKDfp_TVACD_Min_C "Ausblendbedingungen fuer Fehlerpfad Dfp_TVACD_Min" VALUE 0x1CDA95 Kw_Wu8 255.0 OneToOne 0.00 255.0 FORMAT "%5.1" /end CHARACTERISTIC
/begin CHARACTERISTIC DSM_FMKDfp_TVACD_Sig_C "Ausblendbedingungen fuer Fehlerpfad Dfp_TVACD_Sig" VALUE 0x1CDA96 Kw_Wu8 255.0 OneToOne 0.00 255.0 FORMAT "%5.1" /end CHARACTERISTIC
/begin CHARACTERISTIC DSM_FMKDfp_TVACD_SigNpl_C "Ausblendbedingungen fuer Fehlerpfad Dfp_TVACD_SigNpl" VALUE 0x1CDA97 Kw_Wu8 255.0 OneToOne 0.00 255.0 FORMAT "%5.1" /end CHARACTERISTIC
/begin CHARACTERISTIC DSM_FMKDfp_TVACD_stLineDef_C "Ausblendbedingungen fuer Fehlerpfad Dfp_TVACD_stLineDef" VALUE 0x1CDA98 Kw_Wu8 255.0 OneToOne 0.00 255.0 FORMAT "%5.1" /end CHARACTERISTIC
/begin CHARACTERISTIC DSM_FMKDfp_TVASCD_C "Ausblendbedingungen fuer Fehlerpfad Dfp_TVASCD" VALUE 0x1CDA99 Kw_Wu8 255.0 OneToOne 0.00 255.0 FORMAT "%5.1" /end CHARACTERISTIC
/begin CHARACTERISTIC DSM_FMKDfp_TVASCD_Drft_C "Ausblendbedingungen fuer Fehlerpfad Dfp_TVASCD_Drft" VALUE 0x1CDA9A Kw_Wu8 255.0 OneToOne 0.00 255.0 FORMAT "%5.1" /end CHARACTERISTIC
/begin CHARACTERISTIC DSM_FMKDfp_ThrVlvGvnrDvt_C "Ausblendbedingungen fuer Fehlerpfad Dfp_ThrVlvGvnrDvt" VALUE 0x1CDA9B Kw_Wu8 255.0 OneToOne 0.00 255.0 FORMAT "%5.1" /end CHARACTERISTIC
/begin CHARACTERISTIC DSM_FMKDfp_ThrVlvJamVlv_C "Ausblendbedingungen fuer Fehlerpfad Dfp_ThrVlvJamVlv" VALUE 0x1CDA9C Kw_Wu8 255.0 OneToOne 0.00 255.0 FORMAT "%5.1" /end CHARACTERISTIC
/begin CHARACTERISTIC DSM_FMKDfp_UAcc_CodeBitErr_C "Ausblendbedingungen fuer Fehlerpfad Dfp_UAcc_CodeBitErr" VALUE 0x1CDA9D Kw_Wu8 255.0 OneToOne 0.00 255.0 FORMAT "%5.1" /end CHARACTERISTIC
/begin CHARACTERISTIC DSM_FMKDfp_USAp_DataVariant_C "Ausblendbedingungen fuer Fehlerpfad Dfp_USAp_DataVariant" VALUE 0x1CDA9E Kw_Wu8 255.0 OneToOne 0.00 255.0 FORMAT "%5.1" /end CHARACTERISTIC
/begin CHARACTERISTIC DSM_FMKDfp_USAp_FuncCodeRead_C "Ausblendbedingungen fuer Fehlerpfad Dfp_USAp_FuncCodeRead" VALUE 0x1CDA9F Kw_Wu8 255.0 OneToOne 0.00 255.0 FORMAT "%5.1" /end CHARACTERISTIC
/begin CHARACTERISTIC DSM_FMKDfp_VSACD_Max_C "Ausblendbedingungen fuer Fehlerpfad Dfp_VSACD_Max" VALUE 0x1CDAA0 Kw_Wu8 255.0 OneToOne 0.00 255.0 FORMAT "%5.1" /end CHARACTERISTIC
/begin CHARACTERISTIC DSM_FMKDfp_VSACD_Min_C "Ausblendbedingungen fuer Fehlerpfad Dfp_VSACD_Min" VALUE 0x1CDAA1 Kw_Wu8 255.0 OneToOne 0.00 255.0 FORMAT "%5.1" /end CHARACTERISTIC
/begin CHARACTERISTIC DSM_FMKDfp_VSACD_SigNpl_C "Ausblendbedingungen fuer Fehlerpfad Dfp_VSACD_SigNpl" VALUE 0x1CDAA2 Kw_Wu8 255.0 OneToOne 0.00 255.0 FORMAT "%5.1" /end CHARACTERISTIC
/begin CHARACTERISTIC DSM_FMKDfp_VSSCD_C "Ausblendbedingungen fuer Fehlerpfad Dfp_VSSCD" VALUE 0x1CDAA3 Kw_Wu8 255.0 OneToOne 0.00 255.0 FORMAT "%5.1" /end CHARACTERISTIC
/begin CHARACTERISTIC DSM_FMKDfp_VSSCD1_C "Ausblendbedingungen fuer Fehlerpfad Dfp_VSSCD1" VALUE 0x1CDAA4 Kw_Wu8 255.0 OneToOne 0.00 255.0 FORMAT "%5.1" /end CHARACTERISTIC
/begin CHARACTERISTIC DSM_FMKDfp_VSSCD2_C "Ausblendbedingungen fuer Fehlerpfad Dfp_VSSCD2" VALUE 0x1CDAA5 Kw_Wu8 255.0 OneToOne 0.00 255.0 FORMAT "%5.1" /end CHARACTERISTIC
/begin CHARACTERISTIC DSM_FMKDfp_VSSCD4_C "Ausblendbedingungen fuer Fehlerpfad Dfp_VSSCD4" VALUE 0x1CDAA6 Kw_Wu8 255.0 OneToOne 0.00 255.0 FORMAT "%5.1" /end CHARACTERISTIC
/begin CHARACTERISTIC DSM_FMKDfp_VSSCDBrkLowVltg_C "Ausblendbedingungen fuer Fehlerpfad Dfp_VSSCDBrkLowVltg" VALUE 0x1CDAA7 Kw_Wu8 255.0 OneToOne 0.00 255.0 FORMAT "%5.1" /end CHARACTERISTIC
/begin CHARACTERISTIC DSM_FMKDfp_VSSCDCAN_C "Ausblendbedingungen fuer Fehlerpfad Dfp_VSSCDCAN" VALUE 0x1CDAA8 Kw_Wu8 255.0 OneToOne 0.00 255.0 FORMAT "%5.1" /end CHARACTERISTIC
/begin CHARACTERISTIC DSM_FMKDfp_VSSCDNpl_C "Ausblendbedingungen fuer Fehlerpfad Dfp_VSSCDNpl" VALUE 0x1CDAA9 Kw_Wu8 255.0 OneToOne 0.00 255.0 FORMAT "%5.1" /end CHARACTERISTIC
/begin CHARACTERISTIC DSM_FMKDfp_WdCom_C "Ausblendbedingungen fuer Fehlerpfad Dfp_WdCom" VALUE 0x1CDAAB Kw_Wu8 255.0 OneToOne 0.00 255.0 FORMAT "%5.1" /end CHARACTERISTIC
/begin COMPU_METHOD OneToOne "eins zu eins (physikalischer Wert ist gleich dem internen Wert)" RAT_FUNC "%6.2" "[-]" COEFFS 0 1 0 0 0 1 /end COMPU_METHOD
/begin COMPU_METHOD SigName "Verbale Umrechnung für Signal Referenz Nummern" TAB_VERB "%6.3" "[-]" COMPU_TAB_REF SigName /end COMPU_METHOD
/begin COMPU_VTAB SigName "Verbale Umrechnung für Signal Referenz Nummern" TAB_VERB 575 0 "Sig_unused" 4 "CoEng_rTrq__Carb_r_DLen1" 5 "CTSCD_tClntLin__Carb_t_DLen1" 11 "BPSCD_pLin__Carb_p_DLen1" 12 "Eng_nAvrg__Carb_n_DLen2" 13 "VSSCD_vCarb1__Carb_v_DLen1" 15 "IATSCD_tAirLin__Carb_t_DLen1" 16 "AFSCD_dmAirRawPerTime__Carb_mAirTim_DLen2" 17 "TVACD_rOut__Carb_r_DLen1" 28 "Signals_PID0x1C__OneToOne_DLen1" 29 "CARB_Mode1PID1D__OneToOne_DLen1" 31 "VehDa_tiCarbEngOn__OneToOne_DLen2" 33 "DSMDur_ctDfctDur1__Carb_l_DLen2" 44 "EGRCD_rOut__Carb_r_DLen1" 45 "EGRVlv_rGvnrDvtRel__Carb_rNeg_DLen1" 48 "DSM_ctWUC__OneToOne_DLen1" 49 "DSM_lDist__Carb_l_DLen2" 51 "APSCD_pSensorVal__Carb_p_DLen1" 60 "EGPpCD_tPreTrbn__Carb_tHighM1_DLen2" 62 "PFlt_tPre__Carb_tHighM1_DLen2" 65 "DSM_stPID41__LowByte_DLen4" 66 "BattCD_u__Carb_uBatt_DLen2" 69 "CARB_rRelThrVlvPos_PID45__Carb_r_DLen1" 70 "EATSCD_tAir__Carb_t_DLen1" 73 "CARB_rAPPCD_PID49__Carb_r_DLen1" 74 "CARB_rAPPCD_PID4A__Carb_r_DLen1" 76 "AirCtl_rTVA__Carb_r_DLen1" 79 "CARB_Mode1PID4F__LowByte_DLen4" 112 "CARB_LSU_rLmbd0__Carb_lr_DLen2" 113 "LSUCD_uO2Raw__Carb_u_DLen2" 114 "CARB_Mode1PID4FB__LowByte_DLen2" 115 "PFlt_tPst__Carb_tHighM1_DLen2" 116 "PFlt_tOxiPre__Carb_tHighM1_DLen2" 117 "PFlt_tOxiPst__Carb_tHighM1_DLen2" 118 "OxiCCD_tPre__Carb_tHighM1_DLen2" 119 "TVASCD_rNrm__Carb_r_DLen1" 120 "EGRVlv_rDesVal__Carb_r_DLen1" 122 "CARB_rNrmInvTVASCD__Carb_r_DLen1" 197 "Eng_nAvrg__n_DLen1" 198 "APPCD_stSwitchSig__OneToOne_DLen1" 199 "APPCD_uRawAPP1__u_DLen1" 200 "APPCD_uRawAPP2__u_DLen1" 201 "APPCD_rAPP1UnFlt__r_DLen1" 202 "BPSCD_uRawVal__u_DLen1" 203 "BPSCD_pOutVal__p_DLen1" 204 "APSCD_pVal__p_DLen1" 205 "APSCD_uRaw__u_DLen1" 206 "IATSCD_tAirLin__t_DLen1" 207 "IATSCD_uRaw__u_DLen1" 208 "FTSCD_tFuel__t_DLen1" 209 "CTSCD_uRaw__u_DLen1" 210 "CTSCD_tClnt__t_DLen1" 211 "OTSCD_tEngOil__t_DLen1" 212 "VSSCD_v__v_DLen1" 213 "AFSCD_dmAirRawPerTime__mAirTim_DLen1" 214 "AFSCD_uRaw__u_DLen1" 215 "AFSCD_dmAirPerTime__mAirTim_DLen1" 216 "BrkCD_stMnSwtRawVal__OneToOne_DLen1" 217 "BrkCD_stRedSwtRawVal__OneToOne_DLen1" 218 "ConvCD_stRawVal__OneToOne_DLen1" 219 "T15CD_stRawVal__OneToOne_DLen1" 220 "BattCD_uRaw__uBatt_DLen1" 221 "IndSys_rVSA__dcyc_DLen1" 222 "InjCtl_qCurr__q_DLen1" 223 "InjCtl_qSetUnBal__q_DLen1" 224 "BPACD_rOut__dcyc_DLen1" 225 "EGRCD_rOut__dcyc_DLen1" 226 "ACCtl_stLogicOut__OneToOne_DLen1" 227 "AOHt_stHt1Out__OneToOne_DLen1" 228 "GlwCtl_stLmpOut__OneToOne_DLen1" 229 "GlwCtl_stActrOut__OneToOne_DLen1" 230 "InjVlv_nCyl1__nCmpTst_DLen1" 231 "InjVlv_nCyl2__nCmpTst_DLen1" 232 "InjVlv_nCyl3__nCmpTst_DLen1" 233 "InjVlv_nCyl4__nCmpTst_DLen1" 234 "InjVlv_nCyl5__nCmpTst_DLen1" 235 "InjVlv_nCyl6__nCmpTst_DLen1" 236 "InjVlv_qFBCCyl1__q_DLen1" 237 "InjVlv_qFBCCyl2__q_DLen1" 238 "InjVlv_qFBCCyl3__q_DLen1" 239 "InjVlv_qFBCCyl4__q_DLen1" 240 "InjVlv_qFBCCyl5__q_DLen1" 241 "InjVlv_qFBCCyl6__q_DLen1" 242 "CaSCD_nPeriod__n_DLen1" 243 "FBC_qDvtCyl[0]__qdiff_DLen1" 244 "FBC_qDvtCyl[1]__qdiff_DLen1" 245 "FBC_qDvtCyl[2]__qdiff_DLen1" 246 "FBC_qDvtCyl[3]__qdiff_DLen1" 247 "FBC_qDvtCyl[4]__qdiff_DLen1" 248 "FBC_qDvtCyl[5]__qdiff_DLen1" 249 "FBC_qDvtCyl[6]__qdiff_DLen1" 250 "FBC_qDvtCyl[7]__qdiff_DLen1" 251 "FBC_qDvtCyl[8]__qdiff_DLen1" 252 "FBC_qDvtCyl[9]__qdiff_DLen1" 253 "InjCrv_phiMI1Des__phiHResol_DLen1" 254 "InjVlv_phiMI1DurCorr__phi_DLen1" 255 "PSP_stLogicOut__OneToOne_DLen1" 256 "ACCD_stMnSwtRawVal__OneToOne_DLen1" 257 "AOHt_stHt2Out__OneToOne_DLen1" 258 "AFSCD_mAirPerCyl__mAirCyl_DLen1" 259 "AFSCD_dmAirNorm__mAirTim_DLen1" 260 "AirCtl_mGovDev__mAirCylGov_DLen1" 261 "AirCtl_rEGR__r_DLen1" 262 "PCR_rBPACD__r_DLen1" 263 "Dfp_LSUCDCircNernst0_Low__OneToOne_DLen1" 264 "GlwCD_stRawVal__OneToOne_DLen1" 265 "APPCD_rFlt__r_DLen1" 266 "HWEMon_numRecovery__OneToOne_DLen1" 281 "DSM_stSysLamp__OneToOne_DLen1" 282 "DSM_stMIL__OneToOne_DLen1" 283 "BattCD_u__uBatt_DLen1" 284 "LIGov_nSetpoint__n_DLen1" 285 "VSSCD_a__a_DLen1" 286 "Tst_Zyklflag_SB5__OneToOne_DLen1" 287 "IATSCD_tAir__t_DLen1" 288 "AccPed_stPlaAPPBrk__OneToOne_DLen1" 289 "AccPed_trqDes__trqhigh_DLen1" 290 "COTSCD_tClnt__t_DLen1" 291 "AccPed_trqInrDesSig__trq_DLen1" 292 "Gearbx_stGear__OneToOne_DLen1" 293 "LSU_rLmbd[0]__rLmbd_DLen1" 294 "LSU_rLmbd[1]__rLmbd_DLen1" 295 "Tst_Zyklflag_SB1__OneToOne_DLen1" 296 "Tst_Zyklflag_SB2__OneToOne_DLen1" 297 "Tst_Zyklflag_SB3__OneToOne_DLen1" 298 "Tst_Zyklflag_SB4__OneToOne_DLen1" 299 "Tst_Zyklflag_SB6__OneToOne_DLen1" 300 "AirCtl_mDesVal__mAirCyl_DLen1" 301 "Tst_Zyklflag_SB7__OneToOne_DLen1" 302 "CtTCtl_tClntDes__t_DLen1" 303 "PCR_pBDes__p_DLen1" 304 "BPSCD_pFltVal__p_DLen1" 305 "FrmMng_lOil_mp__lLvl_DLen1" 306 "FlMng_stMon_mp__OneToOne_DLen1" 307 "FrmMng_stChrgr1Err1__OneToOne_DLen1" 308 "FrmMng_stChrgr1Err2__OneToOne_DLen1" 309 "FrmMng_stChrgr2Err1__OneToOne_DLen1" 310 "FrmMng_stChrgr2Err2__OneToOne_DLen1" 311 "FMTC_qStrt__q_DLen1" 312 "CrCtl_trqDes__trqhigh_DLen1" 313 "CoVM_trqInc__trqhigh_DLen1" 314 "CoEng_trqInrLim__trq_DLen1" 315 "FMTC_trqInrLimSmk__trq_DLen1" 316 "EngPrt_trqLim__trq_DLen1" 317 "CoVM_trqDec__trqhigh_DLen1" 318 "FlMng_qLimSmk__q_DLen1" 319 "CrCtl_vSetPointTrgt__v_DLen1" 320 "AltCD_rAltLoad__r_DLen1" 321 "CoEng_trqInrSet__trq_DLen1" 322 "CoEng_dvolFlConsum__Cnsmp_DLen1" 323 "AirCtl_stMonitor__OneToOne_DLen1" 324 "ACCtl_stLowByte_mp__OneToOne_DLen1" 325 "EngM_stSync__OneToOne_DLen1" 326 "NetMng_stCAN__LowByte_DLen1" 327 "LSUCD_resRiClb__res_DLen1" 328 "LSUCD_uO2Clb__u_DLen1" 329 "FrmMng_stTSC__LowByte_DLen1" 330 "FrmMng_stDCS__LowByte_DLen1" 331 "LSUCD_stAdpt__OneToOne_DLen1" 332 "LSUCD_uRiRaw__u_DLen1" 333 "LSUCD_mAirAftOvrrun__mAir_DLen1" 334 "GlwCtl_tiPst_mp__tiGlw_DLen1" 335 "PCR_stPCR_mp__LowByte_DLen1" 336 "AOHt_stShutOff_mp__LowByte_DLen1" 337 "FrmMng_stTCS__LowByte_DLen1" 338 "FrmMng_trqTSC__trq_DLen1" 339 "FrmMng_trqDCS__trqhigh_DLen1" 340 "CrCCD_stKeySig__OneToOne_DLen1" 341 "CrCtl_stKeyStateSig__OneToOne_DLen1" 342 "PrpCtl_vCurrTrack_mp__v_DLen1" 343 "CtApCD_rHWE_mp__dcyc_DLen1" 344 "Gearbx_trqDec__trq_DLen1" 345 "CrCtl_stShutOffrev__LowByte_DLen1" 346 "AirCtl_stAirCtl_mp__OneToOne_DLen1" 347 "DSM_stRdyAB__LowByte_DLen1" 348 "DSM_stRdyAB__HighByte_DLen1" 349 "DSM_stRdyCD__LowByte_DLen1" 350 "DSM_stRdyCD__HighByte_DLen1" 351 "PrpBrk_trqDes__trqhigh_DLen1" 352 "DSM_ctOBDPath__OneToOne_DLen1" 353 "DSM_ctRdyActCyc_mp__OneToOne_DLen1" 354 "GlwCtl_stLogic__LowByte_DLen1" 355 "GlwCtl_tiPre__tiGlw_DLen1" 356 "FMTC_trqInr__trq_DLen1" 357 "ACCtl_stBitStructure__HighByte_DLen1" 358 "AOHt_stShutOff_mp__HighByte_DLen1" 359 "FrmMng_stTSC__HighByte_DLen1" 360 "FrmMng_stDCS__HighByte_DLen1" 361 "FrmMng_stTCS__HighByte_DLen1" 362 "CrCtl_stSwitchSig__OneToOne_DLen1" 363 "EGSys_tEGLSU__tExhaust_DLen1" 364 "AOHt_NumRly_mp__OneToOne_DLen1" 365 "DSM_ctFcmEntry__OneToOne_DLen1" 368 "GlwCtl_stLogic__HighByte_DLen1" 369 "Dfp_HWEMonUMinSupply_Low__OneToOne_DLen1" 370 "Dfp_HWEMonUMaxSupply_Low__OneToOne_DLen1" 371 "PCR_rBalGvnrDiff__r_DLen1" 372 "Dfp_SOPTst_Low__OneToOne_DLen1" 373 "UAcc_SWPartNum_cs__OneToOne_DLen1" 374 "UAcc_ECUIdentEep_cs__OneToOne_DLen1" 375 "Gearbx_stTSC_mp__OneToOne_DLen1" 376 "CoVM_stActDem__OneToOne_DLen1" 377 "CrCCD_stKey__OneToOne_DLen1" 378 "CrCtl_stShutOff__OneToOne_DLen1" 379 "FanCtl_dcycFan1__dcyc_DLen1" 380 "FanCtl_dcycFan2__dcyc_DLen1" 381 "ACCD_p__pAC_DLen1" 382 "EngPrt_trqPrtLim__trq_DLen1" 383 "ImmCtl_tiLockCount__OneToOne_DLen1" 384 "UAcc_Vin_cs__OneToOne_DLen1" 385 "UAcc_dBGWVin_cs__OneToOne_DLen1" 386 "UAcc_SigBlk80_cs__OneToOne_DLen1" 387 "UAcc_SigBlk82_cs__OneToOne_DLen1" 388 "FlSys_stFlPp__OneToOne_DLen1" 389 "AOHtCD_volFlConsum__Cnsmp_DLen1" 390 "UAcc_MWB26sum_checksum_cs__OneToOne_DLen1" 391 "BPSCD_pLin__p_DLen1" 392 "CoEng_rTrq__r_DLen1" 393 "EngM_stEngMntCtl_MLS1__OneToOne_DLen1" 394 "EngM_stEngMntCtl_MLS2__OneToOne_DLen1" 395 "EngM_stEngMntCtl_GTL1__OneToOne_DLen1" 396 "EngM_stEngMntCtl_GTL2__OneToOne_DLen1" 397 "FanCD_rFan1HWE_mp__dcyc_DLen1" 398 "FanCD_rFan2HWE_mp__dcyc_DLen1" 399 "ACCD_trqCompr__trq_DLen1" 400 "TVACD_rOut__dcyc_DLen1" 401 "PFltCD_tPre__tExhaust_DLen1" 402 "PFltCD_pDiff__p_DLen1" 403 "EGPpCD_tPreTrbn__tExhaust_DLen1" 404 "AC_pwrDes__pwr_DLen1" 405 "Alt_pwrDes__pwr_DLen1" 406 "SrvPmp_pwrDes__pwr_DLen1" 407 "SvLp_dOilLoad__NoUnit_DLen1" 408 "SvLp_dSootLoad__NoUnit_DLen1" 409 "Dfp_LSUCDCircPumpCur0_Low__OneToOne_DLen1" 410 "Dfp_LSUCDCircVirtGnd0_Low__OneToOne_DLen1" 411 "Dfp_LSUCDHtCoup0_Low__OneToOne_DLen1" 412 "Dfp_LSUCDO20_Low__OneToOne_DLen1" 413 "Dfp_LSUCDHeater0_Low__OneToOne_DLen1" 414 "Dfp_LSUCDO2Clb0_Low__OneToOne_DLen1" 415 "Dfp_LSUCDRiClb0_Low__OneToOne_DLen1" 416 "Dfp_LSUCDSPI0_Low__OneToOne_DLen1" 417 "Dfp_LSUCDWireIP0_Low__OneToOne_DLen1" 418 "Dfp_LSUCtlRiExc0_Low__OneToOne_DLen1" 419 "Dfp_LSUMonFullLd_Low__LowByte_DLen1" 420 "Dfp_LSUMonPartLd_Low__LowByte_DLen1" 421 "Dfp_HWEMonEEPROM_Low__OneToOne_DLen1" 422 "Dfp_HWEMonCom_Low__OneToOne_DLen1" 423 "Ad_NumTyp_FreeApplic1_CSTR__FreeApplic1_DLen1" 424 "Ad_NumTyp_FreeApplic2_CSTR__FreeApplic2_DLen1" 425 "Ad_NumTyp_FreeApplic3_CSTR__FreeApplic3_DLen1" 426 "Ad_NumTyp_FreeApplic4_CSTR__FreeApplic4_DLen1" 427 "AFSCD_dmAirPerTimeB2__mAirTim_DLen1" 428 "AFSCD_mAirPerCylB1__mAirCyl_DLen1" 429 "AFSCD_mAirPerCylB2__mAirCyl_DLen1" 431 "BPACD_rOut2__dcyc_DLen1" 432 "AFSCD_dmAirPerTimeB1__mAirTim_DLen1" 468 "FrmMng_stNumTOOvrFlowECU[0]__OneToOne_DLen1" 469 "FrmMng_stNumTOOvrFlowECU[1]__OneToOne_DLen1" 470 "FrmMng_stNumTOOvrFlowECU[2]__OneToOne_DLen1" 471 "FrmMng_stNumTOOvrFlowECU[3]__OneToOne_DLen1" 472 "FrmMng_stNumTOOvrFlowECU[4]__OneToOne_DLen1" 473 "FrmMng_stNumTOOvrFlowECU[5]__OneToOne_DLen1" 474 "FrmMng_stNumTOOvrFlowECU[6]__OneToOne_DLen1" 475 "FrmMng_stNumTOOvrFlowECU[7]__OneToOne_DLen1" 476 "FrmMng_stNumTOOvrFlowECU[8]__OneToOne_DLen1" 477 "FrmMng_stNumTOOvrFlowECU[9]__OneToOne_DLen1" 478 "FrmMng_stNumTOOvrFlowECU[10]__OneToOne_DLen1" 479 "FrmMng_stNumTOOvrFlowECU[11]__OneToOne_DLen1" 480 "FrmMng_stNumTOOvrFlowECU[12]__OneToOne_DLen1" 481 "FrmMng_stNumTOOvrFlowECU[13]__OneToOne_DLen1" 482 "FrmMng_stNumTOOvrFlowECU[14]__OneToOne_DLen1" 483 "FrmMng_stNumTOOvrFlowECU[15]__OneToOne_DLen1" 484 "FrmMng_stNumTOOvrFlowECU[16]__OneToOne_DLen1" 485 "FrmMng_stNumTOOvrFlowECU[17]__OneToOne_DLen1" 486 "FrmMng_stNumTOOvrFlowECU[18]__OneToOne_DLen1" 487 "FrmMng_stNumTOOvrFlowECU[19]__OneToOne_DLen1" 488 "FrmMng_stNumTOOvrFlowECU[20]__OneToOne_DLen1" 489 "FrmMng_stNumTOOvrFlowECU[21]__OneToOne_DLen1" 490 "FrmMng_stNumTOOvrFlowECU[22]__OneToOne_DLen1" 491 "FrmMng_stNumTOOvrFlowECU[23]__OneToOne_DLen1" 492 "FrmMng_stNumTOOvrFlowECU[24]__OneToOne_DLen1" 493 "FrmMng_stNumTOOvrFlowECU[25]__OneToOne_DLen1" 494 "FrmMng_stNumTOOvrFlowECU[26]__OneToOne_DLen1" 495 "FrmMng_stNumTOOvrFlowECU[27]__OneToOne_DLen1" 496 "FrmMng_stNumTOOvrFlowECU[28]__OneToOne_DLen1" 497 "FrmMng_stNumTOOvrFlowECU[29]__OneToOne_DLen1" 498 "FrmMng_stNumTOOvrFlowECU[30]__OneToOne_DLen1" 499 "FrmMng_stNumTOOvrFlowECU[31]__OneToOne_DLen1" 526 "EGRVlv_rEGR__r_DLen1" 527 "EGRSCD_rRelPos__dcyc_DLen1" 532 "BPSCD_pIntVal__p_DLen1" 533 "EGRVlv_rDesVal__dcyc_DLen1" 535 "BPASCD_rRelPos__rNeg_DLen1" 536 "FMA_qRaw_mp__qNeg_DLen1" 538 "FMA_facSwtOff__Fact_DLen1" 601 "T50CD_stRxDebVal__OneToOne_DLen1" 602 "CoEng_stEng__OneToOne_DLen1" 603 "StSysCtl_stStrtCncl__LowByte_DLen1" 604 "PrpCtl_stSPTrack_mp__OneToOne_DLen1" 605 "ACCCD_stACC__OneToOne_DLen1" 606 "InjCrv_qLmbdCtl__q_DLen1" 607 "EGSys_stHtgLSU__OneToOne_DLen1" 608 "LSUCD_dcycHtCor__dcyc_DLen1" 609 "EGSys_pExhGas__p_DLen1" 610 "EGSys_dmEG__mAirTim_DLen1" 611 "LSUCD_drO2Adpt__O2diff_DLen1" 612 "LSUCD_stCircModeNewLow__OneToOne_DLen1" 613 "LSU_stPlausChk__OneToOne_DLen1" 614 "LSU_stO2Err__LowByte_DLen1" 615 "PFlt_pPre__p_DLen1" 616 "PFlt_pDiff__pPFlt_DLen1" 617 "PFlt_tPre__tExhaust_DLen1" 623 "PFlt_pDiffOfsValAct_mp__pPFlt_DLen1" 624 "PFlt_qFl_mp__q_DLen1" 625 "PFlt_tiSnceRgn_mp__ti_DLen1" 626 "PFlt_lSnceRgn_mp__l_DLen1" 627 "PFlt_stCntRes__OneToOne_DLen1" 628 "PFlt_numEngPOp_mp__OneToOne_DLen1" 629 "FMA_qIC__qdiff_DLen1" 630 "FMA_stSwtOff__LowByte_DLen1" 631 "EEPCD_stErrSet__OneToOne_DLen1" 632 "EEPCD_stOptErrCodSet__OneToOne_DLen1" 633 "CtTCtl_dcycThst__dcyc_DLen1" 634 "CtTCtl_stCtl__OneToOne_DLen1" 635 "EATSCD_tAir__t_DLen1" 636 "HDSCD_prcAir__r_DLen1" 638 "LSUCD_uO2Raw__u_DLen1" 639 "LSUCD_rO2Adpt__r_DLen1" 640 "PFlt_pDiffOfsValOld_mp__pPFlt_DLen1" 643 "ConvCD_stIlsDebVal__OneToOne_DLen1" 644 "StSysCtl_stT50CDOn__OneToOne_DLen1" 645 "StSysCtl_stT50CDOff__OneToOne_DLen1" 646 "T50CD_stDebVal__OneToOne_DLen1" 653 "AirCtl_mMaxDev_mp__mAirCylGov_DLen1" 654 "AirCtl_mMinDev_mp__mAirCylGov_DLen1" 655 "AirCtl_stDebDef__OneToOne_DLen1" 656 "AFSCD_stPlSetyDrft_mp__LowByte_DLen1" 657 "AFSCD_rAirNorm__Fact_DLen1" 658 "NetMng_stCAN__HighByte_DLen1" 659 "NetMng_stCAN__Byte2_DLen1" 660 "NetMng_stCAN__Byte3_DLen1" 661 "PCR_stPCR_mp__HighByte_DLen1" 662 "CrCtl_stShutOffrev__HighByte_DLen1" 663 "CrCtl_stShutOffrev__Byte2_DLen1" 664 "CrCtl_stShutOffrev__Byte3_DLen1" 665 "LSU_stO2Err__HighByte_DLen1" 666 "FMA_stSwtOff__HighByte_DLen1" 667 "AFSCD_stPlSetyDrft_mp__HighByte_DLen1" 671 "CARB_TstNotUsedMaxU__LowByte_DLen2" 672 "CARB_TstNotUsedMinU__LowByte_DLen2" 673 "CARB_TstNotUsedMaxS__LowByte_DLen2" 674 "CARB_TstNotUsedMinS__LowByte_DLen2" 675 "CARB_TstNotUsedTrue__LowByte_DLen2" 676 "CARB_TstNotUsedFalse__LowByte_DLen2" 681 "CoEng_dvolFlConsAllTot__Cnsmp_DLen1" 682 "EGT_st__Byte3_DLen1" 683 "EGT_st__Byte2_DLen1" 684 "EGT_st__HighByte_DLen1" 685 "EGT_st__LowByte_DLen1" 687 "LSUCD_stO2Valid__LowByte_DLen1" 688 "AirCtl_stEGRClgBypVlv__LowByte_DLen1" 689 "FQlSCD_rFlQlLin__ratio_DLen1" 690 "GlwCD_stLampOut__LowByte_DLen1" 691 "GlwCD_stOutHWE_mp__LowByte_DLen1" 692 "GlwCD_rGSK__dcyc_DLen1" 693 "FlPpCD_stFlPp__LowByte_DLen1" 694 "AFVCD_stActrOut__LowByte_DLen1" 695 "FrmMng_prcFan__dcyc_DLen1" 696 "EGPpCD_tLinPreTrbn__tExhaust_DLen1" 697 "EngPrt_facPrtLimCorr__Fact_DLen1" 698 "EngPrt_tPreTrbn__t_DLen1" 699 "FrmMng_trqFrcCan__trq_DLen1" 700 "CoVeh_trqAcs__trq_DLen1" 701 "CoEng_trqMin__trq_DLen1" 702 "BPSCD_pAvgDiff__pDiff_DLen1" 703 "IndSys_pAdj__pDiff_DLen1" 704 "BPSCD_ctAvg__OneToOne_DLen1" 705 "CtT_stCondMon__LowByte_DLen1" 706 "CtT_tAir__t_DLen1" 707 "SvLp_dOilLoadWIV2__NoUnitII_DLen1" 708 "SvLp_dSootLoadWIV2__NoUnitII_DLen1" 709 "CARB_stRdyCurrABCD__LowByte_DLen1" 710 "CARB_stRdyCurrABCD__HighByte_DLen1" 711 "CARB_stRdyCurrABCD__Byte2_DLen1" 712 "CARB_stRdyCurrABCD__Byte3_DLen1" 713 "CtT_stCondMon__HighByte_DLen1" 714 "CoEng_ctUnpla__OneToOne_DLen1" 716 "SvLpCD_ltmpMin2__lLvl2_DLen1" 717 "FanCtl_prcAddReq__r_DLen1" 718 "Dfp_LSUMonOvrRun_Low__LowByte_DLen1" 719 "Dfp_LSUMonDyn_Low__LowByte_DLen1" 720 "APPCD_rRawAPP1__r_DLen1" 721 "APPCD_rRawAPP2__r_DLen1" 722 "APPCD_rKDThres__r_DLen1" 727 "Shtrp_ctRemain__OneToOne_DLen1" 728 "Shtrp_numCurrTst__OneToOne_DLen1" 729 "CrCtl_stShutOffrevSig__LowByte_DLen1" 730 "CrCtl_stShutOffirevSig__LowByte_DLen1" 731 "ACCCD_trqDes__trqhigh_DLen1" 732 "ACC_trqDes__trqhigh_DLen1" 733 "ACC_trqBrk__trqhigh_DLen1" 734 "ACCCD_stACC__OneToOne_DLen1__2" 735 "ACCCD_stBrkErr_mp__OneToOne_DLen1" 736 "ACCCD_stSensErr_mp__OneToOne_DLen1" 737 "ACC_stState__OneToOne_DLen1" 738 "ACCCD_aDes__a_DLen1" 739 "ACCCD_phiRoad__phi2_DLen1" 740 "ACC_rBrkDes__r_DLen1" 748 "TVASCD_rRelPos__dcyc_DLen1" 750 "ThrVlv_rDesVal__dcyc_DLen1" 751 "ThrVlv_stMon__LowByte_DLen1" 752 "ThrVlv_stMon__HighByte_DLen1" 753 "ThrVlv_rTVA__dcyc_DLen1" 755 "StSysCtl_stStrtCncl_mp__LowByte_DLen1" 756 "StSysCtl_stStrtCncl_mp__HighByte_DLen1" 757 "FrmMng_rChrgr1Actr__dcyc_DLen1" 758 "FrmMng_tChrgr1ASIC__tExhaust_DLen1" 759 "FrmMng_rChrgr2Actr__dcyc_DLen1" 760 "FrmMng_tChrgr2ASIC__tExhaust_DLen1" 761 "Shtrp_ActFreeTstTog__OneToOne_DLen1" 762 "PFlt_tSimPstPFlt_mp__tExhaust_DLen1" 763 "FrmMng_volFuelFil__volLiter_DLen1" 764 "CtT_tClntMod__t_DLen1" 765 "InjCrv_stT3Dia_mp__LowByte_DLen1" 766 "InjCrv_stT3Dia_mp__HighByte_DLen1" 767 "InjCrv_ctT3DiaMin_mp__OneToOne_DLen1" 768 "InjCrv_tT3DiaMin_mp__tExhaust_DLen1" 769 "EGRCD_stCBVOutHWE_mp__LowByte_DLen1" 770 "FlClgCD_stFlClg__LowByte_DLen1" 771 "DIUMPR_ctIgn_mp__ct_DLen1" 772 "DIUMPR_ctGenDenom_mp__ct_DLen1" 773 "TVASCD_rDrftOpn_mp__dcycNeghighres_DLen1" 774 "TVASCD_rDrftCls_mp__dcycNeghighres_DLen1" 775 "WDASCD_stWntrSwtVal__LowByte_DLen1" 776 "WDASCD_stWntrLogVal_mp__LowByte_DLen1" 777 "PFlt_stRlsPlausTemp__OneToOne_DLen1" 778 "PFlt_stRlsPlausTempPrePFlt__OneToOne_DLen1" 779 "PFlt_stRlsPlausTempPreOxiC__OneToOne_DLen1" 780 "PFlt_stRlsPlausTempPreTrbn__OneToOne_DLen1" 781 "PFlt_stRlsPlausTempPstPFlt__OneToOne_DLen1" 1000 "BIP_tiDvtFltMI1[1]__tius_DLen1" 1001 "BIP_tiDvtFltMI1[2]__tius_DLen1" 1002 "BIP_tiDvtFltMI1[3]__tius_DLen1" 1003 "BIP_tiDvtFltMI1[4]__tius_DLen1" 1004 "BIP_tiDvtFltMI1[5]__tius_DLen1" 1005 "BIP_tiDvtFltMI1[6]__tius_DLen1" 1006 "BIP_tiDvtFltMI1[7]__tius_DLen1" 1007 "BIP_tiDvtFltMI1[8]__tius_DLen1" 1008 "BIP_tiDvtFltMI1[9]__tius_DLen1" 1009 "BIP_tiDvtFltMI1[10]__tius_DLen1" 1010 "BIPCD_stBIPDetMI1[1]__OneToOne_DLen1" 1011 "BIPCD_stBIPDetMI1[2]__OneToOne_DLen1" 1012 "BIPCD_stBIPDetMI1[3]__OneToOne_DLen1" 1013 "BIPCD_stBIPDetMI1[4]__OneToOne_DLen1" 1014 "BIPCD_stBIPDetMI1[5]__OneToOne_DLen1" 1015 "BIPCD_stBIPDetMI1[6]__OneToOne_DLen1" 1016 "BIPCD_stBIPDetMI1[7]__OneToOne_DLen1" 1017 "BIPCD_stBIPDetMI1[8]__OneToOne_DLen1" 1018 "BIPCD_stBIPDetMI1[9]__OneToOne_DLen1" 1019 "BIPCD_stBIPDetMI1[10]__OneToOne_DLen1" 1020 "EngM_phiCaSOfsCorr__phi_DLen1" 1021 "InjVCD_stInjVlv_mp__OneToOne_DLen1" 1022 "AFSCD_rAirThrHiPlHi_mp__Fact_DLen1" 1023 "AFSCD_rAirThrLoPlLo_mp__Fact_DLen1" 1024 "InjCrv_qPoI2Des__q_DLen1" 1025 "InjCrv_phiPoI2Des__phiHResol_DLen1" 1026 "InjVlv_phiPoI2Dur__phi_DLen1" 1027 "InjVlv_phiPiI1DurCorr__phi_DLen1" 1028 "InjCrv_qPiI1Des__q_DLen1" 1029 "InjCrv_phiPiI1Des__phiHResol_DLen1" 1030 "InjCrv_qPoI2LmbdOfs__q_DLen1" 1031 "PFlt_tiSumRgnMaxTmr__tisecond_DLen1" 1032 "PFlt_rAshLdLrn_mp__r_DLen1" 1033 "PFlt_rSotSimPres__r_DLen1" 1034 "PFlt_lSum_mp__l_DLen1" 1035 "PFlt_ctRgnLck__LowByte_DLen1" 1036 "PFlt_stCntRes__LowByte_DLen1" 1037 "PFlt_tiOp_mp__tiHour_DLen1" 1038 "IndSys_swtVacMonOn__OneToOne_DLen1" 1044 "BPASCD_rLinRelPos__r_DLen1" 1045 "VSACD_rOut__rNeg_DLen1" 1046 "BIPCD_stBIPDetPiI1[1]__OneToOne_DLen1" 1047 "BIPCD_stBIPDetPiI1[2]__OneToOne_DLen1" 1048 "BIPCD_stBIPDetPiI1[3]__OneToOne_DLen1" 1049 "BIPCD_stBIPDetPiI1[4]__OneToOne_DLen1" 1050 "BIPCD_stBIPDetPiI1[5]__OneToOne_DLen1" 1051 "BIPCD_stBIPDetPiI1[6]__OneToOne_DLen1" 1052 "BIPCD_stBIPDetPiI1[7]__OneToOne_DLen1" 1053 "BIPCD_stBIPDetPiI1[8]__OneToOne_DLen1" 1054 "BIPCD_stBIPDetPiI1[9]__OneToOne_DLen1" 1055 "BIPCD_stBIPDetPiI1[10]__OneToOne_DLen1" 1056 "BIPCD_stBIPDetPoI2[1]__OneToOne_DLen1" 1057 "BIPCD_stBIPDetPoI2[2]__OneToOne_DLen1" 1058 "BIPCD_stBIPDetPoI2[3]__OneToOne_DLen1" 1059 "BIPCD_stBIPDetPoI2[4]__OneToOne_DLen1" 1060 "BIPCD_stBIPDetPoI2[5]__OneToOne_DLen1" 1061 "BIPCD_stBIPDetPoI2[6]__OneToOne_DLen1" 1062 "BIPCD_stBIPDetPoI2[7]__OneToOne_DLen1" 1063 "BIPCD_stBIPDetPoI2[8]__OneToOne_DLen1" 1064 "BIPCD_stBIPDetPoI2[9]__OneToOne_DLen1" 1065 "BIPCD_stBIPDetPoI2[10]__OneToOne_DLen1" 1066 "BIP_tiDvtFltPiI1[1]__tius_DLen1" 1067 "BIP_tiDvtFltPiI1[2]__tius_DLen1" 1068 "BIP_tiDvtFltPiI1[3]__tius_DLen1" 1069 "BIP_tiDvtFltPiI1[4]__tius_DLen1" 1070 "BIP_tiDvtFltPiI1[5]__tius_DLen1" 1071 "BIP_tiDvtFltPiI1[6]__tius_DLen1" 1072 "BIP_tiDvtFltPiI1[7]__tius_DLen1" 1073 "BIP_tiDvtFltPiI1[8]__tius_DLen1" 1074 "BIP_tiDvtFltPiI1[9]__tius_DLen1" 1075 "BIP_tiDvtFltPiI1[10]__tius_DLen1" 1076 "BIP_tiDvtFltPoI2[1]__tius_DLen1" 1077 "BIP_tiDvtFltPoI2[2]__tius_DLen1" 1078 "BIP_tiDvtFltPoI2[3]__tius_DLen1" 1079 "BIP_tiDvtFltPoI2[4]__tius_DLen1" 1080 "BIP_tiDvtFltPoI2[5]__tius_DLen1" 1081 "BIP_tiDvtFltPoI2[6]__tius_DLen1" 1082 "BIP_tiDvtFltPoI2[7]__tius_DLen1" 1083 "BIP_tiDvtFltPoI2[8]__tius_DLen1" 1084 "BIP_tiDvtFltPoI2[9]__tius_DLen1" 1085 "BIP_tiDvtFltPoI2[10]__tius_DLen1" 1086 "PFlt_tFlt__tExhaust_DLen1" 1087 "PFlt_mAshTrmTot__mAsh_DLen1" 1089 "PFlt_rSotRatFlt_mp__r_DLen1" 1091 "PFlt_stCntRes__OneToOne_DLen1__2" 1092 "AddPCD_numStrkRem_mp__stroke_DLen1" 1093 "AddPmp_volAddTotDia_mp__vol_DLen1" 1094 "AddPmp_volAddDia_mp__volHigh_DLen1" 1095 "AddPmp_rAdd_mp__MLperL_DLen1" 1096 "EGRSCD_rOfsLrnLst__dcycNeg_DLen1" 1097 "EGRSCD_stAdapt__LowByte_DLen1" 1098 "BPASCD_rOfs__dcycNeg_DLen1" 1099 "BPASCD_stOfs__LowByte_DLen1" 1100 "FlSCD_volTotal__volLiter_DLen1" 1101 "UAcc_sigEnvDat[0]__LowByte_DLen1" 1102 "UAcc_sigEnvDat[1]__LowByte_DLen1" 1103 "UAcc_sigEnvDat[2]__LowByte_DLen1" 1104 "UAcc_sigEnvDat[3]__LowByte_DLen1" 1105 "UAcc_sigEnvDat[4]__LowByte_DLen1" 1106 "UAcc_sigEnvDat[5]__LowByte_DLen1" 1107 "UAcc_sigEnvDat[6]__LowByte_DLen1" 1108 "PFlt_tPst__tExhaust_DLen1" 1109 "GlwCD_rGSK__r_DLen1" 1110 "AddPCD_uTnkLvlRawVal__u_DLen1" 1111 "InjCrv_stPoI2LmbdT3Ctl__LowByte_DLen1" 1112 "PFlt_tSimPreTrbn_mp__tExhaust_DLen1" 1113 "PFlt_tSimPrePFlt_mp__tExhaust_DLen1" 1114 "DIUMPR_rMBGrp[0]__rDIUMPR_DLen1" 1115 "DIUMPR_rMBGrp[1]__rDIUMPR_DLen1" 1116 "DIUMPR_rMBGrp[2]__rDIUMPR_DLen1" 1117 "DIUMPR_rMBGrp[3]__rDIUMPR_DLen1" 1118 "DIUMPR_rMBGrp[4]__rDIUMPR_DLen1" 1119 "DIUMPR_rMBGrp[5]__rDIUMPR_DLen1" 1120 "DIUMPR_rMBGrp[6]__rDIUMPR_DLen1" 1121 "DIUMPR_rMBGrp[7]__rDIUMPR_DLen1" 1122 "DIUMPR_rMBGrp[8]__rDIUMPR_DLen1" 1123 "DIUMPR_rMBGrp[9]__rDIUMPR_DLen1" 1124 "DIUMPR_rMBGrp[10]__rDIUMPR_DLen1" 1125 "DIUMPR_rMBGrp[11]__rDIUMPR_DLen1" 1126 "DIUMPR_rMBGrp[12]__rDIUMPR_DLen1" 1127 "DIUMPR_rMBGrp[13]__rDIUMPR_DLen1" 1128 "DIUMPR_rMBGrp[14]__rDIUMPR_DLen1" 1129 "PFlt_dvol__dvol_DLen1" 1130 "PFlt_pDiffMinSty_mp__pPFlt_DLen1" 1131 "PFltCD_tPst__tExhaust_DLen1" 1132 "InjCrv_stPoI2LmbdT3Ctl__LowByte_DLen1__2" 1133 "InjCrv_tT3DiaPreNomFlt_mp__tExhaust_DLen1" 1134 "EGRSCD_rTmpOfs__dcycNeghighres_DLen1" 1147 "PFlt_rSotSimMax__r_DLen1" 1148 "EGSys_tOxiCatBrik[0]__tExhaust_DLen1" 1149 "EGSys_tOxiCatBrik[1]__tExhaust_DLen1" 1150 "PFlt_rSotSimTemp__r_DLen1" 1151 "PFlt_facArrhThm_mp__facArrh_DLen1" 1152 "PFlt_mSotSimTemp__mSot_DLen1" /end COMPU_VTAB
/begin RECORD_LAYOUT Kwb_Wu16 FNC_VALUES 1 UWORD COLUMN_DIR DIRECT /end RECORD_LAYOUT
/begin RECORD_LAYOUT Kw_Wu8 FNC_VALUES 1 UBYTE COLUMN_DIR DIRECT /end RECORD_LAYOUT
/begin FUNCTION DSM_Env "Configuration parameters for Environment conditions fault path"
 /begin DEF_CHARACTERISTIC DSM_EnvDfp_ACCCDBrkErr_C DSM_EnvDfp_ACCCDBrkNPL_C DSM_EnvDfp_ACCCDSensErr_C DSM_EnvDfp_ACCCDWrongCoded_C DSM_EnvDfp_ACCCD_C DSM_EnvDfp_ACCD_C DSM_EnvDfp_ACCD_PAC_C DSM_EnvDfp_ACCD_pCAN_C DSM_EnvDfp_ACCD_trqCAN_C DSM_EnvDfp_ACCIRevPanErr_C DSM_EnvDfp_ACCIRevShOff_C DSM_EnvDfp_ACCnotPlaus_C DSM_EnvDfp_ADCMon_C DSM_EnvDfp_AFSCD_PlOffsDrft_C DSM_EnvDfp_AFSCD_PlSetyDrft_C DSM_EnvDfp_AFSCD_SRCAirm_C DSM_EnvDfp_AFVCD_Actr_C DSM_EnvDfp_AOHtCDHt1_C DSM_EnvDfp_AOHtCDHt2_C DSM_EnvDfp_AOHtCDHt3_C DSM_EnvDfp_APP1_C DSM_EnvDfp_APP2_C DSM_EnvDfp_APPCD_KickDown_C DSM_EnvDfp_APPCD_PWGDrft_C DSM_EnvDfp_APPSync_C DSM_EnvDfp_APP_Npl_C DSM_EnvDfp_APSCD_C DSM_EnvDfp_AccPedPlausBrk_C DSM_EnvDfp_AirCtl_GovDevMax_C DSM_EnvDfp_AirCtl_GovDevMin_C DSM_EnvDfp_AirCtl_GovDevRgnMax_C DSM_EnvDfp_AirCtl_GovDevRgnMin_C DSM_EnvDfp_AirbCDCrashCrCtl_C DSM_EnvDfp_AirbCDCrashPSP_C DSM_EnvDfp_AirbCDCrash_C DSM_EnvDfp_AltCDExc_C DSM_EnvDfp_AltCD_Load_C DSM_EnvDfp_AltPwrCan_C DSM_EnvDfp_BIP01_C DSM_EnvDfp_BIP02_C DSM_EnvDfp_BIP03_C DSM_EnvDfp_BIP04_C DSM_EnvDfp_BIP05_C DSM_EnvDfp_BIP06_C DSM_EnvDfp_BIP07_C DSM_EnvDfp_BIP08_C DSM_EnvDfp_BIP09_C DSM_EnvDfp_BIP10_C DSM_EnvDfp_BIP11_C DSM_EnvDfp_BIP12_C DSM_EnvDfp_BIP_Con_C DSM_EnvDfp_BPACD_Max2_C DSM_EnvDfp_BPACD_Max_C DSM_EnvDfp_BPACD_Min2_C DSM_EnvDfp_BPACD_Min_C DSM_EnvDfp_BPACD_SigNpl2_C DSM_EnvDfp_BPACD_SigNpl_C DSM_EnvDfp_BPASCD_C DSM_EnvDfp_BPSCD_C DSM_EnvDfp_BattCD_C DSM_EnvDfp_BrkCDBPTInvld_C DSM_EnvDfp_BrkCD_C DSM_EnvDfp_BrkCDdynPl_C DSM_EnvDfp_CANA_C DSM_EnvDfp_CANB_C DSM_EnvDfp_CANBus1_C DSM_EnvDfp_CANBus2_C DSM_EnvDfp_CANBus3_C DSM_EnvDfp_CANC_C DSM_EnvDfp_CANErrActA_C DSM_EnvDfp_CANErrActB_C DSM_EnvDfp_CANErrActC_C DSM_EnvDfp_COTSCD_C DSM_EnvDfp_CTSCDCanInac_C DSM_EnvDfp_CTSCDCanSig_C DSM_EnvDfp_CTSCD_C DSM_EnvDfp_Clg_DynTst_C DSM_EnvDfp_CmbChbMisfire1_C DSM_EnvDfp_CmbChbMisfire2_C DSM_EnvDfp_CmbChbMisfire3_C DSM_EnvDfp_CmbChbMisfire4_C DSM_EnvDfp_CmbChbMisfire5_C DSM_EnvDfp_CmbChbMisfire6_C DSM_EnvDfp_CmbChbMisfireMul_C DSM_EnvDfp_CoVMDCSh_C DSM_EnvDfp_CoVMDCSp_C DSM_EnvDfp_CoVehLvl2_C DSM_EnvDfp_ConvCD_C DSM_EnvDfp_ConvCD_ConvErr_C DSM_EnvDfp_ConvCD_EPB1_C DSM_EnvDfp_CrCCDPanErrMSG_C DSM_EnvDfp_CrCCDPanErrSMLS_C DSM_EnvDfp_CrCCDPanMainSwtErr_C DSM_EnvDfp_CrCtlDsplNotPlaus_C DSM_EnvDfp_CrCtlPECDErr_C DSM_EnvDfp_CrCtlPLmpDef_C DSM_EnvDfp_CrCtlPShutOff_C DSM_EnvDfp_CrCtlPTlrDef_C DSM_EnvDfp_CtApCD_C DSM_EnvDfp_CtTCD_C DSM_EnvDfp_CtT_Mon_C DSM_EnvDfp_DifftrqLimErrPat_C DSM_EnvDfp_EATSCDCanInac_C DSM_EnvDfp_EATSCDCanSig_C DSM_EnvDfp_EATSCD_C DSM_EnvDfp_EEPCDVarMng_C DSM_EnvDfp_EGPpCDTPreTrbn_C DSM_EnvDfp_EGRCD_CBV_C DSM_EnvDfp_EGRCD_Max_C DSM_EnvDfp_EGRCD_Min_C DSM_EnvDfp_EGRCD_SigNpl_C DSM_EnvDfp_EGRCD_Sig_C DSM_EnvDfp_EGRSCD_C DSM_EnvDfp_EGRSCD_JamVlv_C DSM_EnvDfp_EGRSCD_LgTimeDrft_C DSM_EnvDfp_EGRSCD_ShTimeDrft_C DSM_EnvDfp_EGRVlvGvnrDvt_C DSM_EnvDfp_EGRVlv_JamVlv_C DSM_EnvDfp_EMCCD_MLS1_C DSM_EnvDfp_EngMBackUp_C DSM_EnvDfp_EngMCaS1_C DSM_EnvDfp_EngMCaSDrv_C DSM_EnvDfp_EngMCrS1_C DSM_EnvDfp_EngMOfsCaSCrS_C DSM_EnvDfp_EngMonIrrCmb_C DSM_EnvDfp_EngPrt_C DSM_EnvDfp_ErLpCDMILReqON_C DSM_EnvDfp_FMAErrMod_C DSM_EnvDfp_FMTC_NonMonotonMap_C DSM_EnvDfp_FQTSCD_C DSM_EnvDfp_FQlSCD_C DSM_EnvDfp_FTSCDNpl_C DSM_EnvDfp_FTSCD_C DSM_EnvDfp_FanCD_Fan1Ctlr1_C DSM_EnvDfp_FanCD_Fan1Ctlr2_C DSM_EnvDfp_FanCD_Fan2Ctlr1_C DSM_EnvDfp_FanCD_Fan2Ctlr2_C DSM_EnvDfp_FanCD_FanCtlr1_C DSM_EnvDfp_FanCD_FanCtlr2_C DSM_EnvDfp_FanCD_OutFanCtlr1_C DSM_EnvDfp_FanCD_OutFanCtlr2_C DSM_EnvDfp_FlPpCD_C DSM_EnvDfp_FlSCDT1_C DSM_EnvDfp_FrmMngAAGNpl_C DSM_EnvDfp_FrmMngAAGTO_C DSM_EnvDfp_FrmMngAC1Npl_C DSM_EnvDfp_FrmMngAC1TO_C DSM_EnvDfp_FrmMngACCNpl_C DSM_EnvDfp_FrmMngACCTO_C DSM_EnvDfp_FrmMngAIRBGNpl_C DSM_EnvDfp_FrmMngAIRBGTO_C DSM_EnvDfp_FrmMngAWD1Npl_C DSM_EnvDfp_FrmMngAWD1TO_C DSM_EnvDfp_FrmMngBEM1Npl_C DSM_EnvDfp_FrmMngBEM1TO_C DSM_EnvDfp_FrmMngBRK1Npl_C DSM_EnvDfp_FrmMngBRK1TO_C DSM_EnvDfp_FrmMngBRK2Npl_C DSM_EnvDfp_FrmMngBRK2TO_C DSM_EnvDfp_FrmMngBRK8Npl_C DSM_EnvDfp_FrmMngBRK8TO_C DSM_EnvDfp_FrmMngBSG3TO_C DSM_EnvDfp_FrmMngCANVerErr_C DSM_EnvDfp_FrmMngCCSel_C DSM_EnvDfp_FrmMngCCTLNpl_C DSM_EnvDfp_FrmMngCCTLTO_C DSM_EnvDfp_FrmMngCHRGR1Npl_C DSM_EnvDfp_FrmMngCHRGR1TO_C DSM_EnvDfp_FrmMngCHRGR2Npl_C DSM_EnvDfp_FrmMngCHRGR2TO_C DSM_EnvDfp_FrmMngChrgr1A_C DSM_EnvDfp_FrmMngChrgr1C_C DSM_EnvDfp_FrmMngChrgr1N_C DSM_EnvDfp_FrmMngChrgr1T_C DSM_EnvDfp_FrmMngChrgr1V_C DSM_EnvDfp_FrmMngChrgr2A_C DSM_EnvDfp_FrmMngChrgr2C_C DSM_EnvDfp_FrmMngChrgr2N_C DSM_EnvDfp_FrmMngChrgr2T_C DSM_EnvDfp_FrmMngChrgr2V_C DSM_EnvDfp_FrmMngDIA1Npl_C DSM_EnvDfp_FrmMngDIA1TO_C DSM_EnvDfp_FrmMngDSP1Npl_C DSM_EnvDfp_FrmMngDSP1TO_C DSM_EnvDfp_FrmMngDSP2Npl_C DSM_EnvDfp_FrmMngDSP2TO_C DSM_EnvDfp_FrmMngDSP3Npl_C DSM_EnvDfp_FrmMngDSP3TO_C DSM_EnvDfp_FrmMngEPB1Npl_C DSM_EnvDfp_FrmMngEPB1TO_C DSM_EnvDfp_FrmMngESCUNpl_C DSM_EnvDfp_FrmMngESCUTO_C DSM_EnvDfp_FrmMngGW1Npl_C DSM_EnvDfp_FrmMngGW1TO_C DSM_EnvDfp_FrmMngILMNpl_C DSM_EnvDfp_FrmMngILMTO_C DSM_EnvDfp_FrmMngLICHT2TO_C DSM_EnvDfp_FrmMngNIV1WrngCod_C DSM_EnvDfp_FrmMngNIVEAU1Npl_C DSM_EnvDfp_FrmMngNIVEAU1TO_C DSM_EnvDfp_FrmMngSA1Npl_C DSM_EnvDfp_FrmMngSA1TO_C DSM_EnvDfp_FrmMngSTIGNNpl_C DSM_EnvDfp_FrmMngStIgnTO_C DSM_EnvDfp_FrmMngTOSNpl_C DSM_EnvDfp_FrmMngTOSTO_C DSM_EnvDfp_FrmMngTSC1Npl_C DSM_EnvDfp_FrmMngTSC1TO_C DSM_EnvDfp_FrmMngTSC2Npl_C DSM_EnvDfp_FrmMngTSC2TO_C DSM_EnvDfp_FrmMngTSC3Npl_C DSM_EnvDfp_FrmMngTSC3TO_C DSM_EnvDfp_FrmMngTSC6Npl_C DSM_EnvDfp_FrmMngTSC6TO_C DSM_EnvDfp_FrmMngTrbnSpdErr_C DSM_EnvDfp_FrmMngWIPERTO_C DSM_EnvDfp_GbSSCD_C DSM_EnvDfp_GbSSCD_HW_C DSM_EnvDfp_GearbxCVTnMax_C DSM_EnvDfp_GearbxClthPlaus_C DSM_EnvDfp_GearbxINCCup_C DSM_EnvDfp_GearbxNMinMon_C DSM_EnvDfp_GearbxTSC_C DSM_EnvDfp_GearbxTransConv_C DSM_EnvDfp_GearbxTypeMTErr_C DSM_EnvDfp_GlwCDDIAG_C DSM_EnvDfp_GlwCDErr1_C DSM_EnvDfp_GlwCDErr2_C DSM_EnvDfp_GlwCDEvalCod_C DSM_EnvDfp_GlwCDGSK2_C DSM_EnvDfp_GlwCDGSK3_C DSM_EnvDfp_GlwCDLmp_C DSM_EnvDfp_GlwCDPLUG0_C DSM_EnvDfp_GlwCDPLUG1_C DSM_EnvDfp_GlwCDPLUG2_C DSM_EnvDfp_GlwCDPLUG3_C DSM_EnvDfp_GlwCDPLUG4_C DSM_EnvDfp_GlwCDPLUG5_C DSM_EnvDfp_GlwCD_LampCan_C DSM_EnvDfp_GlwCDsfd_C DSM_EnvDfp_HDSCD_C DSM_EnvDfp_HWEMonCom_C DSM_EnvDfp_HWEMonEEPROM_C DSM_EnvDfp_HWEMonRcyLocked_C DSM_EnvDfp_HWEMonRcySuppressed_C DSM_EnvDfp_HWEMonRcyVisible_C DSM_EnvDfp_HWEMonUMaxSupply_C DSM_EnvDfp_HWEMonUMinSupply_C DSM_EnvDfp_IATSCD_C DSM_EnvDfp_IFCD_C DSM_EnvDfp_ImmCtl_C DSM_EnvDfp_IndSysMonIntMnf_C DSM_EnvDfp_InjVlvBnk1A_C DSM_EnvDfp_InjVlvBnk2A_C DSM_EnvDfp_InjVlvCyl10A_C DSM_EnvDfp_InjVlvCyl11A_C DSM_EnvDfp_InjVlvCyl12A_C DSM_EnvDfp_InjVlvCyl1A_C DSM_EnvDfp_InjVlvCyl2A_C DSM_EnvDfp_InjVlvCyl3A_C DSM_EnvDfp_InjVlvCyl4A_C DSM_EnvDfp_InjVlvCyl5A_C DSM_EnvDfp_InjVlvCyl6A_C DSM_EnvDfp_InjVlvCyl7A_C DSM_EnvDfp_InjVlvCyl8A_C DSM_EnvDfp_InjVlvCyl9A_C DSM_EnvDfp_LASCD_C DSM_EnvDfp_LSUCDCircNernst0_C DSM_EnvDfp_LSUCDCircPumpCur0_C DSM_EnvDfp_LSUCDCircVirtGnd0_C DSM_EnvDfp_LSUCDHeater0_C DSM_EnvDfp_LSUCDHtCoup0_C DSM_EnvDfp_LSUCDO20_C DSM_EnvDfp_LSUCDO2Clb0_C DSM_EnvDfp_LSUCDRiClb0_C DSM_EnvDfp_LSUCDSPI0_C DSM_EnvDfp_LSUCDSPIBattLow0_C DSM_EnvDfp_LSUCDWireIP0_C DSM_EnvDfp_LSUCtlRiExc0_C DSM_EnvDfp_LSUMonDyn0_C DSM_EnvDfp_LSUMonFullLd0_C DSM_EnvDfp_LSUMonOvrRun0_C DSM_EnvDfp_LSUMonPartLd0_C DSM_EnvDfp_MIL_C DSM_EnvDfp_MRlyCD_C DSM_EnvDfp_Montr_C DSM_EnvDfp_OTSCDCanInac_C DSM_EnvDfp_OTSCDCanSig_C DSM_EnvDfp_OTSCD_C DSM_EnvDfp_OvRMonCrCtlP_C DSM_EnvDfp_OvRMonSigA_C DSM_EnvDfp_OvRMon_C DSM_EnvDfp_OxiCCDTPre1_C DSM_EnvDfp_OxiCCDTPre_C DSM_EnvDfp_PCR_BalGovDev_C DSM_EnvDfp_PCR_GovDev_C DSM_EnvDfp_PFltAPSens_C DSM_EnvDfp_PFltCDHtg1_C DSM_EnvDfp_PFltCDHtg_C DSM_EnvDfp_PFltCDPDiff_C DSM_EnvDfp_PFltCDTempPre1_C DSM_EnvDfp_PFltCDTempPre_C DSM_EnvDfp_PFltCDTempPst_C DSM_EnvDfp_PFltChar_C DSM_EnvDfp_PFltEngPrt_C DSM_EnvDfp_PFltPresDynPlaus_C DSM_EnvDfp_PFltPresHsChng_C DSM_EnvDfp_PFltPresSensFrz_C DSM_EnvDfp_PFltPresSensHsLn_C DSM_EnvDfp_PFltPresSensSot_C DSM_EnvDfp_PFltPresSens_C DSM_EnvDfp_PFltRgnLckPermTstr_C DSM_EnvDfp_PFltRgnLckPerm_C DSM_EnvDfp_PFltRgnPerm_C DSM_EnvDfp_PFltSotSimPresPerm_C DSM_EnvDfp_PFltTempDwnStrmMax_C DSM_EnvDfp_PFltTempDwnStrmMin_C DSM_EnvDfp_PFltTempDwnStrm_C DSM_EnvDfp_PFltTempPreOxiC_C DSM_EnvDfp_PFltTempPrePFlt_C DSM_EnvDfp_PFltTempPreTrbn_C DSM_EnvDfp_PFltTempPstPFlt_C DSM_EnvDfp_PFltTempSens2_C DSM_EnvDfp_PFltTempSens_C DSM_EnvDfp_PFltTempUpStrmMax_C DSM_EnvDfp_PFltTempUpStrmMin_C DSM_EnvDfp_PFltTempUpStrm_C DSM_EnvDfp_PSPCD_Actr_C DSM_EnvDfp_PrpCtlvLimErrPat_C DSM_EnvDfp_SOPTst_C DSM_EnvDfp_SSpMon1_C DSM_EnvDfp_SSpMon2_C DSM_EnvDfp_SSpMon3_C DSM_EnvDfp_Shtrp_EGRBA_C DSM_EnvDfp_Shtrp_PCRBA_C DSM_EnvDfp_SrvPmpStSAEcu_C DSM_EnvDfp_StSysCtlShCirBatt_C DSM_EnvDfp_StrtCDOffRly_C DSM_EnvDfp_StrtCDOnRly_C DSM_EnvDfp_StrtCtlIlsNotPlaus_C DSM_EnvDfp_StrtCtlT50ROneRly1_C DSM_EnvDfp_StrtCtlT50ROneRly2_C DSM_EnvDfp_StrtCtlT50RZero_C DSM_EnvDfp_SysLamp_C DSM_EnvDfp_T15CD_C DSM_EnvDfp_T50CD_C DSM_EnvDfp_TPUMon_C DSM_EnvDfp_TVACD_Max_C DSM_EnvDfp_TVACD_Min_C DSM_EnvDfp_TVACD_SigNpl_C DSM_EnvDfp_TVACD_Sig_C DSM_EnvDfp_TVACD_stLineDef_C DSM_EnvDfp_TVASCD_C DSM_EnvDfp_TVASCD_Drft_C DSM_EnvDfp_ThrVlvGvnrDvt_C DSM_EnvDfp_ThrVlvJamVlv_C DSM_EnvDfp_UAcc_CodeBitErr_C DSM_EnvDfp_USAp_DataVariant_C DSM_EnvDfp_USAp_FuncCodeRead_C DSM_EnvDfp_VSACD_Max_C DSM_EnvDfp_VSACD_Min_C DSM_EnvDfp_VSACD_SigNpl_C DSM_EnvDfp_VSSCD1_C DSM_EnvDfp_VSSCD2_C DSM_EnvDfp_VSSCD4_C DSM_EnvDfp_VSSCDBrkLowVltg_C DSM_EnvDfp_VSSCDCAN_C DSM_EnvDfp_VSSCDNpl_C DSM_EnvDfp_VSSCD_C DSM_EnvDfp_WdCom_C DSM_FMKDfp_GearbxCVTnMax_C /end DEF_CHARACTERISTIC
/end FUNCTION
/begin FUNCTION DSM_FMK "Configuration parameter for Fade Out mask"
 /begin DEF_CHARACTERISTIC DSM_FMKDfp_ACCCDBrkErr_C DSM_FMKDfp_ACCCDBrkNPL_C DSM_FMKDfp_ACCCDSensErr_C DSM_FMKDfp_ACCCDWrongCoded_C DSM_FMKDfp_ACCCD_C DSM_FMKDfp_ACCD_C DSM_FMKDfp_ACCD_PAC_C DSM_FMKDfp_ACCD_pCAN_C DSM_FMKDfp_ACCD_trqCAN_C DSM_FMKDfp_ACCIRevPanErr_C DSM_FMKDfp_ACCIRevShOff_C DSM_FMKDfp_ACCnotPlaus_C DSM_FMKDfp_ADCMon_C DSM_FMKDfp_AFSCD_PlOffsDrft_C DSM_FMKDfp_AFSCD_PlSetyDrft_C DSM_FMKDfp_AFSCD_SRCAirm_C DSM_FMKDfp_AFVCD_Actr_C DSM_FMKDfp_AOHtCDHt1_C DSM_FMKDfp_AOHtCDHt2_C DSM_FMKDfp_AOHtCDHt3_C DSM_FMKDfp_APP1_C DSM_FMKDfp_APP2_C DSM_FMKDfp_APPCD_KickDown_C DSM_FMKDfp_APPCD_PWGDrft_C DSM_FMKDfp_APPSync_C DSM_FMKDfp_APP_Npl_C DSM_FMKDfp_APSCD_C DSM_FMKDfp_AccPedPlausBrk_C DSM_FMKDfp_AirCtl_GovDevMax_C DSM_FMKDfp_AirCtl_GovDevMin_C DSM_FMKDfp_AirCtl_GovDevRgnMax_C DSM_FMKDfp_AirCtl_GovDevRgnMin_C DSM_FMKDfp_AirbCDCrashCrCtl_C DSM_FMKDfp_AirbCDCrashPSP_C DSM_FMKDfp_AirbCDCrash_C DSM_FMKDfp_AltCDExc_C DSM_FMKDfp_AltCD_Load_C DSM_FMKDfp_AltPwrCan_C DSM_FMKDfp_BIP01_C DSM_FMKDfp_BIP02_C DSM_FMKDfp_BIP03_C DSM_FMKDfp_BIP04_C DSM_FMKDfp_BIP05_C DSM_FMKDfp_BIP06_C DSM_FMKDfp_BIP07_C DSM_FMKDfp_BIP08_C DSM_FMKDfp_BIP09_C DSM_FMKDfp_BIP10_C DSM_FMKDfp_BIP11_C DSM_FMKDfp_BIP12_C DSM_FMKDfp_BIP_Con_C DSM_FMKDfp_BPACD_Max2_C DSM_FMKDfp_BPACD_Max_C DSM_FMKDfp_BPACD_Min2_C DSM_FMKDfp_BPACD_Min_C DSM_FMKDfp_BPACD_SigNpl2_C DSM_FMKDfp_BPACD_SigNpl_C DSM_FMKDfp_BPASCD_C DSM_FMKDfp_BPSCD_C DSM_FMKDfp_BattCD_C DSM_FMKDfp_BrkCDBPTInvld_C DSM_FMKDfp_BrkCD_C DSM_FMKDfp_BrkCDdynPl_C DSM_FMKDfp_CANA_C DSM_FMKDfp_CANB_C DSM_FMKDfp_CANBus1_C DSM_FMKDfp_CANBus2_C DSM_FMKDfp_CANBus3_C DSM_FMKDfp_CANC_C DSM_FMKDfp_CANErrActA_C DSM_FMKDfp_CANErrActB_C DSM_FMKDfp_CANErrActC_C DSM_FMKDfp_COTSCD_C DSM_FMKDfp_CTSCDCanInac_C DSM_FMKDfp_CTSCDCanSig_C DSM_FMKDfp_CTSCD_C DSM_FMKDfp_Clg_DynTst_C DSM_FMKDfp_CmbChbMisfire1_C DSM_FMKDfp_CmbChbMisfire2_C DSM_FMKDfp_CmbChbMisfire3_C DSM_FMKDfp_CmbChbMisfire4_C DSM_FMKDfp_CmbChbMisfire5_C DSM_FMKDfp_CmbChbMisfire6_C DSM_FMKDfp_CmbChbMisfireMul_C DSM_FMKDfp_CoVMDCSh_C DSM_FMKDfp_CoVMDCSp_C DSM_FMKDfp_CoVehLvl2_C DSM_FMKDfp_ConvCD_C DSM_FMKDfp_ConvCD_ConvErr_C DSM_FMKDfp_ConvCD_EPB1_C DSM_FMKDfp_CrCCDPanErrMSG_C DSM_FMKDfp_CrCCDPanErrSMLS_C DSM_FMKDfp_CrCCDPanMainSwtErr_C DSM_FMKDfp_CrCtlDsplNotPlaus_C DSM_FMKDfp_CrCtlPECDErr_C DSM_FMKDfp_CrCtlPLmpDef_C DSM_FMKDfp_CrCtlPShutOff_C DSM_FMKDfp_CrCtlPTlrDef_C DSM_FMKDfp_CtApCD_C DSM_FMKDfp_CtTCD_C DSM_FMKDfp_CtT_Mon_C DSM_FMKDfp_DifftrqLimErrPat_C DSM_FMKDfp_EATSCDCanInac_C DSM_FMKDfp_EATSCDCanSig_C DSM_FMKDfp_EATSCD_C DSM_FMKDfp_EEPCDVarMng_C DSM_FMKDfp_EGPpCDTPreTrbn_C DSM_FMKDfp_EGRCD_CBV_C DSM_FMKDfp_EGRCD_Max_C DSM_FMKDfp_EGRCD_Min_C DSM_FMKDfp_EGRCD_SigNpl_C DSM_FMKDfp_EGRCD_Sig_C DSM_FMKDfp_EGRSCD_C DSM_FMKDfp_EGRSCD_JamVlv_C DSM_FMKDfp_EGRSCD_LgTimeDrft_C DSM_FMKDfp_EGRSCD_ShTimeDrft_C DSM_FMKDfp_EGRVlvGvnrDvt_C DSM_FMKDfp_EGRVlv_JamVlv_C DSM_FMKDfp_EMCCD_MLS1_C DSM_FMKDfp_EngMBackUp_C DSM_FMKDfp_EngMCaS1_C DSM_FMKDfp_EngMCaSDrv_C DSM_FMKDfp_EngMCrS1_C DSM_FMKDfp_EngMOfsCaSCrS_C DSM_FMKDfp_EngMonIrrCmb_C DSM_FMKDfp_EngPrt_C DSM_FMKDfp_ErLpCDMILReqON_C DSM_FMKDfp_FMAErrMod_C DSM_FMKDfp_FMTC_NonMonotonMap_C DSM_FMKDfp_FQTSCD_C DSM_FMKDfp_FQlSCD_C DSM_FMKDfp_FTSCDNpl_C DSM_FMKDfp_FTSCD_C DSM_FMKDfp_FanCD_Fan1Ctlr1_C DSM_FMKDfp_FanCD_Fan1Ctlr2_C DSM_FMKDfp_FanCD_Fan2Ctlr1_C DSM_FMKDfp_FanCD_Fan2Ctlr2_C DSM_FMKDfp_FanCD_FanCtlr1_C DSM_FMKDfp_FanCD_FanCtlr2_C DSM_FMKDfp_FanCD_OutFanCtlr1_C DSM_FMKDfp_FanCD_OutFanCtlr2_C DSM_FMKDfp_FlPpCD_C DSM_FMKDfp_FlSCDT1_C DSM_FMKDfp_FrmMngAAGNpl_C DSM_FMKDfp_FrmMngAAGTO_C DSM_FMKDfp_FrmMngAC1Npl_C DSM_FMKDfp_FrmMngAC1TO_C DSM_FMKDfp_FrmMngACCNpl_C DSM_FMKDfp_FrmMngACCTO_C DSM_FMKDfp_FrmMngAIRBGNpl_C DSM_FMKDfp_FrmMngAIRBGTO_C DSM_FMKDfp_FrmMngAWD1Npl_C DSM_FMKDfp_FrmMngAWD1TO_C DSM_FMKDfp_FrmMngBEM1Npl_C DSM_FMKDfp_FrmMngBEM1TO_C DSM_FMKDfp_FrmMngBRK1Npl_C DSM_FMKDfp_FrmMngBRK1TO_C DSM_FMKDfp_FrmMngBRK2Npl_C DSM_FMKDfp_FrmMngBRK2TO_C DSM_FMKDfp_FrmMngBRK8Npl_C DSM_FMKDfp_FrmMngBRK8TO_C DSM_FMKDfp_FrmMngBSG3TO_C DSM_FMKDfp_FrmMngCANVerErr_C DSM_FMKDfp_FrmMngCCSel_C DSM_FMKDfp_FrmMngCCTLNpl_C DSM_FMKDfp_FrmMngCCTLTO_C DSM_FMKDfp_FrmMngCHRGR1Npl_C DSM_FMKDfp_FrmMngCHRGR1TO_C DSM_FMKDfp_FrmMngCHRGR2Npl_C DSM_FMKDfp_FrmMngCHRGR2TO_C DSM_FMKDfp_FrmMngChrgr1A_C DSM_FMKDfp_FrmMngChrgr1C_C DSM_FMKDfp_FrmMngChrgr1N_C DSM_FMKDfp_FrmMngChrgr1T_C DSM_FMKDfp_FrmMngChrgr1V_C DSM_FMKDfp_FrmMngChrgr2A_C DSM_FMKDfp_FrmMngChrgr2C_C DSM_FMKDfp_FrmMngChrgr2N_C DSM_FMKDfp_FrmMngChrgr2T_C DSM_FMKDfp_FrmMngChrgr2V_C DSM_FMKDfp_FrmMngDIA1Npl_C DSM_FMKDfp_FrmMngDIA1TO_C DSM_FMKDfp_FrmMngDSP1Npl_C DSM_FMKDfp_FrmMngDSP1TO_C DSM_FMKDfp_FrmMngDSP2Npl_C DSM_FMKDfp_FrmMngDSP2TO_C DSM_FMKDfp_FrmMngDSP3Npl_C DSM_FMKDfp_FrmMngDSP3TO_C DSM_FMKDfp_FrmMngEPB1Npl_C DSM_FMKDfp_FrmMngEPB1TO_C DSM_FMKDfp_FrmMngESCUNpl_C DSM_FMKDfp_FrmMngESCUTO_C DSM_FMKDfp_FrmMngGW1Npl_C DSM_FMKDfp_FrmMngGW1TO_C DSM_FMKDfp_FrmMngILMNpl_C DSM_FMKDfp_FrmMngILMTO_C DSM_FMKDfp_FrmMngLICHT2TO_C DSM_FMKDfp_FrmMngNIV1WrngCod_C DSM_FMKDfp_FrmMngNIVEAU1Npl_C DSM_FMKDfp_FrmMngNIVEAU1TO_C DSM_FMKDfp_FrmMngSA1Npl_C DSM_FMKDfp_FrmMngSA1TO_C DSM_FMKDfp_FrmMngSTIGNNpl_C DSM_FMKDfp_FrmMngStIgnTO_C DSM_FMKDfp_FrmMngTOSNpl_C DSM_FMKDfp_FrmMngTOSTO_C DSM_FMKDfp_FrmMngTSC1Npl_C DSM_FMKDfp_FrmMngTSC1TO_C DSM_FMKDfp_FrmMngTSC2Npl_C DSM_FMKDfp_FrmMngTSC2TO_C DSM_FMKDfp_FrmMngTSC3Npl_C DSM_FMKDfp_FrmMngTSC3TO_C DSM_FMKDfp_FrmMngTSC6Npl_C DSM_FMKDfp_FrmMngTSC6TO_C DSM_FMKDfp_FrmMngTrbnSpdErr_C DSM_FMKDfp_FrmMngWIPERTO_C DSM_FMKDfp_GbSSCD_C DSM_FMKDfp_GbSSCD_HW_C DSM_FMKDfp_GearbxClthPlaus_C DSM_FMKDfp_GearbxINCCup_C DSM_FMKDfp_GearbxNMinMon_C DSM_FMKDfp_GearbxTSC_C DSM_FMKDfp_GearbxTransConv_C DSM_FMKDfp_GearbxTypeMTErr_C DSM_FMKDfp_GlwCDDIAG_C DSM_FMKDfp_GlwCDErr1_C DSM_FMKDfp_GlwCDErr2_C DSM_FMKDfp_GlwCDEvalCod_C DSM_FMKDfp_GlwCDGSK2_C DSM_FMKDfp_GlwCDGSK3_C DSM_FMKDfp_GlwCDLmp_C DSM_FMKDfp_GlwCDPLUG0_C DSM_FMKDfp_GlwCDPLUG1_C DSM_FMKDfp_GlwCDPLUG2_C DSM_FMKDfp_GlwCDPLUG3_C DSM_FMKDfp_GlwCDPLUG4_C DSM_FMKDfp_GlwCDPLUG5_C DSM_FMKDfp_GlwCD_LampCan_C DSM_FMKDfp_GlwCDsfd_C DSM_FMKDfp_HDSCD_C DSM_FMKDfp_HWEMonCom_C DSM_FMKDfp_HWEMonEEPROM_C DSM_FMKDfp_HWEMonRcyLocked_C DSM_FMKDfp_HWEMonRcySuppressed_C DSM_FMKDfp_HWEMonRcyVisible_C DSM_FMKDfp_HWEMonUMaxSupply_C DSM_FMKDfp_HWEMonUMinSupply_C DSM_FMKDfp_IATSCD_C DSM_FMKDfp_IFCD_C DSM_FMKDfp_ImmCtl_C DSM_FMKDfp_IndSysMonIntMnf_C DSM_FMKDfp_InjVlvBnk1A_C DSM_FMKDfp_InjVlvBnk2A_C DSM_FMKDfp_InjVlvCyl10A_C DSM_FMKDfp_InjVlvCyl11A_C DSM_FMKDfp_InjVlvCyl12A_C DSM_FMKDfp_InjVlvCyl1A_C DSM_FMKDfp_InjVlvCyl2A_C DSM_FMKDfp_InjVlvCyl3A_C DSM_FMKDfp_InjVlvCyl4A_C DSM_FMKDfp_InjVlvCyl5A_C DSM_FMKDfp_InjVlvCyl6A_C DSM_FMKDfp_InjVlvCyl7A_C DSM_FMKDfp_InjVlvCyl8A_C DSM_FMKDfp_InjVlvCyl9A_C DSM_FMKDfp_LASCD_C DSM_FMKDfp_LSUCDCircNernst0_C DSM_FMKDfp_LSUCDCircPumpCur0_C DSM_FMKDfp_LSUCDCircVirtGnd0_C DSM_FMKDfp_LSUCDHeater0_C DSM_FMKDfp_LSUCDHtCoup0_C DSM_FMKDfp_LSUCDO20_C DSM_FMKDfp_LSUCDO2Clb0_C DSM_FMKDfp_LSUCDRiClb0_C DSM_FMKDfp_LSUCDSPI0_C DSM_FMKDfp_LSUCDSPIBattLow0_C DSM_FMKDfp_LSUCDWireIP0_C DSM_FMKDfp_LSUCtlRiExc0_C DSM_FMKDfp_LSUMonDyn0_C DSM_FMKDfp_LSUMonFullLd0_C DSM_FMKDfp_LSUMonOvrRun0_C DSM_FMKDfp_LSUMonPartLd0_C DSM_FMKDfp_MIL_C DSM_FMKDfp_MRlyCD_C DSM_FMKDfp_Montr_C DSM_FMKDfp_OTSCDCanInac_C DSM_FMKDfp_OTSCDCanSig_C DSM_FMKDfp_OTSCD_C DSM_FMKDfp_OvRMonCrCtlP_C DSM_FMKDfp_OvRMonSigA_C DSM_FMKDfp_OvRMon_C DSM_FMKDfp_OxiCCDTPre1_C DSM_FMKDfp_OxiCCDTPre_C DSM_FMKDfp_PCR_BalGovDev_C DSM_FMKDfp_PCR_GovDev_C DSM_FMKDfp_PFltAPSens_C DSM_FMKDfp_PFltCDHtg1_C DSM_FMKDfp_PFltCDHtg_C DSM_FMKDfp_PFltCDPDiff_C DSM_FMKDfp_PFltCDTempPre1_C DSM_FMKDfp_PFltCDTempPre_C DSM_FMKDfp_PFltCDTempPst_C DSM_FMKDfp_PFltChar_C DSM_FMKDfp_PFltEngPrt_C DSM_FMKDfp_PFltPresDynPlaus_C DSM_FMKDfp_PFltPresHsChng_C DSM_FMKDfp_PFltPresSensFrz_C DSM_FMKDfp_PFltPresSensHsLn_C DSM_FMKDfp_PFltPresSensSot_C DSM_FMKDfp_PFltPresSens_C DSM_FMKDfp_PFltRgnLckPermTstr_C DSM_FMKDfp_PFltRgnLckPerm_C DSM_FMKDfp_PFltRgnPerm_C DSM_FMKDfp_PFltSotSimPresPerm_C DSM_FMKDfp_PFltTempDwnStrmMax_C DSM_FMKDfp_PFltTempDwnStrmMin_C DSM_FMKDfp_PFltTempDwnStrm_C DSM_FMKDfp_PFltTempPreOxiC_C DSM_FMKDfp_PFltTempPrePFlt_C DSM_FMKDfp_PFltTempPreTrbn_C DSM_FMKDfp_PFltTempPstPFlt_C DSM_FMKDfp_PFltTempSens2_C DSM_FMKDfp_PFltTempSens_C DSM_FMKDfp_PFltTempUpStrmMax_C DSM_FMKDfp_PFltTempUpStrmMin_C DSM_FMKDfp_PFltTempUpStrm_C DSM_FMKDfp_PSPCD_Actr_C DSM_FMKDfp_PrpCtlvLimErrPat_C DSM_FMKDfp_SOPTst_C DSM_FMKDfp_SSpMon1_C DSM_FMKDfp_SSpMon2_C DSM_FMKDfp_SSpMon3_C DSM_FMKDfp_Shtrp_EGRBA_C DSM_FMKDfp_Shtrp_PCRBA_C DSM_FMKDfp_SrvPmpStSAEcu_C DSM_FMKDfp_StSysCtlShCirBatt_C DSM_FMKDfp_StrtCDOffRly_C DSM_FMKDfp_StrtCDOnRly_C DSM_FMKDfp_StrtCtlIlsNotPlaus_C DSM_FMKDfp_StrtCtlT50ROneRly1_C DSM_FMKDfp_StrtCtlT50ROneRly2_C DSM_FMKDfp_StrtCtlT50RZero_C DSM_FMKDfp_SysLamp_C DSM_FMKDfp_T15CD_C DSM_FMKDfp_T50CD_C DSM_FMKDfp_TPUMon_C DSM_FMKDfp_TVACD_Max_C DSM_FMKDfp_TVACD_Min_C DSM_FMKDfp_TVACD_SigNpl_C DSM_FMKDfp_TVACD_Sig_C DSM_FMKDfp_TVACD_stLineDef_C DSM_FMKDfp_TVASCD_C DSM_FMKDfp_TVASCD_Drft_C DSM_FMKDfp_ThrVlvGvnrDvt_C DSM_FMKDfp_ThrVlvJamVlv_C DSM_FMKDfp_UAcc_CodeBitErr_C DSM_FMKDfp_USAp_DataVariant_C DSM_FMKDfp_USAp_FuncCodeRead_C DSM_FMKDfp_VSACD_Max_C DSM_FMKDfp_VSACD_Min_C DSM_FMKDfp_VSACD_SigNpl_C DSM_FMKDfp_VSSCD1_C DSM_FMKDfp_VSSCD2_C DSM_FMKDfp_VSSCD4_C DSM_FMKDfp_VSSCDBrkLowVltg_C DSM_FMKDfp_VSSCDCAN_C DSM_FMKDfp_VSSCDNpl_C DSM_FMKDfp_VSSCD_C DSM_FMKDfp_WdCom_C /end DEF_CHARACTERISTIC
/end FUNCTION
/end MODULE
/end PROJECT
