ASAP2_VERSION 1 3
/begin PROJECT X447 "EDC16U34"
/begin HEADER "" VERSION "VAA1" PROJECT_NO X447 /end HEADER
/begin MODULE DIM ""
/begin MOD_COMMON "" BYTE_ORDER MSB_FIRST ALIGNMENT_BYTE 1 ALIGNMENT_WORD 2 ALIGNMENT_LONG 4 ALIGNMENT_FLOAT32_IEEE 4 /end MOD_COMMON
/begin CHARACTERISTIC DSM_CDCDfp_ACCCD_C "CARB spezifischer Fehlercode fuer Fehlerpfad Dfp_ACCCD" VAL_BLK 0x1CDAAC Kwb_Wu16 65535.00 OneToOne 0.00 65535.00 FORMAT "%8.2" NUMBER 4 /end CHARACTERISTIC
/begin CHARACTERISTIC DSM_CDCDfp_ACCCDBrkErr_C "CARB spezifischer Fehlercode fuer Fehlerpfad Dfp_ACCCDBrkErr" VAL_BLK 0x1CDAB4 Kwb_Wu16 65535.00 OneToOne 0.00 65535.00 FORMAT "%8.2" NUMBER 4 /end CHARACTERISTIC
/begin CHARACTERISTIC DSM_CDCDfp_ACCCDBrkNPL_C "CARB spezifischer Fehlercode fuer Fehlerpfad Dfp_ACCCDBrkNPL" VAL_BLK 0x1CDABC Kwb_Wu16 65535.00 OneToOne 0.00 65535.00 FORMAT "%8.2" NUMBER 4 /end CHARACTERISTIC
/begin CHARACTERISTIC DSM_CDCDfp_ACCCDSensErr_C "CARB spezifischer Fehlercode fuer Fehlerpfad Dfp_ACCCDSensErr" VAL_BLK 0x1CDAC4 Kwb_Wu16 65535.00 OneToOne 0.00 65535.00 FORMAT "%8.2" NUMBER 4 /end CHARACTERISTIC
/begin CHARACTERISTIC DSM_CDCDfp_ACCCDWrongCoded_C "CARB spezifischer Fehlercode fuer Fehlerpfad Dfp_ACCCDWrongCoded" VAL_BLK 0x1CDACC Kwb_Wu16 65535.00 OneToOne 0.00 65535.00 FORMAT "%8.2" NUMBER 4 /end CHARACTERISTIC
/begin CHARACTERISTIC DSM_CDCDfp_ACCD_C "CARB spezifischer Fehlercode fuer Fehlerpfad Dfp_ACCD" VAL_BLK 0x1CDAD4 Kwb_Wu16 65535.00 OneToOne 0.00 65535.00 FORMAT "%8.2" NUMBER 4 /end CHARACTERISTIC
/begin CHARACTERISTIC DSM_CDCDfp_ACCD_PAC_C "CARB spezifischer Fehlercode fuer Fehlerpfad Dfp_ACCD_PAC" VAL_BLK 0x1CDADC Kwb_Wu16 65535.00 OneToOne 0.00 65535.00 FORMAT "%8.2" NUMBER 4 /end CHARACTERISTIC
/begin CHARACTERISTIC DSM_CDCDfp_ACCD_pCAN_C "CARB spezifischer Fehlercode fuer Fehlerpfad Dfp_ACCD_pCAN" VAL_BLK 0x1CDAE4 Kwb_Wu16 65535.00 OneToOne 0.00 65535.00 FORMAT "%8.2" NUMBER 4 /end CHARACTERISTIC
/begin CHARACTERISTIC DSM_CDCDfp_ACCD_trqCAN_C "CARB spezifischer Fehlercode fuer Fehlerpfad Dfp_ACCD_trqCAN" VAL_BLK 0x1CDAEC Kwb_Wu16 65535.00 OneToOne 0.00 65535.00 FORMAT "%8.2" NUMBER 4 /end CHARACTERISTIC
/begin CHARACTERISTIC DSM_CDCDfp_ACCIRevPanErr_C "CARB spezifischer Fehlercode fuer Fehlerpfad Dfp_ACCIRevPanErr" VAL_BLK 0x1CDAF4 Kwb_Wu16 65535.00 OneToOne 0.00 65535.00 FORMAT "%8.2" NUMBER 4 /end CHARACTERISTIC
/begin CHARACTERISTIC DSM_CDCDfp_ACCIRevShOff_C "CARB spezifischer Fehlercode fuer Fehlerpfad Dfp_ACCIRevShOff" VAL_BLK 0x1CDAFC Kwb_Wu16 65535.00 OneToOne 0.00 65535.00 FORMAT "%8.2" NUMBER 4 /end CHARACTERISTIC
/begin CHARACTERISTIC DSM_CDCDfp_ACCnotPlaus_C "CARB spezifischer Fehlercode fuer Fehlerpfad Dfp_ACCnotPlaus" VAL_BLK 0x1CDB04 Kwb_Wu16 65535.00 OneToOne 0.00 65535.00 FORMAT "%8.2" NUMBER 4 /end CHARACTERISTIC
/begin CHARACTERISTIC DSM_CDCDfp_ADCMon_C "CARB spezifischer Fehlercode fuer Fehlerpfad Dfp_ADCMon" VAL_BLK 0x1CDB0C Kwb_Wu16 65535.00 OneToOne 0.00 65535.00 FORMAT "%8.2" NUMBER 4 /end CHARACTERISTIC
/begin CHARACTERISTIC DSM_CDCDfp_AFSCD_PlOffsDrft_C "CARB spezifischer Fehlercode fuer Fehlerpfad Dfp_AFSCD_PlOffsDrft" VAL_BLK 0x1CDB14 Kwb_Wu16 65535.00 OneToOne 0.00 65535.00 FORMAT "%8.2" NUMBER 4 /end CHARACTERISTIC
/begin CHARACTERISTIC DSM_CDCDfp_AFSCD_PlSetyDrft_C "CARB spezifischer Fehlercode fuer Fehlerpfad Dfp_AFSCD_PlSetyDrft" VAL_BLK 0x1CDB1C Kwb_Wu16 65535.00 OneToOne 0.00 65535.00 FORMAT "%8.2" NUMBER 4 /end CHARACTERISTIC
/begin CHARACTERISTIC DSM_CDCDfp_AFSCD_SRCAirm_C "CARB spezifischer Fehlercode fuer Fehlerpfad Dfp_AFSCD_SRCAirm" VAL_BLK 0x1CDB24 Kwb_Wu16 65535.00 OneToOne 0.00 65535.00 FORMAT "%8.2" NUMBER 4 /end CHARACTERISTIC
/begin CHARACTERISTIC DSM_CDCDfp_AFVCD_Actr_C "CARB spezifischer Fehlercode fuer Fehlerpfad Dfp_AFVCD_Actr" VAL_BLK 0x1CDB2C Kwb_Wu16 65535.00 OneToOne 0.00 65535.00 FORMAT "%8.2" NUMBER 4 /end CHARACTERISTIC
/begin CHARACTERISTIC DSM_CDCDfp_AOHtCDHt1_C "CARB spezifischer Fehlercode fuer Fehlerpfad Dfp_AOHtCDHt1" VAL_BLK 0x1CDB34 Kwb_Wu16 65535.00 OneToOne 0.00 65535.00 FORMAT "%8.2" NUMBER 4 /end CHARACTERISTIC
/begin CHARACTERISTIC DSM_CDCDfp_AOHtCDHt2_C "CARB spezifischer Fehlercode fuer Fehlerpfad Dfp_AOHtCDHt2" VAL_BLK 0x1CDB3C Kwb_Wu16 65535.00 OneToOne 0.00 65535.00 FORMAT "%8.2" NUMBER 4 /end CHARACTERISTIC
/begin CHARACTERISTIC DSM_CDCDfp_AOHtCDHt3_C "CARB spezifischer Fehlercode fuer Fehlerpfad Dfp_AOHtCDHt3" VAL_BLK 0x1CDB44 Kwb_Wu16 65535.00 OneToOne 0.00 65535.00 FORMAT "%8.2" NUMBER 4 /end CHARACTERISTIC
/begin CHARACTERISTIC DSM_CDCDfp_APP1_C "CARB spezifischer Fehlercode fuer Fehlerpfad Dfp_APP1" VAL_BLK 0x1CDB4C Kwb_Wu16 65535.00 OneToOne 0.00 65535.00 FORMAT "%8.2" NUMBER 4 /end CHARACTERISTIC
/begin CHARACTERISTIC DSM_CDCDfp_APP2_C "CARB spezifischer Fehlercode fuer Fehlerpfad Dfp_APP2" VAL_BLK 0x1CDB54 Kwb_Wu16 65535.00 OneToOne 0.00 65535.00 FORMAT "%8.2" NUMBER 4 /end CHARACTERISTIC
/begin CHARACTERISTIC DSM_CDCDfp_APPCD_KickDown_C "CARB spezifischer Fehlercode fuer Fehlerpfad Dfp_APPCD_KickDown" VAL_BLK 0x1CDB5C Kwb_Wu16 65535.00 OneToOne 0.00 65535.00 FORMAT "%8.2" NUMBER 4 /end CHARACTERISTIC
/begin CHARACTERISTIC DSM_CDCDfp_APPCD_PWGDrft_C "CARB spezifischer Fehlercode fuer Fehlerpfad Dfp_APPCD_PWGDrft" VAL_BLK 0x1CDB64 Kwb_Wu16 65535.00 OneToOne 0.00 65535.00 FORMAT "%8.2" NUMBER 4 /end CHARACTERISTIC
/begin CHARACTERISTIC DSM_CDCDfp_APPSync_C "CARB spezifischer Fehlercode fuer Fehlerpfad Dfp_APPSync" VAL_BLK 0x1CDB6C Kwb_Wu16 65535.00 OneToOne 0.00 65535.00 FORMAT "%8.2" NUMBER 4 /end CHARACTERISTIC
/begin CHARACTERISTIC DSM_CDCDfp_APP_Npl_C "CARB spezifischer Fehlercode fuer Fehlerpfad Dfp_APP_Npl" VAL_BLK 0x1CDB74 Kwb_Wu16 65535.00 OneToOne 0.00 65535.00 FORMAT "%8.2" NUMBER 4 /end CHARACTERISTIC
/begin CHARACTERISTIC DSM_CDCDfp_APSCD_C "CARB spezifischer Fehlercode fuer Fehlerpfad Dfp_APSCD" VAL_BLK 0x1CDB7C Kwb_Wu16 65535.00 OneToOne 0.00 65535.00 FORMAT "%8.2" NUMBER 4 /end CHARACTERISTIC
/begin CHARACTERISTIC DSM_CDCDfp_AccPedPlausBrk_C "CARB spezifischer Fehlercode fuer Fehlerpfad Dfp_AccPedPlausBrk" VAL_BLK 0x1CDB84 Kwb_Wu16 65535.00 OneToOne 0.00 65535.00 FORMAT "%8.2" NUMBER 4 /end CHARACTERISTIC
/begin CHARACTERISTIC DSM_CDCDfp_AirCtl_GovDevMax_C "CARB spezifischer Fehlercode fuer Fehlerpfad Dfp_AirCtl_GovDevMax" VAL_BLK 0x1CDB8C Kwb_Wu16 65535.00 OneToOne 0.00 65535.00 FORMAT "%8.2" NUMBER 4 /end CHARACTERISTIC
/begin CHARACTERISTIC DSM_CDCDfp_AirCtl_GovDevMin_C "CARB spezifischer Fehlercode fuer Fehlerpfad Dfp_AirCtl_GovDevMin" VAL_BLK 0x1CDB94 Kwb_Wu16 65535.00 OneToOne 0.00 65535.00 FORMAT "%8.2" NUMBER 4 /end CHARACTERISTIC
/begin CHARACTERISTIC DSM_CDCDfp_AirCtl_GovDevRgnMax_C "CARB spezifischer Fehlercode fuer Fehlerpfad Dfp_AirCtl_GovDeRgnMax" VAL_BLK 0x1CDB9C Kwb_Wu16 65535.00 OneToOne 0.00 65535.00 FORMAT "%8.2" NUMBER 4 /end CHARACTERISTIC
/begin CHARACTERISTIC DSM_CDCDfp_AirCtl_GovDevRgnMin_C "CARB spezifischer Fehlercode fuer Fehlerpfad Dfp_AirCtl_GovDevRgnMin" VAL_BLK 0x1CDBA4 Kwb_Wu16 65535.00 OneToOne 0.00 65535.00 FORMAT "%8.2" NUMBER 4 /end CHARACTERISTIC
/begin CHARACTERISTIC DSM_CDCDfp_AirbCDCrash_C "CARB spezifischer Fehlercode fuer Fehlerpfad Dfp_AirbCDCrash" VAL_BLK 0x1CDBAC Kwb_Wu16 65535.00 OneToOne 0.00 65535.00 FORMAT "%8.2" NUMBER 4 /end CHARACTERISTIC
/begin CHARACTERISTIC DSM_CDCDfp_AirbCDCrashCrCtl_C "CARB spezifischer Fehlercode fuer Fehlerpfad Dfp_AirbCDCrashCrCtl" VAL_BLK 0x1CDBB4 Kwb_Wu16 65535.00 OneToOne 0.00 65535.00 FORMAT "%8.2" NUMBER 4 /end CHARACTERISTIC
/begin CHARACTERISTIC DSM_CDCDfp_AirbCDCrashPSP_C "CARB spezifischer Fehlercode fuer Fehlerpfad Dfp_AirbCDCrashPSP" VAL_BLK 0x1CDBBC Kwb_Wu16 65535.00 OneToOne 0.00 65535.00 FORMAT "%8.2" NUMBER 4 /end CHARACTERISTIC
/begin CHARACTERISTIC DSM_CDCDfp_AltCDExc_C "CARB spezifischer Fehlercode fuer Fehlerpfad Dfp_AltCDExc" VAL_BLK 0x1CDBC4 Kwb_Wu16 65535.00 OneToOne 0.00 65535.00 FORMAT "%8.2" NUMBER 4 /end CHARACTERISTIC
/begin CHARACTERISTIC DSM_CDCDfp_AltCD_Load_C "CARB spezifischer Fehlercode fuer Fehlerpfad Dfp_AltCD_Load" VAL_BLK 0x1CDBCC Kwb_Wu16 65535.00 OneToOne 0.00 65535.00 FORMAT "%8.2" NUMBER 4 /end CHARACTERISTIC
/begin CHARACTERISTIC DSM_CDCDfp_AltPwrCan_C "CARB spezifischer Fehlercode fuer Fehlerpfad Dfp_AltPwrCan" VAL_BLK 0x1CDBD4 Kwb_Wu16 65535.00 OneToOne 0.00 65535.00 FORMAT "%8.2" NUMBER 4 /end CHARACTERISTIC
/begin CHARACTERISTIC DSM_CDCDfp_BIP01_C "CARB spezifischer Fehlercode fuer Fehlerpfad Dfp_BIP01" VAL_BLK 0x1CDBDC Kwb_Wu16 65535.00 OneToOne 0.00 65535.00 FORMAT "%8.2" NUMBER 4 /end CHARACTERISTIC
/begin CHARACTERISTIC DSM_CDCDfp_BIP02_C "CARB spezifischer Fehlercode fuer Fehlerpfad Dfp_BIP02" VAL_BLK 0x1CDBE4 Kwb_Wu16 65535.00 OneToOne 0.00 65535.00 FORMAT "%8.2" NUMBER 4 /end CHARACTERISTIC
/begin CHARACTERISTIC DSM_CDCDfp_BIP03_C "CARB spezifischer Fehlercode fuer Fehlerpfad Dfp_BIP03" VAL_BLK 0x1CDBEC Kwb_Wu16 65535.00 OneToOne 0.00 65535.00 FORMAT "%8.2" NUMBER 4 /end CHARACTERISTIC
/begin CHARACTERISTIC DSM_CDCDfp_BIP04_C "CARB spezifischer Fehlercode fuer Fehlerpfad Dfp_BIP04" VAL_BLK 0x1CDBF4 Kwb_Wu16 65535.00 OneToOne 0.00 65535.00 FORMAT "%8.2" NUMBER 4 /end CHARACTERISTIC
/begin CHARACTERISTIC DSM_CDCDfp_BIP05_C "CARB spezifischer Fehlercode fuer Fehlerpfad Dfp_BIP05" VAL_BLK 0x1CDBFC Kwb_Wu16 65535.00 OneToOne 0.00 65535.00 FORMAT "%8.2" NUMBER 4 /end CHARACTERISTIC
/begin CHARACTERISTIC DSM_CDCDfp_BIP06_C "CARB spezifischer Fehlercode fuer Fehlerpfad Dfp_BIP06" VAL_BLK 0x1CDC04 Kwb_Wu16 65535.00 OneToOne 0.00 65535.00 FORMAT "%8.2" NUMBER 4 /end CHARACTERISTIC
/begin CHARACTERISTIC DSM_CDCDfp_BIP07_C "CARB spezifischer Fehlercode fuer Fehlerpfad Dfp_BIP07" VAL_BLK 0x1CDC0C Kwb_Wu16 65535.00 OneToOne 0.00 65535.00 FORMAT "%8.2" NUMBER 4 /end CHARACTERISTIC
/begin CHARACTERISTIC DSM_CDCDfp_BIP08_C "CARB spezifischer Fehlercode fuer Fehlerpfad Dfp_BIP08" VAL_BLK 0x1CDC14 Kwb_Wu16 65535.00 OneToOne 0.00 65535.00 FORMAT "%8.2" NUMBER 4 /end CHARACTERISTIC
/begin CHARACTERISTIC DSM_CDCDfp_BIP09_C "CARB spezifischer Fehlercode fuer Fehlerpfad Dfp_BIP09" VAL_BLK 0x1CDC1C Kwb_Wu16 65535.00 OneToOne 0.00 65535.00 FORMAT "%8.2" NUMBER 4 /end CHARACTERISTIC
/begin CHARACTERISTIC DSM_CDCDfp_BIP10_C "CARB spezifischer Fehlercode fuer Fehlerpfad Dfp_BIP10" VAL_BLK 0x1CDC24 Kwb_Wu16 65535.00 OneToOne 0.00 65535.00 FORMAT "%8.2" NUMBER 4 /end CHARACTERISTIC
/begin CHARACTERISTIC DSM_CDCDfp_BIP11_C "CARB spezifischer Fehlercode fuer Fehlerpfad Dfp_BIP11" VAL_BLK 0x1CDC2C Kwb_Wu16 65535.00 OneToOne 0.00 65535.00 FORMAT "%8.2" NUMBER 4 /end CHARACTERISTIC
/begin CHARACTERISTIC DSM_CDCDfp_BIP12_C "CARB spezifischer Fehlercode fuer Fehlerpfad Dfp_BIP12" VAL_BLK 0x1CDC34 Kwb_Wu16 65535.00 OneToOne 0.00 65535.00 FORMAT "%8.2" NUMBER 4 /end CHARACTERISTIC
/begin CHARACTERISTIC DSM_CDCDfp_BIP_Con_C "CARB spezifischer Fehlercode fuer Fehlerpfad Dfp_BIP_Con" VAL_BLK 0x1CDC3C Kwb_Wu16 65535.00 OneToOne 0.00 65535.00 FORMAT "%8.2" NUMBER 4 /end CHARACTERISTIC
/begin CHARACTERISTIC DSM_CDCDfp_BPACD_Max_C "CARB spezifischer Fehlercode fuer Fehlerpfad Dfp_BPACD_Max" VAL_BLK 0x1CDC44 Kwb_Wu16 65535.00 OneToOne 0.00 65535.00 FORMAT "%8.2" NUMBER 4 /end CHARACTERISTIC
/begin CHARACTERISTIC DSM_CDCDfp_BPACD_Max2_C "CARB spezifischer Fehlercode fuer Fehlerpfad Dfp_BPACD_Max2" VAL_BLK 0x1CDC4C Kwb_Wu16 65535.00 OneToOne 0.00 65535.00 FORMAT "%8.2" NUMBER 4 /end CHARACTERISTIC
/begin CHARACTERISTIC DSM_CDCDfp_BPACD_Min_C "CARB spezifischer Fehlercode fuer Fehlerpfad Dfp_BPACD_Min" VAL_BLK 0x1CDC54 Kwb_Wu16 65535.00 OneToOne 0.00 65535.00 FORMAT "%8.2" NUMBER 4 /end CHARACTERISTIC
/begin CHARACTERISTIC DSM_CDCDfp_BPACD_Min2_C "CARB spezifischer Fehlercode fuer Fehlerpfad Dfp_BPACD_Min2" VAL_BLK 0x1CDC5C Kwb_Wu16 65535.00 OneToOne 0.00 65535.00 FORMAT "%8.2" NUMBER 4 /end CHARACTERISTIC
/begin CHARACTERISTIC DSM_CDCDfp_BPACD_SigNpl_C "CARB spezifischer Fehlercode fuer Fehlerpfad Dfp_BPACD_SigNpl" VAL_BLK 0x1CDC64 Kwb_Wu16 65535.00 OneToOne 0.00 65535.00 FORMAT "%8.2" NUMBER 4 /end CHARACTERISTIC
/begin CHARACTERISTIC DSM_CDCDfp_BPACD_SigNpl2_C "CARB spezifischer Fehlercode fuer Fehlerpfad Dfp_BPACD_SigNpl2" VAL_BLK 0x1CDC6C Kwb_Wu16 65535.00 OneToOne 0.00 65535.00 FORMAT "%8.2" NUMBER 4 /end CHARACTERISTIC
/begin CHARACTERISTIC DSM_CDCDfp_BPASCD_C "CARB spezifischer Fehlercode fuer Fehlerpfad Dfp_BPASCD" VAL_BLK 0x1CDC74 Kwb_Wu16 65535.00 OneToOne 0.00 65535.00 FORMAT "%8.2" NUMBER 4 /end CHARACTERISTIC
/begin CHARACTERISTIC DSM_CDCDfp_BPSCD_C "CARB spezifischer Fehlercode fuer Fehlerpfad Dfp_BPSCD" VAL_BLK 0x1CDC7C Kwb_Wu16 65535.00 OneToOne 0.00 65535.00 FORMAT "%8.2" NUMBER 4 /end CHARACTERISTIC
/begin CHARACTERISTIC DSM_CDCDfp_BattCD_C "CARB spezifischer Fehlercode fuer Fehlerpfad Dfp_BattCD" VAL_BLK 0x1CDC8C Kwb_Wu16 65535.00 OneToOne 0.00 65535.00 FORMAT "%8.2" NUMBER 4 /end CHARACTERISTIC
/begin CHARACTERISTIC DSM_CDCDfp_BrkCD_C "CARB spezifischer Fehlercode fuer Fehlerpfad Dfp_BrkCD" VAL_BLK 0x1CDC94 Kwb_Wu16 65535.00 OneToOne 0.00 65535.00 FORMAT "%8.2" NUMBER 4 /end CHARACTERISTIC
/begin CHARACTERISTIC DSM_CDCDfp_BrkCDBPTInvld_C "CARB spezifischer Fehlercode fuer Fehlerpfad Dfp_BrkCDBPTInvld" VAL_BLK 0x1CDC9C Kwb_Wu16 65535.00 OneToOne 0.00 65535.00 FORMAT "%8.2" NUMBER 4 /end CHARACTERISTIC
/begin CHARACTERISTIC DSM_CDCDfp_BrkCDdynPl_C "CARB spezifischer Fehlercode fuer Fehlerpfad Dfp_BrkCDdynPl" VAL_BLK 0x1CDCA4 Kwb_Wu16 65535.00 OneToOne 0.00 65535.00 FORMAT "%8.2" NUMBER 4 /end CHARACTERISTIC
/begin CHARACTERISTIC DSM_CDCDfp_CANA_C "CARB spezifischer Fehlercode fuer Fehlerpfad Dfp_CANA" VAL_BLK 0x1CDCAC Kwb_Wu16 65535.00 OneToOne 0.00 65535.00 FORMAT "%8.2" NUMBER 4 /end CHARACTERISTIC
/begin CHARACTERISTIC DSM_CDCDfp_CANB_C "CARB spezifischer Fehlercode fuer Fehlerpfad Dfp_CANB" VAL_BLK 0x1CDCB4 Kwb_Wu16 65535.00 OneToOne 0.00 65535.00 FORMAT "%8.2" NUMBER 4 /end CHARACTERISTIC
/begin CHARACTERISTIC DSM_CDCDfp_CANBus1_C "CARB spezifischer Fehlercode fuer Fehlerpfad Dfp_CANBus1" VAL_BLK 0x1CDCBC Kwb_Wu16 65535.00 OneToOne 0.00 65535.00 FORMAT "%8.2" NUMBER 4 /end CHARACTERISTIC
/begin CHARACTERISTIC DSM_CDCDfp_CANBus2_C "CARB spezifischer Fehlercode fuer Fehlerpfad Dfp_CANBus2" VAL_BLK 0x1CDCC4 Kwb_Wu16 65535.00 OneToOne 0.00 65535.00 FORMAT "%8.2" NUMBER 4 /end CHARACTERISTIC
/begin CHARACTERISTIC DSM_CDCDfp_CANBus3_C "CARB spezifischer Fehlercode fuer Fehlerpfad Dfp_CANBus3" VAL_BLK 0x1CDCCC Kwb_Wu16 65535.00 OneToOne 0.00 65535.00 FORMAT "%8.2" NUMBER 4 /end CHARACTERISTIC
/begin CHARACTERISTIC DSM_CDCDfp_CANC_C "CARB spezifischer Fehlercode fuer Fehlerpfad Dfp_CANC" VAL_BLK 0x1CDCD4 Kwb_Wu16 65535.00 OneToOne 0.00 65535.00 FORMAT "%8.2" NUMBER 4 /end CHARACTERISTIC
/begin CHARACTERISTIC DSM_CDCDfp_CANErrActA_C "CARB spezifischer Fehlercode fuer Fehlerpfad Dfp_CANErrActA" VAL_BLK 0x1CDCDC Kwb_Wu16 65535.00 OneToOne 0.00 65535.00 FORMAT "%8.2" NUMBER 4 /end CHARACTERISTIC
/begin CHARACTERISTIC DSM_CDCDfp_CANErrActB_C "CARB spezifischer Fehlercode fuer Fehlerpfad Dfp_CANErrActB" VAL_BLK 0x1CDCE4 Kwb_Wu16 65535.00 OneToOne 0.00 65535.00 FORMAT "%8.2" NUMBER 4 /end CHARACTERISTIC
/begin CHARACTERISTIC DSM_CDCDfp_CANErrActC_C "CARB spezifischer Fehlercode fuer Fehlerpfad Dfp_CANErrActC" VAL_BLK 0x1CDCEC Kwb_Wu16 65535.00 OneToOne 0.00 65535.00 FORMAT "%8.2" NUMBER 4 /end CHARACTERISTIC
/begin CHARACTERISTIC DSM_CDCDfp_COTSCD_C "CARB spezifischer Fehlercode fuer Fehlerpfad Dfp_COTSCD" VAL_BLK 0x1CDCF4 Kwb_Wu16 65535.00 OneToOne 0.00 65535.00 FORMAT "%8.2" NUMBER 4 /end CHARACTERISTIC
/begin CHARACTERISTIC DSM_CDCDfp_CTSCD_C "CARB spezifischer Fehlercode fuer Fehlerpfad Dfp_CTSCD" VAL_BLK 0x1CDCFC Kwb_Wu16 65535.00 OneToOne 0.00 65535.00 FORMAT "%8.2" NUMBER 4 /end CHARACTERISTIC
/begin CHARACTERISTIC DSM_CDCDfp_CTSCDCanInac_C "CARB spezifischer Fehlercode fuer Fehlerpfad Dfp_CTSCDCanInac" VAL_BLK 0x1CDD04 Kwb_Wu16 65535.00 OneToOne 0.00 65535.00 FORMAT "%8.2" NUMBER 4 /end CHARACTERISTIC
/begin CHARACTERISTIC DSM_CDCDfp_CTSCDCanSig_C "CARB spezifischer Fehlercode fuer Fehlerpfad Dfp_CTSCDCanSig" VAL_BLK 0x1CDD0C Kwb_Wu16 65535.00 OneToOne 0.00 65535.00 FORMAT "%8.2" NUMBER 4 /end CHARACTERISTIC
/begin CHARACTERISTIC DSM_CDCDfp_Clg_DynTst_C "CARB spezifischer Fehlercode fuer Fehlerpfad Dfp_Clg_DynTst" VAL_BLK 0x1CDD14 Kwb_Wu16 65535.00 OneToOne 0.00 65535.00 FORMAT "%8.2" NUMBER 4 /end CHARACTERISTIC
/begin CHARACTERISTIC DSM_CDCDfp_CmbChbMisfire1_C "CARB spezifischer Fehlercode fuer Fehlerpfad Dfp_CmbChbMisfire1" VAL_BLK 0x1CDD1C Kwb_Wu16 65535.00 OneToOne 0.00 65535.00 FORMAT "%8.2" NUMBER 4 /end CHARACTERISTIC
/begin CHARACTERISTIC DSM_CDCDfp_CmbChbMisfire2_C "CARB spezifischer Fehlercode fuer Fehlerpfad Dfp_CmbChbMisfire2" VAL_BLK 0x1CDD24 Kwb_Wu16 65535.00 OneToOne 0.00 65535.00 FORMAT "%8.2" NUMBER 4 /end CHARACTERISTIC
/begin CHARACTERISTIC DSM_CDCDfp_CmbChbMisfire3_C "CARB spezifischer Fehlercode fuer Fehlerpfad Dfp_CmbChbMisfire3" VAL_BLK 0x1CDD2C Kwb_Wu16 65535.00 OneToOne 0.00 65535.00 FORMAT "%8.2" NUMBER 4 /end CHARACTERISTIC
/begin CHARACTERISTIC DSM_CDCDfp_CmbChbMisfire4_C "CARB spezifischer Fehlercode fuer Fehlerpfad Dfp_CmbChbMisfire4" VAL_BLK 0x1CDD34 Kwb_Wu16 65535.00 OneToOne 0.00 65535.00 FORMAT "%8.2" NUMBER 4 /end CHARACTERISTIC
/begin CHARACTERISTIC DSM_CDCDfp_CmbChbMisfire5_C "CARB spezifischer Fehlercode fuer Fehlerpfad Dfp_CmbChbMisfire5" VAL_BLK 0x1CDD3C Kwb_Wu16 65535.00 OneToOne 0.00 65535.00 FORMAT "%8.2" NUMBER 4 /end CHARACTERISTIC
/begin CHARACTERISTIC DSM_CDCDfp_CmbChbMisfire6_C "CARB spezifischer Fehlercode fuer Fehlerpfad Dfp_CmbChbMisfire6" VAL_BLK 0x1CDD44 Kwb_Wu16 65535.00 OneToOne 0.00 65535.00 FORMAT "%8.2" NUMBER 4 /end CHARACTERISTIC
/begin CHARACTERISTIC DSM_CDCDfp_CmbChbMisfireMul_C "CARB spezifischer Fehlercode fuer Fehlerpfad Dfp_CmbChbMisfireMul" VAL_BLK 0x1CDD4C Kwb_Wu16 65535.00 OneToOne 0.00 65535.00 FORMAT "%8.2" NUMBER 4 /end CHARACTERISTIC
/begin CHARACTERISTIC DSM_CDCDfp_CoVMDCSh_C "CARB spezifischer Fehlercode fuer Fehlerpfad Dfp_CoVMDCSh" VAL_BLK 0x1CDD5C Kwb_Wu16 65535.00 OneToOne 0.00 65535.00 FORMAT "%8.2" NUMBER 4 /end CHARACTERISTIC
/begin CHARACTERISTIC DSM_CDCDfp_CoVMDCSp_C "CARB spezifischer Fehlercode fuer Fehlerpfad Dfp_CoVMDCSp" VAL_BLK 0x1CDD64 Kwb_Wu16 65535.00 OneToOne 0.00 65535.00 FORMAT "%8.2" NUMBER 4 /end CHARACTERISTIC
/begin CHARACTERISTIC DSM_CDCDfp_CoVehLvl2_C "CARB spezifischer Fehlercode fuer Fehlerpfad Dfp_CoVehLvl2" VAL_BLK 0x1CDD7C Kwb_Wu16 65535.00 OneToOne 0.00 65535.00 FORMAT "%8.2" NUMBER 4 /end CHARACTERISTIC
/begin CHARACTERISTIC DSM_CDCDfp_ConvCD_C "CARB spezifischer Fehlercode fuer Fehlerpfad Dfp_ConvCD" VAL_BLK 0x1CDD84 Kwb_Wu16 65535.00 OneToOne 0.00 65535.00 FORMAT "%8.2" NUMBER 4 /end CHARACTERISTIC
/begin CHARACTERISTIC DSM_CDCDfp_ConvCD_ConvErr_C "CARB spezifischer Fehlercode fuer Fehlerpfad Dfp_ConvCD_ConvErr" VAL_BLK 0x1CDD8C Kwb_Wu16 65535.00 OneToOne 0.00 65535.00 FORMAT "%8.2" NUMBER 4 /end CHARACTERISTIC
/begin CHARACTERISTIC DSM_CDCDfp_ConvCD_EPB1_C "CARB spezifischer Fehlercode fuer Fehlerpfad Dfp_ConvCD_EPB1" VAL_BLK 0x1CDD94 Kwb_Wu16 65535.00 OneToOne 0.00 65535.00 FORMAT "%8.2" NUMBER 4 /end CHARACTERISTIC
/begin CHARACTERISTIC DSM_CDCDfp_CrCCDPanErrMSG_C "CARB spezifischer Fehlercode fuer Fehlerpfad Dfp_CrCCDPanErrMSG" VAL_BLK 0x1CDD9C Kwb_Wu16 65535.00 OneToOne 0.00 65535.00 FORMAT "%8.2" NUMBER 4 /end CHARACTERISTIC
/begin CHARACTERISTIC DSM_CDCDfp_CrCCDPanErrSMLS_C "CARB spezifischer Fehlercode fuer Fehlerpfad Dfp_CrCCDPanErrSMLS" VAL_BLK 0x1CDDA4 Kwb_Wu16 65535.00 OneToOne 0.00 65535.00 FORMAT "%8.2" NUMBER 4 /end CHARACTERISTIC
/begin CHARACTERISTIC DSM_CDCDfp_CrCCDPanMainSwtErr_C "CARB spezifischer Fehlercode fuer Fehlerpfad Dfp_CrCCDPanMainSwtErr" VAL_BLK 0x1CDDAC Kwb_Wu16 65535.00 OneToOne 0.00 65535.00 FORMAT "%8.2" NUMBER 4 /end CHARACTERISTIC
/begin CHARACTERISTIC DSM_CDCDfp_CrCtlDsplNotPlaus_C "CARB spezifischer Fehlercode fuer Fehlerpfad Dfp_CrCtlDsplNotPlaus" VAL_BLK 0x1CDDBC Kwb_Wu16 65535.00 OneToOne 0.00 65535.00 FORMAT "%8.2" NUMBER 4 /end CHARACTERISTIC
/begin CHARACTERISTIC DSM_CDCDfp_CrCtlPECDErr_C "CARB spezifischer Fehlercode fuer Fehlerpfad Dfp_CrCtlPECDErr" VAL_BLK 0x1CDDC4 Kwb_Wu16 65535.00 OneToOne 0.00 65535.00 FORMAT "%8.2" NUMBER 4 /end CHARACTERISTIC
/begin CHARACTERISTIC DSM_CDCDfp_CrCtlPLmpDef_C "CARB spezifischer Fehlercode fuer Fehlerpfad Dfp_CrCtlPLmpDef" VAL_BLK 0x1CDDCC Kwb_Wu16 65535.00 OneToOne 0.00 65535.00 FORMAT "%8.2" NUMBER 4 /end CHARACTERISTIC
/begin CHARACTERISTIC DSM_CDCDfp_CrCtlPShutOff_C "CARB spezifischer Fehlercode fuer Fehlerpfad Dfp_CrCtlPShutOff" VAL_BLK 0x1CDDD4 Kwb_Wu16 65535.00 OneToOne 0.00 65535.00 FORMAT "%8.2" NUMBER 4 /end CHARACTERISTIC
/begin CHARACTERISTIC DSM_CDCDfp_CrCtlPTlrDef_C "CARB spezifischer Fehlercode fuer Fehlerpfad Dfp_CrCtlPTlrDef" VAL_BLK 0x1CDDDC Kwb_Wu16 65535.00 OneToOne 0.00 65535.00 FORMAT "%8.2" NUMBER 4 /end CHARACTERISTIC
/begin CHARACTERISTIC DSM_CDCDfp_CtApCD_C "CARB spezifischer Fehlercode fuer Fehlerpfad Dfp_CtApCD" VAL_BLK 0x1CDDEC Kwb_Wu16 65535.00 OneToOne 0.00 65535.00 FORMAT "%8.2" NUMBER 4 /end CHARACTERISTIC
/begin CHARACTERISTIC DSM_CDCDfp_CtTCD_C "CARB spezifischer Fehlercode fuer Fehlerpfad Dfp_CtTCD" VAL_BLK 0x1CDDF4 Kwb_Wu16 65535.00 OneToOne 0.00 65535.00 FORMAT "%8.2" NUMBER 4 /end CHARACTERISTIC
/begin CHARACTERISTIC DSM_CDCDfp_CtT_Mon_C "CARB spezifischer Fehlercode fuer Fehlerpfad Dfp_CtT_Mon" VAL_BLK 0x1CDDFC Kwb_Wu16 65535.00 OneToOne 0.00 65535.00 FORMAT "%8.2" NUMBER 4 /end CHARACTERISTIC
/begin CHARACTERISTIC DSM_CDCDfp_DifftrqLimErrPat_C "CARB spezifischer Fehlercode fuer Fehlerpfad Dfp_DifftrqLimErrPat" VAL_BLK 0x1CDE04 Kwb_Wu16 65535.00 OneToOne 0.00 65535.00 FORMAT "%8.2" NUMBER 4 /end CHARACTERISTIC
/begin CHARACTERISTIC DSM_CDCDfp_EATSCD_C "CARB spezifischer Fehlercode fuer Fehlerpfad Dfp_EATSCD" VAL_BLK 0x1CDE0C Kwb_Wu16 65535.00 OneToOne 0.00 65535.00 FORMAT "%8.2" NUMBER 4 /end CHARACTERISTIC
/begin CHARACTERISTIC DSM_CDCDfp_EATSCDCanInac_C "CARB spezifischer Fehlercode fuer Fehlerpfad Dfp_EATSCDCanInac" VAL_BLK 0x1CDE14 Kwb_Wu16 65535.00 OneToOne 0.00 65535.00 FORMAT "%8.2" NUMBER 4 /end CHARACTERISTIC
/begin CHARACTERISTIC DSM_CDCDfp_EATSCDCanSig_C "CARB spezifischer Fehlercode fuer Fehlerpfad Dfp_EATSCDCanSig" VAL_BLK 0x1CDE1C Kwb_Wu16 65535.00 OneToOne 0.00 65535.00 FORMAT "%8.2" NUMBER 4 /end CHARACTERISTIC
/begin CHARACTERISTIC DSM_CDCDfp_EEPCDVarMng_C "CARB spezifischer Fehlercode fuer Fehlerpfad Dfp_EEPCDVarMng" VAL_BLK 0x1CDE24 Kwb_Wu16 65535.00 OneToOne 0.00 65535.00 FORMAT "%8.2" NUMBER 4 /end CHARACTERISTIC
/begin CHARACTERISTIC DSM_CDCDfp_EGPpCDTPreTrbn_C "CARB spezifischer Fehlercode fuer Fehlerpfad Dfp_EgPpCDTPreTrbn" VAL_BLK 0x1CDE2C Kwb_Wu16 65535.00 OneToOne 0.00 65535.00 FORMAT "%8.2" NUMBER 4 /end CHARACTERISTIC
/begin CHARACTERISTIC DSM_CDCDfp_EGRCD_CBV_C "CARB spezifischer Fehlercode fuer Fehlerpfad Dfp_EGRCD_CBV" VAL_BLK 0x1CDE34 Kwb_Wu16 65535.00 OneToOne 0.00 65535.00 FORMAT "%8.2" NUMBER 4 /end CHARACTERISTIC
/begin CHARACTERISTIC DSM_CDCDfp_EGRCD_Max_C "CARB spezifischer Fehlercode fuer Fehlerpfad Dfp_EGRCD_Max" VAL_BLK 0x1CDE3C Kwb_Wu16 65535.00 OneToOne 0.00 65535.00 FORMAT "%8.2" NUMBER 4 /end CHARACTERISTIC
/begin CHARACTERISTIC DSM_CDCDfp_EGRCD_Min_C "CARB spezifischer Fehlercode fuer Fehlerpfad Dfp_EGRCD_Min" VAL_BLK 0x1CDE44 Kwb_Wu16 65535.00 OneToOne 0.00 65535.00 FORMAT "%8.2" NUMBER 4 /end CHARACTERISTIC
/begin CHARACTERISTIC DSM_CDCDfp_EGRCD_Sig_C "CARB spezifischer Fehlercode fuer Fehlerpfad Dfp_EGRCD_Sig" VAL_BLK 0x1CDE4C Kwb_Wu16 65535.00 OneToOne 0.00 65535.00 FORMAT "%8.2" NUMBER 4 /end CHARACTERISTIC
/begin CHARACTERISTIC DSM_CDCDfp_EGRCD_SigNpl_C "CARB spezifischer Fehlercode fuer Fehlerpfad Dfp_EGRCD_SigNpl" VAL_BLK 0x1CDE54 Kwb_Wu16 65535.00 OneToOne 0.00 65535.00 FORMAT "%8.2" NUMBER 4 /end CHARACTERISTIC
/begin CHARACTERISTIC DSM_CDCDfp_EGRSCD_C "CARB spezifischer Fehlercode fuer Fehlerpfad Dfp_EGRSCD" VAL_BLK 0x1CDE5C Kwb_Wu16 65535.00 OneToOne 0.00 65535.00 FORMAT "%8.2" NUMBER 4 /end CHARACTERISTIC
/begin CHARACTERISTIC DSM_CDCDfp_EGRSCD_JamVlv_C "CARB spezifischer Fehlercode fuer Fehlerpfad Dfp_EGRSCD_JamVlv" VAL_BLK 0x1CDE64 Kwb_Wu16 65535.00 OneToOne 0.00 65535.00 FORMAT "%8.2" NUMBER 4 /end CHARACTERISTIC
/begin CHARACTERISTIC DSM_CDCDfp_EGRSCD_LgTimeDrft_C "CARB spezifischer Fehlercode fuer Fehlerpfad Dfp_EGRSCD_LgTimeDrft" VAL_BLK 0x1CDE6C Kwb_Wu16 65535.00 OneToOne 0.00 65535.00 FORMAT "%8.2" NUMBER 4 /end CHARACTERISTIC
/begin CHARACTERISTIC DSM_CDCDfp_EGRSCD_ShTimeDrft_C "CARB spezifischer Fehlercode fuer Fehlerpfad Dfp_EGRSCD_ShTimeDrft" VAL_BLK 0x1CDE74 Kwb_Wu16 65535.00 OneToOne 0.00 65535.00 FORMAT "%8.2" NUMBER 4 /end CHARACTERISTIC
/begin CHARACTERISTIC DSM_CDCDfp_EGRVlvGvnrDvt_C "CARB spezifischer Fehlercode fuer Fehlerpfad Dfp_EGRVlvGvnrDvt" VAL_BLK 0x1CDE7C Kwb_Wu16 65535.00 OneToOne 0.00 65535.00 FORMAT "%8.2" NUMBER 4 /end CHARACTERISTIC
/begin CHARACTERISTIC DSM_CDCDfp_EGRVlv_JamVlv_C "CARB spezifischer Fehlercode fuer Fehlerpfad Dfp_EGRVlv_JamVlv" VAL_BLK 0x1CDE84 Kwb_Wu16 65535.00 OneToOne 0.00 65535.00 FORMAT "%8.2" NUMBER 4 /end CHARACTERISTIC
/begin CHARACTERISTIC DSM_CDCDfp_EMCCD_MLS1_C "CARB spezifischer Fehlercode fuer Fehlerpfad Dfp_EMCCD_MLS1" VAL_BLK 0x1CDE8C Kwb_Wu16 65535.00 OneToOne 0.00 65535.00 FORMAT "%8.2" NUMBER 4 /end CHARACTERISTIC
/begin CHARACTERISTIC DSM_CDCDfp_EngMBackUp_C "CARB spezifischer Fehlercode fuer Fehlerpfad Dfp_EngMBackUp" VAL_BLK 0x1CDE94 Kwb_Wu16 65535.00 OneToOne 0.00 65535.00 FORMAT "%8.2" NUMBER 4 /end CHARACTERISTIC
/begin CHARACTERISTIC DSM_CDCDfp_EngMCaS1_C "CARB spezifischer Fehlercode fuer Fehlerpfad Dfp_EngMCaS1" VAL_BLK 0x1CDE9C Kwb_Wu16 65535.00 OneToOne 0.00 65535.00 FORMAT "%8.2" NUMBER 4 /end CHARACTERISTIC
/begin CHARACTERISTIC DSM_CDCDfp_EngMCaSDrv_C "CARB spezifischer Fehlercode fuer Fehlerpfad Dfp_EngMCaSDrv" VAL_BLK 0x1CDEA4 Kwb_Wu16 65535.00 OneToOne 0.00 65535.00 FORMAT "%8.2" NUMBER 4 /end CHARACTERISTIC
/begin CHARACTERISTIC DSM_CDCDfp_EngMCrS1_C "CARB spezifischer Fehlercode fuer Fehlerpfad Dfp_EngMCrS1" VAL_BLK 0x1CDEAC Kwb_Wu16 65535.00 OneToOne 0.00 65535.00 FORMAT "%8.2" NUMBER 4 /end CHARACTERISTIC
/begin CHARACTERISTIC DSM_CDCDfp_EngMOfsCaSCrS_C "CARB spezifischer Fehlercode fuer Fehlerpfad Dfp_EngMOfsCaSCrS" VAL_BLK 0x1CDEB4 Kwb_Wu16 65535.00 OneToOne 0.00 65535.00 FORMAT "%8.2" NUMBER 4 /end CHARACTERISTIC
/begin CHARACTERISTIC DSM_CDCDfp_EngMonIrrCmb_C "CARB spezifischer Fehlercode fuer Fehlerpfad Dfp_EngMonIrrCmb" VAL_BLK 0x1CDEBC Kwb_Wu16 65535.00 OneToOne 0.00 65535.00 FORMAT "%8.2" NUMBER 4 /end CHARACTERISTIC
/begin CHARACTERISTIC DSM_CDCDfp_EngPrt_C "CARB spezifischer Fehlercode fuer Fehlerpfad Dfp_EngPrt" VAL_BLK 0x1CDEC4 Kwb_Wu16 65535.00 OneToOne 0.00 65535.00 FORMAT "%8.2" NUMBER 4 /end CHARACTERISTIC
/begin CHARACTERISTIC DSM_CDCDfp_ErLpCDMILReqON_C "CARB spezifischer Fehlercode fuer Fehlerpfad Dfp_ErLpCDMILReqON" VAL_BLK 0x1CDECC Kwb_Wu16 65535.00 OneToOne 0.00 65535.00 FORMAT "%8.2" NUMBER 4 /end CHARACTERISTIC
/begin CHARACTERISTIC DSM_CDCDfp_FMAErrMod_C "CARB spezifischer Fehlercode fuer Fehlerpfad Dfp_FMAErrMod" VAL_BLK 0x1CDED4 Kwb_Wu16 65535.00 OneToOne 0.00 65535.00 FORMAT "%8.2" NUMBER 4 /end CHARACTERISTIC
/begin CHARACTERISTIC DSM_CDCDfp_FMTC_NonMonotonMap_C "CARB spezifischer Fehlercode fuer Fehlerpfad Dfp_FMTC_NonMonotonMap" VAL_BLK 0x1CDEDC Kwb_Wu16 65535.00 OneToOne 0.00 65535.00 FORMAT "%8.2" NUMBER 4 /end CHARACTERISTIC
/begin CHARACTERISTIC DSM_CDCDfp_FQTSCD_C "CARB spezifischer Fehlercode fuer Fehlerpfad Dfp_FQTSCD" VAL_BLK 0x1CDEE4 Kwb_Wu16 65535.00 OneToOne 0.00 65535.00 FORMAT "%8.2" NUMBER 4 /end CHARACTERISTIC
/begin CHARACTERISTIC DSM_CDCDfp_FQlSCD_C "CARB spezifischer Fehlercode fuer Fehlerpfad Dfp_FQlSCD" VAL_BLK 0x1CDEEC Kwb_Wu16 65535.00 OneToOne 0.00 65535.00 FORMAT "%8.2" NUMBER 4 /end CHARACTERISTIC
/begin CHARACTERISTIC DSM_CDCDfp_FTSCD_C "CARB spezifischer Fehlercode fuer Fehlerpfad Dfp_FTSCD" VAL_BLK 0x1CDEF4 Kwb_Wu16 65535.00 OneToOne 0.00 65535.00 FORMAT "%8.2" NUMBER 4 /end CHARACTERISTIC
/begin CHARACTERISTIC DSM_CDCDfp_FTSCDNpl_C "CARB spezifischer Fehlercode fuer Fehlerpfad Dfp_FTSCDNpl" VAL_BLK 0x1CDEFC Kwb_Wu16 65535.00 OneToOne 0.00 65535.00 FORMAT "%8.2" NUMBER 4 /end CHARACTERISTIC
/begin CHARACTERISTIC DSM_CDCDfp_FanCD_Fan1Ctlr1_C "CARB spezifischer Fehlercode fuer Fehlerpfad Dfp_FanCD_Fan1Ctlr1" VAL_BLK 0x1CDF04 Kwb_Wu16 65535.00 OneToOne 0.00 65535.00 FORMAT "%8.2" NUMBER 4 /end CHARACTERISTIC
/begin CHARACTERISTIC DSM_CDCDfp_FanCD_Fan1Ctlr2_C "CARB spezifischer Fehlercode fuer Fehlerpfad Dfp_FanCD_Fan1Ctlr2" VAL_BLK 0x1CDF0C Kwb_Wu16 65535.00 OneToOne 0.00 65535.00 FORMAT "%8.2" NUMBER 4 /end CHARACTERISTIC
/begin CHARACTERISTIC DSM_CDCDfp_FanCD_Fan2Ctlr1_C "CARB spezifischer Fehlercode fuer Fehlerpfad Dfp_FanCD_Fan2Ctlr1" VAL_BLK 0x1CDF14 Kwb_Wu16 65535.00 OneToOne 0.00 65535.00 FORMAT "%8.2" NUMBER 4 /end CHARACTERISTIC
/begin CHARACTERISTIC DSM_CDCDfp_FanCD_Fan2Ctlr2_C "CARB spezifischer Fehlercode fuer Fehlerpfad Dfp_FanCD_Fan2Ctlr2" VAL_BLK 0x1CDF1C Kwb_Wu16 65535.00 OneToOne 0.00 65535.00 FORMAT "%8.2" NUMBER 4 /end CHARACTERISTIC
/begin CHARACTERISTIC DSM_CDCDfp_FanCD_FanCtlr1_C "CARB spezifischer Fehlercode fuer Fehlerpfad Dfp_FanCD_FanCtlr1" VAL_BLK 0x1CDF24 Kwb_Wu16 65535.00 OneToOne 0.00 65535.00 FORMAT "%8.2" NUMBER 4 /end CHARACTERISTIC
/begin CHARACTERISTIC DSM_CDCDfp_FanCD_FanCtlr2_C "CARB spezifischer Fehlercode fuer Fehlerpfad Dfp_FanCD_FanCtlr2" VAL_BLK 0x1CDF2C Kwb_Wu16 65535.00 OneToOne 0.00 65535.00 FORMAT "%8.2" NUMBER 4 /end CHARACTERISTIC
/begin CHARACTERISTIC DSM_CDCDfp_FanCD_OutFanCtlr1_C "CARB spezifischer Fehlercode fuer Fehlerpfad Dfp_FanCD_OutFanCtlr1" VAL_BLK 0x1CDF34 Kwb_Wu16 65535.00 OneToOne 0.00 65535.00 FORMAT "%8.2" NUMBER 4 /end CHARACTERISTIC
/begin CHARACTERISTIC DSM_CDCDfp_FanCD_OutFanCtlr2_C "CARB spezifischer Fehlercode fuer Fehlerpfad Dfp_FanCD_OutFanCtlr2" VAL_BLK 0x1CDF3C Kwb_Wu16 65535.00 OneToOne 0.00 65535.00 FORMAT "%8.2" NUMBER 4 /end CHARACTERISTIC
/begin CHARACTERISTIC DSM_CDCDfp_FlPpCD_C "CARB spezifischer Fehlercode fuer Fehlerpfad Dfp_FlPpCD" VAL_BLK 0x1CDF4C Kwb_Wu16 65535.00 OneToOne 0.00 65535.00 FORMAT "%8.2" NUMBER 4 /end CHARACTERISTIC
/begin CHARACTERISTIC DSM_CDCDfp_FlSCDT1_C "CARB spezifischer Fehlercode fuer Fehlerpfad Dfp_FlSCDT1" VAL_BLK 0x1CDF54 Kwb_Wu16 65535.00 OneToOne 0.00 65535.00 FORMAT "%8.2" NUMBER 4 /end CHARACTERISTIC
/begin CHARACTERISTIC DSM_CDCDfp_FrmMngAAGNpl_C "CARB spezifischer Fehlercode fuer Fehlerpfad Dfp_FrmMngAAGNpl" VAL_BLK 0x1CDF5C Kwb_Wu16 65535.00 OneToOne 0.00 65535.00 FORMAT "%8.2" NUMBER 4 /end CHARACTERISTIC
/begin CHARACTERISTIC DSM_CDCDfp_FrmMngAAGTO_C "CARB spezifischer Fehlercode fuer Fehlerpfad Dfp_FrmMngAAGTO" VAL_BLK 0x1CDF64 Kwb_Wu16 65535.00 OneToOne 0.00 65535.00 FORMAT "%8.2" NUMBER 4 /end CHARACTERISTIC
/begin CHARACTERISTIC DSM_CDCDfp_FrmMngAC1Npl_C "CARB spezifischer Fehlercode fuer Fehlerpfad Dfp_FrmMngAC1Npl" VAL_BLK 0x1CDF6C Kwb_Wu16 65535.00 OneToOne 0.00 65535.00 FORMAT "%8.2" NUMBER 4 /end CHARACTERISTIC
/begin CHARACTERISTIC DSM_CDCDfp_FrmMngAC1TO_C "CARB spezifischer Fehlercode fuer Fehlerpfad Dfp_FrmMngAC1TO" VAL_BLK 0x1CDF74 Kwb_Wu16 65535.00 OneToOne 0.00 65535.00 FORMAT "%8.2" NUMBER 4 /end CHARACTERISTIC
/begin CHARACTERISTIC DSM_CDCDfp_FrmMngACCNpl_C "CARB spezifischer Fehlercode fuer Fehlerpfad Dfp_FrmMngACCNpl" VAL_BLK 0x1CDF7C Kwb_Wu16 65535.00 OneToOne 0.00 65535.00 FORMAT "%8.2" NUMBER 4 /end CHARACTERISTIC
/begin CHARACTERISTIC DSM_CDCDfp_FrmMngACCTO_C "CARB spezifischer Fehlercode fuer Fehlerpfad Dfp_FrmMngACCTO" VAL_BLK 0x1CDF84 Kwb_Wu16 65535.00 OneToOne 0.00 65535.00 FORMAT "%8.2" NUMBER 4 /end CHARACTERISTIC
/begin CHARACTERISTIC DSM_CDCDfp_FrmMngAIRBGNpl_C "CARB spezifischer Fehlercode fuer Fehlerpfad Dfp_FrmMngAIRBGNpl" VAL_BLK 0x1CDF8C Kwb_Wu16 65535.00 OneToOne 0.00 65535.00 FORMAT "%8.2" NUMBER 4 /end CHARACTERISTIC
/begin CHARACTERISTIC DSM_CDCDfp_FrmMngAIRBGTO_C "CARB spezifischer Fehlercode fuer Fehlerpfad Dfp_FrmMngAIRBGTO" VAL_BLK 0x1CDF94 Kwb_Wu16 65535.00 OneToOne 0.00 65535.00 FORMAT "%8.2" NUMBER 4 /end CHARACTERISTIC
/begin CHARACTERISTIC DSM_CDCDfp_FrmMngAWD1Npl_C "CARB spezifischer Fehlercode fuer Fehlerpfad Dfp_FrmMngAWD1Npl" VAL_BLK 0x1CDF9C Kwb_Wu16 65535.00 OneToOne 0.00 65535.00 FORMAT "%8.2" NUMBER 4 /end CHARACTERISTIC
/begin CHARACTERISTIC DSM_CDCDfp_FrmMngAWD1TO_C "CARB spezifischer Fehlercode fuer Fehlerpfad Dfp_FrmMngAWD1TO" VAL_BLK 0x1CDFA4 Kwb_Wu16 65535.00 OneToOne 0.00 65535.00 FORMAT "%8.2" NUMBER 4 /end CHARACTERISTIC
/begin CHARACTERISTIC DSM_CDCDfp_FrmMngBEM1Npl_C "CARB spezifischer Fehlercode für Fehlerpfad Dfp_FrmMngBEM1Npl" VAL_BLK 0x1CDFAC Kwb_Wu16 65535.00 OneToOne 0.00 65535.00 FORMAT "%8.2" NUMBER 4 /end CHARACTERISTIC
/begin CHARACTERISTIC DSM_CDCDfp_FrmMngBEM1TO_C "CARB spezifischer Fehlercode fuer Fehlerpfad Dfp_FrmMngBEM1TO" VAL_BLK 0x1CDFB4 Kwb_Wu16 65535.00 OneToOne 0.00 65535.00 FORMAT "%8.2" NUMBER 4 /end CHARACTERISTIC
/begin CHARACTERISTIC DSM_CDCDfp_FrmMngBRK1Npl_C "CARB spezifischer Fehlercode fuer Fehlerpfad Dfp_FrmMngBRK1Npl" VAL_BLK 0x1CDFBC Kwb_Wu16 65535.00 OneToOne 0.00 65535.00 FORMAT "%8.2" NUMBER 4 /end CHARACTERISTIC
/begin CHARACTERISTIC DSM_CDCDfp_FrmMngBRK1TO_C "CARB spezifischer Fehlercode fuer Fehlerpfad Dfp_FrmMngBRK1TO" VAL_BLK 0x1CDFC4 Kwb_Wu16 65535.00 OneToOne 0.00 65535.00 FORMAT "%8.2" NUMBER 4 /end CHARACTERISTIC
/begin CHARACTERISTIC DSM_CDCDfp_FrmMngBRK2Npl_C "CARB spezifischer Fehlercode fuer Fehlerpfad Dfp_FrmMngBRK2Npl" VAL_BLK 0x1CDFCC Kwb_Wu16 65535.00 OneToOne 0.00 65535.00 FORMAT "%8.2" NUMBER 4 /end CHARACTERISTIC
/begin CHARACTERISTIC DSM_CDCDfp_FrmMngBRK2TO_C "CARB spezifischer Fehlercode fuer Fehlerpfad Dfp_FrmMngBRK2TO" VAL_BLK 0x1CDFD4 Kwb_Wu16 65535.00 OneToOne 0.00 65535.00 FORMAT "%8.2" NUMBER 4 /end CHARACTERISTIC
/begin CHARACTERISTIC DSM_CDCDfp_FrmMngBRK8Npl_C "CARB spezifischer Fehlercode fuer Fehlerpfad Dfp_FrmMngBRK8Npl" VAL_BLK 0x1CDFDC Kwb_Wu16 65535.00 OneToOne 0.00 65535.00 FORMAT "%8.2" NUMBER 4 /end CHARACTERISTIC
/begin CHARACTERISTIC DSM_CDCDfp_FrmMngBRK8TO_C "CARB spezifischer Fehlercode fuer Fehlerpfad Dfp_FrmMngBRK8TO" VAL_BLK 0x1CDFE4 Kwb_Wu16 65535.00 OneToOne 0.00 65535.00 FORMAT "%8.2" NUMBER 4 /end CHARACTERISTIC
/begin CHARACTERISTIC DSM_CDCDfp_FrmMngCANVerErr_C "CARB spezifischer Fehlercode fuer Fehlerpfad Dfp_FrmMngCANVerErr" VAL_BLK 0x1CDFF4 Kwb_Wu16 65535.00 OneToOne 0.00 65535.00 FORMAT "%8.2" NUMBER 4 /end CHARACTERISTIC
/begin CHARACTERISTIC DSM_CDCDfp_FrmMngCCSel_C "CARB spezifischer Fehlercode fuer Fehlerpfad Dfp_FrmMngCCSel" VAL_BLK 0x1CDFFC Kwb_Wu16 65535.00 OneToOne 0.00 65535.00 FORMAT "%8.2" NUMBER 4 /end CHARACTERISTIC
/begin CHARACTERISTIC DSM_CDCDfp_FrmMngCCTLNpl_C "CARB spezifischer Fehlercode fuer Fehlerpfad Dfp_FrmMngCCTLNpl" VAL_BLK 0x1CE004 Kwb_Wu16 65535.00 OneToOne 0.00 65535.00 FORMAT "%8.2" NUMBER 4 /end CHARACTERISTIC
/begin CHARACTERISTIC DSM_CDCDfp_FrmMngCCTLTO_C "CARB spezifischer Fehlercode fuer Fehlerpfad Dfp_FrmMngCCTLTO" VAL_BLK 0x1CE00C Kwb_Wu16 65535.00 OneToOne 0.00 65535.00 FORMAT "%8.2" NUMBER 4 /end CHARACTERISTIC
/begin CHARACTERISTIC DSM_CDCDfp_FrmMngCHRGR1Npl_C "CARB spezifischer Fehlercode fuer Fehlerpfad Dfp_FrmMngCHRGR1Npl" VAL_BLK 0x1CE014 Kwb_Wu16 65535.00 OneToOne 0.00 65535.00 FORMAT "%8.2" NUMBER 4 /end CHARACTERISTIC
/begin CHARACTERISTIC DSM_CDCDfp_FrmMngCHRGR1TO_C "CARB spezifischer Fehlercode fuer Fehlerpfad Dfp_FrmMngCHRGR1TO" VAL_BLK 0x1CE01C Kwb_Wu16 65535.00 OneToOne 0.00 65535.00 FORMAT "%8.2" NUMBER 4 /end CHARACTERISTIC
/begin CHARACTERISTIC DSM_CDCDfp_FrmMngCHRGR2Npl_C "CARB spezifischer Fehlercode fuer Fehlerpfad Dfp_FrmMngCHRGR2Npl" VAL_BLK 0x1CE024 Kwb_Wu16 65535.00 OneToOne 0.00 65535.00 FORMAT "%8.2" NUMBER 4 /end CHARACTERISTIC
/begin CHARACTERISTIC DSM_CDCDfp_FrmMngCHRGR2TO_C "CARB spezifischer Fehlercode fuer Fehlerpfad Dfp_FrmMngCHRGR2TO" VAL_BLK 0x1CE02C Kwb_Wu16 65535.00 OneToOne 0.00 65535.00 FORMAT "%8.2" NUMBER 4 /end CHARACTERISTIC
/begin CHARACTERISTIC DSM_CDCDfp_FrmMngChrgr1A_C "CARB spezifischer Fehlercode fuer Fehlerpfad Dfp_FrmMngChrgr1A" VAL_BLK 0x1CE034 Kwb_Wu16 65535.00 OneToOne 0.00 65535.00 FORMAT "%8.2" NUMBER 4 /end CHARACTERISTIC
/begin CHARACTERISTIC DSM_CDCDfp_FrmMngChrgr1C_C "CARB spezifischer Fehlercode fuer Fehlerpfad Dfp_FrmMngChrgr1C" VAL_BLK 0x1CE03C Kwb_Wu16 65535.00 OneToOne 0.00 65535.00 FORMAT "%8.2" NUMBER 4 /end CHARACTERISTIC
/begin CHARACTERISTIC DSM_CDCDfp_FrmMngChrgr1N_C "CARB spezifischer Fehlercode fuer Fehlerpfad Dfp_FrmMngChrgr1N" VAL_BLK 0x1CE044 Kwb_Wu16 65535.00 OneToOne 0.00 65535.00 FORMAT "%8.2" NUMBER 4 /end CHARACTERISTIC
/begin CHARACTERISTIC DSM_CDCDfp_FrmMngChrgr1T_C "CARB spezifischer Fehlercode fuer Fehlerpfad Dfp_FrmMngChrgr1T" VAL_BLK 0x1CE04C Kwb_Wu16 65535.00 OneToOne 0.00 65535.00 FORMAT "%8.2" NUMBER 4 /end CHARACTERISTIC
/begin CHARACTERISTIC DSM_CDCDfp_FrmMngChrgr1V_C "CARB spezifischer Fehlercode fuer Fehlerpfad Dfp_FrmMngChrgr1V" VAL_BLK 0x1CE054 Kwb_Wu16 65535.00 OneToOne 0.00 65535.00 FORMAT "%8.2" NUMBER 4 /end CHARACTERISTIC
/begin CHARACTERISTIC DSM_CDCDfp_FrmMngChrgr2A_C "CARB spezifischer Fehlercode fuer Fehlerpfad Dfp_FrmMngChrgr2A" VAL_BLK 0x1CE05C Kwb_Wu16 65535.00 OneToOne 0.00 65535.00 FORMAT "%8.2" NUMBER 4 /end CHARACTERISTIC
/begin CHARACTERISTIC DSM_CDCDfp_FrmMngChrgr2C_C "CARB spezifischer Fehlercode fuer Fehlerpfad Dfp_FrmMngChrgr2C" VAL_BLK 0x1CE064 Kwb_Wu16 65535.00 OneToOne 0.00 65535.00 FORMAT "%8.2" NUMBER 4 /end CHARACTERISTIC
/begin CHARACTERISTIC DSM_CDCDfp_FrmMngChrgr2N_C "CARB spezifischer Fehlercode fuer Fehlerpfad Dfp_FrmMngChrgr2N" VAL_BLK 0x1CE06C Kwb_Wu16 65535.00 OneToOne 0.00 65535.00 FORMAT "%8.2" NUMBER 4 /end CHARACTERISTIC
/begin CHARACTERISTIC DSM_CDCDfp_FrmMngChrgr2T_C "CARB spezifischer Fehlercode fuer Fehlerpfad Dfp_FrmMngChrgr2T" VAL_BLK 0x1CE074 Kwb_Wu16 65535.00 OneToOne 0.00 65535.00 FORMAT "%8.2" NUMBER 4 /end CHARACTERISTIC
/begin CHARACTERISTIC DSM_CDCDfp_FrmMngChrgr2V_C "CARB spezifischer Fehlercode fuer Fehlerpfad Dfp_FrmMngChrgr2V" VAL_BLK 0x1CE07C Kwb_Wu16 65535.00 OneToOne 0.00 65535.00 FORMAT "%8.2" NUMBER 4 /end CHARACTERISTIC
/begin CHARACTERISTIC DSM_CDCDfp_FrmMngDIA1Npl_C "CARB spezifischer Fehlercode fuer Fehlerpfad Dfp_FrmMngDIA1Npl" VAL_BLK 0x1CE084 Kwb_Wu16 65535.00 OneToOne 0.00 65535.00 FORMAT "%8.2" NUMBER 4 /end CHARACTERISTIC
/begin CHARACTERISTIC DSM_CDCDfp_FrmMngDIA1TO_C "CARB spezifischer Fehlercode fuer Fehlerpfad Dfp_FrmMngDIA1TO" VAL_BLK 0x1CE08C Kwb_Wu16 65535.00 OneToOne 0.00 65535.00 FORMAT "%8.2" NUMBER 4 /end CHARACTERISTIC
/begin CHARACTERISTIC DSM_CDCDfp_FrmMngDSP1Npl_C "CARB spezifischer Fehlercode fuer Fehlerpfad Dfp_FrmMngDSP1Npl" VAL_BLK 0x1CE094 Kwb_Wu16 65535.00 OneToOne 0.00 65535.00 FORMAT "%8.2" NUMBER 4 /end CHARACTERISTIC
/begin CHARACTERISTIC DSM_CDCDfp_FrmMngDSP1TO_C "CARB spezifischer Fehlercode fuer Fehlerpfad Dfp_FrmMngDSP1TO" VAL_BLK 0x1CE09C Kwb_Wu16 65535.00 OneToOne 0.00 65535.00 FORMAT "%8.2" NUMBER 4 /end CHARACTERISTIC
/begin CHARACTERISTIC DSM_CDCDfp_FrmMngDSP2Npl_C "CARB spezifischer Fehlercode fuer Fehlerpfad Dfp_FrmMngDSP2Npl" VAL_BLK 0x1CE0A4 Kwb_Wu16 65535.00 OneToOne 0.00 65535.00 FORMAT "%8.2" NUMBER 4 /end CHARACTERISTIC
/begin CHARACTERISTIC DSM_CDCDfp_FrmMngDSP2TO_C "CARB spezifischer Fehlercode fuer Fehlerpfad Dfp_FrmMngDSP2TO" VAL_BLK 0x1CE0AC Kwb_Wu16 65535.00 OneToOne 0.00 65535.00 FORMAT "%8.2" NUMBER 4 /end CHARACTERISTIC
/begin CHARACTERISTIC DSM_CDCDfp_FrmMngDSP3Npl_C "CARB spezifischer Fehlercode fuer Fehlerpfad Dfp_FrmMngDSP3Npl" VAL_BLK 0x1CE0B4 Kwb_Wu16 65535.00 OneToOne 0.00 65535.00 FORMAT "%8.2" NUMBER 4 /end CHARACTERISTIC
/begin CHARACTERISTIC DSM_CDCDfp_FrmMngDSP3TO_C "CARB spezifischer Fehlercode fuer Fehlerpfad Dfp_FrmMngDSP3TO" VAL_BLK 0x1CE0BC Kwb_Wu16 65535.00 OneToOne 0.00 65535.00 FORMAT "%8.2" NUMBER 4 /end CHARACTERISTIC
/begin CHARACTERISTIC DSM_CDCDfp_FrmMngEPB1Npl_C "CARB spezifischer Fehlercode fuer Fehlerpfad Dfp_FrmMngEPB1Npl" VAL_BLK 0x1CE0C4 Kwb_Wu16 65535.00 OneToOne 0.00 65535.00 FORMAT "%8.2" NUMBER 4 /end CHARACTERISTIC
/begin CHARACTERISTIC DSM_CDCDfp_FrmMngEPB1TO_C "CARB spezifischer Fehlercode fuer Fehlerpfad Dfp_FrmMngEPB1TO" VAL_BLK 0x1CE0CC Kwb_Wu16 65535.00 OneToOne 0.00 65535.00 FORMAT "%8.2" NUMBER 4 /end CHARACTERISTIC
/begin CHARACTERISTIC DSM_CDCDfp_FrmMngESCUNpl_C "CARB spezifischer Fehlercode fuer Fehlerpfad Dfp_FrmMngESCUNpl" VAL_BLK 0x1CE0D4 Kwb_Wu16 65535.00 OneToOne 0.00 65535.00 FORMAT "%8.2" NUMBER 4 /end CHARACTERISTIC
/begin CHARACTERISTIC DSM_CDCDfp_FrmMngESCUTO_C "CARB spezifischer Fehlercode fuer Fehlerpfad Dfp_FrmMngESCUTO" VAL_BLK 0x1CE0DC Kwb_Wu16 65535.00 OneToOne 0.00 65535.00 FORMAT "%8.2" NUMBER 4 /end CHARACTERISTIC
/begin CHARACTERISTIC DSM_CDCDfp_FrmMngGW1Npl_C "CARB spezifischer Fehlercode fuer Fehlerpfad Dfp_FrmMngGW1Npl" VAL_BLK 0x1CE0EC Kwb_Wu16 65535.00 OneToOne 0.00 65535.00 FORMAT "%8.2" NUMBER 4 /end CHARACTERISTIC
/begin CHARACTERISTIC DSM_CDCDfp_FrmMngGW1TO_C "CARB spezifischer Fehlercode fuer Fehlerpfad Dfp_FrmMngGW1TO" VAL_BLK 0x1CE0F4 Kwb_Wu16 65535.00 OneToOne 0.00 65535.00 FORMAT "%8.2" NUMBER 4 /end CHARACTERISTIC
/begin CHARACTERISTIC DSM_CDCDfp_FrmMngILMNpl_C "CARB spezifischer Fehlercode fuer Fehlerpfad Dfp_FrmMngILMNpl" VAL_BLK 0x1CE0FC Kwb_Wu16 65535.00 OneToOne 0.00 65535.00 FORMAT "%8.2" NUMBER 4 /end CHARACTERISTIC
/begin CHARACTERISTIC DSM_CDCDfp_FrmMngILMTO_C "CARB spezifischer Fehlercode fuer Fehlerpfad Dfp_FrmMngILMTO" VAL_BLK 0x1CE104 Kwb_Wu16 65535.00 OneToOne 0.00 65535.00 FORMAT "%8.2" NUMBER 4 /end CHARACTERISTIC
/begin CHARACTERISTIC DSM_CDCDfp_FrmMngNIV1WrngCod_C "CARB spezifischer Fehlercode fuer Fehlerpfad Dfp_FrmMngNIV1WrngCod" VAL_BLK 0x1CE11C Kwb_Wu16 65535.00 OneToOne 0.00 65535.00 FORMAT "%8.2" NUMBER 4 /end CHARACTERISTIC
/begin CHARACTERISTIC DSM_CDCDfp_FrmMngNIVEAU1Npl_C "CARB spezifischer Fehlercode fuer Fehlerpfad Dfp_FrmMngNIVEAU1Npl" VAL_BLK 0x1CE124 Kwb_Wu16 65535.00 OneToOne 0.00 65535.00 FORMAT "%8.2" NUMBER 4 /end CHARACTERISTIC
/begin CHARACTERISTIC DSM_CDCDfp_FrmMngNIVEAU1TO_C "CARB spezifischer Fehlercode fuer Fehlerpfad Dfp_FrmMngNIVEAU1TO" VAL_BLK 0x1CE12C Kwb_Wu16 65535.00 OneToOne 0.00 65535.00 FORMAT "%8.2" NUMBER 4 /end CHARACTERISTIC
/begin CHARACTERISTIC DSM_CDCDfp_FrmMngSA1Npl_C "CARB spezifischer Fehlercode fuer Fehlerpfad Dfp_FrmMngSA1Npl" VAL_BLK 0x1CE134 Kwb_Wu16 65535.00 OneToOne 0.00 65535.00 FORMAT "%8.2" NUMBER 4 /end CHARACTERISTIC
/begin CHARACTERISTIC DSM_CDCDfp_FrmMngSA1TO_C "CARB spezifischer Fehlercode fuer Fehlerpfad Dfp_FrmMngSA1TO" VAL_BLK 0x1CE13C Kwb_Wu16 65535.00 OneToOne 0.00 65535.00 FORMAT "%8.2" NUMBER 4 /end CHARACTERISTIC
/begin CHARACTERISTIC DSM_CDCDfp_FrmMngSTIGNNpl_C "CARB spezifischer Fehlercode fuer Fehlerpfad Dfp_FrmMngSTIGNNpl" VAL_BLK 0x1CE144 Kwb_Wu16 65535.00 OneToOne 0.00 65535.00 FORMAT "%8.2" NUMBER 4 /end CHARACTERISTIC
/begin CHARACTERISTIC DSM_CDCDfp_FrmMngStIgnTO_C "CARB spezifischer Fehlercode fuer Fehlerpfad Dfp_FrmMngStIgnTO" VAL_BLK 0x1CE14C Kwb_Wu16 65535.00 OneToOne 0.00 65535.00 FORMAT "%8.2" NUMBER 4 /end CHARACTERISTIC
/begin CHARACTERISTIC DSM_CDCDfp_FrmMngTOSNpl_C "CARB spezifischer Fehlercode fuer Fehlerpfad Dfp_FrmMngTOSNpl" VAL_BLK 0x1CE154 Kwb_Wu16 65535.00 OneToOne 0.00 65535.00 FORMAT "%8.2" NUMBER 4 /end CHARACTERISTIC
/begin CHARACTERISTIC DSM_CDCDfp_FrmMngTOSTO_C "CARB spezifischer Fehlercode fuer Fehlerpfad Dfp_FrmMngTOSTO" VAL_BLK 0x1CE15C Kwb_Wu16 65535.00 OneToOne 0.00 65535.00 FORMAT "%8.2" NUMBER 4 /end CHARACTERISTIC
/begin CHARACTERISTIC DSM_CDCDfp_FrmMngTSC1Npl_C "CARB spezifischer Fehlercode fuer Fehlerpfad Dfp_FrmMngTSC1Npl" VAL_BLK 0x1CE164 Kwb_Wu16 65535.00 OneToOne 0.00 65535.00 FORMAT "%8.2" NUMBER 4 /end CHARACTERISTIC
/begin CHARACTERISTIC DSM_CDCDfp_FrmMngTSC1TO_C "CARB spezifischer Fehlercode fuer Fehlerpfad Dfp_FrmMngTSC1TO" VAL_BLK 0x1CE16C Kwb_Wu16 65535.00 OneToOne 0.00 65535.00 FORMAT "%8.2" NUMBER 4 /end CHARACTERISTIC
/begin CHARACTERISTIC DSM_CDCDfp_FrmMngTSC2Npl_C "CARB spezifischer Fehlercode fuer Fehlerpfad Dfp_FrmMngTSC2Npl" VAL_BLK 0x1CE174 Kwb_Wu16 65535.00 OneToOne 0.00 65535.00 FORMAT "%8.2" NUMBER 4 /end CHARACTERISTIC
/begin CHARACTERISTIC DSM_CDCDfp_FrmMngTSC2TO_C "CARB spezifischer Fehlercode fuer Fehlerpfad Dfp_FrmMngTSC2TO" VAL_BLK 0x1CE17C Kwb_Wu16 65535.00 OneToOne 0.00 65535.00 FORMAT "%8.2" NUMBER 4 /end CHARACTERISTIC
/begin CHARACTERISTIC DSM_CDCDfp_FrmMngTSC3Npl_C "CARB spezifischer Fehlercode fuer Fehlerpfad Dfp_FrmMngTSC3Npl" VAL_BLK 0x1CE184 Kwb_Wu16 65535.00 OneToOne 0.00 65535.00 FORMAT "%8.2" NUMBER 4 /end CHARACTERISTIC
/begin CHARACTERISTIC DSM_CDCDfp_FrmMngTSC3TO_C "CARB spezifischer Fehlercode fuer Fehlerpfad Dfp_FrmMngTSC3TO" VAL_BLK 0x1CE18C Kwb_Wu16 65535.00 OneToOne 0.00 65535.00 FORMAT "%8.2" NUMBER 4 /end CHARACTERISTIC
/begin CHARACTERISTIC DSM_CDCDfp_FrmMngTSC6Npl_C "CARB spezifischer Fehlercode fuer Fehlerpfad Dfp_FrmMngTSC6Npl" VAL_BLK 0x1CE194 Kwb_Wu16 65535.00 OneToOne 0.00 65535.00 FORMAT "%8.2" NUMBER 4 /end CHARACTERISTIC
/begin CHARACTERISTIC DSM_CDCDfp_FrmMngTSC6TO_C "CARB spezifischer Fehlercode fuer Fehlerpfad Dfp_FrmMngTSC6TO" VAL_BLK 0x1CE19C Kwb_Wu16 65535.00 OneToOne 0.00 65535.00 FORMAT "%8.2" NUMBER 4 /end CHARACTERISTIC
/begin CHARACTERISTIC DSM_CDCDfp_FrmMngTrbnSpdErr_C "CARB spezifischer Fehlercode fuer Fehlerpfad Dfp_FrmMngTrbnSpdErr" VAL_BLK 0x1CE1A4 Kwb_Wu16 65535.00 OneToOne 0.00 65535.00 FORMAT "%8.2" NUMBER 4 /end CHARACTERISTIC
/begin CHARACTERISTIC DSM_CDCDfp_GbSSCD_C "CARB spezifischer Fehlercode für Fehlerpfad Dfp_GbSSCD" VAL_BLK 0x1CE1B4 Kwb_Wu16 65535.00 OneToOne 0.00 65535.00 FORMAT "%8.2" NUMBER 4 /end CHARACTERISTIC
/begin CHARACTERISTIC DSM_CDCDfp_GbSSCD_HW_C "CARB spezifischer Fehlercode fuer Fehlerpfad Dfp_GbSSCD_HW" VAL_BLK 0x1CE1BC Kwb_Wu16 65535.00 OneToOne 0.00 65535.00 FORMAT "%8.2" NUMBER 4 /end CHARACTERISTIC
/begin CHARACTERISTIC DSM_CDCDfp_GearbxCVTnMax_C "CARB spezifischer Fehlercode fuer Fehlerpfad Dfp_GearbxCVTnMax_mp" VAL_BLK 0x1CE1C4 Kwb_Wu16 65535.00 OneToOne 0.00 65535.00 FORMAT "%8.2" NUMBER 4 /end CHARACTERISTIC
/begin CHARACTERISTIC DSM_CDCDfp_GearbxClthPlaus_C "CARB spezifischer Fehlercode fuer Fehlerpfad Dfp_GearbxClthPlaus" VAL_BLK 0x1CE1CC Kwb_Wu16 65535.00 OneToOne 0.00 65535.00 FORMAT "%8.2" NUMBER 4 /end CHARACTERISTIC
/begin CHARACTERISTIC DSM_CDCDfp_GearbxINCCup_C "CARB spezifischer Fehlercode fuer Fehlerpfad Dfp_GearbxINCCup" VAL_BLK 0x1CE1D4 Kwb_Wu16 65535.00 OneToOne 0.00 65535.00 FORMAT "%8.2" NUMBER 4 /end CHARACTERISTIC
/begin CHARACTERISTIC DSM_CDCDfp_GearbxNMinMon_C "CARB spezifischer Fehlercode fuer Fehlerpfad Dfp_GearbxNMinMon" VAL_BLK 0x1CE1DC Kwb_Wu16 65535.00 OneToOne 0.00 65535.00 FORMAT "%8.2" NUMBER 4 /end CHARACTERISTIC
/begin CHARACTERISTIC DSM_CDCDfp_GearbxTSC_C "CARB spezifischer Fehlercode fuer Fehlerpfad Dfp_GearbxTSC" VAL_BLK 0x1CE1E4 Kwb_Wu16 65535.00 OneToOne 0.00 65535.00 FORMAT "%8.2" NUMBER 4 /end CHARACTERISTIC
/begin CHARACTERISTIC DSM_CDCDfp_GearbxTransConv_C "CARB spezifischer Fehlercode fuer Fehlerpfad Dfp_GearbxTransConv" VAL_BLK 0x1CE1EC Kwb_Wu16 65535.00 OneToOne 0.00 65535.00 FORMAT "%8.2" NUMBER 4 /end CHARACTERISTIC
/begin CHARACTERISTIC DSM_CDCDfp_GearbxTypeMTErr_C "CARB spezifischer Fehlercode fuer Fehlerpfad Dfp_GearbxTypeMTErr" VAL_BLK 0x1CE1F4 Kwb_Wu16 65535.00 OneToOne 0.00 65535.00 FORMAT "%8.2" NUMBER 4 /end CHARACTERISTIC
/begin CHARACTERISTIC DSM_CDCDfp_GlwCDDIAG_C "CARB spezifischer Fehlercode fuer Fehlerpfad Dfp_GlwCDDIAG" VAL_BLK 0x1CE1FC Kwb_Wu16 65535.00 OneToOne 0.00 65535.00 FORMAT "%8.2" NUMBER 4 /end CHARACTERISTIC
/begin CHARACTERISTIC DSM_CDCDfp_GlwCDErr1_C "CARB spezifischer Fehlercode fuer Fehlerpfad Dfp_GlwCDErr1" VAL_BLK 0x1CE204 Kwb_Wu16 65535.00 OneToOne 0.00 65535.00 FORMAT "%8.2" NUMBER 4 /end CHARACTERISTIC
/begin CHARACTERISTIC DSM_CDCDfp_GlwCDErr2_C "CARB spezifischer Fehlercode fuer Fehlerpfad Dfp_GlwCDErr2" VAL_BLK 0x1CE20C Kwb_Wu16 65535.00 OneToOne 0.00 65535.00 FORMAT "%8.2" NUMBER 4 /end CHARACTERISTIC
/begin CHARACTERISTIC DSM_CDCDfp_GlwCDEvalCod_C "CARB spezifischer Fehlercode fuer Fehlerpfad Dfp_GlwCDEvalCod" VAL_BLK 0x1CE214 Kwb_Wu16 65535.00 OneToOne 0.00 65535.00 FORMAT "%8.2" NUMBER 4 /end CHARACTERISTIC
/begin CHARACTERISTIC DSM_CDCDfp_GlwCDGSK2_C "CARB spezifischer Fehlercode fuer Fehlerpfad Dfp_GlwCDGSK2" VAL_BLK 0x1CE21C Kwb_Wu16 65535.00 OneToOne 0.00 65535.00 FORMAT "%8.2" NUMBER 4 /end CHARACTERISTIC
/begin CHARACTERISTIC DSM_CDCDfp_GlwCDGSK3_C "CARB spezifischer Fehlercode fuer Fehlerpfad Dfp_GlwCDGSK3" VAL_BLK 0x1CE224 Kwb_Wu16 65535.00 OneToOne 0.00 65535.00 FORMAT "%8.2" NUMBER 4 /end CHARACTERISTIC
/begin CHARACTERISTIC DSM_CDCDfp_GlwCDLmp_C "CARB spezifischer Fehlercode fuer Fehlerpfad Dfp_GlwCDLmp" VAL_BLK 0x1CE22C Kwb_Wu16 65535.00 OneToOne 0.00 65535.00 FORMAT "%8.2" NUMBER 4 /end CHARACTERISTIC
/begin CHARACTERISTIC DSM_CDCDfp_GlwCDPLUG0_C "CARB spezifischer Fehlercode fuer Fehlerpfad Dfp_GlwCDPLUG0" VAL_BLK 0x1CE234 Kwb_Wu16 65535.00 OneToOne 0.00 65535.00 FORMAT "%8.2" NUMBER 4 /end CHARACTERISTIC
/begin CHARACTERISTIC DSM_CDCDfp_GlwCDPLUG1_C "CARB spezifischer Fehlercode fuer Fehlerpfad Dfp_GlwCDPLUG1" VAL_BLK 0x1CE23C Kwb_Wu16 65535.00 OneToOne 0.00 65535.00 FORMAT "%8.2" NUMBER 4 /end CHARACTERISTIC
/begin CHARACTERISTIC DSM_CDCDfp_GlwCDPLUG2_C "CARB spezifischer Fehlercode fuer Fehlerpfad Dfp_GlwCDPLUG2" VAL_BLK 0x1CE244 Kwb_Wu16 65535.00 OneToOne 0.00 65535.00 FORMAT "%8.2" NUMBER 4 /end CHARACTERISTIC
/begin CHARACTERISTIC DSM_CDCDfp_GlwCDPLUG3_C "CARB spezifischer Fehlercode fuer Fehlerpfad Dfp_GlwCDPLUG3" VAL_BLK 0x1CE24C Kwb_Wu16 65535.00 OneToOne 0.00 65535.00 FORMAT "%8.2" NUMBER 4 /end CHARACTERISTIC
/begin CHARACTERISTIC DSM_CDCDfp_GlwCDPLUG4_C "CARB spezifischer Fehlercode fuer Fehlerpfad Dfp_GlwCDPLUG4" VAL_BLK 0x1CE254 Kwb_Wu16 65535.00 OneToOne 0.00 65535.00 FORMAT "%8.2" NUMBER 4 /end CHARACTERISTIC
/begin CHARACTERISTIC DSM_CDCDfp_GlwCDPLUG5_C "CARB spezifischer Fehlercode fuer Fehlerpfad Dfp_GlwCDPLUG5" VAL_BLK 0x1CE25C Kwb_Wu16 65535.00 OneToOne 0.00 65535.00 FORMAT "%8.2" NUMBER 4 /end CHARACTERISTIC
/begin CHARACTERISTIC DSM_CDCDfp_GlwCD_LampCan_C "CARB spezifischer Fehlercode fuer Fehlerpfad Dfp_GlwCD_LampCan" VAL_BLK 0x1CE264 Kwb_Wu16 65535.00 OneToOne 0.00 65535.00 FORMAT "%8.2" NUMBER 4 /end CHARACTERISTIC
/begin CHARACTERISTIC DSM_CDCDfp_GlwCDsfd_C "CARB spezifischer Fehlercode fuer Fehlerpfad Dfp_GlwCDsfd" VAL_BLK 0x1CE26C Kwb_Wu16 65535.00 OneToOne 0.00 65535.00 FORMAT "%8.2" NUMBER 4 /end CHARACTERISTIC
/begin CHARACTERISTIC DSM_CDCDfp_HDSCD_C "CARB spezifischer Fehlercode fuer Fehlerpfad Dfp_HDSCD" VAL_BLK 0x1CE274 Kwb_Wu16 65535.00 OneToOne 0.00 65535.00 FORMAT "%8.2" NUMBER 4 /end CHARACTERISTIC
/begin CHARACTERISTIC DSM_CDCDfp_HWEMonCom_C "CARB spezifischer Fehlercode fuer Fehlerpfad Dfp_HWEMonCom" VAL_BLK 0x1CE27C Kwb_Wu16 65535.00 OneToOne 0.00 65535.00 FORMAT "%8.2" NUMBER 4 /end CHARACTERISTIC
/begin CHARACTERISTIC DSM_CDCDfp_HWEMonEEPROM_C "CARB spezifischer Fehlercode fuer Fehlerpfad Dfp_HWEMonEEPROM" VAL_BLK 0x1CE284 Kwb_Wu16 65535.00 OneToOne 0.00 65535.00 FORMAT "%8.2" NUMBER 4 /end CHARACTERISTIC
/begin CHARACTERISTIC DSM_CDCDfp_HWEMonRcyLocked_C "CARB spezifischer Fehlercode fuer Fehlerpfad Dfp_HWEMonRcyLocked" VAL_BLK 0x1CE28C Kwb_Wu16 65535.00 OneToOne 0.00 65535.00 FORMAT "%8.2" NUMBER 4 /end CHARACTERISTIC
/begin CHARACTERISTIC DSM_CDCDfp_HWEMonRcySuppressed_C "CARB spezifischer Fehlercode fuer Fehlerpfad Dfp_HWEMonRcySuppressed" VAL_BLK 0x1CE294 Kwb_Wu16 65535.00 OneToOne 0.00 65535.00 FORMAT "%8.2" NUMBER 4 /end CHARACTERISTIC
/begin CHARACTERISTIC DSM_CDCDfp_HWEMonRcyVisible_C "CARB spezifischer Fehlercode fuer Fehlerpfad Dfp_HWEMonRcyVisible" VAL_BLK 0x1CE29C Kwb_Wu16 65535.00 OneToOne 0.00 65535.00 FORMAT "%8.2" NUMBER 4 /end CHARACTERISTIC
/begin CHARACTERISTIC DSM_CDCDfp_HWEMonUMaxSupply_C "CARB spezifischer Fehlercode fuer Fehlerpfad Dfp_HWEMonUMaxSupply" VAL_BLK 0x1CE2A4 Kwb_Wu16 65535.00 OneToOne 0.00 65535.00 FORMAT "%8.2" NUMBER 4 /end CHARACTERISTIC
/begin CHARACTERISTIC DSM_CDCDfp_HWEMonUMinSupply_C "CARB spezifischer Fehlercode fuer Fehlerpfad Dfp_HWEMonUMinSupply" VAL_BLK 0x1CE2AC Kwb_Wu16 65535.00 OneToOne 0.00 65535.00 FORMAT "%8.2" NUMBER 4 /end CHARACTERISTIC
/begin CHARACTERISTIC DSM_CDCDfp_IATSCD_C "CARB spezifischer Fehlercode fuer Fehlerpfad Dfp_IATSCD" VAL_BLK 0x1CE2B4 Kwb_Wu16 65535.00 OneToOne 0.00 65535.00 FORMAT "%8.2" NUMBER 4 /end CHARACTERISTIC
/begin CHARACTERISTIC DSM_CDCDfp_IFCD_C "CARB spezifischer Fehlercode fuer Fehlerpfad Dfp_IFCD" VAL_BLK 0x1CE2BC Kwb_Wu16 65535.00 OneToOne 0.00 65535.00 FORMAT "%8.2" NUMBER 4 /end CHARACTERISTIC
/begin CHARACTERISTIC DSM_CDCDfp_ImmCtl_C "CARB spezifischer Fehlercode fuer Fehlerpfad Dfp_ImmCtl" VAL_BLK 0x1CE2C4 Kwb_Wu16 65535.00 OneToOne 0.00 65535.00 FORMAT "%8.2" NUMBER 4 /end CHARACTERISTIC
/begin CHARACTERISTIC DSM_CDCDfp_IndSysMonIntMnf_C "CARB spezifischer Fehlercode fuer Fehlerpfad Dfp_IndSysMonIntMnf" VAL_BLK 0x1CE2CC Kwb_Wu16 65535.00 OneToOne 0.00 65535.00 FORMAT "%8.2" NUMBER 4 /end CHARACTERISTIC
/begin CHARACTERISTIC DSM_CDCDfp_InjVlvBnk1A_C "CARB spezifischer Fehlercode fuer Fehlerpfad Dfp_InjVlvBnk1A" VAL_BLK 0x1CE2E4 Kwb_Wu16 65535.00 OneToOne 0.00 65535.00 FORMAT "%8.2" NUMBER 4 /end CHARACTERISTIC
/begin CHARACTERISTIC DSM_CDCDfp_InjVlvBnk2A_C "CARB spezifischer Fehlercode fuer Fehlerpfad Dfp_InjVlvBnk2A" VAL_BLK 0x1CE2EC Kwb_Wu16 65535.00 OneToOne 0.00 65535.00 FORMAT "%8.2" NUMBER 4 /end CHARACTERISTIC
/begin CHARACTERISTIC DSM_CDCDfp_InjVlvCyl10A_C "CARB spezifischer Fehlercode fuer Fehlerpfad Dfp_InjVlvCyl10A" VAL_BLK 0x1CE2F4 Kwb_Wu16 65535.00 OneToOne 0.00 65535.00 FORMAT "%8.2" NUMBER 4 /end CHARACTERISTIC
/begin CHARACTERISTIC DSM_CDCDfp_InjVlvCyl11A_C "CARB spezifischer Fehlercode fuer Fehlerpfad Dfp_InjVlvCyl11A" VAL_BLK 0x1CE2FC Kwb_Wu16 65535.00 OneToOne 0.00 65535.00 FORMAT "%8.2" NUMBER 4 /end CHARACTERISTIC
/begin CHARACTERISTIC DSM_CDCDfp_InjVlvCyl12A_C "CARB spezifischer Fehlercode fuer Fehlerpfad Dfp_InjVlvCyl12A" VAL_BLK 0x1CE304 Kwb_Wu16 65535.00 OneToOne 0.00 65535.00 FORMAT "%8.2" NUMBER 4 /end CHARACTERISTIC
/begin CHARACTERISTIC DSM_CDCDfp_InjVlvCyl1A_C "CARB spezifischer Fehlercode fuer Fehlerpfad Dfp_InjVlvCyl1A" VAL_BLK 0x1CE30C Kwb_Wu16 65535.00 OneToOne 0.00 65535.00 FORMAT "%8.2" NUMBER 4 /end CHARACTERISTIC
/begin CHARACTERISTIC DSM_CDCDfp_InjVlvCyl2A_C "CARB spezifischer Fehlercode fuer Fehlerpfad Dfp_InjVlvCyl2A" VAL_BLK 0x1CE314 Kwb_Wu16 65535.00 OneToOne 0.00 65535.00 FORMAT "%8.2" NUMBER 4 /end CHARACTERISTIC
/begin CHARACTERISTIC DSM_CDCDfp_InjVlvCyl3A_C "CARB spezifischer Fehlercode fuer Fehlerpfad Dfp_InjVlvCyl3A" VAL_BLK 0x1CE31C Kwb_Wu16 65535.00 OneToOne 0.00 65535.00 FORMAT "%8.2" NUMBER 4 /end CHARACTERISTIC
/begin CHARACTERISTIC DSM_CDCDfp_InjVlvCyl4A_C "CARB spezifischer Fehlercode fuer Fehlerpfad Dfp_InjVlvCyl4A" VAL_BLK 0x1CE324 Kwb_Wu16 65535.00 OneToOne 0.00 65535.00 FORMAT "%8.2" NUMBER 4 /end CHARACTERISTIC
/begin CHARACTERISTIC DSM_CDCDfp_InjVlvCyl5A_C "CARB spezifischer Fehlercode fuer Fehlerpfad Dfp_InjVlvCyl5A" VAL_BLK 0x1CE32C Kwb_Wu16 65535.00 OneToOne 0.00 65535.00 FORMAT "%8.2" NUMBER 4 /end CHARACTERISTIC
/begin CHARACTERISTIC DSM_CDCDfp_InjVlvCyl6A_C "CARB spezifischer Fehlercode fuer Fehlerpfad Dfp_InjVlvCyl6A" VAL_BLK 0x1CE334 Kwb_Wu16 65535.00 OneToOne 0.00 65535.00 FORMAT "%8.2" NUMBER 4 /end CHARACTERISTIC
/begin CHARACTERISTIC DSM_CDCDfp_InjVlvCyl7A_C "CARB spezifischer Fehlercode fuer Fehlerpfad Dfp_InjVlvCyl7A" VAL_BLK 0x1CE33C Kwb_Wu16 65535.00 OneToOne 0.00 65535.00 FORMAT "%8.2" NUMBER 4 /end CHARACTERISTIC
/begin CHARACTERISTIC DSM_CDCDfp_InjVlvCyl8A_C "CARB spezifischer Fehlercode fuer Fehlerpfad Dfp_InjVlvCyl8A" VAL_BLK 0x1CE344 Kwb_Wu16 65535.00 OneToOne 0.00 65535.00 FORMAT "%8.2" NUMBER 4 /end CHARACTERISTIC
/begin CHARACTERISTIC DSM_CDCDfp_InjVlvCyl9A_C "CARB spezifischer Fehlercode fuer Fehlerpfad Dfp_InjVlvCyl9A" VAL_BLK 0x1CE34C Kwb_Wu16 65535.00 OneToOne 0.00 65535.00 FORMAT "%8.2" NUMBER 4 /end CHARACTERISTIC
/begin CHARACTERISTIC DSM_CDCDfp_LASCD_C "CARB spezifischer Fehlercode fuer Fehlerpfad Dfp_LASCD" VAL_BLK 0x1CE354 Kwb_Wu16 65535.00 OneToOne 0.00 65535.00 FORMAT "%8.2" NUMBER 4 /end CHARACTERISTIC
/begin CHARACTERISTIC DSM_CDCDfp_LSUCDCircNernst0_C "CARB spezifischer Fehlercode fuer Fehlerpfad Dfp_LSUCDCircNernst0" VAL_BLK 0x1CE35C Kwb_Wu16 65535.00 OneToOne 0.00 65535.00 FORMAT "%8.2" NUMBER 4 /end CHARACTERISTIC
/begin CHARACTERISTIC DSM_CDCDfp_LSUCDCircPumpCur0_C "CARB spezifischer Fehlercode fuer Fehlerpfad Dfp_LSUCDCircPumpCur0" VAL_BLK 0x1CE364 Kwb_Wu16 65535.00 OneToOne 0.00 65535.00 FORMAT "%8.2" NUMBER 4 /end CHARACTERISTIC
/begin CHARACTERISTIC DSM_CDCDfp_LSUCDCircVirtGnd0_C "CARB spezifischer Fehlercode fuer Fehlerpfad Dfp_LSUCDCircVirtGnd0" VAL_BLK 0x1CE36C Kwb_Wu16 65535.00 OneToOne 0.00 65535.00 FORMAT "%8.2" NUMBER 4 /end CHARACTERISTIC
/begin CHARACTERISTIC DSM_CDCDfp_LSUCDHeater0_C "CARB spezifischer Fehlercode fuer Fehlerpfad Dfp_LSUCDHeater0" VAL_BLK 0x1CE374 Kwb_Wu16 65535.00 OneToOne 0.00 65535.00 FORMAT "%8.2" NUMBER 4 /end CHARACTERISTIC
/begin CHARACTERISTIC DSM_CDCDfp_LSUCDHtCoup0_C "CARB spezifischer Fehlercode fuer Fehlerpfad Dfp_LSUCDHtCoup0" VAL_BLK 0x1CE37C Kwb_Wu16 65535.00 OneToOne 0.00 65535.00 FORMAT "%8.2" NUMBER 4 /end CHARACTERISTIC
/begin CHARACTERISTIC DSM_CDCDfp_LSUCDO20_C "CARB spezifischer Fehlercode fuer Fehlerpfad Dfp_LSUCDO20" VAL_BLK 0x1CE384 Kwb_Wu16 65535.00 OneToOne 0.00 65535.00 FORMAT "%8.2" NUMBER 4 /end CHARACTERISTIC
/begin CHARACTERISTIC DSM_CDCDfp_LSUCDO2Clb0_C "CARB spezifischer Fehlercode fuer Fehlerpfad Dfp_LSUCDO2Clb0" VAL_BLK 0x1CE38C Kwb_Wu16 65535.00 OneToOne 0.00 65535.00 FORMAT "%8.2" NUMBER 4 /end CHARACTERISTIC
/begin CHARACTERISTIC DSM_CDCDfp_LSUCDRiClb0_C "CARB spezifischer Fehlercode fuer Fehlerpfad Dfp_LSUCDRiClb0" VAL_BLK 0x1CE394 Kwb_Wu16 65535.00 OneToOne 0.00 65535.00 FORMAT "%8.2" NUMBER 4 /end CHARACTERISTIC
/begin CHARACTERISTIC DSM_CDCDfp_LSUCDSPI0_C "CARB spezifischer Fehlercode fuer Fehlerpfad Dfp_LSUCDSPI0" VAL_BLK 0x1CE39C Kwb_Wu16 65535.00 OneToOne 0.00 65535.00 FORMAT "%8.2" NUMBER 4 /end CHARACTERISTIC
/begin CHARACTERISTIC DSM_CDCDfp_LSUCDSPIBattLow0_C "CARB spezifischer Fehlercode fuer Fehlerpfad Dfp_LSUCDSPIBattLow0" VAL_BLK 0x1CE3A4 Kwb_Wu16 65535.00 OneToOne 0.00 65535.00 FORMAT "%8.2" NUMBER 4 /end CHARACTERISTIC
/begin CHARACTERISTIC DSM_CDCDfp_LSUCDWireIP0_C "CARB spezifischer Fehlercode fuer Fehlerpfad Dfp_LSUCDWireIP0" VAL_BLK 0x1CE3AC Kwb_Wu16 65535.00 OneToOne 0.00 65535.00 FORMAT "%8.2" NUMBER 4 /end CHARACTERISTIC
/begin CHARACTERISTIC DSM_CDCDfp_LSUCtlRiExc0_C "CARB spezifischer Fehlercode fuer Fehlerpfad Dfp_LSUCtlRiExc0" VAL_BLK 0x1CE3B4 Kwb_Wu16 65535.00 OneToOne 0.00 65535.00 FORMAT "%8.2" NUMBER 4 /end CHARACTERISTIC
/begin CHARACTERISTIC DSM_CDCDfp_LSUMonDyn0_C "CARB spezifischer Fehlercode fuer Fehlerpfad Dfp_LSUMonDyn0" VAL_BLK 0x1CE3BC Kwb_Wu16 65535.00 OneToOne 0.00 65535.00 FORMAT "%8.2" NUMBER 4 /end CHARACTERISTIC
/begin CHARACTERISTIC DSM_CDCDfp_LSUMonFullLd0_C "CARB spezifischer Fehlercode fuer Fehlerpfad Dfp_LSUMonFullLd0" VAL_BLK 0x1CE3C4 Kwb_Wu16 65535.00 OneToOne 0.00 65535.00 FORMAT "%8.2" NUMBER 4 /end CHARACTERISTIC
/begin CHARACTERISTIC DSM_CDCDfp_LSUMonOvrRun0_C "CARB spezifischer Fehlercode fuer Fehlerpfad Dfp_LSUMonOvrRun0" VAL_BLK 0x1CE3CC Kwb_Wu16 65535.00 OneToOne 0.00 65535.00 FORMAT "%8.2" NUMBER 4 /end CHARACTERISTIC
/begin CHARACTERISTIC DSM_CDCDfp_LSUMonPartLd0_C "CARB spezifischer Fehlercode fuer Fehlerpfad Dfp_LSUMonPartLd0" VAL_BLK 0x1CE3D4 Kwb_Wu16 65535.00 OneToOne 0.00 65535.00 FORMAT "%8.2" NUMBER 4 /end CHARACTERISTIC
/begin CHARACTERISTIC DSM_CDCDfp_MIL_C "CARB spezifischer Fehlercode fuer Fehlerpfad Dfp_MIL" VAL_BLK 0x1CE3DC Kwb_Wu16 65535.00 OneToOne 0.00 65535.00 FORMAT "%8.2" NUMBER 4 /end CHARACTERISTIC
/begin CHARACTERISTIC DSM_CDCDfp_MRlyCD_C "CARB spezifischer Fehlercode fuer Fehlerpfad Dfp_MRlyCD" VAL_BLK 0x1CE3E4 Kwb_Wu16 65535.00 OneToOne 0.00 65535.00 FORMAT "%8.2" NUMBER 4 /end CHARACTERISTIC
/begin CHARACTERISTIC DSM_CDCDfp_Montr_C "CARB spezifischer Fehlercode fuer Fehlerpfad Dfp_Montr" VAL_BLK 0x1CE3EC Kwb_Wu16 65535.00 OneToOne 0.00 65535.00 FORMAT "%8.2" NUMBER 4 /end CHARACTERISTIC
/begin CHARACTERISTIC DSM_CDCDfp_OTSCD_C "CARB spezifischer Fehlercode fuer Fehlerpfad Dfp_OTSCD" VAL_BLK 0x1CE3F4 Kwb_Wu16 65535.00 OneToOne 0.00 65535.00 FORMAT "%8.2" NUMBER 4 /end CHARACTERISTIC
/begin CHARACTERISTIC DSM_CDCDfp_OTSCDCanInac_C "CARB spezifischer Fehlercode fuer Fehlerpfad Dfp_OTSCDCanInac" VAL_BLK 0x1CE3FC Kwb_Wu16 65535.00 OneToOne 0.00 65535.00 FORMAT "%8.2" NUMBER 4 /end CHARACTERISTIC
/begin CHARACTERISTIC DSM_CDCDfp_OTSCDCanSig_C "CARB spezifischer Fehlercode fuer Fehlerpfad Dfp_OTSCDCanSig" VAL_BLK 0x1CE404 Kwb_Wu16 65535.00 OneToOne 0.00 65535.00 FORMAT "%8.2" NUMBER 4 /end CHARACTERISTIC
/begin CHARACTERISTIC DSM_CDCDfp_OvRMon_C "CARB spezifischer Fehlercode fuer Fehlerpfad Dfp_OvRMon" VAL_BLK 0x1CE414 Kwb_Wu16 65535.00 OneToOne 0.00 65535.00 FORMAT "%8.2" NUMBER 4 /end CHARACTERISTIC
/begin CHARACTERISTIC DSM_CDCDfp_OvRMonCrCtlP_C "CARB spezifischer Fehlercode fuer Fehlerpfad Dfp_OvRMonCrCtlP" VAL_BLK 0x1CE41C Kwb_Wu16 65535.00 OneToOne 0.00 65535.00 FORMAT "%8.2" NUMBER 4 /end CHARACTERISTIC
/begin CHARACTERISTIC DSM_CDCDfp_OvRMonSigA_C "CARB spezifischer Fehlercode fuer Fehlerpfad Dfp_OvRMonSigA" VAL_BLK 0x1CE424 Kwb_Wu16 65535.00 OneToOne 0.00 65535.00 FORMAT "%8.2" NUMBER 4 /end CHARACTERISTIC
/begin CHARACTERISTIC DSM_CDCDfp_OxiCCDTPre_C "CARB spezifischer Fehlercode fuer Fehlerpfad Dfp_OxiCCDTPre" VAL_BLK 0x1CE42C Kwb_Wu16 65535.00 OneToOne 0.00 65535.00 FORMAT "%8.2" NUMBER 4 /end CHARACTERISTIC
/begin CHARACTERISTIC DSM_CDCDfp_OxiCCDTPre1_C "CARB spezifischer Fehlercode fuer Fehlerpfad Dfp_OxiCCDTPre1" VAL_BLK 0x1CE434 Kwb_Wu16 65535.00 OneToOne 0.00 65535.00 FORMAT "%8.2" NUMBER 4 /end CHARACTERISTIC
/begin CHARACTERISTIC DSM_CDCDfp_PCR_BalGovDev_C "CARB spezifischer Fehlercode fuer Fehlerpfad Dfp_PCR_BalGovDev" VAL_BLK 0x1CE43C Kwb_Wu16 65535.00 OneToOne 0.00 65535.00 FORMAT "%8.2" NUMBER 4 /end CHARACTERISTIC
/begin CHARACTERISTIC DSM_CDCDfp_PCR_GovDev_C "CARB spezifischer Fehlercode fuer Fehlerpfad Dfp_PCR_GovDev" VAL_BLK 0x1CE444 Kwb_Wu16 65535.00 OneToOne 0.00 65535.00 FORMAT "%8.2" NUMBER 4 /end CHARACTERISTIC
/begin CHARACTERISTIC DSM_CDCDfp_PFltAPSens_C "CARB spezifischer Fehlercode fuer Fehlerpfad Dfp_PFltAPSens" VAL_BLK 0x1CE44C Kwb_Wu16 65535.00 OneToOne 0.00 65535.00 FORMAT "%8.2" NUMBER 4 /end CHARACTERISTIC
/begin CHARACTERISTIC DSM_CDCDfp_PFltCDHtg_C "CARB spezifischer Fehlercode fuer Fehlerpfad Dfp_PFltCDHtg" VAL_BLK 0x1CE454 Kwb_Wu16 65535.00 OneToOne 0.00 65535.00 FORMAT "%8.2" NUMBER 4 /end CHARACTERISTIC
/begin CHARACTERISTIC DSM_CDCDfp_PFltCDHtg1_C "CARB spezifischer Fehlercode fuer Fehlerpfad Dfp_PFltCDHtg1" VAL_BLK 0x1CE45C Kwb_Wu16 65535.00 OneToOne 0.00 65535.00 FORMAT "%8.2" NUMBER 4 /end CHARACTERISTIC
/begin CHARACTERISTIC DSM_CDCDfp_PFltCDPDiff_C "CARB spezifischer Fehlercode fuer Fehlerpfad Dfp_PFltCDPDiff" VAL_BLK 0x1CE464 Kwb_Wu16 65535.00 OneToOne 0.00 65535.00 FORMAT "%8.2" NUMBER 4 /end CHARACTERISTIC
/begin CHARACTERISTIC DSM_CDCDfp_PFltCDTempPre_C "CARB spezifischer Fehlercode fuer Fehlerpfad Dfp_PFltCDTempPre" VAL_BLK 0x1CE46C Kwb_Wu16 65535.00 OneToOne 0.00 65535.00 FORMAT "%8.2" NUMBER 4 /end CHARACTERISTIC
/begin CHARACTERISTIC DSM_CDCDfp_PFltCDTempPre1_C "CARB spezifischer Fehlercode fuer Fehlerpfad Dfp_PFltCDTempPre1" VAL_BLK 0x1CE474 Kwb_Wu16 65535.00 OneToOne 0.00 65535.00 FORMAT "%8.2" NUMBER 4 /end CHARACTERISTIC
/begin CHARACTERISTIC DSM_CDCDfp_PFltCDTempPst_C "CARB spezifischer Fehlercode fuer Fehlerpfad Dfp_PFltCDTempPst" VAL_BLK 0x1CE47C Kwb_Wu16 65535.00 OneToOne 0.00 65535.00 FORMAT "%8.2" NUMBER 4 /end CHARACTERISTIC
/begin CHARACTERISTIC DSM_CDCDfp_PFltChar_C "CARB spezifischer Fehlercode fuer Fehlerpfad Dfp_PFltChar" VAL_BLK 0x1CE484 Kwb_Wu16 65535.00 OneToOne 0.00 65535.00 FORMAT "%8.2" NUMBER 4 /end CHARACTERISTIC
/begin CHARACTERISTIC DSM_CDCDfp_PFltEngPrt_C "CARB spezifischer Fehlercode fuer Fehlerpfad Dfp_PFltEngPrt" VAL_BLK 0x1CE48C Kwb_Wu16 65535.00 OneToOne 0.00 65535.00 FORMAT "%8.2" NUMBER 4 /end CHARACTERISTIC
/begin CHARACTERISTIC DSM_CDCDfp_PFltPresDynPlaus_C "CARB spezifischer Fehlercode fuer Fehlerpfad Dfp_PFltPresDynPlaus" VAL_BLK 0x1CE494 Kwb_Wu16 65535.00 OneToOne 0.00 65535.00 FORMAT "%8.2" NUMBER 4 /end CHARACTERISTIC
/begin CHARACTERISTIC DSM_CDCDfp_PFltPresHsChng_C "CARB spezifischer Fehlercode fuer Fehlerpfad Dfp_PFltPresHsChng" VAL_BLK 0x1CE49C Kwb_Wu16 65535.00 OneToOne 0.00 65535.00 FORMAT "%8.2" NUMBER 4 /end CHARACTERISTIC
/begin CHARACTERISTIC DSM_CDCDfp_PFltPresSens_C "CARB spezifischer Fehlercode fuer Fehlerpfad Dfp_PFltPresSens" VAL_BLK 0x1CE4A4 Kwb_Wu16 65535.00 OneToOne 0.00 65535.00 FORMAT "%8.2" NUMBER 4 /end CHARACTERISTIC
/begin CHARACTERISTIC DSM_CDCDfp_PFltPresSensFrz_C "CARB spezifischer Fehlercode fuer Fehlerpfad Dfp_PFltPresSensFrz" VAL_BLK 0x1CE4AC Kwb_Wu16 65535.00 OneToOne 0.00 65535.00 FORMAT "%8.2" NUMBER 4 /end CHARACTERISTIC
/begin CHARACTERISTIC DSM_CDCDfp_PFltPresSensHsLn_C "CARB spezifischer Fehlercode fuer Fehlerpfad Dfp_PFltPresSensHsLn" VAL_BLK 0x1CE4B4 Kwb_Wu16 65535.00 OneToOne 0.00 65535.00 FORMAT "%8.2" NUMBER 4 /end CHARACTERISTIC
/begin CHARACTERISTIC DSM_CDCDfp_PFltPresSensSot_C "CARB spezifischer Fehlercode fuer Fehlerpfad Dfp_PFltPresSensSot" VAL_BLK 0x1CE4BC Kwb_Wu16 65535.00 OneToOne 0.00 65535.00 FORMAT "%8.2" NUMBER 4 /end CHARACTERISTIC
/begin CHARACTERISTIC DSM_CDCDfp_PFltRgnLckPerm_C "CARB spezifischer Fehlercode fuer Fehlerpfad Dfp_PFltRgnLckPerm" VAL_BLK 0x1CE4C4 Kwb_Wu16 65535.00 OneToOne 0.00 65535.00 FORMAT "%8.2" NUMBER 4 /end CHARACTERISTIC
/begin CHARACTERISTIC DSM_CDCDfp_PFltRgnLckPermTstr_C "CARB spezifischer Fehlercode fuer Fehlerpfad Dfp_PFltRgnLckPermTstr" VAL_BLK 0x1CE4CC Kwb_Wu16 65535.00 OneToOne 0.00 65535.00 FORMAT "%8.2" NUMBER 4 /end CHARACTERISTIC
/begin CHARACTERISTIC DSM_CDCDfp_PFltRgnPerm_C "CARB spezifischer Fehlercode fuer Fehlerpfad Dfp_PFltRgnPerm" VAL_BLK 0x1CE4D4 Kwb_Wu16 65535.00 OneToOne 0.00 65535.00 FORMAT "%8.2" NUMBER 4 /end CHARACTERISTIC
/begin CHARACTERISTIC DSM_CDCDfp_PFltSotSimPresPerm_C "CARB spezifischer Fehlercode fuer Fehlerpfad Dfp_PFltSotSimPresPerm" VAL_BLK 0x1CE4DC Kwb_Wu16 65535.00 OneToOne 0.00 65535.00 FORMAT "%8.2" NUMBER 4 /end CHARACTERISTIC
/begin CHARACTERISTIC DSM_CDCDfp_PFltTempDwnStrm_C "CARB spezifischer Fehlercode fuer Fehlerpfad Dfp_PFltTempDwnStrm" VAL_BLK 0x1CE4E4 Kwb_Wu16 65535.00 OneToOne 0.00 65535.00 FORMAT "%8.2" NUMBER 4 /end CHARACTERISTIC
/begin CHARACTERISTIC DSM_CDCDfp_PFltTempDwnStrmMax_C "CARB spezifischer Fehlercode fuer Fehlerpfad Dfp_PFltTempDwnStrmMax" VAL_BLK 0x1CE4EC Kwb_Wu16 65535.00 OneToOne 0.00 65535.00 FORMAT "%8.2" NUMBER 4 /end CHARACTERISTIC
/begin CHARACTERISTIC DSM_CDCDfp_PFltTempDwnStrmMin_C "CARB spezifischer Fehlercode fuer Fehlerpfad Dfp_PFltTempDwnStrmMin" VAL_BLK 0x1CE4F4 Kwb_Wu16 65535.00 OneToOne 0.00 65535.00 FORMAT "%8.2" NUMBER 4 /end CHARACTERISTIC
/begin CHARACTERISTIC DSM_CDCDfp_PFltTempPreOxiC_C "CARB spezifischer Fehlercode fuer Fehlerpfad Dfp_PFltTempPreOxiC" VAL_BLK 0x1CE4FC Kwb_Wu16 65535.00 OneToOne 0.00 65535.00 FORMAT "%8.2" NUMBER 4 /end CHARACTERISTIC
/begin CHARACTERISTIC DSM_CDCDfp_PFltTempPrePFlt_C "CARB spezifischer Fehlercode fuer Fehlerpfad Dfp_PFltTempPrePFlt" VAL_BLK 0x1CE504 Kwb_Wu16 65535.00 OneToOne 0.00 65535.00 FORMAT "%8.2" NUMBER 4 /end CHARACTERISTIC
/begin CHARACTERISTIC DSM_CDCDfp_PFltTempPreTrbn_C "CARB spezifischer Fehlercode fuer Fehlerpfad Dfp_PFltTempPreTrbn" VAL_BLK 0x1CE50C Kwb_Wu16 65535.00 OneToOne 0.00 65535.00 FORMAT "%8.2" NUMBER 4 /end CHARACTERISTIC
/begin CHARACTERISTIC DSM_CDCDfp_PFltTempPstPFlt_C "CARB spezifischer Fehlercode fuer Fehlerpfad Dfp_PFltTempPstPFlt" VAL_BLK 0x1CE51C Kwb_Wu16 65535.00 OneToOne 0.00 65535.00 FORMAT "%8.2" NUMBER 4 /end CHARACTERISTIC
/begin CHARACTERISTIC DSM_CDCDfp_PFltTempSens_C "CARB spezifischer Fehlercode fuer Fehlerpfad Dfp_PFltTempSens" VAL_BLK 0x1CE524 Kwb_Wu16 65535.00 OneToOne 0.00 65535.00 FORMAT "%8.2" NUMBER 4 /end CHARACTERISTIC
/begin CHARACTERISTIC DSM_CDCDfp_PFltTempSens2_C "CARB spezifischer Fehlercode fuer Fehlerpfad Dfp_PFltTempSens2" VAL_BLK 0x1CE52C Kwb_Wu16 65535.00 OneToOne 0.00 65535.00 FORMAT "%8.2" NUMBER 4 /end CHARACTERISTIC
/begin CHARACTERISTIC DSM_CDCDfp_PFltTempUpStrm_C "CARB spezifischer Fehlercode fuer Fehlerpfad Dfp_PFltTempUpStrm" VAL_BLK 0x1CE534 Kwb_Wu16 65535.00 OneToOne 0.00 65535.00 FORMAT "%8.2" NUMBER 4 /end CHARACTERISTIC
/begin CHARACTERISTIC DSM_CDCDfp_PFltTempUpStrmMax_C "CARB spezifischer Fehlercode fuer Fehlerpfad Dfp_PFltTempUpStrmMax" VAL_BLK 0x1CE53C Kwb_Wu16 65535.00 OneToOne 0.00 65535.00 FORMAT "%8.2" NUMBER 4 /end CHARACTERISTIC
/begin CHARACTERISTIC DSM_CDCDfp_PFltTempUpStrmMin_C "CARB spezifischer Fehlercode fuer Fehlerpfad Dfp_PFltTempUpStrmMin" VAL_BLK 0x1CE544 Kwb_Wu16 65535.00 OneToOne 0.00 65535.00 FORMAT "%8.2" NUMBER 4 /end CHARACTERISTIC
/begin CHARACTERISTIC DSM_CDCDfp_PSPCD_Actr_C "CARB spezifischer Fehlercode fuer Fehlerpfad Dfp_PSPCD_Actr" VAL_BLK 0x1CE54C Kwb_Wu16 65535.00 OneToOne 0.00 65535.00 FORMAT "%8.2" NUMBER 4 /end CHARACTERISTIC
/begin CHARACTERISTIC DSM_CDCDfp_PrpCtlvLimErrPat_C "CARB spezifischer Fehlercode fuer Fehlerpfad Dfp_PrpCtlvLimErrPat" VAL_BLK 0x1CE554 Kwb_Wu16 65535.00 OneToOne 0.00 65535.00 FORMAT "%8.2" NUMBER 4 /end CHARACTERISTIC
/begin CHARACTERISTIC DSM_CDCDfp_SOPTst_C "CARB spezifischer Fehlercode fuer Fehlerpfad Dfp_SOPTst" VAL_BLK 0x1CE55C Kwb_Wu16 65535.00 OneToOne 0.00 65535.00 FORMAT "%8.2" NUMBER 4 /end CHARACTERISTIC
/begin CHARACTERISTIC DSM_CDCDfp_SSpMon1_C "CARB spezifischer Fehlercode fuer Fehlerpfad Dfp_SSpMon1" VAL_BLK 0x1CE564 Kwb_Wu16 65535.00 OneToOne 0.00 65535.00 FORMAT "%8.2" NUMBER 4 /end CHARACTERISTIC
/begin CHARACTERISTIC DSM_CDCDfp_SSpMon2_C "CARB spezifischer Fehlercode fuer Fehlerpfad Dfp_SSpMon2" VAL_BLK 0x1CE56C Kwb_Wu16 65535.00 OneToOne 0.00 65535.00 FORMAT "%8.2" NUMBER 4 /end CHARACTERISTIC
/begin CHARACTERISTIC DSM_CDCDfp_SSpMon3_C "CARB spezifischer Fehlercode fuer Fehlerpfad Dfp_SSpMon3" VAL_BLK 0x1CE574 Kwb_Wu16 65535.00 OneToOne 0.00 65535.00 FORMAT "%8.2" NUMBER 4 /end CHARACTERISTIC
/begin CHARACTERISTIC DSM_CDCDfp_Shtrp_EGRBA_C "CARB spezifischer Fehlercode fuer Fehlerpfad Dfp_Shtrp_EGRBA" VAL_BLK 0x1CE57C Kwb_Wu16 65535.00 OneToOne 0.00 65535.00 FORMAT "%8.2" NUMBER 4 /end CHARACTERISTIC
/begin CHARACTERISTIC DSM_CDCDfp_Shtrp_PCRBA_C "CARB spezifischer Fehlercode fuer Fehlerpfad Dfp_Shtrp_PCRBA" VAL_BLK 0x1CE584 Kwb_Wu16 65535.00 OneToOne 0.00 65535.00 FORMAT "%8.2" NUMBER 4 /end CHARACTERISTIC
/begin CHARACTERISTIC DSM_CDCDfp_SrvPmpStSAEcu_C "CARB spezifischer Fehlercode fuer Fehlerpfad Dfp_SrvPmpStSAEcu" VAL_BLK 0x1CE58C Kwb_Wu16 65535.00 OneToOne 0.00 65535.00 FORMAT "%8.2" NUMBER 4 /end CHARACTERISTIC
/begin CHARACTERISTIC DSM_CDCDfp_StSysCtlShCirBatt_C "CARB spezifischer Fehlercode fuer Fehlerpfad Dfp_StSysCtlShCirBatt" VAL_BLK 0x1CE594 Kwb_Wu16 65535.00 OneToOne 0.00 65535.00 FORMAT "%8.2" NUMBER 4 /end CHARACTERISTIC
/begin CHARACTERISTIC DSM_CDCDfp_StrtCDOffRly_C "CARB spezifischer Fehlercode für Fehlerpfad Dfp_StrtCDOffRly" VAL_BLK 0x1CE59C Kwb_Wu16 65535.00 OneToOne 0.00 65535.00 FORMAT "%8.2" NUMBER 4 /end CHARACTERISTIC
/begin CHARACTERISTIC DSM_CDCDfp_StrtCDOnRly_C "CARB spezifischer Fehlercode für Fehlerpfad Dfp_StrtCDOnRly" VAL_BLK 0x1CE5A4 Kwb_Wu16 65535.00 OneToOne 0.00 65535.00 FORMAT "%8.2" NUMBER 4 /end CHARACTERISTIC
/begin CHARACTERISTIC DSM_CDCDfp_StrtCtlIlsNotPlaus_C "CARB spezifischer Fehlercode für Fehlerpfad Dfp_StrtCtlIlsNotPlaus" VAL_BLK 0x1CE5AC Kwb_Wu16 65535.00 OneToOne 0.00 65535.00 FORMAT "%8.2" NUMBER 4 /end CHARACTERISTIC
/begin CHARACTERISTIC DSM_CDCDfp_StrtCtlT50ROneRly1_C "CARB spezifischer Fehlercode fuer Fehlerpfad Dfp_StrtCtlT50ROneRly1" VAL_BLK 0x1CE5B4 Kwb_Wu16 65535.00 OneToOne 0.00 65535.00 FORMAT "%8.2" NUMBER 4 /end CHARACTERISTIC
/begin CHARACTERISTIC DSM_CDCDfp_StrtCtlT50ROneRly2_C "CARB spezifischer Fehlercode fuer Fehlerpfad Dfp_StrtCtlT50ROneRly2" VAL_BLK 0x1CE5BC Kwb_Wu16 65535.00 OneToOne 0.00 65535.00 FORMAT "%8.2" NUMBER 4 /end CHARACTERISTIC
/begin CHARACTERISTIC DSM_CDCDfp_StrtCtlT50RZero_C "CARB spezifischer Fehlercode fuer Fehlerpfad Dfp_StrtCtlT50RZero" VAL_BLK 0x1CE5C4 Kwb_Wu16 65535.00 OneToOne 0.00 65535.00 FORMAT "%8.2" NUMBER 4 /end CHARACTERISTIC
/begin CHARACTERISTIC DSM_CDCDfp_SysLamp_C "CARB spezifischer Fehlercode fuer Fehlerpfad Dfp_SysLamp" VAL_BLK 0x1CE5CC Kwb_Wu16 65535.00 OneToOne 0.00 65535.00 FORMAT "%8.2" NUMBER 4 /end CHARACTERISTIC
/begin CHARACTERISTIC DSM_CDCDfp_T15CD_C "CARB spezifischer Fehlercode fuer Fehlerpfad Dfp_T15CD" VAL_BLK 0x1CE5D4 Kwb_Wu16 65535.00 OneToOne 0.00 65535.00 FORMAT "%8.2" NUMBER 4 /end CHARACTERISTIC
/begin CHARACTERISTIC DSM_CDCDfp_T50CD_C "CARB spezifischer Fehlercode fuer Fehlerpfad Dfp_T50CD" VAL_BLK 0x1CE5DC Kwb_Wu16 65535.00 OneToOne 0.00 65535.00 FORMAT "%8.2" NUMBER 4 /end CHARACTERISTIC
/begin CHARACTERISTIC DSM_CDCDfp_TPUMon_C "CARB spezifischer Fehlercode fuer Fehlerpfad Dfp_TPUMon" VAL_BLK 0x1CE5E4 Kwb_Wu16 65535.00 OneToOne 0.00 65535.00 FORMAT "%8.2" NUMBER 4 /end CHARACTERISTIC
/begin CHARACTERISTIC DSM_CDCDfp_TVACD_Max_C "CARB spezifischer Fehlercode fuer Fehlerpfad Dfp_TVACD_Max" VAL_BLK 0x1CE5EC Kwb_Wu16 65535.00 OneToOne 0.00 65535.00 FORMAT "%8.2" NUMBER 4 /end CHARACTERISTIC
/begin CHARACTERISTIC DSM_CDCDfp_TVACD_Min_C "CARB spezifischer Fehlercode fuer Fehlerpfad Dfp_TVACD_Min" VAL_BLK 0x1CE5F4 Kwb_Wu16 65535.00 OneToOne 0.00 65535.00 FORMAT "%8.2" NUMBER 4 /end CHARACTERISTIC
/begin CHARACTERISTIC DSM_CDCDfp_TVACD_Sig_C "CARB spezifischer Fehlercode fuer Fehlerpfad Dfp_TVACD_Sig" VAL_BLK 0x1CE5FC Kwb_Wu16 65535.00 OneToOne 0.00 65535.00 FORMAT "%8.2" NUMBER 4 /end CHARACTERISTIC
/begin CHARACTERISTIC DSM_CDCDfp_TVACD_SigNpl_C "CARB spezifischer Fehlercode fuer Fehlerpfad Dfp_TVACD_SigNpl" VAL_BLK 0x1CE604 Kwb_Wu16 65535.00 OneToOne 0.00 65535.00 FORMAT "%8.2" NUMBER 4 /end CHARACTERISTIC
/begin CHARACTERISTIC DSM_CDCDfp_TVACD_stLineDef_C "CARB spezifischer Fehlercode fuer Fehlerpfad Dfp_TVACD_stLineDef" VAL_BLK 0x1CE60C Kwb_Wu16 65535.00 OneToOne 0.00 65535.00 FORMAT "%8.2" NUMBER 4 /end CHARACTERISTIC
/begin CHARACTERISTIC DSM_CDCDfp_TVASCD_C "CARB spezifischer Fehlercode fuer Fehlerpfad Dfp_TVASCD" VAL_BLK 0x1CE614 Kwb_Wu16 65535.00 OneToOne 0.00 65535.00 FORMAT "%8.2" NUMBER 4 /end CHARACTERISTIC
/begin CHARACTERISTIC DSM_CDCDfp_TVASCD_Drft_C "CARB spezifischer Fehlercode fuer Fehlerpfad Dfp_TVASCD_Drft" VAL_BLK 0x1CE61C Kwb_Wu16 65535.00 OneToOne 0.00 65535.00 FORMAT "%8.2" NUMBER 4 /end CHARACTERISTIC
/begin CHARACTERISTIC DSM_CDCDfp_ThrVlvGvnrDvt_C "CARB spezifischer Fehlercode fuer Fehlerpfad Dfp_ThrVlvGvnrDvt" VAL_BLK 0x1CE624 Kwb_Wu16 65535.00 OneToOne 0.00 65535.00 FORMAT "%8.2" NUMBER 4 /end CHARACTERISTIC
/begin CHARACTERISTIC DSM_CDCDfp_ThrVlvJamVlv_C "CARB spezifischer Fehlercode fuer Fehlerpfad Dfp_ThrVlvJamVlv" VAL_BLK 0x1CE62C Kwb_Wu16 65535.00 OneToOne 0.00 65535.00 FORMAT "%8.2" NUMBER 4 /end CHARACTERISTIC
/begin CHARACTERISTIC DSM_CDCDfp_UAcc_CodeBitErr_C "CARB spezifischer Fehlercode fuer Fehlerpfad Dfp_UAcc_CodeBitErr" VAL_BLK 0x1CE634 Kwb_Wu16 65535.00 OneToOne 0.00 65535.00 FORMAT "%8.2" NUMBER 4 /end CHARACTERISTIC
/begin CHARACTERISTIC DSM_CDCDfp_USAp_DataVariant_C "CARB spezifischer Fehlercode fuer Fehlerpfad Dfp_USAp_DataVariant" VAL_BLK 0x1CE63C Kwb_Wu16 65535.00 OneToOne 0.00 65535.00 FORMAT "%8.2" NUMBER 4 /end CHARACTERISTIC
/begin CHARACTERISTIC DSM_CDCDfp_USAp_FuncCodeRead_C "CARB spezifischer Fehlercode fuer Fehlerpfad Dfp_USAp_FuncCodeRead" VAL_BLK 0x1CE644 Kwb_Wu16 65535.00 OneToOne 0.00 65535.00 FORMAT "%8.2" NUMBER 4 /end CHARACTERISTIC
/begin CHARACTERISTIC DSM_CDCDfp_VSACD_Max_C "CARB spezifischer Fehlercode fuer Fehlerpfad Dfp_VSACD_Max" VAL_BLK 0x1CE64C Kwb_Wu16 65535.00 OneToOne 0.00 65535.00 FORMAT "%8.2" NUMBER 4 /end CHARACTERISTIC
/begin CHARACTERISTIC DSM_CDCDfp_VSACD_Min_C "CARB spezifischer Fehlercode fuer Fehlerpfad Dfp_VSACD_Min" VAL_BLK 0x1CE654 Kwb_Wu16 65535.00 OneToOne 0.00 65535.00 FORMAT "%8.2" NUMBER 4 /end CHARACTERISTIC
/begin CHARACTERISTIC DSM_CDCDfp_VSACD_SigNpl_C "CARB spezifischer Fehlercode fuer Fehlerpfad Dfp_VSACD_SigNpl" VAL_BLK 0x1CE65C Kwb_Wu16 65535.00 OneToOne 0.00 65535.00 FORMAT "%8.2" NUMBER 4 /end CHARACTERISTIC
/begin CHARACTERISTIC DSM_CDCDfp_VSSCD_C "CARB spezifischer Fehlercode fuer Fehlerpfad Dfp_VSSCD" VAL_BLK 0x1CE664 Kwb_Wu16 65535.00 OneToOne 0.00 65535.00 FORMAT "%8.2" NUMBER 4 /end CHARACTERISTIC
/begin CHARACTERISTIC DSM_CDCDfp_VSSCD1_C "CARB spezifischer Fehlercode fuer Fehlerpfad Dfp_VSSCD1" VAL_BLK 0x1CE66C Kwb_Wu16 65535.00 OneToOne 0.00 65535.00 FORMAT "%8.2" NUMBER 4 /end CHARACTERISTIC
/begin CHARACTERISTIC DSM_CDCDfp_VSSCD2_C "CARB spezifischer Fehlercode fuer Fehlerpfad Dfp_VSSCD2" VAL_BLK 0x1CE674 Kwb_Wu16 65535.00 OneToOne 0.00 65535.00 FORMAT "%8.2" NUMBER 4 /end CHARACTERISTIC
/begin CHARACTERISTIC DSM_CDCDfp_VSSCD4_C "CARB spezifischer Fehlercode fuer Fehlerpfad Dfp_VSSCD4" VAL_BLK 0x1CE67C Kwb_Wu16 65535.00 OneToOne 0.00 65535.00 FORMAT "%8.2" NUMBER 4 /end CHARACTERISTIC
/begin CHARACTERISTIC DSM_CDCDfp_VSSCDBrkLowVltg_C "CARB spezifischer Fehlercode fuer Fehlerpfad Dfp_VSSCDBrkLowVltg" VAL_BLK 0x1CE684 Kwb_Wu16 65535.00 OneToOne 0.00 65535.00 FORMAT "%8.2" NUMBER 4 /end CHARACTERISTIC
/begin CHARACTERISTIC DSM_CDCDfp_VSSCDCAN_C "CARB spezifischer Fehlercode fuer Fehlerpfad Dfp_VSSCDCAN" VAL_BLK 0x1CE68C Kwb_Wu16 65535.00 OneToOne 0.00 65535.00 FORMAT "%8.2" NUMBER 4 /end CHARACTERISTIC
/begin CHARACTERISTIC DSM_CDCDfp_VSSCDNpl_C "CARB spezifischer Fehlercode fuer Fehlerpfad Dfp_VSSCDNpl" VAL_BLK 0x1CE694 Kwb_Wu16 65535.00 OneToOne 0.00 65535.00 FORMAT "%8.2" NUMBER 4 /end CHARACTERISTIC
/begin CHARACTERISTIC DSM_CDCDfp_WdCom_C "CARB spezifischer Fehlercode fuer Fehlerpfad Dfp_WdCom" VAL_BLK 0x1CE6A4 Kwb_Wu16 65535.00 OneToOne 0.00 65535.00 FORMAT "%8.2" NUMBER 4 /end CHARACTERISTIC
/begin CHARACTERISTIC DSM_CDKDfp_ACCCD_C "Kundenspezifischer Fehlercode fuer Fehlerpfad Dfp_ACCCD" VAL_BLK 0x1CE6AC Kwb_Wu16 65535.00 OneToOne 0.00 65535.00 FORMAT "%8.2" NUMBER 4 /end CHARACTERISTIC
/begin CHARACTERISTIC DSM_CDKDfp_ACCCDBrkErr_C "Kundenspezifischer Fehlercode fuer Fehlerpfad Dfp_ACCCDBrkErr" VAL_BLK 0x1CE6B4 Kwb_Wu16 65535.00 OneToOne 0.00 65535.00 FORMAT "%8.2" NUMBER 4 /end CHARACTERISTIC
/begin CHARACTERISTIC DSM_CDKDfp_ACCCDBrkNPL_C "Kundenspezifischer Fehlercode fuer Fehlerpfad Dfp_ACCCDBrkNPL" VAL_BLK 0x1CE6BC Kwb_Wu16 65535.00 OneToOne 0.00 65535.00 FORMAT "%8.2" NUMBER 4 /end CHARACTERISTIC
/begin CHARACTERISTIC DSM_CDKDfp_ACCCDSensErr_C "Kundenspezifischer Fehlercode fuer Fehlerpfad Dfp_ACCCDSensErr" VAL_BLK 0x1CE6C4 Kwb_Wu16 65535.00 OneToOne 0.00 65535.00 FORMAT "%8.2" NUMBER 4 /end CHARACTERISTIC
/begin CHARACTERISTIC DSM_CDKDfp_ACCCDWrongCoded_C "Kundenspezifischer Fehlercode fuer Fehlerpfad Dfp_ACCCDWrongCoded" VAL_BLK 0x1CE6CC Kwb_Wu16 65535.00 OneToOne 0.00 65535.00 FORMAT "%8.2" NUMBER 4 /end CHARACTERISTIC
/begin CHARACTERISTIC DSM_CDKDfp_ACCD_C "Kundenspezifischer Fehlercode fuer Fehlerpfad Dfp_ACCD" VAL_BLK 0x1CE6D4 Kwb_Wu16 65535.00 OneToOne 0.00 65535.00 FORMAT "%8.2" NUMBER 4 /end CHARACTERISTIC
/begin CHARACTERISTIC DSM_CDKDfp_ACCD_PAC_C "Kundenspezifischer Fehlercode fuer Fehlerpfad Dfp_ACCD_PAC" VAL_BLK 0x1CE6DC Kwb_Wu16 65535.00 OneToOne 0.00 65535.00 FORMAT "%8.2" NUMBER 4 /end CHARACTERISTIC
/begin CHARACTERISTIC DSM_CDKDfp_ACCD_pCAN_C "Kundenspezifischer Fehlercode fuer Fehlerpfad Dfp_ACCD_pCAN" VAL_BLK 0x1CE6E4 Kwb_Wu16 65535.00 OneToOne 0.00 65535.00 FORMAT "%8.2" NUMBER 4 /end CHARACTERISTIC
/begin CHARACTERISTIC DSM_CDKDfp_ACCD_trqCAN_C "Kundenspezifischer Fehlercode fuer Fehlerpfad Dfp_ACCD_trqCAN" VAL_BLK 0x1CE6EC Kwb_Wu16 65535.00 OneToOne 0.00 65535.00 FORMAT "%8.2" NUMBER 4 /end CHARACTERISTIC
/begin CHARACTERISTIC DSM_CDKDfp_ACCIRevPanErr_C "Kundenspezifischer Fehlercode fuer Fehlerpfad Dfp_ACCIRevPanErr" VAL_BLK 0x1CE6F4 Kwb_Wu16 65535.00 OneToOne 0.00 65535.00 FORMAT "%8.2" NUMBER 4 /end CHARACTERISTIC
/begin CHARACTERISTIC DSM_CDKDfp_ACCIRevShOff_C "Kundenspezifischer Fehlercode fuer Fehlerpfad Dfp_ACCIRevShOff" VAL_BLK 0x1CE6FC Kwb_Wu16 65535.00 OneToOne 0.00 65535.00 FORMAT "%8.2" NUMBER 4 /end CHARACTERISTIC
/begin CHARACTERISTIC DSM_CDKDfp_ACCnotPlaus_C "Kundenspezifischer Fehlercode fuer Fehlerpfad Dfp_ACCnotPlaus" VAL_BLK 0x1CE704 Kwb_Wu16 65535.00 OneToOne 0.00 65535.00 FORMAT "%8.2" NUMBER 4 /end CHARACTERISTIC
/begin CHARACTERISTIC DSM_CDKDfp_ADCMon_C "Kundenspezifischer Fehlercode fuer Fehlerpfad Dfp_ADCMon" VAL_BLK 0x1CE70C Kwb_Wu16 65535.00 OneToOne 0.00 65535.00 FORMAT "%8.2" NUMBER 4 /end CHARACTERISTIC
/begin CHARACTERISTIC DSM_CDKDfp_AFSCD_PlOffsDrft_C "Kundenspezifischer Fehlercode fuer Fehlerpfad Dfp_AFSCD_PlOffsDrft" VAL_BLK 0x1CE714 Kwb_Wu16 65535.00 OneToOne 0.00 65535.00 FORMAT "%8.2" NUMBER 4 /end CHARACTERISTIC
/begin CHARACTERISTIC DSM_CDKDfp_AFSCD_PlSetyDrft_C "Kundenspezifischer Fehlercode fuer Fehlerpfad Dfp_AFSCD_PlSetyDrft" VAL_BLK 0x1CE71C Kwb_Wu16 65535.00 OneToOne 0.00 65535.00 FORMAT "%8.2" NUMBER 4 /end CHARACTERISTIC
/begin CHARACTERISTIC DSM_CDKDfp_AFSCD_SRCAirm_C "Kundenspezifischer Fehlercode fuer Fehlerpfad Dfp_AFSCD_SRCAirm" VAL_BLK 0x1CE724 Kwb_Wu16 65535.00 OneToOne 0.00 65535.00 FORMAT "%8.2" NUMBER 4 /end CHARACTERISTIC
/begin CHARACTERISTIC DSM_CDKDfp_AFVCD_Actr_C "Kundenspezifischer Fehlercode fuer Fehlerpfad Dfp_AFVCD_Actr" VAL_BLK 0x1CE72C Kwb_Wu16 65535.00 OneToOne 0.00 65535.00 FORMAT "%8.2" NUMBER 4 /end CHARACTERISTIC
/begin CHARACTERISTIC DSM_CDKDfp_AOHtCDHt1_C "Kundenspezifischer Fehlercode fuer Fehlerpfad Dfp_AOHtCDHt1" VAL_BLK 0x1CE734 Kwb_Wu16 65535.00 OneToOne 0.00 65535.00 FORMAT "%8.2" NUMBER 4 /end CHARACTERISTIC
/begin CHARACTERISTIC DSM_CDKDfp_AOHtCDHt2_C "Kundenspezifischer Fehlercode fuer Fehlerpfad Dfp_AOHtCDHt2" VAL_BLK 0x1CE73C Kwb_Wu16 65535.00 OneToOne 0.00 65535.00 FORMAT "%8.2" NUMBER 4 /end CHARACTERISTIC
/begin CHARACTERISTIC DSM_CDKDfp_AOHtCDHt3_C "Kundenspezifischer Fehlercode fuer Fehlerpfad Dfp_AOHtCDHt3" VAL_BLK 0x1CE744 Kwb_Wu16 65535.00 OneToOne 0.00 65535.00 FORMAT "%8.2" NUMBER 4 /end CHARACTERISTIC
/begin CHARACTERISTIC DSM_CDKDfp_APP1_C "Kundenspezifischer Fehlercode fuer Fehlerpfad Dfp_APP1" VAL_BLK 0x1CE74C Kwb_Wu16 65535.00 OneToOne 0.00 65535.00 FORMAT "%8.2" NUMBER 4 /end CHARACTERISTIC
/begin CHARACTERISTIC DSM_CDKDfp_APP2_C "Kundenspezifischer Fehlercode fuer Fehlerpfad Dfp_APP2" VAL_BLK 0x1CE754 Kwb_Wu16 65535.00 OneToOne 0.00 65535.00 FORMAT "%8.2" NUMBER 4 /end CHARACTERISTIC
/begin CHARACTERISTIC DSM_CDKDfp_APPCD_KickDown_C "Kundenspezifischer Fehlercode fuer Fehlerpfad Dfp_APPCD_KickDown" VAL_BLK 0x1CE75C Kwb_Wu16 65535.00 OneToOne 0.00 65535.00 FORMAT "%8.2" NUMBER 4 /end CHARACTERISTIC
/begin CHARACTERISTIC DSM_CDKDfp_APPCD_PWGDrft_C "Kundenspezifischer Fehlercode fuer Fehlerpfad Dfp_APPCD_PWGDrft" VAL_BLK 0x1CE764 Kwb_Wu16 65535.00 OneToOne 0.00 65535.00 FORMAT "%8.2" NUMBER 4 /end CHARACTERISTIC
/begin CHARACTERISTIC DSM_CDKDfp_APPSync_C "Kundenspezifischer Fehlercode fuer Fehlerpfad Dfp_APPSync" VAL_BLK 0x1CE76C Kwb_Wu16 65535.00 OneToOne 0.00 65535.00 FORMAT "%8.2" NUMBER 4 /end CHARACTERISTIC
/begin CHARACTERISTIC DSM_CDKDfp_APP_Npl_C "Kundenspezifischer Fehlercode fuer Fehlerpfad Dfp_APP_Npl" VAL_BLK 0x1CE774 Kwb_Wu16 65535.00 OneToOne 0.00 65535.00 FORMAT "%8.2" NUMBER 4 /end CHARACTERISTIC
/begin CHARACTERISTIC DSM_CDKDfp_APSCD_C "Kundenspezifischer Fehlercode fuer Fehlerpfad Dfp_APSCD" VAL_BLK 0x1CE77C Kwb_Wu16 65535.00 OneToOne 0.00 65535.00 FORMAT "%8.2" NUMBER 4 /end CHARACTERISTIC
/begin CHARACTERISTIC DSM_CDKDfp_AccPedPlausBrk_C "Kundenspezifischer Fehlercode fuer Fehlerpfad Dfp_AccPedPlausBrk" VAL_BLK 0x1CE784 Kwb_Wu16 65535.00 OneToOne 0.00 65535.00 FORMAT "%8.2" NUMBER 4 /end CHARACTERISTIC
/begin CHARACTERISTIC DSM_CDKDfp_AirCtl_GovDevMax_C "Kundenspezifischer Fehlercode fuer Fehlerpfad Dfp_AirCtl_GovDevMax" VAL_BLK 0x1CE78C Kwb_Wu16 65535.00 OneToOne 0.00 65535.00 FORMAT "%8.2" NUMBER 4 /end CHARACTERISTIC
/begin CHARACTERISTIC DSM_CDKDfp_AirCtl_GovDevMin_C "Kundenspezifischer Fehlercode fuer Fehlerpfad Dfp_AirCtl_GovDevMin" VAL_BLK 0x1CE794 Kwb_Wu16 65535.00 OneToOne 0.00 65535.00 FORMAT "%8.2" NUMBER 4 /end CHARACTERISTIC
/begin CHARACTERISTIC DSM_CDKDfp_AirCtl_GovDevRgnMax_C "Kundenspezifischer Fehlercode fuer Fehlerpfad Dfp_AirCtl_GovDevRgnMax" VAL_BLK 0x1CE79C Kwb_Wu16 65535.00 OneToOne 0.00 65535.00 FORMAT "%8.2" NUMBER 4 /end CHARACTERISTIC
/begin CHARACTERISTIC DSM_CDKDfp_AirCtl_GovDevRgnMin_C "Kundenspezifischer Fehlercode fuer Fehlerpfad Dfp_AirCtl_GovDevRgnMin" VAL_BLK 0x1CE7A4 Kwb_Wu16 65535.00 OneToOne 0.00 65535.00 FORMAT "%8.2" NUMBER 4 /end CHARACTERISTIC
/begin CHARACTERISTIC DSM_CDKDfp_AirbCDCrash_C "Kundenspezifischer Fehlercode fuer Fehlerpfad Dfp_AirbCDCrash" VAL_BLK 0x1CE7AC Kwb_Wu16 65535.00 OneToOne 0.00 65535.00 FORMAT "%8.2" NUMBER 4 /end CHARACTERISTIC
/begin CHARACTERISTIC DSM_CDKDfp_AirbCDCrashCrCtl_C "Kundenspezifischer Fehlercode fuer Fehlerpfad Dfp_AirbCDCrashCrCtl" VAL_BLK 0x1CE7B4 Kwb_Wu16 65535.00 OneToOne 0.00 65535.00 FORMAT "%8.2" NUMBER 4 /end CHARACTERISTIC
/begin CHARACTERISTIC DSM_CDKDfp_AirbCDCrashPSP_C "Kundenspezifischer Fehlercode fuer Fehlerpfad Dfp_AirbCDCrashPSP" VAL_BLK 0x1CE7BC Kwb_Wu16 65535.00 OneToOne 0.00 65535.00 FORMAT "%8.2" NUMBER 4 /end CHARACTERISTIC
/begin CHARACTERISTIC DSM_CDKDfp_AltCDExc_C "Kundenspezifischer Fehlercode fuer Fehlerpfad Dfp_AltCDExc" VAL_BLK 0x1CE7C4 Kwb_Wu16 65535.00 OneToOne 0.00 65535.00 FORMAT "%8.2" NUMBER 4 /end CHARACTERISTIC
/begin CHARACTERISTIC DSM_CDKDfp_AltCD_Load_C "Kundenspezifischer Fehlercode fuer Fehlerpfad Dfp_AltCD_Load" VAL_BLK 0x1CE7CC Kwb_Wu16 65535.00 OneToOne 0.00 65535.00 FORMAT "%8.2" NUMBER 4 /end CHARACTERISTIC
/begin CHARACTERISTIC DSM_CDKDfp_AltPwrCan_C "Kundenspezifischer Fehlercode fuer Fehlerpfad Dfp_AltPwrCan" VAL_BLK 0x1CE7D4 Kwb_Wu16 65535.00 OneToOne 0.00 65535.00 FORMAT "%8.2" NUMBER 4 /end CHARACTERISTIC
/begin CHARACTERISTIC DSM_CDKDfp_BIP01_C "Kundenspezifischer Fehlercode fuer Fehlerpfad Dfp_BIP01" VAL_BLK 0x1CE7DC Kwb_Wu16 65535.00 OneToOne 0.00 65535.00 FORMAT "%8.2" NUMBER 4 /end CHARACTERISTIC
/begin CHARACTERISTIC DSM_CDKDfp_BIP02_C "Kundenspezifischer Fehlercode fuer Fehlerpfad Dfp_BIP02" VAL_BLK 0x1CE7E4 Kwb_Wu16 65535.00 OneToOne 0.00 65535.00 FORMAT "%8.2" NUMBER 4 /end CHARACTERISTIC
/begin CHARACTERISTIC DSM_CDKDfp_BIP03_C "Kundenspezifischer Fehlercode fuer Fehlerpfad Dfp_BIP03" VAL_BLK 0x1CE7EC Kwb_Wu16 65535.00 OneToOne 0.00 65535.00 FORMAT "%8.2" NUMBER 4 /end CHARACTERISTIC
/begin CHARACTERISTIC DSM_CDKDfp_BIP04_C "Kundenspezifischer Fehlercode fuer Fehlerpfad Dfp_BIP04" VAL_BLK 0x1CE7F4 Kwb_Wu16 65535.00 OneToOne 0.00 65535.00 FORMAT "%8.2" NUMBER 4 /end CHARACTERISTIC
/begin CHARACTERISTIC DSM_CDKDfp_BIP05_C "Kundenspezifischer Fehlercode fuer Fehlerpfad Dfp_BIP05" VAL_BLK 0x1CE7FC Kwb_Wu16 65535.00 OneToOne 0.00 65535.00 FORMAT "%8.2" NUMBER 4 /end CHARACTERISTIC
/begin CHARACTERISTIC DSM_CDKDfp_BIP06_C "Kundenspezifischer Fehlercode fuer Fehlerpfad Dfp_BIP06" VAL_BLK 0x1CE804 Kwb_Wu16 65535.00 OneToOne 0.00 65535.00 FORMAT "%8.2" NUMBER 4 /end CHARACTERISTIC
/begin CHARACTERISTIC DSM_CDKDfp_BIP07_C "Kundenspezifischer Fehlercode fuer Fehlerpfad Dfp_BIP07" VAL_BLK 0x1CE80C Kwb_Wu16 65535.00 OneToOne 0.00 65535.00 FORMAT "%8.2" NUMBER 4 /end CHARACTERISTIC
/begin CHARACTERISTIC DSM_CDKDfp_BIP08_C "Kundenspezifischer Fehlercode fuer Fehlerpfad Dfp_BIP08" VAL_BLK 0x1CE814 Kwb_Wu16 65535.00 OneToOne 0.00 65535.00 FORMAT "%8.2" NUMBER 4 /end CHARACTERISTIC
/begin CHARACTERISTIC DSM_CDKDfp_BIP09_C "Kundenspezifischer Fehlercode fuer Fehlerpfad Dfp_BIP09" VAL_BLK 0x1CE81C Kwb_Wu16 65535.00 OneToOne 0.00 65535.00 FORMAT "%8.2" NUMBER 4 /end CHARACTERISTIC
/begin CHARACTERISTIC DSM_CDKDfp_BIP10_C "Kundenspezifischer Fehlercode fuer Fehlerpfad Dfp_BIP10" VAL_BLK 0x1CE824 Kwb_Wu16 65535.00 OneToOne 0.00 65535.00 FORMAT "%8.2" NUMBER 4 /end CHARACTERISTIC
/begin CHARACTERISTIC DSM_CDKDfp_BIP11_C "Kundenspezifischer Fehlercode fuer Fehlerpfad Dfp_BIP11" VAL_BLK 0x1CE82C Kwb_Wu16 65535.00 OneToOne 0.00 65535.00 FORMAT "%8.2" NUMBER 4 /end CHARACTERISTIC
/begin CHARACTERISTIC DSM_CDKDfp_BIP12_C "Kundenspezifischer Fehlercode fuer Fehlerpfad Dfp_BIP12" VAL_BLK 0x1CE834 Kwb_Wu16 65535.00 OneToOne 0.00 65535.00 FORMAT "%8.2" NUMBER 4 /end CHARACTERISTIC
/begin CHARACTERISTIC DSM_CDKDfp_BIP_Con_C "Kundenspezifischer Fehlercode fuer Fehlerpfad Dfp_BIP_Con" VAL_BLK 0x1CE83C Kwb_Wu16 65535.00 OneToOne 0.00 65535.00 FORMAT "%8.2" NUMBER 4 /end CHARACTERISTIC
/begin CHARACTERISTIC DSM_CDKDfp_BPACD_Max_C "Kundenspezifischer Fehlercode fuer Fehlerpfad Dfp_BPACD_Max" VAL_BLK 0x1CE844 Kwb_Wu16 65535.00 OneToOne 0.00 65535.00 FORMAT "%8.2" NUMBER 4 /end CHARACTERISTIC
/begin CHARACTERISTIC DSM_CDKDfp_BPACD_Max2_C "Kundenspezifischer Fehlercode fuer Fehlerpfad Dfp_BPACD_Max2" VAL_BLK 0x1CE84C Kwb_Wu16 65535.00 OneToOne 0.00 65535.00 FORMAT "%8.2" NUMBER 4 /end CHARACTERISTIC
/begin CHARACTERISTIC DSM_CDKDfp_BPACD_Min_C "Kundenspezifischer Fehlercode fuer Fehlerpfad Dfp_BPACD_Min" VAL_BLK 0x1CE854 Kwb_Wu16 65535.00 OneToOne 0.00 65535.00 FORMAT "%8.2" NUMBER 4 /end CHARACTERISTIC
/begin CHARACTERISTIC DSM_CDKDfp_BPACD_Min2_C "Kundenspezifischer Fehlercode fuer Fehlerpfad Dfp_BPACD_Min2" VAL_BLK 0x1CE85C Kwb_Wu16 65535.00 OneToOne 0.00 65535.00 FORMAT "%8.2" NUMBER 4 /end CHARACTERISTIC
/begin CHARACTERISTIC DSM_CDKDfp_BPACD_SigNpl_C "Kundenspezifischer Fehlercode fuer Fehlerpfad Dfp_BPACD_SigNpl" VAL_BLK 0x1CE864 Kwb_Wu16 65535.00 OneToOne 0.00 65535.00 FORMAT "%8.2" NUMBER 4 /end CHARACTERISTIC
/begin CHARACTERISTIC DSM_CDKDfp_BPACD_SigNpl2_C "Kundenspezifischer Fehlercode fuer Fehlerpfad Dfp_BPACD_SigNpl2" VAL_BLK 0x1CE86C Kwb_Wu16 65535.00 OneToOne 0.00 65535.00 FORMAT "%8.2" NUMBER 4 /end CHARACTERISTIC
/begin CHARACTERISTIC DSM_CDKDfp_BPASCD_C "Kundenspezifischer Fehlercode fuer Fehlerpfad Dfp_BPASCD" VAL_BLK 0x1CE874 Kwb_Wu16 65535.00 OneToOne 0.00 65535.00 FORMAT "%8.2" NUMBER 4 /end CHARACTERISTIC
/begin CHARACTERISTIC DSM_CDKDfp_BPSCD_C "Kundenspezifischer Fehlercode fuer Fehlerpfad Dfp_BPSCD" VAL_BLK 0x1CE87C Kwb_Wu16 65535.00 OneToOne 0.00 65535.00 FORMAT "%8.2" NUMBER 4 /end CHARACTERISTIC
/begin CHARACTERISTIC DSM_CDKDfp_BattCD_C "Kundenspezifischer Fehlercode fuer Fehlerpfad Dfp_BattCD" VAL_BLK 0x1CE88C Kwb_Wu16 65535.00 OneToOne 0.00 65535.00 FORMAT "%8.2" NUMBER 4 /end CHARACTERISTIC
/begin CHARACTERISTIC DSM_CDKDfp_BrkCD_C "Kundenspezifischer Fehlercode fuer Fehlerpfad Dfp_BrkCD" VAL_BLK 0x1CE894 Kwb_Wu16 65535.00 OneToOne 0.00 65535.00 FORMAT "%8.2" NUMBER 4 /end CHARACTERISTIC
/begin CHARACTERISTIC DSM_CDKDfp_BrkCDBPTInvld_C "Kundenspezifischer Fehlercode fuer Fehlerpfad Dfp_BrkCDBPTInvld" VAL_BLK 0x1CE89C Kwb_Wu16 65535.00 OneToOne 0.00 65535.00 FORMAT "%8.2" NUMBER 4 /end CHARACTERISTIC
/begin CHARACTERISTIC DSM_CDKDfp_BrkCDdynPl_C "Kundenspezifischer Fehlercode fuer Fehlerpfad Dfp_BrkCDdynPl" VAL_BLK 0x1CE8A4 Kwb_Wu16 65535.00 OneToOne 0.00 65535.00 FORMAT "%8.2" NUMBER 4 /end CHARACTERISTIC
/begin CHARACTERISTIC DSM_CDKDfp_CANA_C "Kundenspezifischer Fehlercode fuer Fehlerpfad Dfp_CANA" VAL_BLK 0x1CE8AC Kwb_Wu16 65535.00 OneToOne 0.00 65535.00 FORMAT "%8.2" NUMBER 4 /end CHARACTERISTIC
/begin CHARACTERISTIC DSM_CDKDfp_CANB_C "Kundenspezifischer Fehlercode fuer Fehlerpfad Dfp_CANB" VAL_BLK 0x1CE8B4 Kwb_Wu16 65535.00 OneToOne 0.00 65535.00 FORMAT "%8.2" NUMBER 4 /end CHARACTERISTIC
/begin CHARACTERISTIC DSM_CDKDfp_CANBus1_C "Kundenspezifischer Fehlercode fuer Fehlerpfad Dfp_CANBus1" VAL_BLK 0x1CE8BC Kwb_Wu16 65535.00 OneToOne 0.00 65535.00 FORMAT "%8.2" NUMBER 4 /end CHARACTERISTIC
/begin CHARACTERISTIC DSM_CDKDfp_CANBus2_C "Kundenspezifischer Fehlercode fuer Fehlerpfad Dfp_CANBus2" VAL_BLK 0x1CE8C4 Kwb_Wu16 65535.00 OneToOne 0.00 65535.00 FORMAT "%8.2" NUMBER 4 /end CHARACTERISTIC
/begin CHARACTERISTIC DSM_CDKDfp_CANBus3_C "Kundenspezifischer Fehlercode fuer Fehlerpfad Dfp_CANBus3" VAL_BLK 0x1CE8CC Kwb_Wu16 65535.00 OneToOne 0.00 65535.00 FORMAT "%8.2" NUMBER 4 /end CHARACTERISTIC
/begin CHARACTERISTIC DSM_CDKDfp_CANC_C "Kundenspezifischer Fehlercode fuer Fehlerpfad Dfp_CANC" VAL_BLK 0x1CE8D4 Kwb_Wu16 65535.00 OneToOne 0.00 65535.00 FORMAT "%8.2" NUMBER 4 /end CHARACTERISTIC
/begin CHARACTERISTIC DSM_CDKDfp_CANErrActA_C "Kundenspezifischer Fehlercode fuer Fehlerpfad Dfp_CANErrActA" VAL_BLK 0x1CE8DC Kwb_Wu16 65535.00 OneToOne 0.00 65535.00 FORMAT "%8.2" NUMBER 4 /end CHARACTERISTIC
/begin CHARACTERISTIC DSM_CDKDfp_CANErrActB_C "Kundenspezifischer Fehlercode fuer Fehlerpfad Dfp_CANErrActB" VAL_BLK 0x1CE8E4 Kwb_Wu16 65535.00 OneToOne 0.00 65535.00 FORMAT "%8.2" NUMBER 4 /end CHARACTERISTIC
/begin CHARACTERISTIC DSM_CDKDfp_CANErrActC_C "Kundenspezifischer Fehlercode fuer Fehlerpfad Dfp_CANErrActC" VAL_BLK 0x1CE8EC Kwb_Wu16 65535.00 OneToOne 0.00 65535.00 FORMAT "%8.2" NUMBER 4 /end CHARACTERISTIC
/begin CHARACTERISTIC DSM_CDKDfp_COTSCD_C "Kundenspezifischer Fehlercode fuer Fehlerpfad Dfp_COTSCD" VAL_BLK 0x1CE8F4 Kwb_Wu16 65535.00 OneToOne 0.00 65535.00 FORMAT "%8.2" NUMBER 4 /end CHARACTERISTIC
/begin CHARACTERISTIC DSM_CDKDfp_CTSCD_C "Kundenspezifischer Fehlercode fuer Fehlerpfad Dfp_CTSCD" VAL_BLK 0x1CE8FC Kwb_Wu16 65535.00 OneToOne 0.00 65535.00 FORMAT "%8.2" NUMBER 4 /end CHARACTERISTIC
/begin CHARACTERISTIC DSM_CDKDfp_CTSCDCanInac_C "Kundenspezifischer Fehlercode fuer Fehlerpfad Dfp_CTSCDCanInac" VAL_BLK 0x1CE904 Kwb_Wu16 65535.00 OneToOne 0.00 65535.00 FORMAT "%8.2" NUMBER 4 /end CHARACTERISTIC
/begin CHARACTERISTIC DSM_CDKDfp_CTSCDCanSig_C "Kundenspezifischer Fehlercode fuer Fehlerpfad Dfp_CTSCDCanSig" VAL_BLK 0x1CE90C Kwb_Wu16 65535.00 OneToOne 0.00 65535.00 FORMAT "%8.2" NUMBER 4 /end CHARACTERISTIC
/begin CHARACTERISTIC DSM_CDKDfp_Clg_DynTst_C "Kundenspezifischer Fehlercode fuer Fehlerpfad Dfp_Clg_DynTst" VAL_BLK 0x1CE914 Kwb_Wu16 65535.00 OneToOne 0.00 65535.00 FORMAT "%8.2" NUMBER 4 /end CHARACTERISTIC
/begin CHARACTERISTIC DSM_CDKDfp_CmbChbMisfire1_C "Kundenspezifischer Fehlercode fuer Fehlerpfad Dfp_CmbChbMisfire1" VAL_BLK 0x1CE91C Kwb_Wu16 65535.00 OneToOne 0.00 65535.00 FORMAT "%8.2" NUMBER 4 /end CHARACTERISTIC
/begin CHARACTERISTIC DSM_CDKDfp_CmbChbMisfire2_C "Kundenspezifischer Fehlercode fuer Fehlerpfad Dfp_CmbChbMisfire2" VAL_BLK 0x1CE924 Kwb_Wu16 65535.00 OneToOne 0.00 65535.00 FORMAT "%8.2" NUMBER 4 /end CHARACTERISTIC
/begin CHARACTERISTIC DSM_CDKDfp_CmbChbMisfire3_C "Kundenspezifischer Fehlercode fuer Fehlerpfad Dfp_CmbChbMisfire3" VAL_BLK 0x1CE92C Kwb_Wu16 65535.00 OneToOne 0.00 65535.00 FORMAT "%8.2" NUMBER 4 /end CHARACTERISTIC
/begin CHARACTERISTIC DSM_CDKDfp_CmbChbMisfire4_C "Kundenspezifischer Fehlercode fuer Fehlerpfad Dfp_CmbChbMisfire4" VAL_BLK 0x1CE934 Kwb_Wu16 65535.00 OneToOne 0.00 65535.00 FORMAT "%8.2" NUMBER 4 /end CHARACTERISTIC
/begin CHARACTERISTIC DSM_CDKDfp_CmbChbMisfire5_C "Kundenspezifischer Fehlercode fuer Fehlerpfad Dfp_CmbChbMisfire5" VAL_BLK 0x1CE93C Kwb_Wu16 65535.00 OneToOne 0.00 65535.00 FORMAT "%8.2" NUMBER 4 /end CHARACTERISTIC
/begin CHARACTERISTIC DSM_CDKDfp_CmbChbMisfire6_C "Kundenspezifischer Fehlercode fuer Fehlerpfad Dfp_CmbChbMisfire6" VAL_BLK 0x1CE944 Kwb_Wu16 65535.00 OneToOne 0.00 65535.00 FORMAT "%8.2" NUMBER 4 /end CHARACTERISTIC
/begin CHARACTERISTIC DSM_CDKDfp_CmbChbMisfireMul_C "Kundenspezifischer Fehlercode fuer Fehlerpfad Dfp_CmbChbMisfireMul" VAL_BLK 0x1CE94C Kwb_Wu16 65535.00 OneToOne 0.00 65535.00 FORMAT "%8.2" NUMBER 4 /end CHARACTERISTIC
/begin CHARACTERISTIC DSM_CDKDfp_CoVMDCSh_C "Kundenspezifischer Fehlercode fuer Fehlerpfad Dfp_CoVMDCSh" VAL_BLK 0x1CE95C Kwb_Wu16 65535.00 OneToOne 0.00 65535.00 FORMAT "%8.2" NUMBER 4 /end CHARACTERISTIC
/begin CHARACTERISTIC DSM_CDKDfp_CoVMDCSp_C "Kundenspezifischer Fehlercode fuer Fehlerpfad Dfp_CoVMDCSp" VAL_BLK 0x1CE964 Kwb_Wu16 65535.00 OneToOne 0.00 65535.00 FORMAT "%8.2" NUMBER 4 /end CHARACTERISTIC
/begin CHARACTERISTIC DSM_CDKDfp_CoVehLvl2_C "Kundenspezifischer Fehlercode fuer Fehlerpfad Dfp_CoVehLvl2" VAL_BLK 0x1CE97C Kwb_Wu16 65535.00 OneToOne 0.00 65535.00 FORMAT "%8.2" NUMBER 4 /end CHARACTERISTIC
/begin CHARACTERISTIC DSM_CDKDfp_ConvCD_C "Kundenspezifischer Fehlercode fuer Fehlerpfad Dfp_ConvCD" VAL_BLK 0x1CE984 Kwb_Wu16 65535.00 OneToOne 0.00 65535.00 FORMAT "%8.2" NUMBER 4 /end CHARACTERISTIC
/begin CHARACTERISTIC DSM_CDKDfp_ConvCD_ConvErr_C "Kundenspezifischer Fehlercode fuer Fehlerpfad Dfp_ConvCD_ConvErr" VAL_BLK 0x1CE98C Kwb_Wu16 65535.00 OneToOne 0.00 65535.00 FORMAT "%8.2" NUMBER 4 /end CHARACTERISTIC
/begin CHARACTERISTIC DSM_CDKDfp_ConvCD_EPB1_C "Kundenspezifischer Fehlercode fuer Fehlerpfad Dfp_ConvCD_EPB1" VAL_BLK 0x1CE994 Kwb_Wu16 65535.00 OneToOne 0.00 65535.00 FORMAT "%8.2" NUMBER 4 /end CHARACTERISTIC
/begin CHARACTERISTIC DSM_CDKDfp_CrCCDPanErrMSG_C "Kundenspezifischer Fehlercode fuer Fehlerpfad Dfp_CrCCDPanErrMSG" VAL_BLK 0x1CE99C Kwb_Wu16 65535.00 OneToOne 0.00 65535.00 FORMAT "%8.2" NUMBER 4 /end CHARACTERISTIC
/begin CHARACTERISTIC DSM_CDKDfp_CrCCDPanErrSMLS_C "Kundenspezifischer Fehlercode fuer Fehlerpfad Dfp_CrCCDPanErrSMLS" VAL_BLK 0x1CE9A4 Kwb_Wu16 65535.00 OneToOne 0.00 65535.00 FORMAT "%8.2" NUMBER 4 /end CHARACTERISTIC
/begin CHARACTERISTIC DSM_CDKDfp_CrCCDPanMainSwtErr_C "Kundenspezifischer Fehlercode fuer Fehlerpfad Dfp_CrCCDPanMainSwtErr" VAL_BLK 0x1CE9AC Kwb_Wu16 65535.00 OneToOne 0.00 65535.00 FORMAT "%8.2" NUMBER 4 /end CHARACTERISTIC
/begin CHARACTERISTIC DSM_CDKDfp_CrCtlDsplNotPlaus_C "Kundenspezifischer Fehlercode fuer Fehlerpfad Dfp_CrCtlDsplNotPlaus" VAL_BLK 0x1CE9BC Kwb_Wu16 65535.00 OneToOne 0.00 65535.00 FORMAT "%8.2" NUMBER 4 /end CHARACTERISTIC
/begin CHARACTERISTIC DSM_CDKDfp_CrCtlPECDErr_C "Kundenspezifischer Fehlercode fuer Fehlerpfad Dfp_CrCtlPECDErr" VAL_BLK 0x1CE9C4 Kwb_Wu16 65535.00 OneToOne 0.00 65535.00 FORMAT "%8.2" NUMBER 4 /end CHARACTERISTIC
/begin CHARACTERISTIC DSM_CDKDfp_CrCtlPLmpDef_C "Kundenspezifischer Fehlercode fuer Fehlerpfad Dfp_CrCtlPLmpDef" VAL_BLK 0x1CE9CC Kwb_Wu16 65535.00 OneToOne 0.00 65535.00 FORMAT "%8.2" NUMBER 4 /end CHARACTERISTIC
/begin CHARACTERISTIC DSM_CDKDfp_CrCtlPShutOff_C "Kundenspezifischer Fehlercode fuer Fehlerpfad Dfp_CrCtlPShutOff" VAL_BLK 0x1CE9D4 Kwb_Wu16 65535.00 OneToOne 0.00 65535.00 FORMAT "%8.2" NUMBER 4 /end CHARACTERISTIC
/begin CHARACTERISTIC DSM_CDKDfp_CrCtlPTlrDef_C "Kundenspezifischer Fehlercode fuer Fehlerpfad Dfp_CrCtlPTlrDef" VAL_BLK 0x1CE9DC Kwb_Wu16 65535.00 OneToOne 0.00 65535.00 FORMAT "%8.2" NUMBER 4 /end CHARACTERISTIC
/begin CHARACTERISTIC DSM_CDKDfp_CtApCD_C "Kundenspezifischer Fehlercode fuer Fehlerpfad Dfp_CtApCD" VAL_BLK 0x1CE9EC Kwb_Wu16 65535.00 OneToOne 0.00 65535.00 FORMAT "%8.2" NUMBER 4 /end CHARACTERISTIC
/begin CHARACTERISTIC DSM_CDKDfp_CtTCD_C "Kundenspezifischer Fehlercode fuer Fehlerpfad Dfp_CtTCD" VAL_BLK 0x1CE9F4 Kwb_Wu16 65535.00 OneToOne 0.00 65535.00 FORMAT "%8.2" NUMBER 4 /end CHARACTERISTIC
/begin CHARACTERISTIC DSM_CDKDfp_CtT_Mon_C "Kundenspezifischer Fehlercode fuer Fehlerpfad Dfp_CtT_Mon" VAL_BLK 0x1CE9FC Kwb_Wu16 65535.00 OneToOne 0.00 65535.00 FORMAT "%8.2" NUMBER 4 /end CHARACTERISTIC
/begin CHARACTERISTIC DSM_CDKDfp_DifftrqLimErrPat_C "Kundenspezifischer Fehlercode fuer Fehlerpfad Dfp_DifftrqLimErrPat" VAL_BLK 0x1CEA04 Kwb_Wu16 65535.00 OneToOne 0.00 65535.00 FORMAT "%8.2" NUMBER 4 /end CHARACTERISTIC
/begin CHARACTERISTIC DSM_CDKDfp_EATSCD_C "Kundenspezifischer Fehlercode fuer Fehlerpfad Dfp_EATSCD" VAL_BLK 0x1CEA0C Kwb_Wu16 65535.00 OneToOne 0.00 65535.00 FORMAT "%8.2" NUMBER 4 /end CHARACTERISTIC
/begin CHARACTERISTIC DSM_CDKDfp_EATSCDCanInac_C "Kundenspezifischer Fehlercode fuer Fehlerpfad Dfp_EATSCDCanInac" VAL_BLK 0x1CEA14 Kwb_Wu16 65535.00 OneToOne 0.00 65535.00 FORMAT "%8.2" NUMBER 4 /end CHARACTERISTIC
/begin CHARACTERISTIC DSM_CDKDfp_EATSCDCanSig_C "Kundenspezifischer Fehlercode fuer Fehlerpfad Dfp_EATSCDCanSig" VAL_BLK 0x1CEA1C Kwb_Wu16 65535.00 OneToOne 0.00 65535.00 FORMAT "%8.2" NUMBER 4 /end CHARACTERISTIC
/begin CHARACTERISTIC DSM_CDKDfp_EEPCDVarMng_C "Kundenspezifischer Fehlercode fuer Fehlerpfad Dfp_EEPCD_VarMng" VAL_BLK 0x1CEA24 Kwb_Wu16 65535.00 OneToOne 0.00 65535.00 FORMAT "%8.2" NUMBER 4 /end CHARACTERISTIC
/begin CHARACTERISTIC DSM_CDKDfp_EGPpCDTPreTrbn_C "Kundenspezifischer Fehlercode fuer Fehlerpfad Dfp_EgPpCDTPreTrbn" VAL_BLK 0x1CEA2C Kwb_Wu16 65535.00 OneToOne 0.00 65535.00 FORMAT "%8.2" NUMBER 4 /end CHARACTERISTIC
/begin CHARACTERISTIC DSM_CDKDfp_EGRCD_CBV_C "Kundenspezifischer Fehlercode fuer Fehlerpfad Dfp_EGRCD_CBV" VAL_BLK 0x1CEA34 Kwb_Wu16 65535.00 OneToOne 0.00 65535.00 FORMAT "%8.2" NUMBER 4 /end CHARACTERISTIC
/begin CHARACTERISTIC DSM_CDKDfp_EGRCD_Max_C "Kundenspezifischer Fehlercode fuer Fehlerpfad Dfp_EGRCD_Max" VAL_BLK 0x1CEA3C Kwb_Wu16 65535.00 OneToOne 0.00 65535.00 FORMAT "%8.2" NUMBER 4 /end CHARACTERISTIC
/begin CHARACTERISTIC DSM_CDKDfp_EGRCD_Min_C "Kundenspezifischer Fehlercode fuer Fehlerpfad Dfp_EGRCD_Min" VAL_BLK 0x1CEA44 Kwb_Wu16 65535.00 OneToOne 0.00 65535.00 FORMAT "%8.2" NUMBER 4 /end CHARACTERISTIC
/begin CHARACTERISTIC DSM_CDKDfp_EGRCD_Sig_C "Kundenspezifischer Fehlercode fuer Fehlerpfad Dfp_EGRCD_Sig" VAL_BLK 0x1CEA4C Kwb_Wu16 65535.00 OneToOne 0.00 65535.00 FORMAT "%8.2" NUMBER 4 /end CHARACTERISTIC
/begin CHARACTERISTIC DSM_CDKDfp_EGRCD_SigNpl_C "Kundenspezifischer Fehlercode fuer Fehlerpfad Dfp_EGRCD_SigNpl" VAL_BLK 0x1CEA54 Kwb_Wu16 65535.00 OneToOne 0.00 65535.00 FORMAT "%8.2" NUMBER 4 /end CHARACTERISTIC
/begin CHARACTERISTIC DSM_CDKDfp_EGRSCD_C "Kundenspezifischer Fehlercode fuer Fehlerpfad Dfp_EGRSCD" VAL_BLK 0x1CEA5C Kwb_Wu16 65535.00 OneToOne 0.00 65535.00 FORMAT "%8.2" NUMBER 4 /end CHARACTERISTIC
/begin CHARACTERISTIC DSM_CDKDfp_EGRSCD_JamVlv_C "Kundenspezifischer Fehlercode fuer Fehlerpfad Dfp_EGRSCD_JamVlv" VAL_BLK 0x1CEA64 Kwb_Wu16 65535.00 OneToOne 0.00 65535.00 FORMAT "%8.2" NUMBER 4 /end CHARACTERISTIC
/begin CHARACTERISTIC DSM_CDKDfp_EGRSCD_LgTimeDrft_C "Kundenspezifischer Fehlercode fuer Fehlerpfad Dfp_EGRSCD_LgTimeDrft" VAL_BLK 0x1CEA6C Kwb_Wu16 65535.00 OneToOne 0.00 65535.00 FORMAT "%8.2" NUMBER 4 /end CHARACTERISTIC
/begin CHARACTERISTIC DSM_CDKDfp_EGRSCD_ShTimeDrft_C "Kundenspezifischer Fehlercode fuer Fehlerpfad Dfp_EGRSCD_ShTimeDrft" VAL_BLK 0x1CEA74 Kwb_Wu16 65535.00 OneToOne 0.00 65535.00 FORMAT "%8.2" NUMBER 4 /end CHARACTERISTIC
/begin CHARACTERISTIC DSM_CDKDfp_EGRVlvGvnrDvt_C "Kundenspezifischer Fehlercode fuer Fehlerpfad Dfp_EGRVlvGvnrDvt" VAL_BLK 0x1CEA7C Kwb_Wu16 65535.00 OneToOne 0.00 65535.00 FORMAT "%8.2" NUMBER 4 /end CHARACTERISTIC
/begin CHARACTERISTIC DSM_CDKDfp_EGRVlv_JamVlv_C "Kundenspezifischer Fehlercode fuer Fehlerpfad Dfp_EGRVlv_JamVlv" VAL_BLK 0x1CEA84 Kwb_Wu16 65535.00 OneToOne 0.00 65535.00 FORMAT "%8.2" NUMBER 4 /end CHARACTERISTIC
/begin CHARACTERISTIC DSM_CDKDfp_EMCCD_MLS1_C "Kundenspezifischer Fehlercode fuer Fehlerpfad Dfp_EMCCD_MLS1" VAL_BLK 0x1CEA8C Kwb_Wu16 65535.00 OneToOne 0.00 65535.00 FORMAT "%8.2" NUMBER 4 /end CHARACTERISTIC
/begin CHARACTERISTIC DSM_CDKDfp_EngMBackUp_C "Kundenspezifischer Fehlercode fuer Fehlerpfad Dfp_EngMBackUp" VAL_BLK 0x1CEA94 Kwb_Wu16 65535.00 OneToOne 0.00 65535.00 FORMAT "%8.2" NUMBER 4 /end CHARACTERISTIC
/begin CHARACTERISTIC DSM_CDKDfp_EngMCaS1_C "Kundenspezifischer Fehlercode fuer Fehlerpfad Dfp_EngMCaS1" VAL_BLK 0x1CEA9C Kwb_Wu16 65535.00 OneToOne 0.00 65535.00 FORMAT "%8.2" NUMBER 4 /end CHARACTERISTIC
/begin CHARACTERISTIC DSM_CDKDfp_EngMCaSDrv_C "Kundenspezifischer Fehlercode fuer Fehlerpfad Dfp_EngMCaSDrv" VAL_BLK 0x1CEAA4 Kwb_Wu16 65535.00 OneToOne 0.00 65535.00 FORMAT "%8.2" NUMBER 4 /end CHARACTERISTIC
/begin CHARACTERISTIC DSM_CDKDfp_EngMCrS1_C "Kundenspezifischer Fehlercode fuer Fehlerpfad Dfp_EngMCrS1" VAL_BLK 0x1CEAAC Kwb_Wu16 65535.00 OneToOne 0.00 65535.00 FORMAT "%8.2" NUMBER 4 /end CHARACTERISTIC
/begin CHARACTERISTIC DSM_CDKDfp_EngMOfsCaSCrS_C "Kundenspezifischer Fehlercode fuer Fehlerpfad Dfp_EngMOfsCaSCrS" VAL_BLK 0x1CEAB4 Kwb_Wu16 65535.00 OneToOne 0.00 65535.00 FORMAT "%8.2" NUMBER 4 /end CHARACTERISTIC
/begin CHARACTERISTIC DSM_CDKDfp_EngMonIrrCmb_C "Kundenspezifischer Fehlercode fuer Fehlerpfad Dfp_EngMonIrrCmb" VAL_BLK 0x1CEABC Kwb_Wu16 65535.00 OneToOne 0.00 65535.00 FORMAT "%8.2" NUMBER 4 /end CHARACTERISTIC
/begin CHARACTERISTIC DSM_CDKDfp_EngPrt_C "Kundenspezifischer Fehlercode fuer Fehlerpfad Dfp_EngPrt" VAL_BLK 0x1CEAC4 Kwb_Wu16 65535.00 OneToOne 0.00 65535.00 FORMAT "%8.2" NUMBER 4 /end CHARACTERISTIC
/begin CHARACTERISTIC DSM_CDKDfp_ErLpCDMILReqON_C "Kundenspezifischer Fehlercode fuer Fehlerpfad Dfp_ErLpCDMILReqON" VAL_BLK 0x1CEACC Kwb_Wu16 65535.00 OneToOne 0.00 65535.00 FORMAT "%8.2" NUMBER 4 /end CHARACTERISTIC
/begin CHARACTERISTIC DSM_CDKDfp_FMAErrMod_C "Kundenspezifischer Fehlercode fuer Fehlerpfad Dfp_FMAErrMod" VAL_BLK 0x1CEAD4 Kwb_Wu16 65535.00 OneToOne 0.00 65535.00 FORMAT "%8.2" NUMBER 4 /end CHARACTERISTIC
/begin CHARACTERISTIC DSM_CDKDfp_FMTC_NonMonotonMap_C "Kundenspezifischer Fehlercode fuer Fehlerpfad Dfp_FMTC_NonMonotonMap" VAL_BLK 0x1CEADC Kwb_Wu16 65535.00 OneToOne 0.00 65535.00 FORMAT "%8.2" NUMBER 4 /end CHARACTERISTIC
/begin CHARACTERISTIC DSM_CDKDfp_FQTSCD_C "Kundenspezifischer Fehlercode fuer Fehlerpfad Dfp_FQTSCD" VAL_BLK 0x1CEAE4 Kwb_Wu16 65535.00 OneToOne 0.00 65535.00 FORMAT "%8.2" NUMBER 4 /end CHARACTERISTIC
/begin CHARACTERISTIC DSM_CDKDfp_FQlSCD_C "Kundenspezifischer Fehlercode fuer Fehlerpfad Dfp_FQlSCD" VAL_BLK 0x1CEAEC Kwb_Wu16 65535.00 OneToOne 0.00 65535.00 FORMAT "%8.2" NUMBER 4 /end CHARACTERISTIC
/begin CHARACTERISTIC DSM_CDKDfp_FTSCD_C "Kundenspezifischer Fehlercode fuer Fehlerpfad Dfp_FTSCD" VAL_BLK 0x1CEAF4 Kwb_Wu16 65535.00 OneToOne 0.00 65535.00 FORMAT "%8.2" NUMBER 4 /end CHARACTERISTIC
/begin CHARACTERISTIC DSM_CDKDfp_FTSCDNpl_C "Kundenspezifischer Fehlercode fuer Fehlerpfad Dfp_FTSCDNpl" VAL_BLK 0x1CEAFC Kwb_Wu16 65535.00 OneToOne 0.00 65535.00 FORMAT "%8.2" NUMBER 4 /end CHARACTERISTIC
/begin CHARACTERISTIC DSM_CDKDfp_FanCD_Fan1Ctlr1_C "Kundenspezifischer Fehlercode fuer Fehlerpfad Dfp_FanCD_Fan1Ctlr1" VAL_BLK 0x1CEB04 Kwb_Wu16 65535.00 OneToOne 0.00 65535.00 FORMAT "%8.2" NUMBER 4 /end CHARACTERISTIC
/begin CHARACTERISTIC DSM_CDKDfp_FanCD_Fan1Ctlr2_C "Kundenspezifischer Fehlercode fuer Fehlerpfad Dfp_FanCD_Fan1Ctlr2" VAL_BLK 0x1CEB0C Kwb_Wu16 65535.00 OneToOne 0.00 65535.00 FORMAT "%8.2" NUMBER 4 /end CHARACTERISTIC
/begin CHARACTERISTIC DSM_CDKDfp_FanCD_Fan2Ctlr1_C "Kundenspezifischer Fehlercode fuer Fehlerpfad Dfp_FanCD_Fan2Ctlr1" VAL_BLK 0x1CEB14 Kwb_Wu16 65535.00 OneToOne 0.00 65535.00 FORMAT "%8.2" NUMBER 4 /end CHARACTERISTIC
/begin CHARACTERISTIC DSM_CDKDfp_FanCD_Fan2Ctlr2_C "Kundenspezifischer Fehlercode fuer Fehlerpfad Dfp_FanCD_Fan2Ctlr2" VAL_BLK 0x1CEB1C Kwb_Wu16 65535.00 OneToOne 0.00 65535.00 FORMAT "%8.2" NUMBER 4 /end CHARACTERISTIC
/begin CHARACTERISTIC DSM_CDKDfp_FanCD_FanCtlr1_C "Kundenspezifischer Fehlercode fuer Fehlerpfad Dfp_FanCD_FanCtlr1" VAL_BLK 0x1CEB24 Kwb_Wu16 65535.00 OneToOne 0.00 65535.00 FORMAT "%8.2" NUMBER 4 /end CHARACTERISTIC
/begin CHARACTERISTIC DSM_CDKDfp_FanCD_FanCtlr2_C "Kundenspezifischer Fehlercode fuer Fehlerpfad Dfp_FanCD_FanCtlr2" VAL_BLK 0x1CEB2C Kwb_Wu16 65535.00 OneToOne 0.00 65535.00 FORMAT "%8.2" NUMBER 4 /end CHARACTERISTIC
/begin CHARACTERISTIC DSM_CDKDfp_FanCD_OutFanCtlr1_C "Kundenspezifischer Fehlercode fuer Fehlerpfad Dfp_FanCD_OutFanCtlr1" VAL_BLK 0x1CEB34 Kwb_Wu16 65535.00 OneToOne 0.00 65535.00 FORMAT "%8.2" NUMBER 4 /end CHARACTERISTIC
/begin CHARACTERISTIC DSM_CDKDfp_FanCD_OutFanCtlr2_C "Kundenspezifischer Fehlercode fuer Fehlerpfad Dfp_FanCD_OutFanCtlr2" VAL_BLK 0x1CEB3C Kwb_Wu16 65535.00 OneToOne 0.00 65535.00 FORMAT "%8.2" NUMBER 4 /end CHARACTERISTIC
/begin CHARACTERISTIC DSM_CDKDfp_FlPpCD_C "Kundenspezifischer Fehlercode fuer Fehlerpfad Dfp_FlPpCD" VAL_BLK 0x1CEB4C Kwb_Wu16 65535.00 OneToOne 0.00 65535.00 FORMAT "%8.2" NUMBER 4 /end CHARACTERISTIC
/begin CHARACTERISTIC DSM_CDKDfp_FlSCDT1_C "Kundenspezifischer Fehlercode fuer Fehlerpfad Dfp_FlSCDT1" VAL_BLK 0x1CEB54 Kwb_Wu16 65535.00 OneToOne 0.00 65535.00 FORMAT "%8.2" NUMBER 4 /end CHARACTERISTIC
/begin CHARACTERISTIC DSM_CDKDfp_FrmMngAAGNpl_C "Kundenspezifischer Fehlercode fuer Fehlerpfad Dfp_FrmMngAAGNpl" VAL_BLK 0x1CEB5C Kwb_Wu16 65535.00 OneToOne 0.00 65535.00 FORMAT "%8.2" NUMBER 4 /end CHARACTERISTIC
/begin CHARACTERISTIC DSM_CDKDfp_FrmMngAAGTO_C "Kundenspezifischer Fehlercode fuer Fehlerpfad Dfp_FrmMngAAGTO" VAL_BLK 0x1CEB64 Kwb_Wu16 65535.00 OneToOne 0.00 65535.00 FORMAT "%8.2" NUMBER 4 /end CHARACTERISTIC
/begin CHARACTERISTIC DSM_CDKDfp_FrmMngAC1Npl_C "Kundenspezifischer Fehlercode fuer Fehlerpfad Dfp_FrmMngAC1Npl" VAL_BLK 0x1CEB6C Kwb_Wu16 65535.00 OneToOne 0.00 65535.00 FORMAT "%8.2" NUMBER 4 /end CHARACTERISTIC
/begin CHARACTERISTIC DSM_CDKDfp_FrmMngAC1TO_C "Kundenspezifischer Fehlercode fuer Fehlerpfad Dfp_FrmMngAC1TO" VAL_BLK 0x1CEB74 Kwb_Wu16 65535.00 OneToOne 0.00 65535.00 FORMAT "%8.2" NUMBER 4 /end CHARACTERISTIC
/begin CHARACTERISTIC DSM_CDKDfp_FrmMngACCNpl_C "Kundenspezifischer Fehlercode fuer Fehlerpfad Dfp_FrmMngACCNpl" VAL_BLK 0x1CEB7C Kwb_Wu16 65535.00 OneToOne 0.00 65535.00 FORMAT "%8.2" NUMBER 4 /end CHARACTERISTIC
/begin CHARACTERISTIC DSM_CDKDfp_FrmMngACCTO_C "Kundenspezifischer Fehlercode fuer Fehlerpfad Dfp_FrmMngACCTO" VAL_BLK 0x1CEB84 Kwb_Wu16 65535.00 OneToOne 0.00 65535.00 FORMAT "%8.2" NUMBER 4 /end CHARACTERISTIC
/begin CHARACTERISTIC DSM_CDKDfp_FrmMngAIRBGNpl_C "Kundenspezifischer Fehlercode fuer Fehlerpfad Dfp_FrmMngAIRBGNpl" VAL_BLK 0x1CEB8C Kwb_Wu16 65535.00 OneToOne 0.00 65535.00 FORMAT "%8.2" NUMBER 4 /end CHARACTERISTIC
/begin CHARACTERISTIC DSM_CDKDfp_FrmMngAIRBGTO_C "Kundenspezifischer Fehlercode fuer Fehlerpfad Dfp_FrmMngAIRBGTO" VAL_BLK 0x1CEB94 Kwb_Wu16 65535.00 OneToOne 0.00 65535.00 FORMAT "%8.2" NUMBER 4 /end CHARACTERISTIC
/begin CHARACTERISTIC DSM_CDKDfp_FrmMngAWD1Npl_C "Kundenspezifischer Fehlercode fuer Fehlerpfad Dfp_FrmMngAWD1Npl" VAL_BLK 0x1CEB9C Kwb_Wu16 65535.00 OneToOne 0.00 65535.00 FORMAT "%8.2" NUMBER 4 /end CHARACTERISTIC
/begin CHARACTERISTIC DSM_CDKDfp_FrmMngAWD1TO_C "Kundenspezifischer Fehlercode fuer Fehlerpfad Dfp_FrmMngAWD1TO" VAL_BLK 0x1CEBA4 Kwb_Wu16 65535.00 OneToOne 0.00 65535.00 FORMAT "%8.2" NUMBER 4 /end CHARACTERISTIC
/begin CHARACTERISTIC DSM_CDKDfp_FrmMngBEM1Npl_C "Kundenspezifischer Fehlercode für Fehlerpfad Dfp_FrmMngBEM1Npl" VAL_BLK 0x1CEBAC Kwb_Wu16 65535.00 OneToOne 0.00 65535.00 FORMAT "%8.2" NUMBER 4 /end CHARACTERISTIC
/begin CHARACTERISTIC DSM_CDKDfp_FrmMngBEM1TO_C "Kundenspezifischer Fehlercode fuer Fehlerpfad Dfp_FrmMngBEM1TO" VAL_BLK 0x1CEBB4 Kwb_Wu16 65535.00 OneToOne 0.00 65535.00 FORMAT "%8.2" NUMBER 4 /end CHARACTERISTIC
/begin CHARACTERISTIC DSM_CDKDfp_FrmMngBRK1Npl_C "Kundenspezifischer Fehlercode fuer Fehlerpfad Dfp_FrmMngBRK1Npl" VAL_BLK 0x1CEBBC Kwb_Wu16 65535.00 OneToOne 0.00 65535.00 FORMAT "%8.2" NUMBER 4 /end CHARACTERISTIC
/begin CHARACTERISTIC DSM_CDKDfp_FrmMngBRK1TO_C "Kundenspezifischer Fehlercode fuer Fehlerpfad Dfp_FrmMngBRK1TO" VAL_BLK 0x1CEBC4 Kwb_Wu16 65535.00 OneToOne 0.00 65535.00 FORMAT "%8.2" NUMBER 4 /end CHARACTERISTIC
/begin CHARACTERISTIC DSM_CDKDfp_FrmMngBRK2Npl_C "Kundenspezifischer Fehlercode fuer Fehlerpfad Dfp_FrmMngBRK2Npl" VAL_BLK 0x1CEBCC Kwb_Wu16 65535.00 OneToOne 0.00 65535.00 FORMAT "%8.2" NUMBER 4 /end CHARACTERISTIC
/begin CHARACTERISTIC DSM_CDKDfp_FrmMngBRK2TO_C "Kundenspezifischer Fehlercode fuer Fehlerpfad Dfp_FrmMngBRK2TO" VAL_BLK 0x1CEBD4 Kwb_Wu16 65535.00 OneToOne 0.00 65535.00 FORMAT "%8.2" NUMBER 4 /end CHARACTERISTIC
/begin CHARACTERISTIC DSM_CDKDfp_FrmMngBRK8Npl_C "Kundenspezifischer Fehlercode fuer Fehlerpfad Dfp_FrmMngBRK8Npl" VAL_BLK 0x1CEBDC Kwb_Wu16 65535.00 OneToOne 0.00 65535.00 FORMAT "%8.2" NUMBER 4 /end CHARACTERISTIC
/begin CHARACTERISTIC DSM_CDKDfp_FrmMngBRK8TO_C "Kundenspezifischer Fehlercode fuer Fehlerpfad Dfp_FrmMngBRK8TO" VAL_BLK 0x1CEBE4 Kwb_Wu16 65535.00 OneToOne 0.00 65535.00 FORMAT "%8.2" NUMBER 4 /end CHARACTERISTIC
/begin CHARACTERISTIC DSM_CDKDfp_FrmMngBSG3TO_C "Kundenspezifischer Fehlercode fuer Fehlerpfad Dfp_FrmMngBSG3TO" VAL_BLK 0x1CEBEC Kwb_Wu16 65535.00 OneToOne 0.00 65535.00 FORMAT "%8.2" NUMBER 4 /end CHARACTERISTIC
/begin CHARACTERISTIC DSM_CDKDfp_FrmMngCANVerErr_C "Kundenspezifischer Fehlercode fuer Fehlerpfad Dfp_FrmMngCANVerErr" VAL_BLK 0x1CEBF4 Kwb_Wu16 65535.00 OneToOne 0.00 65535.00 FORMAT "%8.2" NUMBER 4 /end CHARACTERISTIC
/begin CHARACTERISTIC DSM_CDKDfp_FrmMngCCSel_C "Kundenspezifischer Fehlercode fuer Fehlerpfad Dfp_FrmMngCCSel_C" VAL_BLK 0x1CEBFC Kwb_Wu16 65535.00 OneToOne 0.00 65535.00 FORMAT "%8.2" NUMBER 4 /end CHARACTERISTIC
/begin CHARACTERISTIC DSM_CDKDfp_FrmMngCCTLNpl_C "Kundenspezifischer Fehlercode fuer Fehlerpfad Dfp_FrmMngCCTLNpl" VAL_BLK 0x1CEC04 Kwb_Wu16 65535.00 OneToOne 0.00 65535.00 FORMAT "%8.2" NUMBER 4 /end CHARACTERISTIC
/begin CHARACTERISTIC DSM_CDKDfp_FrmMngCCTLTO_C "Kundenspezifischer Fehlercode fuer Fehlerpfad Dfp_FrmMngCCTLTO" VAL_BLK 0x1CEC0C Kwb_Wu16 65535.00 OneToOne 0.00 65535.00 FORMAT "%8.2" NUMBER 4 /end CHARACTERISTIC
/begin CHARACTERISTIC DSM_CDKDfp_FrmMngCHRGR1Npl_C "Kundenspezifischer Fehlercode fuer Fehlerpfad Dfp_FrmMngCHRGR1Npl" VAL_BLK 0x1CEC14 Kwb_Wu16 65535.00 OneToOne 0.00 65535.00 FORMAT "%8.2" NUMBER 4 /end CHARACTERISTIC
/begin CHARACTERISTIC DSM_CDKDfp_FrmMngCHRGR1TO_C "Kundenspezifischer Fehlercode fuer Fehlerpfad Dfp_FrmMngCHRGR1TO" VAL_BLK 0x1CEC1C Kwb_Wu16 65535.00 OneToOne 0.00 65535.00 FORMAT "%8.2" NUMBER 4 /end CHARACTERISTIC
/begin CHARACTERISTIC DSM_CDKDfp_FrmMngCHRGR2Npl_C "Kundenspezifischer Fehlercode fuer Fehlerpfad Dfp_FrmMngCHRGR2Npl" VAL_BLK 0x1CEC24 Kwb_Wu16 65535.00 OneToOne 0.00 65535.00 FORMAT "%8.2" NUMBER 4 /end CHARACTERISTIC
/begin CHARACTERISTIC DSM_CDKDfp_FrmMngCHRGR2TO_C "Kundenspezifischer Fehlercode fuer Fehlerpfad Dfp_FrmMngCHRGR2TO" VAL_BLK 0x1CEC2C Kwb_Wu16 65535.00 OneToOne 0.00 65535.00 FORMAT "%8.2" NUMBER 4 /end CHARACTERISTIC
/begin CHARACTERISTIC DSM_CDKDfp_FrmMngChrgr1A_C "Kundenspezifischer Fehlercode fuer Fehlerpfad Dfp_FrmMngChrgr1A" VAL_BLK 0x1CEC34 Kwb_Wu16 65535.00 OneToOne 0.00 65535.00 FORMAT "%8.2" NUMBER 4 /end CHARACTERISTIC
/begin CHARACTERISTIC DSM_CDKDfp_FrmMngChrgr1C_C "Kundenspezifischer Fehlercode fuer Fehlerpfad Dfp_FrmMngChrgr1C" VAL_BLK 0x1CEC3C Kwb_Wu16 65535.00 OneToOne 0.00 65535.00 FORMAT "%8.2" NUMBER 4 /end CHARACTERISTIC
/begin CHARACTERISTIC DSM_CDKDfp_FrmMngChrgr1N_C "Kundenspezifischer Fehlercode fuer Fehlerpfad Dfp_FrmMngChrgr1N" VAL_BLK 0x1CEC44 Kwb_Wu16 65535.00 OneToOne 0.00 65535.00 FORMAT "%8.2" NUMBER 4 /end CHARACTERISTIC
/begin CHARACTERISTIC DSM_CDKDfp_FrmMngChrgr1T_C "Kundenspezifischer Fehlercode fuer Fehlerpfad Dfp_FrmMngChrgr1T" VAL_BLK 0x1CEC4C Kwb_Wu16 65535.00 OneToOne 0.00 65535.00 FORMAT "%8.2" NUMBER 4 /end CHARACTERISTIC
/begin CHARACTERISTIC DSM_CDKDfp_FrmMngChrgr1V_C "Kundenspezifischer Fehlercode fuer Fehlerpfad Dfp_FrmMngChrgr1V" VAL_BLK 0x1CEC54 Kwb_Wu16 65535.00 OneToOne 0.00 65535.00 FORMAT "%8.2" NUMBER 4 /end CHARACTERISTIC
/begin CHARACTERISTIC DSM_CDKDfp_FrmMngChrgr2A_C "Kundenspezifischer Fehlercode fuer Fehlerpfad Dfp_FrmMngChrgr2A" VAL_BLK 0x1CEC5C Kwb_Wu16 65535.00 OneToOne 0.00 65535.00 FORMAT "%8.2" NUMBER 4 /end CHARACTERISTIC
/begin CHARACTERISTIC DSM_CDKDfp_FrmMngChrgr2C_C "Kundenspezifischer Fehlercode fuer Fehlerpfad Dfp_FrmMngChrgr2C" VAL_BLK 0x1CEC64 Kwb_Wu16 65535.00 OneToOne 0.00 65535.00 FORMAT "%8.2" NUMBER 4 /end CHARACTERISTIC
/begin CHARACTERISTIC DSM_CDKDfp_FrmMngChrgr2N_C "Kundenspezifischer Fehlercode fuer Fehlerpfad Dfp_FrmMngChrgr2N" VAL_BLK 0x1CEC6C Kwb_Wu16 65535.00 OneToOne 0.00 65535.00 FORMAT "%8.2" NUMBER 4 /end CHARACTERISTIC
/begin CHARACTERISTIC DSM_CDKDfp_FrmMngChrgr2T_C "Kundenspezifischer Fehlercode fuer Fehlerpfad Dfp_FrmMngChrgr2T" VAL_BLK 0x1CEC74 Kwb_Wu16 65535.00 OneToOne 0.00 65535.00 FORMAT "%8.2" NUMBER 4 /end CHARACTERISTIC
/begin CHARACTERISTIC DSM_CDKDfp_FrmMngChrgr2V_C "Kundenspezifischer Fehlercode fuer Fehlerpfad Dfp_FrmMngChrgr2V" VAL_BLK 0x1CEC7C Kwb_Wu16 65535.00 OneToOne 0.00 65535.00 FORMAT "%8.2" NUMBER 4 /end CHARACTERISTIC
/begin CHARACTERISTIC DSM_CDKDfp_FrmMngDIA1Npl_C "Kundenspezifischer Fehlercode fuer Fehlerpfad Dfp_FrmMngDIA1Npl" VAL_BLK 0x1CEC84 Kwb_Wu16 65535.00 OneToOne 0.00 65535.00 FORMAT "%8.2" NUMBER 4 /end CHARACTERISTIC
/begin CHARACTERISTIC DSM_CDKDfp_FrmMngDIA1TO_C "Kundenspezifischer Fehlercode fuer Fehlerpfad Dfp_FrmMngDIA1TO" VAL_BLK 0x1CEC8C Kwb_Wu16 65535.00 OneToOne 0.00 65535.00 FORMAT "%8.2" NUMBER 4 /end CHARACTERISTIC
/begin CHARACTERISTIC DSM_CDKDfp_FrmMngDSP1Npl_C "Kundenspezifischer Fehlercode fuer Fehlerpfad Dfp_FrmMngDSP1Npl" VAL_BLK 0x1CEC94 Kwb_Wu16 65535.00 OneToOne 0.00 65535.00 FORMAT "%8.2" NUMBER 4 /end CHARACTERISTIC
/begin CHARACTERISTIC DSM_CDKDfp_FrmMngDSP1TO_C "Kundenspezifischer Fehlercode fuer Fehlerpfad Dfp_FrmMngDSP1TO" VAL_BLK 0x1CEC9C Kwb_Wu16 65535.00 OneToOne 0.00 65535.00 FORMAT "%8.2" NUMBER 4 /end CHARACTERISTIC
/begin CHARACTERISTIC DSM_CDKDfp_FrmMngDSP2Npl_C "Kundenspezifischer Fehlercode fuer Fehlerpfad Dfp_FrmMngDSP2Npl" VAL_BLK 0x1CECA4 Kwb_Wu16 65535.00 OneToOne 0.00 65535.00 FORMAT "%8.2" NUMBER 4 /end CHARACTERISTIC
/begin CHARACTERISTIC DSM_CDKDfp_FrmMngDSP2TO_C "Kundenspezifischer Fehlercode fuer Fehlerpfad Dfp_FrmMngDSP2TO" VAL_BLK 0x1CECAC Kwb_Wu16 65535.00 OneToOne 0.00 65535.00 FORMAT "%8.2" NUMBER 4 /end CHARACTERISTIC
/begin CHARACTERISTIC DSM_CDKDfp_FrmMngDSP3Npl_C "Kundenspezifischer Fehlercode fuer Fehlerpfad Dfp_FrmMngDSP3Npl" VAL_BLK 0x1CECB4 Kwb_Wu16 65535.00 OneToOne 0.00 65535.00 FORMAT "%8.2" NUMBER 4 /end CHARACTERISTIC
/begin CHARACTERISTIC DSM_CDKDfp_FrmMngDSP3TO_C "Kundenspezifischer Fehlercode fuer Fehlerpfad Dfp_FrmMngDSP3TO" VAL_BLK 0x1CECBC Kwb_Wu16 65535.00 OneToOne 0.00 65535.00 FORMAT "%8.2" NUMBER 4 /end CHARACTERISTIC
/begin CHARACTERISTIC DSM_CDKDfp_FrmMngEPB1Npl_C "Kundenspezifischer Fehlercode fuer Fehlerpfad Dfp_FrmMngEPB1Npl" VAL_BLK 0x1CECC4 Kwb_Wu16 65535.00 OneToOne 0.00 65535.00 FORMAT "%8.2" NUMBER 4 /end CHARACTERISTIC
/begin CHARACTERISTIC DSM_CDKDfp_FrmMngEPB1TO_C "Kundenspezifischer Fehlercode fuer Fehlerpfad Dfp_FrmMngEPB1TO" VAL_BLK 0x1CECCC Kwb_Wu16 65535.00 OneToOne 0.00 65535.00 FORMAT "%8.2" NUMBER 4 /end CHARACTERISTIC
/begin CHARACTERISTIC DSM_CDKDfp_FrmMngESCUNpl_C "Kundenspezifischer Fehlercode fuer Fehlerpfad Dfp_FrmMngESCUNpl" VAL_BLK 0x1CECD4 Kwb_Wu16 65535.00 OneToOne 0.00 65535.00 FORMAT "%8.2" NUMBER 4 /end CHARACTERISTIC
/begin CHARACTERISTIC DSM_CDKDfp_FrmMngESCUTO_C "Kundenspezifischer Fehlercode fuer Fehlerpfad Dfp_FrmMngESCUTO" VAL_BLK 0x1CECDC Kwb_Wu16 65535.00 OneToOne 0.00 65535.00 FORMAT "%8.2" NUMBER 4 /end CHARACTERISTIC
/begin CHARACTERISTIC DSM_CDKDfp_FrmMngGW1Npl_C "Kundenspezifischer Fehlercode fuer Fehlerpfad Dfp_FrmMngGW1Npl" VAL_BLK 0x1CECEC Kwb_Wu16 65535.00 OneToOne 0.00 65535.00 FORMAT "%8.2" NUMBER 4 /end CHARACTERISTIC
/begin CHARACTERISTIC DSM_CDKDfp_FrmMngGW1TO_C "Kundenspezifischer Fehlercode fuer Fehlerpfad Dfp_FrmMngGW1TO" VAL_BLK 0x1CECF4 Kwb_Wu16 65535.00 OneToOne 0.00 65535.00 FORMAT "%8.2" NUMBER 4 /end CHARACTERISTIC
/begin CHARACTERISTIC DSM_CDKDfp_FrmMngILMNpl_C "Kundenspezifischer Fehlercode fuer Fehlerpfad Dfp_FrmMngILMNpl" VAL_BLK 0x1CECFC Kwb_Wu16 65535.00 OneToOne 0.00 65535.00 FORMAT "%8.2" NUMBER 4 /end CHARACTERISTIC
/begin CHARACTERISTIC DSM_CDKDfp_FrmMngILMTO_C "Kundenspezifischer Fehlercode fuer Fehlerpfad Dfp_FrmMngILMTO" VAL_BLK 0x1CED04 Kwb_Wu16 65535.00 OneToOne 0.00 65535.00 FORMAT "%8.2" NUMBER 4 /end CHARACTERISTIC
/begin CHARACTERISTIC DSM_CDKDfp_FrmMngLICHT2TO_C "Kundenspezifischer Fehlercode fuer Fehlerpfad Dfp_FrmMngLICHT2TO" VAL_BLK 0x1CED14 Kwb_Wu16 65535.00 OneToOne 0.00 65535.00 FORMAT "%8.2" NUMBER 4 /end CHARACTERISTIC
/begin CHARACTERISTIC DSM_CDKDfp_FrmMngNIV1WrngCod_C "Kundenspezifischer Fehlercode fuer Fehlerpfad Dfp_FrmMngNIV1WrngCod" VAL_BLK 0x1CED1C Kwb_Wu16 65535.00 OneToOne 0.00 65535.00 FORMAT "%8.2" NUMBER 4 /end CHARACTERISTIC
/begin CHARACTERISTIC DSM_CDKDfp_FrmMngNIVEAU1Npl_C "Kundenspezifischer Fehlercode fuer Fehlerpfad Dfp_FrmMngNIVEAU1Npl" VAL_BLK 0x1CED24 Kwb_Wu16 65535.00 OneToOne 0.00 65535.00 FORMAT "%8.2" NUMBER 4 /end CHARACTERISTIC
/begin CHARACTERISTIC DSM_CDKDfp_FrmMngNIVEAU1TO_C "Kundenspezifischer Fehlercode fuer Fehlerpfad Dfp_FrmMngNIVEAU1TO" VAL_BLK 0x1CED2C Kwb_Wu16 65535.00 OneToOne 0.00 65535.00 FORMAT "%8.2" NUMBER 4 /end CHARACTERISTIC
/begin CHARACTERISTIC DSM_CDKDfp_FrmMngSA1Npl_C "Kundenspezifischer Fehlercode fuer Fehlerpfad Dfp_FrmMngSA1Npl" VAL_BLK 0x1CED34 Kwb_Wu16 65535.00 OneToOne 0.00 65535.00 FORMAT "%8.2" NUMBER 4 /end CHARACTERISTIC
/begin CHARACTERISTIC DSM_CDKDfp_FrmMngSA1TO_C "Kundenspezifischer Fehlercode fuer Fehlerpfad Dfp_FrmMngSA1TO" VAL_BLK 0x1CED3C Kwb_Wu16 65535.00 OneToOne 0.00 65535.00 FORMAT "%8.2" NUMBER 4 /end CHARACTERISTIC
/begin CHARACTERISTIC DSM_CDKDfp_FrmMngSTIGNNpl_C "Kundenspezifischer Fehlercode fuer Fehlerpfad Dfp_FrmMngSTIGNNpl" VAL_BLK 0x1CED44 Kwb_Wu16 65535.00 OneToOne 0.00 65535.00 FORMAT "%8.2" NUMBER 4 /end CHARACTERISTIC
/begin CHARACTERISTIC DSM_CDKDfp_FrmMngStIgnTO_C "Kundenspezifischer Fehlercode fuer Fehlerpfad Dfp_FrmMngStIgnTO" VAL_BLK 0x1CED4C Kwb_Wu16 65535.00 OneToOne 0.00 65535.00 FORMAT "%8.2" NUMBER 4 /end CHARACTERISTIC
/begin CHARACTERISTIC DSM_CDKDfp_FrmMngTOSNpl_C "Kundenspezifischer Fehlercode fuer Fehlerpfad Dfp_FrmMngTOSNpl" VAL_BLK 0x1CED54 Kwb_Wu16 65535.00 OneToOne 0.00 65535.00 FORMAT "%8.2" NUMBER 4 /end CHARACTERISTIC
/begin CHARACTERISTIC DSM_CDKDfp_FrmMngTOSTO_C "Kundenspezifischer Fehlercode fuer Fehlerpfad Dfp_FrmMngTOSTO" VAL_BLK 0x1CED5C Kwb_Wu16 65535.00 OneToOne 0.00 65535.00 FORMAT "%8.2" NUMBER 4 /end CHARACTERISTIC
/begin CHARACTERISTIC DSM_CDKDfp_FrmMngTSC1Npl_C "Kundenspezifischer Fehlercode fuer Fehlerpfad Dfp_FrmMngTSC1Npl" VAL_BLK 0x1CED64 Kwb_Wu16 65535.00 OneToOne 0.00 65535.00 FORMAT "%8.2" NUMBER 4 /end CHARACTERISTIC
/begin CHARACTERISTIC DSM_CDKDfp_FrmMngTSC1TO_C "Kundenspezifischer Fehlercode fuer Fehlerpfad Dfp_FrmMngTSC1TO" VAL_BLK 0x1CED6C Kwb_Wu16 65535.00 OneToOne 0.00 65535.00 FORMAT "%8.2" NUMBER 4 /end CHARACTERISTIC
/begin CHARACTERISTIC DSM_CDKDfp_FrmMngTSC2Npl_C "Kundenspezifischer Fehlercode fuer Fehlerpfad Dfp_FrmMngTSC2Npl" VAL_BLK 0x1CED74 Kwb_Wu16 65535.00 OneToOne 0.00 65535.00 FORMAT "%8.2" NUMBER 4 /end CHARACTERISTIC
/begin CHARACTERISTIC DSM_CDKDfp_FrmMngTSC2TO_C "Kundenspezifischer Fehlercode fuer Fehlerpfad Dfp_FrmMngTSC2TO" VAL_BLK 0x1CED7C Kwb_Wu16 65535.00 OneToOne 0.00 65535.00 FORMAT "%8.2" NUMBER 4 /end CHARACTERISTIC
/begin CHARACTERISTIC DSM_CDKDfp_FrmMngTSC3Npl_C "Kundenspezifischer Fehlercode fuer Fehlerpfad Dfp_FrmMngTSC3Npl" VAL_BLK 0x1CED84 Kwb_Wu16 65535.00 OneToOne 0.00 65535.00 FORMAT "%8.2" NUMBER 4 /end CHARACTERISTIC
/begin CHARACTERISTIC DSM_CDKDfp_FrmMngTSC3TO_C "Kundenspezifischer Fehlercode fuer Fehlerpfad Dfp_FrmMngTSC3TO" VAL_BLK 0x1CED8C Kwb_Wu16 65535.00 OneToOne 0.00 65535.00 FORMAT "%8.2" NUMBER 4 /end CHARACTERISTIC
/begin CHARACTERISTIC DSM_CDKDfp_FrmMngTSC6Npl_C "Kundenspezifischer Fehlercode fuer Fehlerpfad Dfp_FrmMngTSC6Npl" VAL_BLK 0x1CED94 Kwb_Wu16 65535.00 OneToOne 0.00 65535.00 FORMAT "%8.2" NUMBER 4 /end CHARACTERISTIC
/begin CHARACTERISTIC DSM_CDKDfp_FrmMngTSC6TO_C "Kundenspezifischer Fehlercode fuer Fehlerpfad Dfp_FrmMngTSC6TO" VAL_BLK 0x1CED9C Kwb_Wu16 65535.00 OneToOne 0.00 65535.00 FORMAT "%8.2" NUMBER 4 /end CHARACTERISTIC
/begin CHARACTERISTIC DSM_CDKDfp_FrmMngTrbnSpdErr_C "Kundenspezifischer Fehlercode fuer Fehlerpfad Dfp_FrmMngTrbnSpdErr" VAL_BLK 0x1CEDA4 Kwb_Wu16 65535.00 OneToOne 0.00 65535.00 FORMAT "%8.2" NUMBER 4 /end CHARACTERISTIC
/begin CHARACTERISTIC DSM_CDKDfp_FrmMngWIPERTO_C "Kundenspezifischer Fehlercode fuer Fehlerpfad Dfp_FrmMngWIPERTO" VAL_BLK 0x1CEDAC Kwb_Wu16 65535.00 OneToOne 0.00 65535.00 FORMAT "%8.2" NUMBER 4 /end CHARACTERISTIC
/begin CHARACTERISTIC DSM_CDKDfp_GbSSCD_C "Kundenspezifischer Fehlercode für Fehlerpfad Dfp_GbSSCD" VAL_BLK 0x1CEDB4 Kwb_Wu16 65535.00 OneToOne 0.00 65535.00 FORMAT "%8.2" NUMBER 4 /end CHARACTERISTIC
/begin CHARACTERISTIC DSM_CDKDfp_GbSSCD_HW_C "Kundenspezifischer Fehlercode fuer Fehlerpfad Dfp_GbSSCD_HW" VAL_BLK 0x1CEDBC Kwb_Wu16 65535.00 OneToOne 0.00 65535.00 FORMAT "%8.2" NUMBER 4 /end CHARACTERISTIC
/begin CHARACTERISTIC DSM_CDKDfp_GearbxCVTnMax_C "Kundenspezifischer Fehlercode fuer Fehlerpfad Dfp_GearbxCVTnMax_mp" VAL_BLK 0x1CEDC4 Kwb_Wu16 65535.00 OneToOne 0.00 65535.00 FORMAT "%8.2" NUMBER 4 /end CHARACTERISTIC
/begin CHARACTERISTIC DSM_CDKDfp_GearbxClthPlaus_C "Kundenspezifischer Fehlercode fuer Fehlerpfad Dfp_GearbxClthPlaus" VAL_BLK 0x1CEDCC Kwb_Wu16 65535.00 OneToOne 0.00 65535.00 FORMAT "%8.2" NUMBER 4 /end CHARACTERISTIC
/begin CHARACTERISTIC DSM_CDKDfp_GearbxINCCup_C "Kundenspezifischer Fehlercode fuer Fehlerpfad Dfp_GearbxINCCup" VAL_BLK 0x1CEDD4 Kwb_Wu16 65535.00 OneToOne 0.00 65535.00 FORMAT "%8.2" NUMBER 4 /end CHARACTERISTIC
/begin CHARACTERISTIC DSM_CDKDfp_GearbxNMinMon_C "Kundenspezifischer Fehlercode fuer Fehlerpfad Dfp_GearbxNMinMon" VAL_BLK 0x1CEDDC Kwb_Wu16 65535.00 OneToOne 0.00 65535.00 FORMAT "%8.2" NUMBER 4 /end CHARACTERISTIC
/begin CHARACTERISTIC DSM_CDKDfp_GearbxTSC_C "Kundenspezifischer Fehlercode fuer Fehlerpfad Dfp_GearbxTSC" VAL_BLK 0x1CEDE4 Kwb_Wu16 65535.00 OneToOne 0.00 65535.00 FORMAT "%8.2" NUMBER 4 /end CHARACTERISTIC
/begin CHARACTERISTIC DSM_CDKDfp_GearbxTransConv_C "Kundenspezifischer Fehlercodefuer Fehlerpfad Dfp_GearbxTransConv" VAL_BLK 0x1CEDEC Kwb_Wu16 65535.00 OneToOne 0.00 65535.00 FORMAT "%8.2" NUMBER 4 /end CHARACTERISTIC
/begin CHARACTERISTIC DSM_CDKDfp_GearbxTypeMTErr_C "Kundenspezifischer Fehlercode fuer Fehlerpfad Dfp_GearbxTypeMTErr" VAL_BLK 0x1CEDF4 Kwb_Wu16 65535.00 OneToOne 0.00 65535.00 FORMAT "%8.2" NUMBER 4 /end CHARACTERISTIC
/begin CHARACTERISTIC DSM_CDKDfp_GlwCDDIAG_C "Kundenspezifischer Fehlercode fuer Fehlerpfad Dfp_GlwCDDIAG" VAL_BLK 0x1CEDFC Kwb_Wu16 65535.00 OneToOne 0.00 65535.00 FORMAT "%8.2" NUMBER 4 /end CHARACTERISTIC
/begin CHARACTERISTIC DSM_CDKDfp_GlwCDErr1_C "Kundenspezifischer Fehlercode fuer Fehlerpfad Dfp_GlwCDErr1" VAL_BLK 0x1CEE04 Kwb_Wu16 65535.00 OneToOne 0.00 65535.00 FORMAT "%8.2" NUMBER 4 /end CHARACTERISTIC
/begin CHARACTERISTIC DSM_CDKDfp_GlwCDErr2_C "Kundenspezifischer Fehlercode fuer Fehlerpfad Dfp_GlwCDErr2" VAL_BLK 0x1CEE0C Kwb_Wu16 65535.00 OneToOne 0.00 65535.00 FORMAT "%8.2" NUMBER 4 /end CHARACTERISTIC
/begin CHARACTERISTIC DSM_CDKDfp_GlwCDEvalCod_C "Kundenspezifischer Fehlercode fuer Fehlerpfad Dfp_GlwCDEvalCod" VAL_BLK 0x1CEE14 Kwb_Wu16 65535.00 OneToOne 0.00 65535.00 FORMAT "%8.2" NUMBER 4 /end CHARACTERISTIC
/begin CHARACTERISTIC DSM_CDKDfp_GlwCDGSK2_C "Kundenspezifischer Fehlercode fuer Fehlerpfad Dfp_GlwCDGSK2" VAL_BLK 0x1CEE1C Kwb_Wu16 65535.00 OneToOne 0.00 65535.00 FORMAT "%8.2" NUMBER 4 /end CHARACTERISTIC
/begin CHARACTERISTIC DSM_CDKDfp_GlwCDGSK3_C "Kundenspezifischer Fehlercode fuer Fehlerpfad Dfp_GlwCDGSK3" VAL_BLK 0x1CEE24 Kwb_Wu16 65535.00 OneToOne 0.00 65535.00 FORMAT "%8.2" NUMBER 4 /end CHARACTERISTIC
/begin CHARACTERISTIC DSM_CDKDfp_GlwCDLmp_C "Kundenspezifischer Fehlercode fuer Fehlerpfad Dfp_GlwCDLmp" VAL_BLK 0x1CEE2C Kwb_Wu16 65535.00 OneToOne 0.00 65535.00 FORMAT "%8.2" NUMBER 4 /end CHARACTERISTIC
/begin CHARACTERISTIC DSM_CDKDfp_GlwCDPLUG0_C "Kundenspezifischer Fehlercode fuer Fehlerpfad Dfp_GlwCDPLUG0" VAL_BLK 0x1CEE34 Kwb_Wu16 65535.00 OneToOne 0.00 65535.00 FORMAT "%8.2" NUMBER 4 /end CHARACTERISTIC
/begin CHARACTERISTIC DSM_CDKDfp_GlwCDPLUG1_C "Kundenspezifischer Fehlercode fuer Fehlerpfad Dfp_GlwCDPLUG1" VAL_BLK 0x1CEE3C Kwb_Wu16 65535.00 OneToOne 0.00 65535.00 FORMAT "%8.2" NUMBER 4 /end CHARACTERISTIC
/begin CHARACTERISTIC DSM_CDKDfp_GlwCDPLUG2_C "Kundenspezifischer Fehlercode fuer Fehlerpfad Dfp_GlwCDPLUG2" VAL_BLK 0x1CEE44 Kwb_Wu16 65535.00 OneToOne 0.00 65535.00 FORMAT "%8.2" NUMBER 4 /end CHARACTERISTIC
/begin CHARACTERISTIC DSM_CDKDfp_GlwCDPLUG3_C "Kundenspezifischer Fehlercode fuer Fehlerpfad Dfp_GlwCDPLUG3" VAL_BLK 0x1CEE4C Kwb_Wu16 65535.00 OneToOne 0.00 65535.00 FORMAT "%8.2" NUMBER 4 /end CHARACTERISTIC
/begin CHARACTERISTIC DSM_CDKDfp_GlwCDPLUG4_C "Kundenspezifischer Fehlercode fuer Fehlerpfad Dfp_GlwCDPLUG4" VAL_BLK 0x1CEE54 Kwb_Wu16 65535.00 OneToOne 0.00 65535.00 FORMAT "%8.2" NUMBER 4 /end CHARACTERISTIC
/begin CHARACTERISTIC DSM_CDKDfp_GlwCDPLUG5_C "Kundenspezifischer Fehlercode fuer Fehlerpfad Dfp_GlwCDPLUG5" VAL_BLK 0x1CEE5C Kwb_Wu16 65535.00 OneToOne 0.00 65535.00 FORMAT "%8.2" NUMBER 4 /end CHARACTERISTIC
/begin CHARACTERISTIC DSM_CDKDfp_GlwCD_LampCan_C "Kundenspezifischer Fehlercode fuer Fehlerpfad Dfp_GlwCD_LampCan" VAL_BLK 0x1CEE64 Kwb_Wu16 65535.00 OneToOne 0.00 65535.00 FORMAT "%8.2" NUMBER 4 /end CHARACTERISTIC
/begin CHARACTERISTIC DSM_CDKDfp_GlwCDsfd_C "Kundenspezifischer Fehlercode fuer Fehlerpfad Dfp_GlwCDsfd" VAL_BLK 0x1CEE6C Kwb_Wu16 65535.00 OneToOne 0.00 65535.00 FORMAT "%8.2" NUMBER 4 /end CHARACTERISTIC
/begin CHARACTERISTIC DSM_CDKDfp_HDSCD_C "Kundenspezifischer Fehlercode fuer Fehlerpfad Dfp_HDSCD" VAL_BLK 0x1CEE74 Kwb_Wu16 65535.00 OneToOne 0.00 65535.00 FORMAT "%8.2" NUMBER 4 /end CHARACTERISTIC
/begin CHARACTERISTIC DSM_CDKDfp_HWEMonCom_C "Kundenspezifischer Fehlercode fuer Fehlerpfad Dfp_HWEMonCom" VAL_BLK 0x1CEE7C Kwb_Wu16 65535.00 OneToOne 0.00 65535.00 FORMAT "%8.2" NUMBER 4 /end CHARACTERISTIC
/begin CHARACTERISTIC DSM_CDKDfp_HWEMonEEPROM_C "Kundenspezifischer Fehlercode fuer Fehlerpfad Dfp_HWEMonEEPROM" VAL_BLK 0x1CEE84 Kwb_Wu16 65535.00 OneToOne 0.00 65535.00 FORMAT "%8.2" NUMBER 4 /end CHARACTERISTIC
/begin CHARACTERISTIC DSM_CDKDfp_HWEMonRcyLocked_C "Kundenspezifischer Fehlercode fuer Fehlerpfad Dfp_HWEMonRcyLocked" VAL_BLK 0x1CEE8C Kwb_Wu16 65535.00 OneToOne 0.00 65535.00 FORMAT "%8.2" NUMBER 4 /end CHARACTERISTIC
/begin CHARACTERISTIC DSM_CDKDfp_HWEMonRcySuppressed_C "Kundenspezifischer Fehlercode fuer Fehlerpfad Dfp_HWEMonRcySuppressed" VAL_BLK 0x1CEE94 Kwb_Wu16 65535.00 OneToOne 0.00 65535.00 FORMAT "%8.2" NUMBER 4 /end CHARACTERISTIC
/begin CHARACTERISTIC DSM_CDKDfp_HWEMonRcyVisible_C "Kundenspezifischer Fehlercode fuer Fehlerpfad Dfp_HWEMonRcyVisible" VAL_BLK 0x1CEE9C Kwb_Wu16 65535.00 OneToOne 0.00 65535.00 FORMAT "%8.2" NUMBER 4 /end CHARACTERISTIC
/begin CHARACTERISTIC DSM_CDKDfp_HWEMonUMaxSupply_C "Kundenspezifischer Fehlercode fuer Fehlerpfad Dfp_HWEMonUMaxSupply" VAL_BLK 0x1CEEA4 Kwb_Wu16 65535.00 OneToOne 0.00 65535.00 FORMAT "%8.2" NUMBER 4 /end CHARACTERISTIC
/begin CHARACTERISTIC DSM_CDKDfp_HWEMonUMinSupply_C "Kundenspezifischer Fehlercode fuer Fehlerpfad Dfp_HWEMonUMinSupply" VAL_BLK 0x1CEEAC Kwb_Wu16 65535.00 OneToOne 0.00 65535.00 FORMAT "%8.2" NUMBER 4 /end CHARACTERISTIC
/begin CHARACTERISTIC DSM_CDKDfp_IATSCD_C "Kundenspezifischer Fehlercode fuer Fehlerpfad Dfp_IATSCD" VAL_BLK 0x1CEEB4 Kwb_Wu16 65535.00 OneToOne 0.00 65535.00 FORMAT "%8.2" NUMBER 4 /end CHARACTERISTIC
/begin CHARACTERISTIC DSM_CDKDfp_IFCD_C "Kundenspezifischer Fehlercode fuer Fehlerpfad Dfp_IFCD" VAL_BLK 0x1CEEBC Kwb_Wu16 65535.00 OneToOne 0.00 65535.00 FORMAT "%8.2" NUMBER 4 /end CHARACTERISTIC
/begin CHARACTERISTIC DSM_CDKDfp_ImmCtl_C "Kundenspezifischer Fehlercode fuer Fehlerpfad Dfp_ImmCtl" VAL_BLK 0x1CEEC4 Kwb_Wu16 65535.00 OneToOne 0.00 65535.00 FORMAT "%8.2" NUMBER 4 /end CHARACTERISTIC
/begin CHARACTERISTIC DSM_CDKDfp_IndSysMonIntMnf_C "Kundenspezifischer Fehlercode fuer Fehlerpfad Dfp_IndSysMonIntMnf" VAL_BLK 0x1CEECC Kwb_Wu16 65535.00 OneToOne 0.00 65535.00 FORMAT "%8.2" NUMBER 4 /end CHARACTERISTIC
/begin CHARACTERISTIC DSM_CDKDfp_InjVlvBnk1A_C "Kundenspezifischer Fehlercode fuer Fehlerpfad Dfp_InjVlvBnk1A" VAL_BLK 0x1CEEE4 Kwb_Wu16 65535.00 OneToOne 0.00 65535.00 FORMAT "%8.2" NUMBER 4 /end CHARACTERISTIC
/begin CHARACTERISTIC DSM_CDKDfp_InjVlvBnk2A_C "Kundenspezifischer Fehlercode fuer Fehlerpfad Dfp_InjVlvBnk2A" VAL_BLK 0x1CEEEC Kwb_Wu16 65535.00 OneToOne 0.00 65535.00 FORMAT "%8.2" NUMBER 4 /end CHARACTERISTIC
/begin CHARACTERISTIC DSM_CDKDfp_InjVlvCyl10A_C "Kundenspezifischer Fehlercode fuer Fehlerpfad Dfp_InjVlvCyl10A" VAL_BLK 0x1CEEF4 Kwb_Wu16 65535.00 OneToOne 0.00 65535.00 FORMAT "%8.2" NUMBER 4 /end CHARACTERISTIC
/begin CHARACTERISTIC DSM_CDKDfp_InjVlvCyl11A_C "Kundenspezifischer Fehlercode fuer Fehlerpfad Dfp_InjVlvCyl11A" VAL_BLK 0x1CEEFC Kwb_Wu16 65535.00 OneToOne 0.00 65535.00 FORMAT "%8.2" NUMBER 4 /end CHARACTERISTIC
/begin CHARACTERISTIC DSM_CDKDfp_InjVlvCyl12A_C "Kundenspezifischer Fehlercode fuer Fehlerpfad Dfp_InjVlvCyl12A" VAL_BLK 0x1CEF04 Kwb_Wu16 65535.00 OneToOne 0.00 65535.00 FORMAT "%8.2" NUMBER 4 /end CHARACTERISTIC
/begin CHARACTERISTIC DSM_CDKDfp_InjVlvCyl1A_C "Kundenspezifischer Fehlercode fuer Fehlerpfad Dfp_InjVlvCyl1A" VAL_BLK 0x1CEF0C Kwb_Wu16 65535.00 OneToOne 0.00 65535.00 FORMAT "%8.2" NUMBER 4 /end CHARACTERISTIC
/begin CHARACTERISTIC DSM_CDKDfp_InjVlvCyl2A_C "Kundenspezifischer Fehlercode fuer Fehlerpfad Dfp_InjVlvCyl2A" VAL_BLK 0x1CEF14 Kwb_Wu16 65535.00 OneToOne 0.00 65535.00 FORMAT "%8.2" NUMBER 4 /end CHARACTERISTIC
/begin CHARACTERISTIC DSM_CDKDfp_InjVlvCyl3A_C "Kundenspezifischer Fehlercode fuer Fehlerpfad Dfp_InjVlvCyl3A" VAL_BLK 0x1CEF1C Kwb_Wu16 65535.00 OneToOne 0.00 65535.00 FORMAT "%8.2" NUMBER 4 /end CHARACTERISTIC
/begin CHARACTERISTIC DSM_CDKDfp_InjVlvCyl4A_C "Kundenspezifischer Fehlercode fuer Fehlerpfad Dfp_InjVlvCyl4A" VAL_BLK 0x1CEF24 Kwb_Wu16 65535.00 OneToOne 0.00 65535.00 FORMAT "%8.2" NUMBER 4 /end CHARACTERISTIC
/begin CHARACTERISTIC DSM_CDKDfp_InjVlvCyl5A_C "Kundenspezifischer Fehlercode fuer Fehlerpfad Dfp_InjVlvCyl5A" VAL_BLK 0x1CEF2C Kwb_Wu16 65535.00 OneToOne 0.00 65535.00 FORMAT "%8.2" NUMBER 4 /end CHARACTERISTIC
/begin CHARACTERISTIC DSM_CDKDfp_InjVlvCyl6A_C "Kundenspezifischer Fehlercode fuer Fehlerpfad Dfp_InjVlvCyl6A" VAL_BLK 0x1CEF34 Kwb_Wu16 65535.00 OneToOne 0.00 65535.00 FORMAT "%8.2" NUMBER 4 /end CHARACTERISTIC
/begin CHARACTERISTIC DSM_CDKDfp_InjVlvCyl7A_C "Kundenspezifischer Fehlercode fuer Fehlerpfad Dfp_InjVlvCyl7A" VAL_BLK 0x1CEF3C Kwb_Wu16 65535.00 OneToOne 0.00 65535.00 FORMAT "%8.2" NUMBER 4 /end CHARACTERISTIC
/begin CHARACTERISTIC DSM_CDKDfp_InjVlvCyl8A_C "Kundenspezifischer Fehlercode fuer Fehlerpfad Dfp_InjVlvCyl8A" VAL_BLK 0x1CEF44 Kwb_Wu16 65535.00 OneToOne 0.00 65535.00 FORMAT "%8.2" NUMBER 4 /end CHARACTERISTIC
/begin CHARACTERISTIC DSM_CDKDfp_InjVlvCyl9A_C "Kundenspezifischer Fehlercode fuer Fehlerpfad Dfp_InjVlvCyl9A" VAL_BLK 0x1CEF4C Kwb_Wu16 65535.00 OneToOne 0.00 65535.00 FORMAT "%8.2" NUMBER 4 /end CHARACTERISTIC
/begin CHARACTERISTIC DSM_CDKDfp_LASCD_C "Kundenspezifischer Fehlercode fuer Fehlerpfad Dfp_LASCD" VAL_BLK 0x1CEF54 Kwb_Wu16 65535.00 OneToOne 0.00 65535.00 FORMAT "%8.2" NUMBER 4 /end CHARACTERISTIC
/begin CHARACTERISTIC DSM_CDKDfp_LSUCDCircNernst0_C "Kundenspezifischer Fehlercode fuer Fehlerpfad Dfp_LSUCDCircNernst0" VAL_BLK 0x1CEF5C Kwb_Wu16 65535.00 OneToOne 0.00 65535.00 FORMAT "%8.2" NUMBER 4 /end CHARACTERISTIC
/begin CHARACTERISTIC DSM_CDKDfp_LSUCDCircPumpCur0_C "Kundenspezifischer Fehlercode fuer Fehlerpfad Dfp_LSUCDCircPumpCur0" VAL_BLK 0x1CEF64 Kwb_Wu16 65535.00 OneToOne 0.00 65535.00 FORMAT "%8.2" NUMBER 4 /end CHARACTERISTIC
/begin CHARACTERISTIC DSM_CDKDfp_LSUCDCircVirtGnd0_C "Kundenspezifischer Fehlercode fuer Fehlerpfad Dfp_LSUCDCircVirtGnd0" VAL_BLK 0x1CEF6C Kwb_Wu16 65535.00 OneToOne 0.00 65535.00 FORMAT "%8.2" NUMBER 4 /end CHARACTERISTIC
/begin CHARACTERISTIC DSM_CDKDfp_LSUCDHeater0_C "Kundenspezifischer Fehlercode fuer Fehlerpfad Dfp_LSUCDHeater0" VAL_BLK 0x1CEF74 Kwb_Wu16 65535.00 OneToOne 0.00 65535.00 FORMAT "%8.2" NUMBER 4 /end CHARACTERISTIC
/begin CHARACTERISTIC DSM_CDKDfp_LSUCDHtCoup0_C "Kundenspezifischer Fehlercode fuer Fehlerpfad Dfp_LSUCDHtCoup0" VAL_BLK 0x1CEF7C Kwb_Wu16 65535.00 OneToOne 0.00 65535.00 FORMAT "%8.2" NUMBER 4 /end CHARACTERISTIC
/begin CHARACTERISTIC DSM_CDKDfp_LSUCDO20_C "Kundenspezifischer Fehlercode fuer Fehlerpfad Dfp_LSUCDO20" VAL_BLK 0x1CEF84 Kwb_Wu16 65535.00 OneToOne 0.00 65535.00 FORMAT "%8.2" NUMBER 4 /end CHARACTERISTIC
/begin CHARACTERISTIC DSM_CDKDfp_LSUCDO2Clb0_C "Kundenspezifischer Fehlercode fuer Fehlerpfad Dfp_LSUCDO2Clb0" VAL_BLK 0x1CEF8C Kwb_Wu16 65535.00 OneToOne 0.00 65535.00 FORMAT "%8.2" NUMBER 4 /end CHARACTERISTIC
/begin CHARACTERISTIC DSM_CDKDfp_LSUCDRiClb0_C "Kundenspezifischer Fehlercode fuer Fehlerpfad Dfp_LSUCDRiClb0" VAL_BLK 0x1CEF94 Kwb_Wu16 65535.00 OneToOne 0.00 65535.00 FORMAT "%8.2" NUMBER 4 /end CHARACTERISTIC
/begin CHARACTERISTIC DSM_CDKDfp_LSUCDSPI0_C "Kundenspezifischer Fehlercode fuer Fehlerpfad Dfp_LSUCDSPI0" VAL_BLK 0x1CEF9C Kwb_Wu16 65535.00 OneToOne 0.00 65535.00 FORMAT "%8.2" NUMBER 4 /end CHARACTERISTIC
/begin CHARACTERISTIC DSM_CDKDfp_LSUCDSPIBattLow0_C "Kundenspezifischer Fehlercode fuer Fehlerpfad Dfp_LSUCDSPIBattLow0" VAL_BLK 0x1CEFA4 Kwb_Wu16 65535.00 OneToOne 0.00 65535.00 FORMAT "%8.2" NUMBER 4 /end CHARACTERISTIC
/begin CHARACTERISTIC DSM_CDKDfp_LSUCDWireIP0_C "Kundenspezifischer Fehlercode fuer Fehlerpfad Dfp_LSUCDWireIP0" VAL_BLK 0x1CEFAC Kwb_Wu16 65535.00 OneToOne 0.00 65535.00 FORMAT "%8.2" NUMBER 4 /end CHARACTERISTIC
/begin CHARACTERISTIC DSM_CDKDfp_LSUCtlRiExc0_C "Kundenspezifischer Fehlercode fuer Fehlerpfad Dfp_LSUCtlRiExc0" VAL_BLK 0x1CEFB4 Kwb_Wu16 65535.00 OneToOne 0.00 65535.00 FORMAT "%8.2" NUMBER 4 /end CHARACTERISTIC
/begin CHARACTERISTIC DSM_CDKDfp_LSUMonDyn0_C "Kundenspezifischer Fehlercode fuer Fehlerpfad Dfp_LSUMonDyn0" VAL_BLK 0x1CEFBC Kwb_Wu16 65535.00 OneToOne 0.00 65535.00 FORMAT "%8.2" NUMBER 4 /end CHARACTERISTIC
/begin CHARACTERISTIC DSM_CDKDfp_LSUMonFullLd0_C "Kundenspezifischer Fehlercode fuer Fehlerpfad Dfp_LSUMonFullLd0" VAL_BLK 0x1CEFC4 Kwb_Wu16 65535.00 OneToOne 0.00 65535.00 FORMAT "%8.2" NUMBER 4 /end CHARACTERISTIC
/begin CHARACTERISTIC DSM_CDKDfp_LSUMonOvrRun0_C "Kundenspezifischer Fehlercode fuer Fehlerpfad Dfp_LSUMonOvrRun0" VAL_BLK 0x1CEFCC Kwb_Wu16 65535.00 OneToOne 0.00 65535.00 FORMAT "%8.2" NUMBER 4 /end CHARACTERISTIC
/begin CHARACTERISTIC DSM_CDKDfp_LSUMonPartLd0_C "Kundenspezifischer Fehlercode fuer Fehlerpfad Dfp_LSUMonPartLd0" VAL_BLK 0x1CEFD4 Kwb_Wu16 65535.00 OneToOne 0.00 65535.00 FORMAT "%8.2" NUMBER 4 /end CHARACTERISTIC
/begin CHARACTERISTIC DSM_CDKDfp_MIL_C "Kundenspezifischer Fehlercode fuer Fehlerpfad Dfp_MIL" VAL_BLK 0x1CEFDC Kwb_Wu16 65535.00 OneToOne 0.00 65535.00 FORMAT "%8.2" NUMBER 4 /end CHARACTERISTIC
/begin CHARACTERISTIC DSM_CDKDfp_MRlyCD_C "Kundenspezifischer Fehlercode fuer Fehlerpfad Dfp_MRlyCD" VAL_BLK 0x1CEFE4 Kwb_Wu16 65535.00 OneToOne 0.00 65535.00 FORMAT "%8.2" NUMBER 4 /end CHARACTERISTIC
/begin CHARACTERISTIC DSM_CDKDfp_Montr_C "Kundenspezifischer Fehlercode fuer Fehlerpfad Dfp_Montr" VAL_BLK 0x1CEFEC Kwb_Wu16 65535.00 OneToOne 0.00 65535.00 FORMAT "%8.2" NUMBER 4 /end CHARACTERISTIC
/begin CHARACTERISTIC DSM_CDKDfp_OTSCD_C "Kundenspezifischer Fehlercode fuer Fehlerpfad Dfp_OTSCD" VAL_BLK 0x1CEFF4 Kwb_Wu16 65535.00 OneToOne 0.00 65535.00 FORMAT "%8.2" NUMBER 4 /end CHARACTERISTIC
/begin CHARACTERISTIC DSM_CDKDfp_OTSCDCanInac_C "Kundenspezifischer Fehlercode fuer Fehlerpfad Dfp_OTSCDCanInac" VAL_BLK 0x1CEFFC Kwb_Wu16 65535.00 OneToOne 0.00 65535.00 FORMAT "%8.2" NUMBER 4 /end CHARACTERISTIC
/begin CHARACTERISTIC DSM_CDKDfp_OTSCDCanSig_C "Kundenspezifischer Fehlercode fuer Fehlerpfad Dfp_OTSCDCanSig" VAL_BLK 0x1CF004 Kwb_Wu16 65535.00 OneToOne 0.00 65535.00 FORMAT "%8.2" NUMBER 4 /end CHARACTERISTIC
/begin CHARACTERISTIC DSM_CDKDfp_OvRMon_C "Kundenspezifischer Fehlercode fuer Fehlerpfad Dfp_OvRMon" VAL_BLK 0x1CF014 Kwb_Wu16 65535.00 OneToOne 0.00 65535.00 FORMAT "%8.2" NUMBER 4 /end CHARACTERISTIC
/begin CHARACTERISTIC DSM_CDKDfp_OvRMonCrCtlP_C "Kundenspezifischer Fehlercode fuer Fehlerpfad Dfp_OvRMonCrCtlP" VAL_BLK 0x1CF01C Kwb_Wu16 65535.00 OneToOne 0.00 65535.00 FORMAT "%8.2" NUMBER 4 /end CHARACTERISTIC
/begin CHARACTERISTIC DSM_CDKDfp_OvRMonSigA_C "Kundenspezifischer Fehlercode fuer Fehlerpfad Dfp_OvRMonSigA" VAL_BLK 0x1CF024 Kwb_Wu16 65535.00 OneToOne 0.00 65535.00 FORMAT "%8.2" NUMBER 4 /end CHARACTERISTIC
/begin CHARACTERISTIC DSM_CDKDfp_OxiCCDTPre_C "Kundenspezifischer Fehlercode fuer Fehlerpfad Dfp_OxiCCDTPre" VAL_BLK 0x1CF02C Kwb_Wu16 65535.00 OneToOne 0.00 65535.00 FORMAT "%8.2" NUMBER 4 /end CHARACTERISTIC
/begin CHARACTERISTIC DSM_CDKDfp_OxiCCDTPre1_C "Kundenspezifischer Fehlercode fuer Fehlerpfad Dfp_OxiCCDTPre1" VAL_BLK 0x1CF034 Kwb_Wu16 65535.00 OneToOne 0.00 65535.00 FORMAT "%8.2" NUMBER 4 /end CHARACTERISTIC
/begin CHARACTERISTIC DSM_CDKDfp_PCR_BalGovDev_C "Kundenspezifischer Fehlercode fuer Fehlerpfad Dfp_PCR_BalGovDev" VAL_BLK 0x1CF03C Kwb_Wu16 65535.00 OneToOne 0.00 65535.00 FORMAT "%8.2" NUMBER 4 /end CHARACTERISTIC
/begin CHARACTERISTIC DSM_CDKDfp_PCR_GovDev_C "Kundenspezifischer Fehlercode fuer Fehlerpfad Dfp_PCR_GovDev" VAL_BLK 0x1CF044 Kwb_Wu16 65535.00 OneToOne 0.00 65535.00 FORMAT "%8.2" NUMBER 4 /end CHARACTERISTIC
/begin CHARACTERISTIC DSM_CDKDfp_PFltAPSens_C "Kundenspezifischer Fehlercode fuer Fehlerpfad Dfp_PFltAPSens" VAL_BLK 0x1CF04C Kwb_Wu16 65535.00 OneToOne 0.00 65535.00 FORMAT "%8.2" NUMBER 4 /end CHARACTERISTIC
/begin CHARACTERISTIC DSM_CDKDfp_PFltCDHtg_C "Kundenspezifischer Fehlercode fuer Fehlerpfad Dfp_PFltCDHtg" VAL_BLK 0x1CF054 Kwb_Wu16 65535.00 OneToOne 0.00 65535.00 FORMAT "%8.2" NUMBER 4 /end CHARACTERISTIC
/begin CHARACTERISTIC DSM_CDKDfp_PFltCDHtg1_C "Kundenspezifischer Fehlercode fuer Fehlerpfad Dfp_PFltCDHtg1" VAL_BLK 0x1CF05C Kwb_Wu16 65535.00 OneToOne 0.00 65535.00 FORMAT "%8.2" NUMBER 4 /end CHARACTERISTIC
/begin CHARACTERISTIC DSM_CDKDfp_PFltCDPDiff_C "Kundenspezifischer Fehlercode fuer Fehlerpfad Dfp_PFltCDPDiff" VAL_BLK 0x1CF064 Kwb_Wu16 65535.00 OneToOne 0.00 65535.00 FORMAT "%8.2" NUMBER 4 /end CHARACTERISTIC
/begin CHARACTERISTIC DSM_CDKDfp_PFltCDTempPre_C "Kundenspezifischer Fehlercode fuer Fehlerpfad Dfp_PFltCDTempPre" VAL_BLK 0x1CF06C Kwb_Wu16 65535.00 OneToOne 0.00 65535.00 FORMAT "%8.2" NUMBER 4 /end CHARACTERISTIC
/begin CHARACTERISTIC DSM_CDKDfp_PFltCDTempPre1_C "Kundenspezifischer Fehlercode fuer Fehlerpfad Dfp_PFltCDTempPre1" VAL_BLK 0x1CF074 Kwb_Wu16 65535.00 OneToOne 0.00 65535.00 FORMAT "%8.2" NUMBER 4 /end CHARACTERISTIC
/begin CHARACTERISTIC DSM_CDKDfp_PFltCDTempPst_C "Kundenspezifischer Fehlercode fuer Fehlerpfad Dfp_PFltCDTempPst" VAL_BLK 0x1CF07C Kwb_Wu16 65535.00 OneToOne 0.00 65535.00 FORMAT "%8.2" NUMBER 4 /end CHARACTERISTIC
/begin CHARACTERISTIC DSM_CDKDfp_PFltChar_C "Kundenspezifischer Fehlercode fuer Fehlerpfad Dfp_PFltChar" VAL_BLK 0x1CF084 Kwb_Wu16 65535.00 OneToOne 0.00 65535.00 FORMAT "%8.2" NUMBER 4 /end CHARACTERISTIC
/begin CHARACTERISTIC DSM_CDKDfp_PFltEngPrt_C "Kundenspezifischer Fehlercode fuer Fehlerpfad Dfp_PFltEngPrt" VAL_BLK 0x1CF08C Kwb_Wu16 65535.00 OneToOne 0.00 65535.00 FORMAT "%8.2" NUMBER 4 /end CHARACTERISTIC
/begin CHARACTERISTIC DSM_CDKDfp_PFltPresDynPlaus_C "Kundenspezifischer Fehlercode fuer Fehlerpfad Dfp_PFltPresDynPlaus" VAL_BLK 0x1CF094 Kwb_Wu16 65535.00 OneToOne 0.00 65535.00 FORMAT "%8.2" NUMBER 4 /end CHARACTERISTIC
/begin CHARACTERISTIC DSM_CDKDfp_PFltPresHsChng_C "Kundenspezifischer Fehlercode fuer Fehlerpfad Dfp_PFltPresHsChng" VAL_BLK 0x1CF09C Kwb_Wu16 65535.00 OneToOne 0.00 65535.00 FORMAT "%8.2" NUMBER 4 /end CHARACTERISTIC
/begin CHARACTERISTIC DSM_CDKDfp_PFltPresSens_C "Kundenspezifischer Fehlercode fuer Fehlerpfad Dfp_PFltPresSens" VAL_BLK 0x1CF0A4 Kwb_Wu16 65535.00 OneToOne 0.00 65535.00 FORMAT "%8.2" NUMBER 4 /end CHARACTERISTIC
/begin CHARACTERISTIC DSM_CDKDfp_PFltPresSensFrz_C "Kundenspezifischer Fehlercode fuer Fehlerpfad Dfp_PFltPresSensFrz" VAL_BLK 0x1CF0AC Kwb_Wu16 65535.00 OneToOne 0.00 65535.00 FORMAT "%8.2" NUMBER 4 /end CHARACTERISTIC
/begin CHARACTERISTIC DSM_CDKDfp_PFltPresSensHsLn_C "Kundenspezifischer Fehlercode fuer Fehlerpfad Dfp_PFltPresSensHsLn" VAL_BLK 0x1CF0B4 Kwb_Wu16 65535.00 OneToOne 0.00 65535.00 FORMAT "%8.2" NUMBER 4 /end CHARACTERISTIC
/begin CHARACTERISTIC DSM_CDKDfp_PFltPresSensSot_C "Kundenspezifischer Fehlercode fuer Fehlerpfad Dfp_PFltPresSensSot" VAL_BLK 0x1CF0BC Kwb_Wu16 65535.00 OneToOne 0.00 65535.00 FORMAT "%8.2" NUMBER 4 /end CHARACTERISTIC
/begin CHARACTERISTIC DSM_CDKDfp_PFltRgnLckPerm_C "Kundenspezifischer Fehlercode fuer Fehlerpfad Dfp_PFltRgnLckPerm" VAL_BLK 0x1CF0C4 Kwb_Wu16 65535.00 OneToOne 0.00 65535.00 FORMAT "%8.2" NUMBER 4 /end CHARACTERISTIC
/begin CHARACTERISTIC DSM_CDKDfp_PFltRgnLckPermTstr_C "Kundenspezifischer Fehlercode fuer Fehlerpfad Dfp_PFltRgnLckPermTstr" VAL_BLK 0x1CF0CC Kwb_Wu16 65535.00 OneToOne 0.00 65535.00 FORMAT "%8.2" NUMBER 4 /end CHARACTERISTIC
/begin CHARACTERISTIC DSM_CDKDfp_PFltRgnPerm_C "Kundenspezifischer Fehlercode fuer Fehlerpfad Dfp_PFltRgnPerm" VAL_BLK 0x1CF0D4 Kwb_Wu16 65535.00 OneToOne 0.00 65535.00 FORMAT "%8.2" NUMBER 4 /end CHARACTERISTIC
/begin CHARACTERISTIC DSM_CDKDfp_PFltSotSimPresPerm_C "Kundenspezifischer Fehlercode fuer Fehlerpfad Dfp_PFltSotSimPresPerm" VAL_BLK 0x1CF0DC Kwb_Wu16 65535.00 OneToOne 0.00 65535.00 FORMAT "%8.2" NUMBER 4 /end CHARACTERISTIC
/begin CHARACTERISTIC DSM_CDKDfp_PFltTempDwnStrm_C "Kundenspezifischer Fehlercode fuer Fehlerpfad Dfp_PFltTempDwnStrm" VAL_BLK 0x1CF0E4 Kwb_Wu16 65535.00 OneToOne 0.00 65535.00 FORMAT "%8.2" NUMBER 4 /end CHARACTERISTIC
/begin CHARACTERISTIC DSM_CDKDfp_PFltTempDwnStrmMax_C "Kundenspezifischer Fehlercode fuer Fehlerpfad Dfp_PFltTempDwnStrmMax" VAL_BLK 0x1CF0EC Kwb_Wu16 65535.00 OneToOne 0.00 65535.00 FORMAT "%8.2" NUMBER 4 /end CHARACTERISTIC
/begin CHARACTERISTIC DSM_CDKDfp_PFltTempDwnStrmMin_C "Kundenspezifischer Fehlercode fuer Fehlerpfad Dfp_PFltTempDwnStrmMin" VAL_BLK 0x1CF0F4 Kwb_Wu16 65535.00 OneToOne 0.00 65535.00 FORMAT "%8.2" NUMBER 4 /end CHARACTERISTIC
/begin CHARACTERISTIC DSM_CDKDfp_PFltTempPreOxiC_C "Kundenspezifischer Fehlercode fuer Fehlerpfad Dfp_PFltTempPreOxiC" VAL_BLK 0x1CF0FC Kwb_Wu16 65535.00 OneToOne 0.00 65535.00 FORMAT "%8.2" NUMBER 4 /end CHARACTERISTIC
/begin CHARACTERISTIC DSM_CDKDfp_PFltTempPrePFlt_C "Kundenspezifischer Fehlercode fuer Fehlerpfad Dfp_PFltTempPrePFlt" VAL_BLK 0x1CF104 Kwb_Wu16 65535.00 OneToOne 0.00 65535.00 FORMAT "%8.2" NUMBER 4 /end CHARACTERISTIC
/begin CHARACTERISTIC DSM_CDKDfp_PFltTempPreTrbn_C "Kundenspezifischer Fehlercode fuer Fehlerpfad Dfp_PFltTempPreTrbn" VAL_BLK 0x1CF10C Kwb_Wu16 65535.00 OneToOne 0.00 65535.00 FORMAT "%8.2" NUMBER 4 /end CHARACTERISTIC
/begin CHARACTERISTIC DSM_CDKDfp_PFltTempPstPFlt_C "Kundenspezifischer Fehlercode fuer Fehlerpfad Dfp_PFltTempPstPFlt" VAL_BLK 0x1CF11C Kwb_Wu16 65535.00 OneToOne 0.00 65535.00 FORMAT "%8.2" NUMBER 4 /end CHARACTERISTIC
/begin CHARACTERISTIC DSM_CDKDfp_PFltTempSens_C "Kundenspezifischer Fehlercode fuer Fehlerpfad Dfp_PFltTempSens" VAL_BLK 0x1CF124 Kwb_Wu16 65535.00 OneToOne 0.00 65535.00 FORMAT "%8.2" NUMBER 4 /end CHARACTERISTIC
/begin CHARACTERISTIC DSM_CDKDfp_PFltTempSens2_C "Kundenspezifischer Fehlercode fuer Fehlerpfad Dfp_PFltTempSens2" VAL_BLK 0x1CF12C Kwb_Wu16 65535.00 OneToOne 0.00 65535.00 FORMAT "%8.2" NUMBER 4 /end CHARACTERISTIC
/begin CHARACTERISTIC DSM_CDKDfp_PFltTempUpStrm_C "Kundenspezifischer Fehlercode fuer Fehlerpfad Dfp_PFltTempUpStrm" VAL_BLK 0x1CF134 Kwb_Wu16 65535.00 OneToOne 0.00 65535.00 FORMAT "%8.2" NUMBER 4 /end CHARACTERISTIC
/begin CHARACTERISTIC DSM_CDKDfp_PFltTempUpStrmMax_C "Kundenspezifischer Fehlercode fuer Fehlerpfad Dfp_PFltTempUpStrmMax" VAL_BLK 0x1CF13C Kwb_Wu16 65535.00 OneToOne 0.00 65535.00 FORMAT "%8.2" NUMBER 4 /end CHARACTERISTIC
/begin CHARACTERISTIC DSM_CDKDfp_PFltTempUpStrmMin_C "Kundenspezifischer Fehlercode fuer Fehlerpfad Dfp_PFltTempUpStrmMin" VAL_BLK 0x1CF144 Kwb_Wu16 65535.00 OneToOne 0.00 65535.00 FORMAT "%8.2" NUMBER 4 /end CHARACTERISTIC
/begin CHARACTERISTIC DSM_CDKDfp_PSPCD_Actr_C "Kundenspezifischer Fehlercode fuer Fehlerpfad Dfp_PSPCD_Actr" VAL_BLK 0x1CF14C Kwb_Wu16 65535.00 OneToOne 0.00 65535.00 FORMAT "%8.2" NUMBER 4 /end CHARACTERISTIC
/begin CHARACTERISTIC DSM_CDKDfp_PrpCtlvLimErrPat_C "Kundenspezifischer Fehlercode fuer Fehlerpfad Dfp_PrpCtlvLimErrPat" VAL_BLK 0x1CF154 Kwb_Wu16 65535.00 OneToOne 0.00 65535.00 FORMAT "%8.2" NUMBER 4 /end CHARACTERISTIC
/begin CHARACTERISTIC DSM_CDKDfp_SOPTst_C "Kundenspezifischer Fehlercode fuer Fehlerpfad Dfp_SOPTst" VAL_BLK 0x1CF15C Kwb_Wu16 65535.00 OneToOne 0.00 65535.00 FORMAT "%8.2" NUMBER 4 /end CHARACTERISTIC
/begin CHARACTERISTIC DSM_CDKDfp_SSpMon1_C "Kundenspezifischer Fehlercode fuer Fehlerpfad Dfp_SSpMon1" VAL_BLK 0x1CF164 Kwb_Wu16 65535.00 OneToOne 0.00 65535.00 FORMAT "%8.2" NUMBER 4 /end CHARACTERISTIC
/begin CHARACTERISTIC DSM_CDKDfp_SSpMon2_C "Kundenspezifischer Fehlercode fuer Fehlerpfad Dfp_SSpMon2" VAL_BLK 0x1CF16C Kwb_Wu16 65535.00 OneToOne 0.00 65535.00 FORMAT "%8.2" NUMBER 4 /end CHARACTERISTIC
/begin CHARACTERISTIC DSM_CDKDfp_SSpMon3_C "Kundenspezifischer Fehlercode fuer Fehlerpfad Dfp_SSpMon3" VAL_BLK 0x1CF174 Kwb_Wu16 65535.00 OneToOne 0.00 65535.00 FORMAT "%8.2" NUMBER 4 /end CHARACTERISTIC
/begin CHARACTERISTIC DSM_CDKDfp_Shtrp_EGRBA_C "Kundenspezifischer Fehlercode fuer Fehlerpfad Dfp_Shtrp_EGRBA" VAL_BLK 0x1CF17C Kwb_Wu16 65535.00 OneToOne 0.00 65535.00 FORMAT "%8.2" NUMBER 4 /end CHARACTERISTIC
/begin CHARACTERISTIC DSM_CDKDfp_Shtrp_PCRBA_C "Kundenspezifischer Fehlercode fuer Fehlerpfad Dfp_Shtrp_PCRBA" VAL_BLK 0x1CF184 Kwb_Wu16 65535.00 OneToOne 0.00 65535.00 FORMAT "%8.2" NUMBER 4 /end CHARACTERISTIC
/begin CHARACTERISTIC DSM_CDKDfp_SrvPmpStSAEcu_C "Kundenspezifischer Fehlercode fuer Fehlerpfad Dfp_SrvPmpStSAEcu" VAL_BLK 0x1CF18C Kwb_Wu16 65535.00 OneToOne 0.00 65535.00 FORMAT "%8.2" NUMBER 4 /end CHARACTERISTIC
/begin CHARACTERISTIC DSM_CDKDfp_StSysCtlShCirBatt_C "Kundenspezifischer Fehlercode fuer Fehlerpfad Dfp_StSysCtlShCirBatt" VAL_BLK 0x1CF194 Kwb_Wu16 65535.00 OneToOne 0.00 65535.00 FORMAT "%8.2" NUMBER 4 /end CHARACTERISTIC
/begin CHARACTERISTIC DSM_CDKDfp_StrtCDOffRly_C "Kundenspezifischer Fehlercode für Fehlerpfad Dfp_StrtCDOffRly" VAL_BLK 0x1CF19C Kwb_Wu16 65535.00 OneToOne 0.00 65535.00 FORMAT "%8.2" NUMBER 4 /end CHARACTERISTIC
/begin CHARACTERISTIC DSM_CDKDfp_StrtCDOnRly_C "Kundenspezifischer Fehlercode für Fehlerpfad Dfp_StrtCDOnRly" VAL_BLK 0x1CF1A4 Kwb_Wu16 65535.00 OneToOne 0.00 65535.00 FORMAT "%8.2" NUMBER 4 /end CHARACTERISTIC
/begin CHARACTERISTIC DSM_CDKDfp_StrtCtlIlsNotPlaus_C "Kundenspezifischer Fehlercode für Fehlerpfad Dfp_StrtCtlIlsNotPlaus" VAL_BLK 0x1CF1AC Kwb_Wu16 65535.00 OneToOne 0.00 65535.00 FORMAT "%8.2" NUMBER 4 /end CHARACTERISTIC
/begin CHARACTERISTIC DSM_CDKDfp_StrtCtlT50ROneRly1_C "Kundenspezifischer Fehlercode fuer Fehlerpfad Dfp_StrtCtlT50ROneRly1" VAL_BLK 0x1CF1B4 Kwb_Wu16 65535.00 OneToOne 0.00 65535.00 FORMAT "%8.2" NUMBER 4 /end CHARACTERISTIC
/begin CHARACTERISTIC DSM_CDKDfp_StrtCtlT50ROneRly2_C "Kundenspezifischer Fehlercode fuer Fehlerpfad Dfp_StrtCtlT50ROneRly2" VAL_BLK 0x1CF1BC Kwb_Wu16 65535.00 OneToOne 0.00 65535.00 FORMAT "%8.2" NUMBER 4 /end CHARACTERISTIC
/begin CHARACTERISTIC DSM_CDKDfp_StrtCtlT50RZero_C "Kundenspezifischer Fehlercode fuer Fehlerpfad Dfp_StrtCtlT50RZero" VAL_BLK 0x1CF1C4 Kwb_Wu16 65535.00 OneToOne 0.00 65535.00 FORMAT "%8.2" NUMBER 4 /end CHARACTERISTIC
/begin CHARACTERISTIC DSM_CDKDfp_SysLamp_C "Kundenspezifischer Fehlercode fuer Fehlerpfad Dfp_SysLamp" VAL_BLK 0x1CF1CC Kwb_Wu16 65535.00 OneToOne 0.00 65535.00 FORMAT "%8.2" NUMBER 4 /end CHARACTERISTIC
/begin CHARACTERISTIC DSM_CDKDfp_T15CD_C "Kundenspezifischer Fehlercode fuer Fehlerpfad Dfp_T15CD" VAL_BLK 0x1CF1D4 Kwb_Wu16 65535.00 OneToOne 0.00 65535.00 FORMAT "%8.2" NUMBER 4 /end CHARACTERISTIC
/begin CHARACTERISTIC DSM_CDKDfp_T50CD_C "Kundenspezifischer Fehlercode fuer Fehlerpfad Dfp_T50CD" VAL_BLK 0x1CF1DC Kwb_Wu16 65535.00 OneToOne 0.00 65535.00 FORMAT "%8.2" NUMBER 4 /end CHARACTERISTIC
/begin CHARACTERISTIC DSM_CDKDfp_TPUMon_C "Kundenspezifischer Fehlercode fuer Fehlerpfad Dfp_TPUMon" VAL_BLK 0x1CF1E4 Kwb_Wu16 65535.00 OneToOne 0.00 65535.00 FORMAT "%8.2" NUMBER 4 /end CHARACTERISTIC
/begin CHARACTERISTIC DSM_CDKDfp_TVACD_Max_C "Kundenspezifischer Fehlercode fuer Fehlerpfad Dfp_TVACD_Max" VAL_BLK 0x1CF1EC Kwb_Wu16 65535.00 OneToOne 0.00 65535.00 FORMAT "%8.2" NUMBER 4 /end CHARACTERISTIC
/begin CHARACTERISTIC DSM_CDKDfp_TVACD_Min_C "Kundenspezifischer Fehlercode fuer Fehlerpfad Dfp_TVACD_Min" VAL_BLK 0x1CF1F4 Kwb_Wu16 65535.00 OneToOne 0.00 65535.00 FORMAT "%8.2" NUMBER 4 /end CHARACTERISTIC
/begin CHARACTERISTIC DSM_CDKDfp_TVACD_Sig_C "Kundenspezifischer Fehlercode fuer Fehlerpfad Dfp_TVACD_Sig" VAL_BLK 0x1CF1FC Kwb_Wu16 65535.00 OneToOne 0.00 65535.00 FORMAT "%8.2" NUMBER 4 /end CHARACTERISTIC
/begin CHARACTERISTIC DSM_CDKDfp_TVACD_SigNpl_C "Kundenspezifischer Fehlercode fuer Fehlerpfad Dfp_TVACD_SigNpl" VAL_BLK 0x1CF204 Kwb_Wu16 65535.00 OneToOne 0.00 65535.00 FORMAT "%8.2" NUMBER 4 /end CHARACTERISTIC
/begin CHARACTERISTIC DSM_CDKDfp_TVACD_stLineDef_C "Kundenspezifischer Fehlercode fuer Fehlerpfad Dfp_TVACD_stLineDef" VAL_BLK 0x1CF20C Kwb_Wu16 65535.00 OneToOne 0.00 65535.00 FORMAT "%8.2" NUMBER 4 /end CHARACTERISTIC
/begin CHARACTERISTIC DSM_CDKDfp_TVASCD_C "Kundenspezifischer Fehlercode fuer Fehlerpfad Dfp_TVASCD" VAL_BLK 0x1CF214 Kwb_Wu16 65535.00 OneToOne 0.00 65535.00 FORMAT "%8.2" NUMBER 4 /end CHARACTERISTIC
/begin CHARACTERISTIC DSM_CDKDfp_TVASCD_Drft_C "Kundenspezifischer Fehlercode fuer Fehlerpfad Dfp_TVASCD_Drft" VAL_BLK 0x1CF21C Kwb_Wu16 65535.00 OneToOne 0.00 65535.00 FORMAT "%8.2" NUMBER 4 /end CHARACTERISTIC
/begin CHARACTERISTIC DSM_CDKDfp_ThrVlvGvnrDvt_C "Kundenspezifischer Fehlercode fuer Fehlerpfad Dfp_ThrVlvGvnrDvt" VAL_BLK 0x1CF224 Kwb_Wu16 65535.00 OneToOne 0.00 65535.00 FORMAT "%8.2" NUMBER 4 /end CHARACTERISTIC
/begin CHARACTERISTIC DSM_CDKDfp_ThrVlvJamVlv_C "Kundenspezifischer Fehlercode fuer Fehlerpfad Dfp_ThrVlvJamVlv" VAL_BLK 0x1CF22C Kwb_Wu16 65535.00 OneToOne 0.00 65535.00 FORMAT "%8.2" NUMBER 4 /end CHARACTERISTIC
/begin CHARACTERISTIC DSM_CDKDfp_UAcc_CodeBitErr_C "Kundenspezifischer Fehlercode fuer Fehlerpfad Dfp_UAcc_CodeBitErr" VAL_BLK 0x1CF234 Kwb_Wu16 65535.00 OneToOne 0.00 65535.00 FORMAT "%8.2" NUMBER 4 /end CHARACTERISTIC
/begin CHARACTERISTIC DSM_CDKDfp_USAp_DataVariant_C "Kundenspezifischer Fehlercode fuer Fehlerpfad Dfp_USAp_DataVariant" VAL_BLK 0x1CF23C Kwb_Wu16 65535.00 OneToOne 0.00 65535.00 FORMAT "%8.2" NUMBER 4 /end CHARACTERISTIC
/begin CHARACTERISTIC DSM_CDKDfp_USAp_FuncCodeRead_C "Kundenspezifischer Fehlercode fuer Fehlerpfad Dfp_USAp_FuncCodeRead" VAL_BLK 0x1CF244 Kwb_Wu16 65535.00 OneToOne 0.00 65535.00 FORMAT "%8.2" NUMBER 4 /end CHARACTERISTIC
/begin CHARACTERISTIC DSM_CDKDfp_VSACD_Max_C "Kundenspezifischer Fehlercode fuer Fehlerpfad Dfp_VSACD_Max" VAL_BLK 0x1CF24C Kwb_Wu16 65535.00 OneToOne 0.00 65535.00 FORMAT "%8.2" NUMBER 4 /end CHARACTERISTIC
/begin CHARACTERISTIC DSM_CDKDfp_VSACD_Min_C "Kundenspezifischer Fehlercode fuer Fehlerpfad Dfp_VSACD_Min" VAL_BLK 0x1CF254 Kwb_Wu16 65535.00 OneToOne 0.00 65535.00 FORMAT "%8.2" NUMBER 4 /end CHARACTERISTIC
/begin CHARACTERISTIC DSM_CDKDfp_VSACD_SigNpl_C "Kundenspezifischer Fehlercode fuer Fehlerpfad Dfp_VSACD_SigNpl" VAL_BLK 0x1CF25C Kwb_Wu16 65535.00 OneToOne 0.00 65535.00 FORMAT "%8.2" NUMBER 4 /end CHARACTERISTIC
/begin CHARACTERISTIC DSM_CDKDfp_VSSCD_C "Kundenspezifischer Fehlercode fuer Fehlerpfad Dfp_VSSCD" VAL_BLK 0x1CF264 Kwb_Wu16 65535.00 OneToOne 0.00 65535.00 FORMAT "%8.2" NUMBER 4 /end CHARACTERISTIC
/begin CHARACTERISTIC DSM_CDKDfp_VSSCD1_C "Kundenspezifischer Fehlercode fuer Fehlerpfad Dfp_VSSCD1" VAL_BLK 0x1CF26C Kwb_Wu16 65535.00 OneToOne 0.00 65535.00 FORMAT "%8.2" NUMBER 4 /end CHARACTERISTIC
/begin CHARACTERISTIC DSM_CDKDfp_VSSCD2_C "Kundenspezifischer Fehlercode fuer Fehlerpfad Dfp_VSSCD2" VAL_BLK 0x1CF274 Kwb_Wu16 65535.00 OneToOne 0.00 65535.00 FORMAT "%8.2" NUMBER 4 /end CHARACTERISTIC
/begin CHARACTERISTIC DSM_CDKDfp_VSSCD4_C "Kundenspezifischer Fehlercode fuer Fehlerpfad Dfp_VSSCD4" VAL_BLK 0x1CF27C Kwb_Wu16 65535.00 OneToOne 0.00 65535.00 FORMAT "%8.2" NUMBER 4 /end CHARACTERISTIC
/begin CHARACTERISTIC DSM_CDKDfp_VSSCDBrkLowVltg_C "Kundenspezifischer Fehlercode fuer Fehlerpfad Dfp_VSSCDBrkLowVltg" VAL_BLK 0x1CF284 Kwb_Wu16 65535.00 OneToOne 0.00 65535.00 FORMAT "%8.2" NUMBER 4 /end CHARACTERISTIC
/begin CHARACTERISTIC DSM_CDKDfp_VSSCDCAN_C "Kundenspezifischer Fehlercode fuer Fehlerpfad Dfp_VSSCDCAN" VAL_BLK 0x1CF28C Kwb_Wu16 65535.00 OneToOne 0.00 65535.00 FORMAT "%8.2" NUMBER 4 /end CHARACTERISTIC
/begin CHARACTERISTIC DSM_CDKDfp_VSSCDNpl_C "Kundenspezifischer Fehlercode fuer Fehlerpfad Dfp_VSSCDNpl" VAL_BLK 0x1CF294 Kwb_Wu16 65535.00 OneToOne 0.00 65535.00 FORMAT "%8.2" NUMBER 4 /end CHARACTERISTIC
/begin CHARACTERISTIC DSM_CDKDfp_WdCom_C "Kundenspezifischer Fehlercode fuer Fehlerpfad Dfp_WdCom" VAL_BLK 0x1CF2A4 Kwb_Wu16 65535.00 OneToOne 0.00 65535.00 FORMAT "%8.2" NUMBER 4 /end CHARACTERISTIC
/begin COMPU_METHOD OneToOne "eins zu eins (physikalischer Wert ist gleich dem internen Wert)" RAT_FUNC "%6.2" "[-]" COEFFS 0 1 0 0 0 1 /end COMPU_METHOD
/begin RECORD_LAYOUT Kwb_Wu16 FNC_VALUES 1 UWORD COLUMN_DIR DIRECT /end RECORD_LAYOUT
/begin FUNCTION DSM_CDC "Configuration parameters for CARB specific fault code for fault path"
 /begin DEF_CHARACTERISTIC DSM_CDCDfp_ACCCDBrkErr_C DSM_CDCDfp_ACCCDBrkNPL_C DSM_CDCDfp_ACCCDSensErr_C DSM_CDCDfp_ACCCDWrongCoded_C DSM_CDCDfp_ACCCD_C DSM_CDCDfp_ACCD_C DSM_CDCDfp_ACCD_PAC_C DSM_CDCDfp_ACCD_pCAN_C DSM_CDCDfp_ACCD_trqCAN_C DSM_CDCDfp_ACCIRevPanErr_C DSM_CDCDfp_ACCIRevShOff_C DSM_CDCDfp_ACCnotPlaus_C DSM_CDCDfp_ADCMon_C DSM_CDCDfp_AFSCD_PlOffsDrft_C DSM_CDCDfp_AFSCD_PlSetyDrft_C DSM_CDCDfp_AFSCD_SRCAirm_C DSM_CDCDfp_AFVCD_Actr_C DSM_CDCDfp_AOHtCDHt1_C DSM_CDCDfp_AOHtCDHt2_C DSM_CDCDfp_AOHtCDHt3_C DSM_CDCDfp_APP1_C DSM_CDCDfp_APP2_C DSM_CDCDfp_APPCD_KickDown_C DSM_CDCDfp_APPCD_PWGDrft_C DSM_CDCDfp_APPSync_C DSM_CDCDfp_APP_Npl_C DSM_CDCDfp_APSCD_C DSM_CDCDfp_AccPedPlausBrk_C DSM_CDCDfp_AirCtl_GovDevMax_C DSM_CDCDfp_AirCtl_GovDevMin_C DSM_CDCDfp_AirCtl_GovDevRgnMax_C DSM_CDCDfp_AirCtl_GovDevRgnMin_C DSM_CDCDfp_AirbCDCrashCrCtl_C DSM_CDCDfp_AirbCDCrashPSP_C DSM_CDCDfp_AirbCDCrash_C DSM_CDCDfp_AltCDExc_C DSM_CDCDfp_AltCD_Load_C DSM_CDCDfp_AltPwrCan_C DSM_CDCDfp_BIP01_C DSM_CDCDfp_BIP02_C DSM_CDCDfp_BIP03_C DSM_CDCDfp_BIP04_C DSM_CDCDfp_BIP05_C DSM_CDCDfp_BIP06_C DSM_CDCDfp_BIP07_C DSM_CDCDfp_BIP08_C DSM_CDCDfp_BIP09_C DSM_CDCDfp_BIP10_C DSM_CDCDfp_BIP11_C DSM_CDCDfp_BIP12_C DSM_CDCDfp_BIP_Con_C DSM_CDCDfp_BPACD_Max2_C DSM_CDCDfp_BPACD_Max_C DSM_CDCDfp_BPACD_Min2_C DSM_CDCDfp_BPACD_Min_C DSM_CDCDfp_BPACD_SigNpl2_C DSM_CDCDfp_BPACD_SigNpl_C DSM_CDCDfp_BPASCD_C DSM_CDCDfp_BPSCD_C DSM_CDCDfp_BattCD_C DSM_CDCDfp_BrkCDBPTInvld_C DSM_CDCDfp_BrkCD_C DSM_CDCDfp_BrkCDdynPl_C DSM_CDCDfp_CANA_C DSM_CDCDfp_CANB_C DSM_CDCDfp_CANBus1_C DSM_CDCDfp_CANBus2_C DSM_CDCDfp_CANBus3_C DSM_CDCDfp_CANC_C DSM_CDCDfp_CANErrActA_C DSM_CDCDfp_CANErrActB_C DSM_CDCDfp_CANErrActC_C DSM_CDCDfp_COTSCD_C DSM_CDCDfp_CTSCDCanInac_C DSM_CDCDfp_CTSCDCanSig_C DSM_CDCDfp_CTSCD_C DSM_CDCDfp_Clg_DynTst_C DSM_CDCDfp_CmbChbMisfire1_C DSM_CDCDfp_CmbChbMisfire2_C DSM_CDCDfp_CmbChbMisfire3_C DSM_CDCDfp_CmbChbMisfire4_C DSM_CDCDfp_CmbChbMisfire5_C DSM_CDCDfp_CmbChbMisfire6_C DSM_CDCDfp_CmbChbMisfireMul_C DSM_CDCDfp_CoVMDCSh_C DSM_CDCDfp_CoVMDCSp_C DSM_CDCDfp_CoVehLvl2_C DSM_CDCDfp_ConvCD_C DSM_CDCDfp_ConvCD_ConvErr_C DSM_CDCDfp_ConvCD_EPB1_C DSM_CDCDfp_CrCCDPanErrMSG_C DSM_CDCDfp_CrCCDPanErrSMLS_C DSM_CDCDfp_CrCCDPanMainSwtErr_C DSM_CDCDfp_CrCtlDsplNotPlaus_C DSM_CDCDfp_CrCtlPECDErr_C DSM_CDCDfp_CrCtlPLmpDef_C DSM_CDCDfp_CrCtlPShutOff_C DSM_CDCDfp_CtApCD_C DSM_CDCDfp_CtTCD_C DSM_CDCDfp_CtT_Mon_C DSM_CDCDfp_DifftrqLimErrPat_C DSM_CDCDfp_EATSCDCanInac_C DSM_CDCDfp_EATSCDCanSig_C DSM_CDCDfp_EATSCD_C DSM_CDCDfp_EEPCDVarMng_C DSM_CDCDfp_EGPpCDTPreTrbn_C DSM_CDCDfp_EGRCD_CBV_C DSM_CDCDfp_EGRCD_Max_C DSM_CDCDfp_EGRCD_Min_C DSM_CDCDfp_EGRCD_SigNpl_C DSM_CDCDfp_EGRCD_Sig_C DSM_CDCDfp_EGRSCD_C DSM_CDCDfp_EGRSCD_JamVlv_C DSM_CDCDfp_EGRSCD_LgTimeDrft_C DSM_CDCDfp_EGRSCD_ShTimeDrft_C DSM_CDCDfp_EGRVlvGvnrDvt_C DSM_CDCDfp_EGRVlv_JamVlv_C DSM_CDCDfp_EMCCD_MLS1_C DSM_CDCDfp_EngMBackUp_C DSM_CDCDfp_EngMCaS1_C DSM_CDCDfp_EngMCaSDrv_C DSM_CDCDfp_EngMCrS1_C DSM_CDCDfp_EngMOfsCaSCrS_C DSM_CDCDfp_EngMonIrrCmb_C DSM_CDCDfp_EngPrt_C DSM_CDCDfp_ErLpCDMILReqON_C DSM_CDCDfp_FMAErrMod_C DSM_CDCDfp_FMTC_NonMonotonMap_C DSM_CDCDfp_FQTSCD_C DSM_CDCDfp_FQlSCD_C DSM_CDCDfp_FTSCDNpl_C DSM_CDCDfp_FTSCD_C DSM_CDCDfp_FanCD_Fan1Ctlr1_C DSM_CDCDfp_FanCD_Fan1Ctlr2_C DSM_CDCDfp_FanCD_Fan2Ctlr1_C DSM_CDCDfp_FanCD_Fan2Ctlr2_C DSM_CDCDfp_FanCD_FanCtlr1_C DSM_CDCDfp_FanCD_FanCtlr2_C DSM_CDCDfp_FanCD_OutFanCtlr1_C DSM_CDCDfp_FanCD_OutFanCtlr2_C DSM_CDCDfp_FlPpCD_C DSM_CDCDfp_FlSCDT1_C DSM_CDCDfp_FrmMngAAGNpl_C DSM_CDCDfp_FrmMngAAGTO_C DSM_CDCDfp_FrmMngAC1Npl_C DSM_CDCDfp_FrmMngAC1TO_C DSM_CDCDfp_FrmMngACCNpl_C DSM_CDCDfp_FrmMngACCTO_C DSM_CDCDfp_FrmMngAIRBGNpl_C DSM_CDCDfp_FrmMngAIRBGTO_C DSM_CDCDfp_FrmMngAWD1Npl_C DSM_CDCDfp_FrmMngAWD1TO_C DSM_CDCDfp_FrmMngBEM1Npl_C DSM_CDCDfp_FrmMngBEM1TO_C DSM_CDCDfp_FrmMngBRK1Npl_C DSM_CDCDfp_FrmMngBRK1TO_C DSM_CDCDfp_FrmMngBRK2Npl_C DSM_CDCDfp_FrmMngBRK2TO_C DSM_CDCDfp_FrmMngBRK8Npl_C DSM_CDCDfp_FrmMngBRK8TO_C DSM_CDCDfp_FrmMngCANVerErr_C DSM_CDCDfp_FrmMngCCSel_C DSM_CDCDfp_FrmMngCCTLNpl_C DSM_CDCDfp_FrmMngCCTLTO_C DSM_CDCDfp_FrmMngCHRGR1Npl_C DSM_CDCDfp_FrmMngCHRGR1TO_C DSM_CDCDfp_FrmMngCHRGR2Npl_C DSM_CDCDfp_FrmMngCHRGR2TO_C DSM_CDCDfp_FrmMngChrgr1A_C DSM_CDCDfp_FrmMngChrgr1C_C DSM_CDCDfp_FrmMngChrgr1N_C DSM_CDCDfp_FrmMngChrgr1T_C DSM_CDCDfp_FrmMngChrgr1V_C DSM_CDCDfp_FrmMngChrgr2A_C DSM_CDCDfp_FrmMngChrgr2C_C DSM_CDCDfp_FrmMngChrgr2N_C DSM_CDCDfp_FrmMngChrgr2T_C DSM_CDCDfp_FrmMngChrgr2V_C DSM_CDCDfp_FrmMngDIA1Npl_C DSM_CDCDfp_FrmMngDIA1TO_C DSM_CDCDfp_FrmMngDSP1Npl_C DSM_CDCDfp_FrmMngDSP1TO_C DSM_CDCDfp_FrmMngDSP2Npl_C DSM_CDCDfp_FrmMngDSP2TO_C DSM_CDCDfp_FrmMngDSP3Npl_C DSM_CDCDfp_FrmMngDSP3TO_C DSM_CDCDfp_FrmMngEPB1Npl_C DSM_CDCDfp_FrmMngEPB1TO_C DSM_CDCDfp_FrmMngESCUNpl_C DSM_CDCDfp_FrmMngESCUTO_C DSM_CDCDfp_FrmMngGW1Npl_C DSM_CDCDfp_FrmMngGW1TO_C DSM_CDCDfp_FrmMngILMNpl_C DSM_CDCDfp_FrmMngILMTO_C DSM_CDCDfp_FrmMngNIV1WrngCod_C DSM_CDCDfp_FrmMngNIVEAU1Npl_C DSM_CDCDfp_FrmMngNIVEAU1TO_C DSM_CDCDfp_FrmMngSA1Npl_C DSM_CDCDfp_FrmMngSA1TO_C DSM_CDCDfp_FrmMngSTIGNNpl_C DSM_CDCDfp_FrmMngStIgnTO_C DSM_CDCDfp_FrmMngTOSNpl_C DSM_CDCDfp_FrmMngTOSTO_C DSM_CDCDfp_FrmMngTSC1Npl_C DSM_CDCDfp_FrmMngTSC1TO_C DSM_CDCDfp_FrmMngTSC2Npl_C DSM_CDCDfp_FrmMngTSC2TO_C DSM_CDCDfp_FrmMngTSC3Npl_C DSM_CDCDfp_FrmMngTSC3TO_C DSM_CDCDfp_FrmMngTSC6Npl_C DSM_CDCDfp_FrmMngTSC6TO_C DSM_CDCDfp_FrmMngTrbnSpdErr_C DSM_CDCDfp_GbSSCD_C DSM_CDCDfp_GbSSCD_HW_C DSM_CDCDfp_GearbxCVTnMax_C DSM_CDCDfp_GearbxClthPlaus_C DSM_CDCDfp_GearbxINCCup_C DSM_CDCDfp_GearbxNMinMon_C DSM_CDCDfp_GearbxTSC_C DSM_CDCDfp_GearbxTransConv_C DSM_CDCDfp_GearbxTypeMTErr_C DSM_CDCDfp_GlwCDDIAG_C DSM_CDCDfp_GlwCDErr1_C DSM_CDCDfp_GlwCDErr2_C DSM_CDCDfp_GlwCDEvalCod_C DSM_CDCDfp_GlwCDGSK2_C DSM_CDCDfp_GlwCDGSK3_C DSM_CDCDfp_GlwCDLmp_C DSM_CDCDfp_GlwCDPLUG0_C DSM_CDCDfp_GlwCDPLUG1_C DSM_CDCDfp_GlwCDPLUG2_C DSM_CDCDfp_GlwCDPLUG3_C DSM_CDCDfp_GlwCDPLUG4_C DSM_CDCDfp_GlwCDPLUG5_C DSM_CDCDfp_GlwCD_LampCan_C DSM_CDCDfp_GlwCDsfd_C DSM_CDCDfp_HDSCD_C DSM_CDCDfp_HWEMonCom_C DSM_CDCDfp_HWEMonEEPROM_C DSM_CDCDfp_HWEMonRcyLocked_C DSM_CDCDfp_HWEMonRcySuppressed_C DSM_CDCDfp_HWEMonRcyVisible_C DSM_CDCDfp_HWEMonUMaxSupply_C DSM_CDCDfp_HWEMonUMinSupply_C DSM_CDCDfp_IATSCD_C DSM_CDCDfp_IFCD_C DSM_CDCDfp_ImmCtl_C DSM_CDCDfp_IndSysMonIntMnf_C DSM_CDCDfp_InjVlvBnk1A_C DSM_CDCDfp_InjVlvBnk2A_C DSM_CDCDfp_InjVlvCyl10A_C DSM_CDCDfp_InjVlvCyl11A_C DSM_CDCDfp_InjVlvCyl12A_C DSM_CDCDfp_InjVlvCyl1A_C DSM_CDCDfp_InjVlvCyl2A_C DSM_CDCDfp_InjVlvCyl3A_C DSM_CDCDfp_InjVlvCyl4A_C DSM_CDCDfp_InjVlvCyl5A_C DSM_CDCDfp_InjVlvCyl6A_C DSM_CDCDfp_InjVlvCyl7A_C DSM_CDCDfp_InjVlvCyl8A_C DSM_CDCDfp_InjVlvCyl9A_C DSM_CDCDfp_LASCD_C DSM_CDCDfp_LSUCDCircNernst0_C DSM_CDCDfp_LSUCDCircPumpCur0_C DSM_CDCDfp_LSUCDCircVirtGnd0_C DSM_CDCDfp_LSUCDHeater0_C DSM_CDCDfp_LSUCDHtCoup0_C DSM_CDCDfp_LSUCDO20_C DSM_CDCDfp_LSUCDO2Clb0_C DSM_CDCDfp_LSUCDRiClb0_C DSM_CDCDfp_LSUCDSPI0_C DSM_CDCDfp_LSUCDSPIBattLow0_C DSM_CDCDfp_LSUCDWireIP0_C DSM_CDCDfp_LSUCtlRiExc0_C DSM_CDCDfp_LSUMonDyn0_C DSM_CDCDfp_LSUMonFullLd0_C DSM_CDCDfp_LSUMonOvrRun0_C DSM_CDCDfp_LSUMonPartLd0_C DSM_CDCDfp_MIL_C DSM_CDCDfp_MRlyCD_C DSM_CDCDfp_Montr_C DSM_CDCDfp_OTSCDCanInac_C DSM_CDCDfp_OTSCDCanSig_C DSM_CDCDfp_OTSCD_C DSM_CDCDfp_OvRMonCrCtlP_C DSM_CDCDfp_OvRMonSigA_C DSM_CDCDfp_OvRMon_C DSM_CDCDfp_OxiCCDTPre1_C DSM_CDCDfp_OxiCCDTPre_C DSM_CDCDfp_PCR_BalGovDev_C DSM_CDCDfp_PCR_GovDev_C DSM_CDCDfp_PFltAPSens_C DSM_CDCDfp_PFltCDHtg1_C DSM_CDCDfp_PFltCDHtg_C DSM_CDCDfp_PFltCDPDiff_C DSM_CDCDfp_PFltCDTempPre1_C DSM_CDCDfp_PFltCDTempPre_C DSM_CDCDfp_PFltCDTempPst_C DSM_CDCDfp_PFltChar_C DSM_CDCDfp_PFltEngPrt_C DSM_CDCDfp_PFltPresDynPlaus_C DSM_CDCDfp_PFltPresHsChng_C DSM_CDCDfp_PFltPresSensFrz_C DSM_CDCDfp_PFltPresSensHsLn_C DSM_CDCDfp_PFltPresSensSot_C DSM_CDCDfp_PFltPresSens_C DSM_CDCDfp_PFltRgnLckPermTstr_C DSM_CDCDfp_PFltRgnLckPerm_C DSM_CDCDfp_PFltRgnPerm_C DSM_CDCDfp_PFltSotSimPresPerm_C DSM_CDCDfp_PFltTempDwnStrmMax_C DSM_CDCDfp_PFltTempDwnStrmMin_C DSM_CDCDfp_PFltTempDwnStrm_C DSM_CDCDfp_PFltTempPreOxiC_C DSM_CDCDfp_PFltTempPrePFlt_C DSM_CDCDfp_PFltTempPreTrbn_C DSM_CDCDfp_PFltTempPstPFlt_C DSM_CDCDfp_PFltTempSens2_C DSM_CDCDfp_PFltTempSens_C DSM_CDCDfp_PFltTempUpStrmMax_C DSM_CDCDfp_PFltTempUpStrmMin_C DSM_CDCDfp_PFltTempUpStrm_C DSM_CDCDfp_PSPCD_Actr_C DSM_CDCDfp_PrpCtlvLimErrPat_C DSM_CDCDfp_SOPTst_C DSM_CDCDfp_SSpMon1_C DSM_CDCDfp_SSpMon2_C DSM_CDCDfp_SSpMon3_C DSM_CDCDfp_Shtrp_EGRBA_C DSM_CDCDfp_Shtrp_PCRBA_C DSM_CDCDfp_SrvPmpStSAEcu_C DSM_CDCDfp_StSysCtlShCirBatt_C DSM_CDCDfp_StrtCDOffRly_C DSM_CDCDfp_StrtCDOnRly_C DSM_CDCDfp_StrtCtlIlsNotPlaus_C DSM_CDCDfp_StrtCtlT50ROneRly1_C DSM_CDCDfp_StrtCtlT50ROneRly2_C DSM_CDCDfp_StrtCtlT50RZero_C DSM_CDCDfp_SysLamp_C DSM_CDCDfp_T15CD_C DSM_CDCDfp_T50CD_C DSM_CDCDfp_TPUMon_C DSM_CDCDfp_TVACD_Max_C DSM_CDCDfp_TVACD_Min_C DSM_CDCDfp_TVACD_SigNpl_C DSM_CDCDfp_TVACD_Sig_C DSM_CDCDfp_TVACD_stLineDef_C DSM_CDCDfp_TVASCD_C DSM_CDCDfp_TVASCD_Drft_C DSM_CDCDfp_ThrVlvGvnrDvt_C DSM_CDCDfp_ThrVlvJamVlv_C DSM_CDCDfp_UAcc_CodeBitErr_C DSM_CDCDfp_USAp_DataVariant_C DSM_CDCDfp_USAp_FuncCodeRead_C DSM_CDCDfp_VSACD_Max_C DSM_CDCDfp_VSACD_Min_C DSM_CDCDfp_VSACD_SigNpl_C DSM_CDCDfp_VSSCD1_C DSM_CDCDfp_VSSCD2_C DSM_CDCDfp_VSSCD4_C DSM_CDCDfp_VSSCDBrkLowVltg_C DSM_CDCDfp_VSSCDCAN_C DSM_CDCDfp_VSSCDNpl_C DSM_CDCDfp_VSSCD_C DSM_CDCDfp_WdCom_C DSM_CDKDfp_CrCtlPShutOff_C /end DEF_CHARACTERISTIC
/end FUNCTION
/begin FUNCTION DSM_CDK "Configuration parameters for customer specific diagnostic trouble code for fault path"
 /begin DEF_CHARACTERISTIC DSM_CDCDfp_CrCtlPTlrDef_C DSM_CDKDfp_ACCCDBrkErr_C DSM_CDKDfp_ACCCDBrkNPL_C DSM_CDKDfp_ACCCDSensErr_C DSM_CDKDfp_ACCCDWrongCoded_C DSM_CDKDfp_ACCCD_C DSM_CDKDfp_ACCD_C DSM_CDKDfp_ACCD_PAC_C DSM_CDKDfp_ACCD_pCAN_C DSM_CDKDfp_ACCD_trqCAN_C DSM_CDKDfp_ACCIRevPanErr_C DSM_CDKDfp_ACCIRevShOff_C DSM_CDKDfp_ACCnotPlaus_C DSM_CDKDfp_ADCMon_C DSM_CDKDfp_AFSCD_PlOffsDrft_C DSM_CDKDfp_AFSCD_PlSetyDrft_C DSM_CDKDfp_AFSCD_SRCAirm_C DSM_CDKDfp_AFVCD_Actr_C DSM_CDKDfp_AOHtCDHt1_C DSM_CDKDfp_AOHtCDHt2_C DSM_CDKDfp_AOHtCDHt3_C DSM_CDKDfp_APP1_C DSM_CDKDfp_APP2_C DSM_CDKDfp_APPCD_KickDown_C DSM_CDKDfp_APPCD_PWGDrft_C DSM_CDKDfp_APPSync_C DSM_CDKDfp_APP_Npl_C DSM_CDKDfp_APSCD_C DSM_CDKDfp_AccPedPlausBrk_C DSM_CDKDfp_AirCtl_GovDevMax_C DSM_CDKDfp_AirCtl_GovDevMin_C DSM_CDKDfp_AirCtl_GovDevRgnMax_C DSM_CDKDfp_AirCtl_GovDevRgnMin_C DSM_CDKDfp_AirbCDCrashCrCtl_C DSM_CDKDfp_AirbCDCrashPSP_C DSM_CDKDfp_AirbCDCrash_C DSM_CDKDfp_AltCDExc_C DSM_CDKDfp_AltCD_Load_C DSM_CDKDfp_AltPwrCan_C DSM_CDKDfp_BIP01_C DSM_CDKDfp_BIP02_C DSM_CDKDfp_BIP03_C DSM_CDKDfp_BIP04_C DSM_CDKDfp_BIP05_C DSM_CDKDfp_BIP06_C DSM_CDKDfp_BIP07_C DSM_CDKDfp_BIP08_C DSM_CDKDfp_BIP09_C DSM_CDKDfp_BIP10_C DSM_CDKDfp_BIP11_C DSM_CDKDfp_BIP12_C DSM_CDKDfp_BIP_Con_C DSM_CDKDfp_BPACD_Max2_C DSM_CDKDfp_BPACD_Max_C DSM_CDKDfp_BPACD_Min2_C DSM_CDKDfp_BPACD_Min_C DSM_CDKDfp_BPACD_SigNpl2_C DSM_CDKDfp_BPACD_SigNpl_C DSM_CDKDfp_BPASCD_C DSM_CDKDfp_BPSCD_C DSM_CDKDfp_BattCD_C DSM_CDKDfp_BrkCDBPTInvld_C DSM_CDKDfp_BrkCD_C DSM_CDKDfp_BrkCDdynPl_C DSM_CDKDfp_CANA_C DSM_CDKDfp_CANB_C DSM_CDKDfp_CANBus1_C DSM_CDKDfp_CANBus2_C DSM_CDKDfp_CANBus3_C DSM_CDKDfp_CANC_C DSM_CDKDfp_CANErrActA_C DSM_CDKDfp_CANErrActB_C DSM_CDKDfp_CANErrActC_C DSM_CDKDfp_COTSCD_C DSM_CDKDfp_CTSCDCanInac_C DSM_CDKDfp_CTSCDCanSig_C DSM_CDKDfp_CTSCD_C DSM_CDKDfp_Clg_DynTst_C DSM_CDKDfp_CmbChbMisfire1_C DSM_CDKDfp_CmbChbMisfire2_C DSM_CDKDfp_CmbChbMisfire3_C DSM_CDKDfp_CmbChbMisfire4_C DSM_CDKDfp_CmbChbMisfire5_C DSM_CDKDfp_CmbChbMisfire6_C DSM_CDKDfp_CmbChbMisfireMul_C DSM_CDKDfp_CoVMDCSh_C DSM_CDKDfp_CoVMDCSp_C DSM_CDKDfp_CoVehLvl2_C DSM_CDKDfp_ConvCD_C DSM_CDKDfp_ConvCD_ConvErr_C DSM_CDKDfp_ConvCD_EPB1_C DSM_CDKDfp_CrCCDPanErrMSG_C DSM_CDKDfp_CrCCDPanErrSMLS_C DSM_CDKDfp_CrCCDPanMainSwtErr_C DSM_CDKDfp_CrCtlDsplNotPlaus_C DSM_CDKDfp_CrCtlPECDErr_C DSM_CDKDfp_CrCtlPLmpDef_C DSM_CDKDfp_CrCtlPTlrDef_C DSM_CDKDfp_CtApCD_C DSM_CDKDfp_CtTCD_C DSM_CDKDfp_CtT_Mon_C DSM_CDKDfp_DifftrqLimErrPat_C DSM_CDKDfp_EATSCDCanInac_C DSM_CDKDfp_EATSCDCanSig_C DSM_CDKDfp_EATSCD_C DSM_CDKDfp_EEPCDVarMng_C DSM_CDKDfp_EGPpCDTPreTrbn_C DSM_CDKDfp_EGRCD_CBV_C DSM_CDKDfp_EGRCD_Max_C DSM_CDKDfp_EGRCD_Min_C DSM_CDKDfp_EGRCD_SigNpl_C DSM_CDKDfp_EGRCD_Sig_C DSM_CDKDfp_EGRSCD_C DSM_CDKDfp_EGRSCD_JamVlv_C DSM_CDKDfp_EGRSCD_LgTimeDrft_C DSM_CDKDfp_EGRSCD_ShTimeDrft_C DSM_CDKDfp_EGRVlvGvnrDvt_C DSM_CDKDfp_EGRVlv_JamVlv_C DSM_CDKDfp_EMCCD_MLS1_C DSM_CDKDfp_EngMBackUp_C DSM_CDKDfp_EngMCaS1_C DSM_CDKDfp_EngMCaSDrv_C DSM_CDKDfp_EngMCrS1_C DSM_CDKDfp_EngMOfsCaSCrS_C DSM_CDKDfp_EngMonIrrCmb_C DSM_CDKDfp_EngPrt_C DSM_CDKDfp_ErLpCDMILReqON_C DSM_CDKDfp_FMAErrMod_C DSM_CDKDfp_FMTC_NonMonotonMap_C DSM_CDKDfp_FQTSCD_C DSM_CDKDfp_FQlSCD_C DSM_CDKDfp_FTSCDNpl_C DSM_CDKDfp_FTSCD_C DSM_CDKDfp_FanCD_Fan1Ctlr1_C DSM_CDKDfp_FanCD_Fan1Ctlr2_C DSM_CDKDfp_FanCD_Fan2Ctlr1_C DSM_CDKDfp_FanCD_Fan2Ctlr2_C DSM_CDKDfp_FanCD_FanCtlr1_C DSM_CDKDfp_FanCD_FanCtlr2_C DSM_CDKDfp_FanCD_OutFanCtlr1_C DSM_CDKDfp_FanCD_OutFanCtlr2_C DSM_CDKDfp_FlPpCD_C DSM_CDKDfp_FlSCDT1_C DSM_CDKDfp_FrmMngAAGNpl_C DSM_CDKDfp_FrmMngAAGTO_C DSM_CDKDfp_FrmMngAC1Npl_C DSM_CDKDfp_FrmMngAC1TO_C DSM_CDKDfp_FrmMngACCNpl_C DSM_CDKDfp_FrmMngACCTO_C DSM_CDKDfp_FrmMngAIRBGNpl_C DSM_CDKDfp_FrmMngAIRBGTO_C DSM_CDKDfp_FrmMngAWD1Npl_C DSM_CDKDfp_FrmMngAWD1TO_C DSM_CDKDfp_FrmMngBEM1Npl_C DSM_CDKDfp_FrmMngBEM1TO_C DSM_CDKDfp_FrmMngBRK1Npl_C DSM_CDKDfp_FrmMngBRK1TO_C DSM_CDKDfp_FrmMngBRK2Npl_C DSM_CDKDfp_FrmMngBRK2TO_C DSM_CDKDfp_FrmMngBRK8Npl_C DSM_CDKDfp_FrmMngBRK8TO_C DSM_CDKDfp_FrmMngBSG3TO_C DSM_CDKDfp_FrmMngCANVerErr_C DSM_CDKDfp_FrmMngCCSel_C DSM_CDKDfp_FrmMngCCTLNpl_C DSM_CDKDfp_FrmMngCCTLTO_C DSM_CDKDfp_FrmMngCHRGR1Npl_C DSM_CDKDfp_FrmMngCHRGR1TO_C DSM_CDKDfp_FrmMngCHRGR2Npl_C DSM_CDKDfp_FrmMngCHRGR2TO_C DSM_CDKDfp_FrmMngChrgr1A_C DSM_CDKDfp_FrmMngChrgr1C_C DSM_CDKDfp_FrmMngChrgr1N_C DSM_CDKDfp_FrmMngChrgr1T_C DSM_CDKDfp_FrmMngChrgr1V_C DSM_CDKDfp_FrmMngChrgr2A_C DSM_CDKDfp_FrmMngChrgr2C_C DSM_CDKDfp_FrmMngChrgr2N_C DSM_CDKDfp_FrmMngChrgr2T_C DSM_CDKDfp_FrmMngChrgr2V_C DSM_CDKDfp_FrmMngDIA1Npl_C DSM_CDKDfp_FrmMngDIA1TO_C DSM_CDKDfp_FrmMngDSP1Npl_C DSM_CDKDfp_FrmMngDSP1TO_C DSM_CDKDfp_FrmMngDSP2Npl_C DSM_CDKDfp_FrmMngDSP2TO_C DSM_CDKDfp_FrmMngDSP3Npl_C DSM_CDKDfp_FrmMngDSP3TO_C DSM_CDKDfp_FrmMngEPB1Npl_C DSM_CDKDfp_FrmMngEPB1TO_C DSM_CDKDfp_FrmMngESCUNpl_C DSM_CDKDfp_FrmMngESCUTO_C DSM_CDKDfp_FrmMngGW1Npl_C DSM_CDKDfp_FrmMngGW1TO_C DSM_CDKDfp_FrmMngILMNpl_C DSM_CDKDfp_FrmMngILMTO_C DSM_CDKDfp_FrmMngLICHT2TO_C DSM_CDKDfp_FrmMngNIV1WrngCod_C DSM_CDKDfp_FrmMngNIVEAU1Npl_C DSM_CDKDfp_FrmMngNIVEAU1TO_C DSM_CDKDfp_FrmMngSA1Npl_C DSM_CDKDfp_FrmMngSA1TO_C DSM_CDKDfp_FrmMngSTIGNNpl_C DSM_CDKDfp_FrmMngStIgnTO_C DSM_CDKDfp_FrmMngTOSNpl_C DSM_CDKDfp_FrmMngTOSTO_C DSM_CDKDfp_FrmMngTSC1Npl_C DSM_CDKDfp_FrmMngTSC1TO_C DSM_CDKDfp_FrmMngTSC2Npl_C DSM_CDKDfp_FrmMngTSC2TO_C DSM_CDKDfp_FrmMngTSC3Npl_C DSM_CDKDfp_FrmMngTSC3TO_C DSM_CDKDfp_FrmMngTSC6Npl_C DSM_CDKDfp_FrmMngTSC6TO_C DSM_CDKDfp_FrmMngTrbnSpdErr_C DSM_CDKDfp_FrmMngWIPERTO_C DSM_CDKDfp_GbSSCD_C DSM_CDKDfp_GbSSCD_HW_C DSM_CDKDfp_GearbxCVTnMax_C DSM_CDKDfp_GearbxClthPlaus_C DSM_CDKDfp_GearbxINCCup_C DSM_CDKDfp_GearbxNMinMon_C DSM_CDKDfp_GearbxTSC_C DSM_CDKDfp_GearbxTransConv_C DSM_CDKDfp_GearbxTypeMTErr_C DSM_CDKDfp_GlwCDDIAG_C DSM_CDKDfp_GlwCDErr1_C DSM_CDKDfp_GlwCDErr2_C DSM_CDKDfp_GlwCDEvalCod_C DSM_CDKDfp_GlwCDGSK2_C DSM_CDKDfp_GlwCDGSK3_C DSM_CDKDfp_GlwCDLmp_C DSM_CDKDfp_GlwCDPLUG0_C DSM_CDKDfp_GlwCDPLUG1_C DSM_CDKDfp_GlwCDPLUG2_C DSM_CDKDfp_GlwCDPLUG3_C DSM_CDKDfp_GlwCDPLUG4_C DSM_CDKDfp_GlwCDPLUG5_C DSM_CDKDfp_GlwCD_LampCan_C DSM_CDKDfp_GlwCDsfd_C DSM_CDKDfp_HDSCD_C DSM_CDKDfp_HWEMonCom_C DSM_CDKDfp_HWEMonEEPROM_C DSM_CDKDfp_HWEMonRcyLocked_C DSM_CDKDfp_HWEMonRcySuppressed_C DSM_CDKDfp_HWEMonRcyVisible_C DSM_CDKDfp_HWEMonUMaxSupply_C DSM_CDKDfp_HWEMonUMinSupply_C DSM_CDKDfp_IATSCD_C DSM_CDKDfp_IFCD_C DSM_CDKDfp_ImmCtl_C DSM_CDKDfp_IndSysMonIntMnf_C DSM_CDKDfp_InjVlvBnk1A_C DSM_CDKDfp_InjVlvBnk2A_C DSM_CDKDfp_InjVlvCyl10A_C DSM_CDKDfp_InjVlvCyl11A_C DSM_CDKDfp_InjVlvCyl12A_C DSM_CDKDfp_InjVlvCyl1A_C DSM_CDKDfp_InjVlvCyl2A_C DSM_CDKDfp_InjVlvCyl3A_C DSM_CDKDfp_InjVlvCyl4A_C DSM_CDKDfp_InjVlvCyl5A_C DSM_CDKDfp_InjVlvCyl6A_C DSM_CDKDfp_InjVlvCyl7A_C DSM_CDKDfp_InjVlvCyl8A_C DSM_CDKDfp_InjVlvCyl9A_C DSM_CDKDfp_LASCD_C DSM_CDKDfp_LSUCDCircNernst0_C DSM_CDKDfp_LSUCDCircPumpCur0_C DSM_CDKDfp_LSUCDCircVirtGnd0_C DSM_CDKDfp_LSUCDHeater0_C DSM_CDKDfp_LSUCDHtCoup0_C DSM_CDKDfp_LSUCDO20_C DSM_CDKDfp_LSUCDO2Clb0_C DSM_CDKDfp_LSUCDRiClb0_C DSM_CDKDfp_LSUCDSPI0_C DSM_CDKDfp_LSUCDSPIBattLow0_C DSM_CDKDfp_LSUCDWireIP0_C DSM_CDKDfp_LSUCtlRiExc0_C DSM_CDKDfp_LSUMonDyn0_C DSM_CDKDfp_LSUMonFullLd0_C DSM_CDKDfp_LSUMonOvrRun0_C DSM_CDKDfp_LSUMonPartLd0_C DSM_CDKDfp_MIL_C DSM_CDKDfp_MRlyCD_C DSM_CDKDfp_Montr_C DSM_CDKDfp_OTSCDCanInac_C DSM_CDKDfp_OTSCDCanSig_C DSM_CDKDfp_OTSCD_C DSM_CDKDfp_OvRMonCrCtlP_C DSM_CDKDfp_OvRMonSigA_C DSM_CDKDfp_OvRMon_C DSM_CDKDfp_OxiCCDTPre1_C DSM_CDKDfp_OxiCCDTPre_C DSM_CDKDfp_PCR_BalGovDev_C DSM_CDKDfp_PCR_GovDev_C DSM_CDKDfp_PFltAPSens_C DSM_CDKDfp_PFltCDHtg1_C DSM_CDKDfp_PFltCDHtg_C DSM_CDKDfp_PFltCDPDiff_C DSM_CDKDfp_PFltCDTempPre1_C DSM_CDKDfp_PFltCDTempPre_C DSM_CDKDfp_PFltCDTempPst_C DSM_CDKDfp_PFltChar_C DSM_CDKDfp_PFltEngPrt_C DSM_CDKDfp_PFltPresDynPlaus_C DSM_CDKDfp_PFltPresHsChng_C DSM_CDKDfp_PFltPresSensFrz_C DSM_CDKDfp_PFltPresSensHsLn_C DSM_CDKDfp_PFltPresSensSot_C DSM_CDKDfp_PFltPresSens_C DSM_CDKDfp_PFltRgnLckPermTstr_C DSM_CDKDfp_PFltRgnLckPerm_C DSM_CDKDfp_PFltRgnPerm_C DSM_CDKDfp_PFltSotSimPresPerm_C DSM_CDKDfp_PFltTempDwnStrmMax_C DSM_CDKDfp_PFltTempDwnStrmMin_C DSM_CDKDfp_PFltTempDwnStrm_C DSM_CDKDfp_PFltTempPreOxiC_C DSM_CDKDfp_PFltTempPrePFlt_C DSM_CDKDfp_PFltTempPreTrbn_C DSM_CDKDfp_PFltTempPstPFlt_C DSM_CDKDfp_PFltTempSens2_C DSM_CDKDfp_PFltTempSens_C DSM_CDKDfp_PFltTempUpStrmMax_C DSM_CDKDfp_PFltTempUpStrmMin_C DSM_CDKDfp_PFltTempUpStrm_C DSM_CDKDfp_PSPCD_Actr_C DSM_CDKDfp_PrpCtlvLimErrPat_C DSM_CDKDfp_SOPTst_C DSM_CDKDfp_SSpMon1_C DSM_CDKDfp_SSpMon2_C DSM_CDKDfp_SSpMon3_C DSM_CDKDfp_Shtrp_EGRBA_C DSM_CDKDfp_Shtrp_PCRBA_C DSM_CDKDfp_SrvPmpStSAEcu_C DSM_CDKDfp_StSysCtlShCirBatt_C DSM_CDKDfp_StrtCDOffRly_C DSM_CDKDfp_StrtCDOnRly_C DSM_CDKDfp_StrtCtlIlsNotPlaus_C DSM_CDKDfp_StrtCtlT50ROneRly1_C DSM_CDKDfp_StrtCtlT50ROneRly2_C DSM_CDKDfp_StrtCtlT50RZero_C DSM_CDKDfp_SysLamp_C DSM_CDKDfp_T15CD_C DSM_CDKDfp_T50CD_C DSM_CDKDfp_TPUMon_C DSM_CDKDfp_TVACD_Max_C DSM_CDKDfp_TVACD_Min_C DSM_CDKDfp_TVACD_SigNpl_C DSM_CDKDfp_TVACD_Sig_C DSM_CDKDfp_TVACD_stLineDef_C DSM_CDKDfp_TVASCD_C DSM_CDKDfp_TVASCD_Drft_C DSM_CDKDfp_ThrVlvGvnrDvt_C DSM_CDKDfp_ThrVlvJamVlv_C DSM_CDKDfp_UAcc_CodeBitErr_C DSM_CDKDfp_USAp_DataVariant_C DSM_CDKDfp_USAp_FuncCodeRead_C DSM_CDKDfp_VSACD_Max_C DSM_CDKDfp_VSACD_Min_C DSM_CDKDfp_VSACD_SigNpl_C DSM_CDKDfp_VSSCD1_C DSM_CDKDfp_VSSCD2_C DSM_CDKDfp_VSSCD4_C DSM_CDKDfp_VSSCDBrkLowVltg_C DSM_CDKDfp_VSSCDCAN_C DSM_CDKDfp_VSSCDNpl_C DSM_CDKDfp_VSSCD_C DSM_CDKDfp_WdCom_C /end DEF_CHARACTERISTIC
/end FUNCTION
/end MODULE
/end PROJECT
