ASAP2_VERSION 1 3
/begin PROJECT X447 "EDC16U34"
/begin HEADER "" VERSION "VAA1" PROJECT_NO X447 /end HEADER
/begin MODULE DIM ""
/begin MOD_COMMON "" BYTE_ORDER MSB_FIRST ALIGNMENT_BYTE 1 ALIGNMENT_WORD 2 ALIGNMENT_LONG 4 ALIGNMENT_FLOAT32_IEEE 4 /end MOD_COMMON
/begin MEASUREMENT ASDdc_stNewNeg_mp "Weitere Bedingung für ASDdc_stNGvnr_mp.2" UBYTE OneToOne 1 100 0.00 255.0 FORMAT "%5.1" ECU_ADDRESS 0x9FF9FC /end MEASUREMENT
/begin MEASUREMENT ASDdc_stNewPosByp_mp "Meßpunkt für Bypass Freischnitt" UBYTE OneToOne 1 100 0.00 255.0 FORMAT "%5.1" ECU_ADDRESS 0x9FF9FD /end MEASUREMENT
/begin MEASUREMENT ASDdc_stNewPos_mp "Weitere Bedingung fuer ASDdc_stNGvnr_mp.1" UBYTE OneToOne 1 100 0.00 255.0 FORMAT "%5.1" ECU_ADDRESS 0x9FF9FE /end MEASUREMENT
/begin MEASUREMENT ASDdc_stNGvnrExtInt "Information für Drehzahlregler, ob externer Eingriff erkannt" UBYTE OneToOne 1 100 0.00 255.0 FORMAT "%5.1" ECU_ADDRESS 0x7F92E6 /end MEASUREMENT
/begin MEASUREMENT ASDdc_stNGvnrExtIntByp_mp "Meßpunkt für Bypass Freischnitt" UBYTE OneToOne 1 100 0.00 255.0 FORMAT "%5.1" ECU_ADDRESS 0x9FFA05 /end MEASUREMENT
/begin MEASUREMENT ASDdc_stNGvnr_mp "Status fuer Drehzahlregler (bitorientiert)" UBYTE OneToOne 1 100 0.00 255.0 FORMAT "%5.1" ECU_ADDRESS 0x9FF9FF /end MEASUREMENT
/begin MEASUREMENT ASDdc_stPosNeg_mp "pos/neg Mengentendenz" UBYTE OneToOne 1 100 0.00 255.0 FORMAT "%5.1" ECU_ADDRESS 0x9FFA06 /end MEASUREMENT
/begin MEASUREMENT ASDdc_stPwrOnOff_mp "Lastschlag erkannt" UBYTE OneToOne 1 100 0.00 255.0 FORMAT "%5.1" ECU_ADDRESS 0x9FFA07 /end MEASUREMENT
/begin MEASUREMENT ASDdc_stShOffPT1Flt_mp "Schalter für Überbrückung der Sollwertfilterung des PT1 Gliedes" SWORD OneToOne 1 100 -32768.00 32767.00 FORMAT "%8.2" ECU_ADDRESS 0x9FE936 /end MEASUREMENT
/begin MEASUREMENT ASDdc_stStMNGvnr_mp "Status der Drehzahlregler Statemachine" UBYTE OneToOne 1 100 0.00 255.0 FORMAT "%5.1" ECU_ADDRESS 0x9FFA00 /end MEASUREMENT
/begin MEASUREMENT ASDdc_stTrbnSpdCAN_mp "Aktivierungsstatus der Verwendung der Turbinendrehzahl über CAN" UBYTE OneToOne 1 100 0.00 255.0 FORMAT "%5.1" ECU_ADDRESS 0x9FFA01 /end MEASUREMENT
/begin MEASUREMENT ASDdc_sttrqMask "Bitmaske für die Berücksichtigung des LLR - Moments" UBYTE OneToOne 1 100 0.00 255.0 FORMAT "%5.1" ECU_ADDRESS 0x7F92E7 /end MEASUREMENT
/begin MEASUREMENT ASDdc_stTrqRmp_mp "Schalterstellung Rampe zur ARDsr-Abschaltung im Schub" UBYTE OneToOne 1 100 0.00 255.0 FORMAT "%5.1" ECU_ADDRESS 0x9FFA02 /end MEASUREMENT
/begin MEASUREMENT ASDdc_T1Curr_mp "Aktueller Parameter T1 des Störungsreglers" FLOAT32_IEEE ASD_GvrnDT1T1_float 1 100 -1.00000000 100.000000 FORMAT "%10.6" ECU_ADDRESS 0x9FE400 /end MEASUREMENT
/begin MEASUREMENT ASDdc_tiRmpStrt "aus Kennfeld berechnete Wartezeit bis Faktorrampe startet" UWORD Time_s 1 100 0.00 655.3500 FORMAT "%8.4" ECU_ADDRESS 0x7F961A /end MEASUREMENT
/begin MEASUREMENT ASDdc_tiSwtOff "Zeit nach der die Schubabschalterampe hart auf Null geschaltet wird" UWORD Time_ms 1 100 0.00 655350.0 FORMAT "%8.1" ECU_ADDRESS 0x7F961C /end MEASUREMENT
/begin MEASUREMENT ASDdc_trq "Momentforderung Aktiver Ruckeldämpfer (Störungsregler)" SWORD Trq 1 100 -3276.800 3276.700 FORMAT "%8.3" ECU_ADDRESS 0x7F961E /end MEASUREMENT
/begin MEASUREMENT ASDdc_trqBeforeRmp_mp "ASDdc Ausgang vor Schubabschaltung" SWORD Trq 1 100 -3276.800 3276.700 FORMAT "%8.3" ECU_ADDRESS 0x9FE938 /end MEASUREMENT
/begin MEASUREMENT ASDdc_trqDpn_mp "Verlustmoment" SWORD Trq 1 100 -3276.800 3276.700 FORMAT "%8.3" ECU_ADDRESS 0x9FE93A /end MEASUREMENT
/begin MEASUREMENT ASDdc_trqDT1InitRaw_mp "Berechneter Initialisierungsrohwert für den DT1-Filter" SWORD Trq 1 100 -3276.800 3276.700 FORMAT "%8.3" ECU_ADDRESS 0x9FE93C /end MEASUREMENT
/begin MEASUREMENT ASDdc_trqDT1Init_mp "Initialisierungswert des DT1-Filters" SWORD Trq 1 100 -3276.800 3276.700 FORMAT "%8.3" ECU_ADDRESS 0x9FE93E /end MEASUREMENT
/begin MEASUREMENT ASDdc_trqEngOutLtd_mp "limitiertes Motorausgangsmoment" SWORD Trq 1 100 -3276.800 3276.700 FORMAT "%8.3" ECU_ADDRESS 0x9FE940 /end MEASUREMENT
/begin MEASUREMENT ASDdc_trqInrDesSlowFlt_mp "Gefiltertes Wunschmoment" SWORD Trq 1 100 -3276.800 3276.700 FORMAT "%8.3" ECU_ADDRESS 0x9FE958 /end MEASUREMENT
/begin MEASUREMENT ASDdc_trqLimMax_mp "obere Begrenzung des Störreglerausgangs" SWORD Trq 1 100 -3276.800 3276.700 FORMAT "%8.3" ECU_ADDRESS 0x9FE95A /end MEASUREMENT
/begin MEASUREMENT ASDdc_trqLimMin_mp "untere Begrenzung des Störreglerausgangs" SWORD Trq 1 100 -3276.800 3276.700 FORMAT "%8.3" ECU_ADDRESS 0x9FE95C /end MEASUREMENT
/begin MEASUREMENT ASDdc_trqNGvnrDT1_mp "DT1 - Anteil des Drehzahlreglers" SWORD Trq 1 100 -3276.800 3276.700 FORMAT "%8.3" ECU_ADDRESS 0x9FE942 /end MEASUREMENT
/begin MEASUREMENT ASDdc_trqNGvnrIn_mp "Bezungsmoment für die Erkennung / Beendigung der Lastschläge" SWORD Trq 1 100 -3276.800 3276.700 FORMAT "%8.3" ECU_ADDRESS 0x9FE944 /end MEASUREMENT
/begin MEASUREMENT ASDdc_trqNGvnrI_mp "I-Anteil des Drehzahlreglers" SWORD Trq 1 100 -3276.800 3276.700 FORMAT "%8.3" ECU_ADDRESS 0x9FE946 /end MEASUREMENT
/begin MEASUREMENT ASDdc_trqNGvnrNeg "negatives Ausgangsmoment des Drehzahlreglers" SWORD Trq 1 100 -3276.800 3276.700 FORMAT "%8.3" ECU_ADDRESS 0x7F9620 /end MEASUREMENT
/begin MEASUREMENT ASDdc_trqNGvnrNegByp_mp "Meßpunkt für Bypass Freischnitt" SWORD Trq 1 100 -3276.800 3276.700 FORMAT "%8.3" ECU_ADDRESS 0x9FE948 /end MEASUREMENT
/begin MEASUREMENT ASDdc_trqNGvnrPID_mp "Summe der einzelnen Reglerausgänge" SWORD Trq 1 100 -3276.800 3276.700 FORMAT "%8.3" ECU_ADDRESS 0x9FE94A /end MEASUREMENT
/begin MEASUREMENT ASDdc_trqNGvnrPos "positves Ausgangsmoment des Drehzahlreglers" SWORD Trq 1 100 -3276.800 3276.700 FORMAT "%8.3" ECU_ADDRESS 0x7F9622 /end MEASUREMENT
/begin MEASUREMENT ASDdc_trqNGvnrPosByp_mp "Meßpunkt für Bypass Freischnitt" SWORD Trq 1 100 -3276.800 3276.700 FORMAT "%8.3" ECU_ADDRESS 0x9FE94C /end MEASUREMENT
/begin MEASUREMENT ASDdc_trqNGvnrP_mp "P - Anteil des Drehzahlreglers" SWORD Trq 1 100 -3276.800 3276.700 FORMAT "%8.3" ECU_ADDRESS 0x9FE94E /end MEASUREMENT
/begin MEASUREMENT ASDdc_trqPwrOnOffLim_mp "Schwelle für Aktivierung der Lastschlagerkennung" SWORD Trq 1 100 -3276.800 3276.700 FORMAT "%8.3" ECU_ADDRESS 0x9FE95E /end MEASUREMENT
/begin MEASUREMENT ASDdc_trqRawNGvnrNeg_mp "negatives roh Ausgangsmoment des Drehzahlreglers" SWORD Trq 1 100 -3276.800 3276.700 FORMAT "%8.3" ECU_ADDRESS 0x9FE950 /end MEASUREMENT
/begin MEASUREMENT ASDdc_trqRstDpnOfs_mp "Initialisierungsmoment des I-Reglers aus Kennfeld" SWORD Trq 1 100 -3276.800 3276.700 FORMAT "%8.3" ECU_ADDRESS 0x9FE952 /end MEASUREMENT
/begin MEASUREMENT ASDdc_trqUnLtd "unbegrenzter Störreglerausgang" SWORD Trq 1 100 -3276.800 3276.700 FORMAT "%8.3" ECU_ADDRESS 0x7F9624 /end MEASUREMENT
/begin MEASUREMENT ASDrf_dtrqInrLtd_mp "zeitliche Ableitung von CoEng_trqInrLtd" SWORD dTrq 1 100 -3276.800 3276.700 FORMAT "%8.3" ECU_ADDRESS 0x9FE960 /end MEASUREMENT
/begin MEASUREMENT ASDrf_dtrqLim_mp "durch ASDrf_dtrqInrLtdLim_CUR begrenzte zeitliche Ableitung von CoEng_trqInrLtd" SLONG dTrq 1 100 -214748364.800 214748364.700 FORMAT "%13.3" ECU_ADDRESS 0x9FE408 /end MEASUREMENT
/begin MEASUREMENT ASDrf_KdCurr_mp "Aktueller Parameter Kd des ARD-FF (ASDrf)" SLONG Kd 1 100 -32768.0000000 32767.9999847 FORMAT "%13.7" ECU_ADDRESS 0x9FE40C /end MEASUREMENT
/begin MEASUREMENT ASDrf_rAPP1Flt "gefilterter PWG Wert" SWORD Prc 1 100 -327.6800 327.6700 FORMAT "%8.4" ECU_ADDRESS 0x7F9626 /end MEASUREMENT
/begin MEASUREMENT ASDrf_stBitFrame "Status von Parameterauswahl" UBYTE OneToOne 1 100 0.00 255.0 FORMAT "%5.1" ECU_ADDRESS 0x7F92E8 /end MEASUREMENT
/begin MEASUREMENT ASDrf_stExtInt "Erkennung von externem Momenteneingriff" UBYTE OneToOne 1 100 0.00 255.0 FORMAT "%5.1" ECU_ADDRESS 0x7F92E9 /end MEASUREMENT
/begin MEASUREMENT ASDrf_stGrip "Status Kraftschluß bzw.  Wandlerkupplung geregelt" UBYTE OneToOne 1 100 0.00 255.0 FORMAT "%5.1" ECU_ADDRESS 0x7F92EA /end MEASUREMENT
/begin MEASUREMENT ASDrf_stInitSteepIn_mp "Indikator für Initialisierung aufgrund großer Eingangsgradienten" UBYTE OneToOne 1 100 0.00 255.0 FORMAT "%5.1" ECU_ADDRESS 0x9FFA08 /end MEASUREMENT
/begin MEASUREMENT ASDrf_stPosNeg "pos/neg Mengentendenz" UBYTE OneToOne 1 100 0.00 255.0 FORMAT "%5.1" ECU_ADDRESS 0x7F92EB /end MEASUREMENT
/begin MEASUREMENT ASDrf_stSlpLim_mp "Steigungsbegrenzung aktiv" UBYTE OneToOne 1 100 0.00 255.0 FORMAT "%5.1" ECU_ADDRESS 0x9FFA09 /end MEASUREMENT
/begin MEASUREMENT ASDrf_stTMFWRO "Statusleiste für Ausrollerkennung" UBYTE OneToOne 1 100 0.00 255.0 FORMAT "%5.1" ECU_ADDRESS 0x7F92EC /end MEASUREMENT
/begin MEASUREMENT ASDrf_T1Curr_mp "Aktueller Parameter T1 des ARD-FF (ASDrf)" ULONG TimeDelay_s 1 100 0.0000010000000 4294.9673 FORMAT "%9.4" ECU_ADDRESS 0x9FE410 /end MEASUREMENT
/begin MEASUREMENT ASDrf_trqCompoffset_mp "Offset für Schleppfehlerkorrektur" SLONG Trq 1 100 -214748364.800 214748364.700 FORMAT "%13.3" ECU_ADDRESS 0x9FE414 /end MEASUREMENT
/begin MEASUREMENT ASDrf_trqInit_mp "berechneter Initialisierungswert für PT1 Zustandsvariable" SWORD Trq 1 100 -3276.800 3276.700 FORMAT "%8.3" ECU_ADDRESS 0x9FE962 /end MEASUREMENT
/begin MEASUREMENT ASDrf_trqInr "ARD Führungsformer Momentausgang (inneres Moment)" SWORD Trq 1 100 -3276.800 3276.700 FORMAT "%8.3" ECU_ADDRESS 0x7F9628 /end MEASUREMENT
/begin MEASUREMENT ASDrf_trqInrLtdFlt_mp "Gefiltertes Eingangssignal CoEng_trqInrLtd" SWORD Trq 1 100 -3276.800 3276.700 FORMAT "%8.3" ECU_ADDRESS 0x9FE964 /end MEASUREMENT
/begin MEASUREMENT ASDrf_trqInrUnLim_mp "Ausgang des PDT1-Glieds, vor der Steigungsbegrenzung des Führungsformers." SWORD Trq 1 100 -3276.800 3276.700 FORMAT "%8.3" ECU_ADDRESS 0x9FE966 /end MEASUREMENT
/begin MEASUREMENT ASDrf_trqLimPull_mp "Zuggrenze" SWORD Trq 1 100 -3276.800 3276.700 FORMAT "%8.3" ECU_ADDRESS 0x9FE968 /end MEASUREMENT
/begin MEASUREMENT ASDrf_trqLimPush_mp "Schubgrenze" SWORD Trq 1 100 -3276.800 3276.700 FORMAT "%8.3" ECU_ADDRESS 0x9FE96A /end MEASUREMENT
/begin MEASUREMENT ASDrf_trqLossComp_mp "Verlustmoment nach Kompesation des Leerlaufrglermoments" SWORD Trq 1 100 -3276.800 3276.700 FORMAT "%8.3" ECU_ADDRESS 0x9FE96C /end MEASUREMENT
/begin MEASUREMENT ASDrf_trqLoss_mp "Reibmoment inc. Nebenaggregate" SWORD Trq 1 100 -3276.800 3276.700 FORMAT "%8.3" ECU_ADDRESS 0x9FE96E /end MEASUREMENT
/begin MEASUREMENT ASDrf_trqPT1In_mp "aktueller PT1 Eingangswert" SLONG Trq 1 100 -214748364.800 214748364.700 FORMAT "%13.3" ECU_ADDRESS 0x9FE418 /end MEASUREMENT
/begin MEASUREMENT ASDrf_trqPT1Out_mp "aktueller PT1 Ausgangswert" SWORD Trq 1 100 -3276.800 3276.700 FORMAT "%8.3" ECU_ADDRESS 0x9FE970 /end MEASUREMENT
/begin MEASUREMENT ASDrf_trqPT1P_mp "Ausgang P-Anteil in PT1 gefiltertem Signal" SWORD Trq 1 100 -3276.800 3276.700 FORMAT "%8.3" ECU_ADDRESS 0x9FE972 /end MEASUREMENT
/begin MEASUREMENT ASDrf_trqP_mp "Ausgang ASDrf P-Anteil" SWORD Trq 1 100 -3276.800 3276.700 FORMAT "%8.3" ECU_ADDRESS 0x9FE974 /end MEASUREMENT
/begin MEASUREMENT BasAdj_ActRout_mp "vom Tester vorgegebene Grundeinstellungsnummer (Diagnose)" UBYTE OneToOne 1 100 0.00 255.0 FORMAT "%5.1" ECU_ADDRESS 0x9FFA0A /end MEASUREMENT
/begin MEASUREMENT BasAdj_DispMode_mp "Dummy Wert für die x Eingangsgröße in den Kennfeldern BasAdj_K2SigBlkVal x _MAP in basadj.kgs  (Diagnose)" UBYTE OneToOne 1 100 0.00 255.0 FORMAT "%5.1" ECU_ADDRESS 0x9FFA0B /end MEASUREMENT
/begin MEASUREMENT BasAdj_lastRout_mp "Nummer der zuletzt aufgerufenen Grundeinstellung  (Diagnose)" UBYTE OneToOne 1 100 0.00 255.0 FORMAT "%5.1" ECU_ADDRESS 0x9FFA0C /end MEASUREMENT
/begin MEASUREMENT BasAdj_nRmpSlpDwn "Rampensteigung für verringernde Drehzahlwerte für BasAdj" ULONG RmpEngN_LIGov 1 100 0.00 9362285.71211 FORMAT "%13.5" ECU_ADDRESS 0x7F9D48 /end MEASUREMENT
/begin MEASUREMENT BasAdj_nRmpSlpUp "Rampensteigung für erhöhende Drehzahlwerte für BasAdj" ULONG RmpEngN_LIGov 1 100 0.00 9362285.71211 FORMAT "%13.5" ECU_ADDRESS 0x7F9D4C /end MEASUREMENT
/begin MEASUREMENT BasAdj_nSetPointDia "Leerlaufsolldrehzahl bei Grundeinstellung  (Diagnose)" SWORD EngN 1 100 -32768.00 32767.00 FORMAT "%8.2" ECU_ADDRESS 0x7F96C4 /end MEASUREMENT
/begin MEASUREMENT BasAdj_rAirCtlEGR "Sollwert des EGR-Ventils bei EGR Grundeinstellung  (Diagnose)" SWORD Prc 1 100 -327.6800 327.6700 FORMAT "%8.4" ECU_ADDRESS 0x7F96C6 /end MEASUREMENT
/begin MEASUREMENT BasAdj_rAirCtlTVA "Sollwert der Drosselklappe bei EGR Grundeinstellung  (Diagnose)" SWORD Prc 1 100 -327.6800 327.6700 FORMAT "%8.4" ECU_ADDRESS 0x7F96C8 /end MEASUREMENT
/begin MEASUREMENT BasAdj_rPCR "Sollwert des PCR-Stellglieds bei PCR Grundeinstellung  (Diagnose)" SWORD Prc 1 100 -327.6800 327.6700 FORMAT "%8.4" ECU_ADDRESS 0x7F96CA /end MEASUREMENT
/begin MEASUREMENT BasAdj_rPCRBiT1 "Vorgabewert fuer den 1. Ladedrucksteller bei BiT Grundeinstellung  (Diagnose)" SWORD Prc 1 100 -327.6800 327.6700 FORMAT "%8.4" ECU_ADDRESS 0x7F96CC /end MEASUREMENT
/begin MEASUREMENT BasAdj_rPCRBiT2 "Vorgabewert fuer den 2. Ladedrucksteller bei BiT Grundeinstellung  (Diagnose)" SWORD Prc 1 100 -327.6800 327.6700 FORMAT "%8.4" ECU_ADDRESS 0x7F96CE /end MEASUREMENT
/begin MEASUREMENT BasAdj_rTVA "Sollwert der Drosselklappe bei Grundeinstellung" SWORD DtyCyc 1 100 -327.6800 327.6700 FORMAT "%8.4" ECU_ADDRESS 0x7F96D0 /end MEASUREMENT
/begin MEASUREMENT BasAdj_rVSA1 "Vorgabewert fuer den 1. Drallsteller bei VSA1 Grundeinstellung  (Diagnose)" SWORD DtyCyc 1 100 -327.6800 327.6700 FORMAT "%8.4" ECU_ADDRESS 0x7F96D2 /end MEASUREMENT
/begin MEASUREMENT BasAdj_rVSA2 "Vorgabewert fuer den 2. Drallsteller bei VSA2 Grundeinstellung  (Diagnose)" SWORD DtyCyc 1 100 -327.6800 327.6700 FORMAT "%8.4" ECU_ADDRESS 0x7F96D4 /end MEASUREMENT
/begin MEASUREMENT BasAdj_st "Status Grundeinstellungstest für Diagnose" UWORD OneToOne 1 100 0.00 65535.00 FORMAT "%8.2" ECU_ADDRESS 0x7F96D6 /end MEASUREMENT
/begin MEASUREMENT BasAdj_st1 "Status von der zweiten Grundeinstellung" UWORD OneToOne 1 100 0.00 65535.00 FORMAT "%8.2" ECU_ADDRESS 0x7F96D8 /end MEASUREMENT
/begin MEASUREMENT BasAdj_stAct "Status ob die Grundeinstellung mit Sicherheitsbedingungen aktiv ist" UBYTE OneToOne 1 100 0.00 255.0 FORMAT "%5.1" ECU_ADDRESS 0x7F9314 /end MEASUREMENT
/begin MEASUREMENT BasAdj_stActRout_mp "Status des aktuellen Grundeinstellungtests  (Diagnose)" UBYTE OneToOne 1 100 0.00 255.0 FORMAT "%5.1" ECU_ADDRESS 0x9FFA0D /end MEASUREMENT
/begin MEASUREMENT BasAdj_stAFVCD "Vorgabewert für AFVCD" UBYTE OneToOne 1 100 0.00 255.0 FORMAT "%5.1" ECU_ADDRESS 0x7F9313 /end MEASUREMENT
/begin MEASUREMENT BasAdj_stAllowed "Status der Weiterschaltbedingungen zur Freigabe der Grundeinstellung" UWORD OneToOne 1 100 0.00 65535.00 FORMAT "%8.2" ECU_ADDRESS 0x7F96DA /end MEASUREMENT
/begin MEASUREMENT BasAdj_stPSP "Vorgabewert fuer die Elektrische Vorfoerderpumpe bei PSP Grundeinstellung  (Diagnose)" UBYTE OneToOne 1 100 0.00 255.0 FORMAT "%5.1" ECU_ADDRESS 0x7F9315 /end MEASUREMENT
/begin MEASUREMENT BasAdj_stRelease "Status zur Ausblendung von AccPed bei Grundeinstellung" UBYTE OneToOne 1 100 0.00 255.0 FORMAT "%5.1" ECU_ADDRESS 0x7F9316 /end MEASUREMENT
/begin MEASUREMENT BasAdj_stReleaseTxt "Status zur Umschaltung zwischen Messwerten und Textanzeigen" UBYTE OneToOne 1 100 0.00 255.0 FORMAT "%5.1" ECU_ADDRESS 0x7F9317 /end MEASUREMENT
/begin MEASUREMENT BasAdj_stRoutDem_mp "Zeigt die Kommunikation mit dem Tester (Anforderung vom Tester)    (Diagnose)" UBYTE OneToOne 1 100 0.00 255.0 FORMAT "%5.1" ECU_ADDRESS 0x9FFA0E /end MEASUREMENT
/begin MEASUREMENT BasAdj_stShortTrip "Staus des Zustandsautomaten bei Short Trip Grundeinstellung" UBYTE OneToOne 1 100 0.00 255.0 FORMAT "%5.1" ECU_ADDRESS 0x7F9318 /end MEASUREMENT
/begin MEASUREMENT BattCD_u "Batteriespannung" SWORD Volt_Batt 1 100 -665674.1 665653.8 FORMAT "%8.1" ECU_ADDRESS 0x7F96DC /end MEASUREMENT
/begin MEASUREMENT BattCD_uFlt "PT1-gefilterte Batteriespannung" SWORD OneToOne 1 100 -32768.00 32767.00 FORMAT "%8.2" ECU_ADDRESS 0x7F96DE /end MEASUREMENT
/begin MEASUREMENT BattCD_uLin_mp "Rohwert Batterspannung über ADC" SWORD Volt_Batt 1 100 -665674.1 665653.8 FORMAT "%8.1" ECU_ADDRESS 0x9FE976 /end MEASUREMENT
/begin MEASUREMENT BattCD_uRaw "Rohwert ADC-Signalspannung für Batteriespannung" SWORD Volt_Batt 1 100 -665674.1 665653.8 FORMAT "%8.1" ECU_ADDRESS 0x7F96E0 /end MEASUREMENT
/begin MEASUREMENT Batt_facCor "Faktor für Batteriespannungskorrektur" SWORD Fact 1 100 -4.000000 3.999878 FORMAT "%8.6" ECU_ADDRESS 0x7F96E2 /end MEASUREMENT
/begin MEASUREMENT BdInt_nMax "Schutzdrehzahl für Karosserie und Innenraum" SWORD EngN 1 100 -32768.00 32767.00 FORMAT "%8.2" ECU_ADDRESS 0x7F96E4 /end MEASUREMENT
/begin MEASUREMENT BdInt_nMin "Anforderung Leerlaufdrehzahl durch Karosserie & Innenraum" SWORD EngN 1 100 -32768.00 32767.00 FORMAT "%8.2" ECU_ADDRESS 0x7F96E6 /end MEASUREMENT
/begin MEASUREMENT BdInt_pwrDes "Leistungsanforderung Wunsch Karosserie & Innenraum" SWORD Pwr 1 100 -308831.1 308821.7 FORMAT "%8.1" ECU_ADDRESS 0x7F96E8 /end MEASUREMENT
/begin MEASUREMENT BdInt_pwrLead "Leistungsanforderung Vorhalt Karosserie & Innenraum" SWORD Pwr 1 100 -308831.1 308821.7 FORMAT "%8.1" ECU_ADDRESS 0x7F96EA /end MEASUREMENT
/begin MEASUREMENT BIPCD_ddiBW_mp "Aktuelle BIP-Bandbreite (zylinderselektives Array)" SWORD OneToOne 1 100 -32768.00 32767.00 FORMAT "%8.2" ARRAY_SIZE 5 ECU_ADDRESS 0x9FE994 /end MEASUREMENT
/begin MEASUREMENT BIPCD_iDelta "Differenz zwischen gemessenem Strom im BIP-Fenster und maximal erlaubtem Strom gemäß Kennlinie" SWORD UI_Curr 1 100 -1091005. 1090972. FORMAT "%8.0" ECU_ADDRESS 0x7F9672 /end MEASUREMENT
/begin MEASUREMENT BIPCD_iMaxMI1_mp "Größter gemessener Stromwert im BIP-Fenster MI1 (zylinderselektives Array)" SWORD UI_Curr 1 100 -1091005. 1090972. FORMAT "%8.0" ECU_ADDRESS 0x9FE99E /end MEASUREMENT
/begin MEASUREMENT BIPCD_iMaxPiI1_mp "Größter gemessener Stromwert im BIP-Fenster PiI1 (zylinderselektives Array)" SWORD UI_Curr 1 100 -1091005. 1090972. FORMAT "%8.0" ECU_ADDRESS 0x9FE9A0 /end MEASUREMENT
/begin MEASUREMENT BIPCD_iMaxPoI2_mp "Größter gemessener Stromwert im BIP-Fenster PoI2 (zylinderselektives Array)" SWORD UI_Curr 1 100 -1091005. 1090972. FORMAT "%8.0" ECU_ADDRESS 0x9FE9A2 /end MEASUREMENT
/begin MEASUREMENT BIPCD_iWinLim_mp "Aktueller maximal zulaessiger Strom im BIP- Fenster" SWORD UI_Curr 1 100 -1091005. 1090972. FORMAT "%8.0" ECU_ADDRESS 0x9FE9BA /end MEASUREMENT
/begin MEASUREMENT BIPCD_stBIPDetMI1 "BIP-Erfassungs-Status MI1 (zylinderselektives Array)" UBYTE OneToOne 1 100 0.00 255.0 FORMAT "%5.1" ARRAY_SIZE 5 ECU_ADDRESS 0x7F9ED8 /end MEASUREMENT
/begin MEASUREMENT BIPCD_stBIPDetPiI1 "BIP-Erfassungs-Status PiI1 (zylinderselektives Array)" UBYTE OneToOne 1 100 0.00 255.0 FORMAT "%5.1" ARRAY_SIZE 5 ECU_ADDRESS 0x7F9EDD /end MEASUREMENT
/begin MEASUREMENT BIPCD_stBIPDetPoI2 "BIP-Erfassungs-Status PoI2 (zylinderselektives Array)" UBYTE OneToOne 1 100 0.00 255.0 FORMAT "%5.1" ARRAY_SIZE 5 ECU_ADDRESS 0x7F9EE2 /end MEASUREMENT
/begin MEASUREMENT BIPCD_tiBIPActMI1 "Aktuelle BIP-Zeit (=Magnetventil-Schließzeit) MI1 (zylinderselektives Array)" UWORD InjTime_us 1 100 0.00 65535.00 FORMAT "%8.2" ARRAY_SIZE 5 ECU_ADDRESS 0x7F9F3E /end MEASUREMENT
/begin MEASUREMENT BIPCD_tiBIPActPiI1 "Aktuelle BIP-Zeit (=Magnetventil-Schließzeit) PiI1 (zylinderselektives Array)" UWORD InjTime_us 1 100 0.00 65535.00 FORMAT "%8.2" ARRAY_SIZE 5 ECU_ADDRESS 0x7F9F48 /end MEASUREMENT
/begin MEASUREMENT BIPCD_tiBIPActPoI2 "Aktuelle BIP-Zeit (=Magnetventil-Schließzeit) PoI2 (zylinderselektives Array)" UWORD InjTime_us 1 100 0.00 65535.00 FORMAT "%8.2" ARRAY_SIZE 5 ECU_ADDRESS 0x7F9F52 /end MEASUREMENT
/begin MEASUREMENT BIPCD_tiDvtCtrMI1_mp "Abweichung zwischen aktueller BIP-Zeit und Vorhaltezeit MI1 (zylinderselektives Array)" SWORD InjTime_us 1 100 -32768.00 32767.00 FORMAT "%8.2" ARRAY_SIZE 5 ECU_ADDRESS 0x9FE9A4 /end MEASUREMENT
/begin MEASUREMENT BIPCD_tiDvtCtrPiI1_mp "Abweichung zwischen aktueller BIP-Zeit und Vorhaltezeit PiI1 (zylinderselektives Array)" SWORD InjTime_us 1 100 -32768.00 32767.00 FORMAT "%8.2" ECU_ADDRESS 0x9FE9AE /end MEASUREMENT
/begin MEASUREMENT BIPCD_tiDvtCtrPoI2_mp "Abweichung zwischen aktueller BIP-Zeit und Vorhaltezeit PoI2 (zylinderselektives Array)" SWORD InjTime_us 1 100 -32768.00 32767.00 FORMAT "%8.2" ARRAY_SIZE 5 ECU_ADDRESS 0x9FE9B0 /end MEASUREMENT
/begin MEASUREMENT BIP_ctITAlt "Anzahl der aktiven ES-Typen für alternierendes BIP-Fenster" UBYTE OneToOne 1 100 0.00 255.0 FORMAT "%5.1" ECU_ADDRESS 0x7F9308 /end MEASUREMENT
/begin MEASUREMENT BIP_facDvtFltMI1 "Gefilterte relative Erwartungswertabw. MI1 (zyl.sel. Array)" UWORD Fact_BIP 1 100 0.00 15.99976 FORMAT "%8.5" ARRAY_SIZE 5 ECU_ADDRESS 0x7F9F5C /end MEASUREMENT
/begin MEASUREMENT BIP_facDvtFltPiI1 "Gefilterte relative Erwartungswertabw. PiI1 (zyl.sel. Array)" UWORD Fact_BIP 1 100 0.00 15.99976 FORMAT "%8.5" ARRAY_SIZE 5 ECU_ADDRESS 0x7F9F66 /end MEASUREMENT
/begin MEASUREMENT BIP_facDvtFltPoI2 "Gefilterte relative Erwartungswertabw. PoI2 (zyl.sel. Array)" UWORD Fact_BIP 1 100 0.00 15.99976 FORMAT "%8.5" ARRAY_SIZE 5 ECU_ADDRESS 0x7F9F70 /end MEASUREMENT
/begin MEASUREMENT BIP_facFlt_mp "gerade verwendeter Faktor zur Filterung der BIP-Zeit-Erwartungswertabweichung" UWORD Fact_BIP 1 100 0.00 15.99976 FORMAT "%8.5" ECU_ADDRESS 0x9FE98C /end MEASUREMENT
/begin MEASUREMENT BIP_phiIDes_mp "Förderbeginn PiI1, MI1 oder PoI2 (je nach BIP_swtInjBegDisplay_C)" SWORD AngleCrS 1 100 -768.0000 767.9766 FORMAT "%8.4" ECU_ADDRESS 0x7F9674 /end MEASUREMENT
/begin MEASUREMENT BIP_stBatt_mp "Batteriespannungs-Status" UBYTE OneToOne 1 100 0.00 255.0 FORMAT "%5.1" ECU_ADDRESS 0x9FFA0F /end MEASUREMENT
/begin MEASUREMENT BIP_stControl "Regelungs-Status (zylinderselektives Array)" UBYTE OneToOne 1 100 0.00 255.0 FORMAT "%5.1" ARRAY_SIZE 5 ECU_ADDRESS 0x7F9EE7 /end MEASUREMENT
/begin MEASUREMENT BIP_stDvtVal "Gibt an, ob aktuelle BIP-Zeit-Erwartungswertabweichung gültig ist (ein Bit pro Zylinder)" UWORD OneToOne 1 100 0.00 65535.00 FORMAT "%8.2" ECU_ADDRESS 0x7F9676 /end MEASUREMENT
/begin MEASUREMENT BIP_stErrPerm "Gibt an, ob BIP-Fehlereinträge zugelassen sind" UBYTE OneToOne 1 100 0.00 255.0 FORMAT "%5.1" ECU_ADDRESS 0x7F9309 /end MEASUREMENT
/begin MEASUREMENT BIP_stEvalTDC "0 = Erfassung abgeschrankt, 1 = Erfassung zugelassen" UBYTE OneToOne 1 100 0.00 255.0 FORMAT "%5.1" ECU_ADDRESS 0x7F930A /end MEASUREMENT
/begin MEASUREMENT BIP_stInflMI1 "Beeinflussung der MI1 (ein Bit pro Zylinder)" UWORD OneToOne 1 100 0.00 65535.00 FORMAT "%8.2" ECU_ADDRESS 0x7F9678 /end MEASUREMENT
/begin MEASUREMENT BIP_stInflPoI2 "Beeinflussung der PoI2 (ein Bit pro Zylinder)" UWORD OneToOne 1 100 0.00 65535.00 FORMAT "%8.2" ECU_ADDRESS 0x7F967A /end MEASUREMENT
/begin MEASUREMENT BIP_stSRPoI2_mp "Info, ob Suche auf PoI2 aktiv (ein Bit pro Zylinder)" UWORD OneToOne 1 100 0.00 65535.00 FORMAT "%8.2" ECU_ADDRESS 0x9FE990 /end MEASUREMENT
/begin MEASUREMENT BIP_stState "BIP-State-Machine-Status (zylinderselektives Array)" UWORD OneToOne 1 100 0.00 65535.00 FORMAT "%8.2" ARRAY_SIZE 5 ECU_ADDRESS 0x7F9F7A /end MEASUREMENT
/begin MEASUREMENT BIP_stSummary_mp "BIP-Gesamt-Status (ein Bit pro Zylinder)" UWORD OneToOne 1 100 0.00 65535.00 FORMAT "%8.2" ECU_ADDRESS 0x9FE98E /end MEASUREMENT
/begin MEASUREMENT BIP_stWinSet "Gibt an, ob ein BIP-Fenster aufgesetzt wurde (ein Bit pro Zylinder)" UWORD OneToOne 1 100 0.00 65535.00 FORMAT "%8.2" ECU_ADDRESS 0x7F967C /end MEASUREMENT
/begin MEASUREMENT BIP_swtLastWinPos "Einspritztyp, auf den das BIP-Fenster beim letzten TDC aufgesetzt wurde" UBYTE OneToOne 1 100 0.00 255.0 FORMAT "%5.1" ECU_ADDRESS 0x7F930B /end MEASUREMENT
/begin MEASUREMENT BIP_swtWinPos "Einspritztyp, auf den das BIP-Fenster aufgesetzt wurde" UBYTE OneToOne 1 100 0.00 255.0 FORMAT "%5.1" ECU_ADDRESS 0x7F930C /end MEASUREMENT
/begin MEASUREMENT BIP_tiDvtFltMI1 "Gefilterte Erwartungswertabweichung MI1 (zyl.sel. Array)" SWORD InjTime_us 1 100 -32768.00 32767.00 FORMAT "%8.2" ARRAY_SIZE 5 ECU_ADDRESS 0x7F9F84 /end MEASUREMENT
/begin MEASUREMENT BIP_tiDvtFltPiI1 "Gefilterte Erwartungswertabweichung PiI1 (zyl.sel. Array)" SWORD InjTime_us 1 100 -32768.00 32767.00 FORMAT "%8.2" ARRAY_SIZE 5 ECU_ADDRESS 0x7F9F8E /end MEASUREMENT
/begin MEASUREMENT BIP_tiDvtFltPoI2 "Gefilterte Erwartungswertabweichung PoI2 (zyl.sel. Array)" SWORD InjTime_us 1 100 -32768.00 32767.00 FORMAT "%8.2" ARRAY_SIZE 5 ECU_ADDRESS 0x7F9F98 /end MEASUREMENT
/begin MEASUREMENT BIP_tiDvtRaw "BIP-Zeit-Erwartungswertabweichung (des letzten TDCs)" SWORD InjTime_us 1 100 -32768.00 32767.00 FORMAT "%8.2" ECU_ADDRESS 0x7F967E /end MEASUREMENT
/begin MEASUREMENT BIP_tiLastSetPointGate "BIP-Zeit-Erwartungswert für BIP-Fenster mit Gate des vorhergehenden TDCs" UWORD InjTime_us 1 100 0.00 65535.00 FORMAT "%8.2" ECU_ADDRESS 0x7F9680 /end MEASUREMENT
/begin MEASUREMENT BIP_tiMI1Dur_mp "Dauer der MI1 in Zeit" SWORD InjTime_us 1 100 -32768.00 32767.00 FORMAT "%8.2" ECU_ADDRESS 0x9FE97A /end MEASUREMENT
/begin MEASUREMENT BIP_tiPauseToMI1_mp "Ansteuerpause vor MI1 in Zeit" SWORD InjTime_us 1 100 -32768.00 32767.00 FORMAT "%8.2" ECU_ADDRESS 0x9FE97E /end MEASUREMENT
/begin MEASUREMENT BIP_tiPauseToPoI2_mp "Ansteuerpause vor PoI2 in Zeit" SWORD InjTime_us 1 100 -32768.00 32767.00 FORMAT "%8.2" ECU_ADDRESS 0x9FE980 /end MEASUREMENT
/begin MEASUREMENT BIP_tiPiI1Dur_mp "Dauer der PiI1 in Zeit" SWORD InjTime_us 1 100 -32768.00 32767.00 FORMAT "%8.2" ECU_ADDRESS 0x9FE97C /end MEASUREMENT
/begin MEASUREMENT BIP_tiSetPointCommon "Allgemeiner BIP-Zeit-Erwartungswert" UWORD InjTime_us 1 100 0.00 65535.00 FORMAT "%8.2" ECU_ADDRESS 0x7F9682 /end MEASUREMENT
/begin MEASUREMENT BIP_tiSetPointCtrMI1 "BIP-Vorhaltezeit MI1" UWORD InjTime_us 1 100 0.00 65535.00 FORMAT "%8.2" ECU_ADDRESS 0x7F9684 /end MEASUREMENT
/begin MEASUREMENT BIP_tiSetPointCtrMI1Byp_mp "Messpunkt um BIP_tiSetPointCtrMI1 ueber ASCET vor Bypass auszulesen" UWORD InjTime_us 1 100 0.00 65535.00 FORMAT "%8.2" ECU_ADDRESS 0x9FE982 /end MEASUREMENT
/begin MEASUREMENT BIP_tiSetPointCtrPiI1 "BIP-Vorhaltezeit PiI1" UWORD InjTime_us 1 100 0.00 65535.00 FORMAT "%8.2" ECU_ADDRESS 0x7F9686 /end MEASUREMENT
/begin MEASUREMENT BIP_tiSetPointCtrPiI1Byp_mp "Messpunkt um BIP_tiSetPointCtrPiI1 ueber ASCET vor Bypass auszulesen" UWORD InjTime_us 1 100 0.00 65535.00 FORMAT "%8.2" ECU_ADDRESS 0x9FE984 /end MEASUREMENT
/begin MEASUREMENT BIP_tiSetPointCtrPoI2 "BIP-Vorhaltezeit PoI2" UWORD InjTime_us 1 100 0.00 65535.00 FORMAT "%8.2" ECU_ADDRESS 0x7F9688 /end MEASUREMENT
/begin MEASUREMENT BIP_tiSetPointCtrPoI2Byp_mp "Messpunkt um BIP_tiSetPointCtrPoI2 ueber ASCET vor Bypass auszulesen" UWORD InjTime_us 1 100 0.00 65535.00 FORMAT "%8.2" ECU_ADDRESS 0x9FE986 /end MEASUREMENT
/begin MEASUREMENT BIP_tiSetPointMI1 "BIP-Zeit-Erwartungswert MI1" UWORD InjTime_us 1 100 0.00 65535.00 FORMAT "%8.2" ECU_ADDRESS 0x7F968A /end MEASUREMENT
/begin MEASUREMENT BIP_tiSetPointMI1Raw_mp "BIP-Zeit-Erwartungswert MI1 ohne Einfluss der PiI1" UWORD InjTime_us 1 100 0.00 65535.00 FORMAT "%8.2" ECU_ADDRESS 0x9FE988 /end MEASUREMENT
/begin MEASUREMENT BIP_tiSetPointPiI1 "BIP-Zeit-Erwartungswert PiI1" UWORD InjTime_us 1 100 0.00 65535.00 FORMAT "%8.2" ECU_ADDRESS 0x7F968C /end MEASUREMENT
/begin MEASUREMENT BIP_tiSetPointPoI2 "BIP-Zeit-Erwartungswert PoI2" UWORD InjTime_us 1 100 0.00 65535.00 FORMAT "%8.2" ECU_ADDRESS 0x7F968E /end MEASUREMENT
/begin MEASUREMENT BIP_tiSetPointPoI2Raw_mp "BIP-Zeit-Erwartungswert PoI2 ohne Einfluss der MI1/PiI1" UWORD InjTime_us 1 100 0.00 65535.00 FORMAT "%8.2" ECU_ADDRESS 0x9FE98A /end MEASUREMENT
/begin MEASUREMENT BIP_tiWinBegMI1 "BIP-Fensterbeginn MI1" UWORD InjTime_us 1 100 0.00 65535.00 FORMAT "%8.2" ECU_ADDRESS 0x7F9690 /end MEASUREMENT
/begin MEASUREMENT BIP_tiWinBegPiI1 "BIP-Fensterbeginn PiI1" UWORD InjTime_us 1 100 0.00 65535.00 FORMAT "%8.2" ECU_ADDRESS 0x7F9692 /end MEASUREMENT
/begin MEASUREMENT BIP_tiWinBegPoI2 "BIP-Fensterbeginn PoI2" UWORD InjTime_us 1 100 0.00 65535.00 FORMAT "%8.2" ECU_ADDRESS 0x7F9694 /end MEASUREMENT
/begin MEASUREMENT BIP_tiWinDur "Aktuelle BIP-Fenster-Breite (zylinderselektives Array)" SWORD InjTime_us 1 100 -32768.00 32767.00 FORMAT "%8.2" ARRAY_SIZE 5 ECU_ADDRESS 0x7F9FA2 /end MEASUREMENT
/begin MEASUREMENT BIP_tiWinDurDelta_mp "Aktuell erlaubte Änderung der BIP-Fenster-Breite" SWORD InjTime_us 1 100 -32768.00 32767.00 FORMAT "%8.2" ECU_ADDRESS 0x9FE992 /end MEASUREMENT
/begin MEASUREMENT BIP_tiWinEndMI1 "BIP-Fensterende MI1" UWORD InjTime_us 1 100 0.00 65535.00 FORMAT "%8.2" ECU_ADDRESS 0x7F9696 /end MEASUREMENT
/begin MEASUREMENT BIP_tiWinEndPiI1 "BIP-Fensterende PiI1" UWORD InjTime_us 1 100 0.00 65535.00 FORMAT "%8.2" ECU_ADDRESS 0x7F9698 /end MEASUREMENT
/begin MEASUREMENT BIP_tiWinEndPoI2 "BIP-Fensterende PoI2" UWORD InjTime_us 1 100 0.00 65535.00 FORMAT "%8.2" ECU_ADDRESS 0x7F969A /end MEASUREMENT
/begin MEASUREMENT BIP_tiWinOffMI1 "Aktueller BIP-Fenster-Offset MI1 (zylinderselektives Array)" SWORD InjTime_us 1 100 -32768.00 32767.00 FORMAT "%8.2" ARRAY_SIZE 5 ECU_ADDRESS 0x7F9FAC /end MEASUREMENT
/begin MEASUREMENT BIP_tiWinOffPiI1 "Aktueller BIP-Fenster-Offset PiI1 (zylinderselektives Array)" SWORD InjTime_us 1 100 -32768.00 32767.00 FORMAT "%8.2" ARRAY_SIZE 5 ECU_ADDRESS 0x7F9FB6 /end MEASUREMENT
/begin MEASUREMENT BIP_tiWinOffPoI2 "Aktueller BIP-Fenster-Offset PoI2 (zylinderselektives Array)" SWORD InjTime_us 1 100 -32768.00 32767.00 FORMAT "%8.2" ARRAY_SIZE 5 ECU_ADDRESS 0x7F9FC0 /end MEASUREMENT
/begin MEASUREMENT BIP_uBatt_mp "Batteriespannung für Bildung des BIP-Zeit-Erwartungswerts" SWORD Volt_Batt 1 100 -665674.1 665653.8 FORMAT "%8.1" ECU_ADDRESS 0x9FE978 /end MEASUREMENT
/begin MEASUREMENT BPACD_rCnv2_mp "Tastverhältnis 2 basierend auf dem Ausgang des Ladedrucksreglers" SWORD DtyCyc 1 100 -327.6800 327.6700 FORMAT "%8.4" ECU_ADDRESS 0x9FE9BC /end MEASUREMENT
/begin MEASUREMENT BPACD_rCnv_mp "Tastverhältnis basierend auf dem Ausgang des Ladedrucksreglers" SWORD DtyCyc 1 100 -327.6800 327.6700 FORMAT "%8.4" ECU_ADDRESS 0x9FE9BE /end MEASUREMENT
/begin MEASUREMENT BPACD_rIn1 "Positionsistwert des Ladedruckstellers 1" SWORD DtyCyc 1 100 -327.6800 327.6700 FORMAT "%8.4" ECU_ADDRESS 0x7F969C /end MEASUREMENT
/begin MEASUREMENT BPACD_rIn2 "Positionsistwert des Ladedruckstellers 2" SWORD DtyCyc 1 100 -327.6800 327.6700 FORMAT "%8.4" ECU_ADDRESS 0x7F969E /end MEASUREMENT
/begin MEASUREMENT BPACD_rOut "Tastverhältnis zür Endstufenansteuerung" SWORD DtyCyc 1 100 -327.6800 327.6700 FORMAT "%8.4" ECU_ADDRESS 0x7F96A0 /end MEASUREMENT
/begin MEASUREMENT BPACD_rOut2 "Tastverhältnis 2 zur Endstufenansteuerung" SWORD DtyCyc 1 100 -327.6800 327.6700 FORMAT "%8.4" ECU_ADDRESS 0x7F96A2 /end MEASUREMENT
/begin MEASUREMENT BPASCD_rLinNoOfs "Rueckmeldesignal des Laderstellers ohne Offset" SWORD Prc 1 100 -327.6800 327.6700 FORMAT "%8.4" ECU_ADDRESS 0x7F96A4 /end MEASUREMENT
/begin MEASUREMENT BPASCD_rLinRelPos "Linearisierter Wert vor der Fehlerbehandlung" SWORD Prc 1 100 -327.6800 327.6700 FORMAT "%8.4" ECU_ADDRESS 0x7F96A6 /end MEASUREMENT
/begin MEASUREMENT BPASCD_rOfs "Offsetwert zur Adaption" SWORD Prc 1 100 -327.6800 327.6700 FORMAT "%8.4" ECU_ADDRESS 0x7F96A8 /end MEASUREMENT
/begin MEASUREMENT BPASCD_rRelPos "Relative Position des Ladedruckstellers nach der Fehlerbehandlung" SWORD Prc 1 100 -327.6800 327.6700 FORMAT "%8.4" ECU_ADDRESS 0x7F96AA /end MEASUREMENT
/begin MEASUREMENT BPASCD_stOfs "Status der Offsetadaption" UBYTE OneToOne 1 100 0.00 255.0 FORMAT "%5.1" ECU_ADDRESS 0x7F930D /end MEASUREMENT
/begin MEASUREMENT BPASCD_uRawRelPos "Spannungsrohwert des Ladedrucksteller Positionsgebers" SWORD Volt 1 100 -160156.4 160151.5 FORMAT "%8.1" ECU_ADDRESS 0x7F96AC /end MEASUREMENT
/begin MEASUREMENT BPSCD_ctAvg "Durchschnittliche Absolute APS-BPS Differenz für den Plausibilitäts Test" UWORD OneToOne 1 100 0.00 65535.00 FORMAT "%8.2" ECU_ADDRESS 0x7F96AE /end MEASUREMENT
/begin MEASUREMENT BPSCD_pAvgDiff "Berechnungswert der Absoluten APS-BPS Differenz" SWORD Pres_hPa 1 100 -32768.00 32767.00 FORMAT "%8.2" ECU_ADDRESS 0x7F96B0 /end MEASUREMENT
/begin MEASUREMENT BPSCD_pDiffLim "Grenzwert für gemittelte absolute APS-BPS Differenz" SWORD Pres_hPa 1 100 -32768.00 32767.00 FORMAT "%8.2" ECU_ADDRESS 0x7F96B2 /end MEASUREMENT
/begin MEASUREMENT BPSCD_pDiffLim_mp "Maximal erlaubte durchschnittliche absolute APS-BPS Differenz. Kopie von BPSCD_pDiffLim_C für signals" SWORD Pres_hPa 1 100 -32768.00 32767.00 FORMAT "%8.2" ECU_ADDRESS 0x9FE9C0 /end MEASUREMENT
/begin MEASUREMENT BPSCD_pDiff_mp "Absolute APS-BPS Differenz des aktuellen Berechnungszyklus" SWORD OneToOne 1 100 -32768.00 32767.00 FORMAT "%8.2" ECU_ADDRESS 0x9FE9C2 /end MEASUREMENT
/begin MEASUREMENT BPSCD_pFltVal "gefilterter Wert des Ladedrucks" SWORD Pres_hPa 1 100 -32768.00 32767.00 FORMAT "%8.2" ECU_ADDRESS 0x7F96B4 /end MEASUREMENT
/begin MEASUREMENT BPSCD_pIntVal "aktueller Ladedruck" SWORD Pres_hPa 1 100 -32768.00 32767.00 FORMAT "%8.2" ECU_ADDRESS 0x7F96B6 /end MEASUREMENT
/begin MEASUREMENT BPSCD_pLastPhyVal "Ladedruck im letzten Zyklus" SWORD Pres_hPa 1 100 -32768.00 32767.00 FORMAT "%8.2" ECU_ADDRESS 0x7F96B8 /end MEASUREMENT
/begin MEASUREMENT BPSCD_pLin "Mittelere Ladedruck-Wert (liniarisiert)" SWORD Pres_hPa 1 100 -32768.00 32767.00 FORMAT "%8.2" ECU_ADDRESS 0x7F96BA /end MEASUREMENT
/begin MEASUREMENT BPSCD_pOutVal "Ladedruckwert" SWORD Pres_hPa 1 100 -32768.00 32767.00 FORMAT "%8.2" ECU_ADDRESS 0x7F96BC /end MEASUREMENT
/begin MEASUREMENT BPSCD_pPhyVal "Ladedruck in diesem Zyklus" SWORD Pres_hPa 1 100 -32768.00 32767.00 FORMAT "%8.2" ECU_ADDRESS 0x7F96BE /end MEASUREMENT
/begin MEASUREMENT BPSCD_stErr "Fehlererkennung (falls einer auftritt) des Ladedrucksensors in einem Zyklus" UBYTE OneToOne 1 100 0.00 255.0 FORMAT "%5.1" ECU_ADDRESS 0x7F930F /end MEASUREMENT
/begin MEASUREMENT BPSCD_stPlausCalc "Status der APS-BPS Plausibilitätsprüfung" UBYTE OneToOne 1 100 0.00 255.0 FORMAT "%5.1" ECU_ADDRESS 0x7F9310 /end MEASUREMENT
/begin MEASUREMENT BPSCD_stPlausCalc_mp "Status der APS-BPS Plausibilitäts-Berechnung" UBYTE OneToOne 1 100 0.00 255.0 FORMAT "%5.1" ECU_ADDRESS 0x9FFA12 /end MEASUREMENT
/begin MEASUREMENT BPSCD_stPlausErr "Plausibilitaetsfehler Status ( zwischen BPSCD und APSCD )" UBYTE OneToOne 1 100 0.00 255.0 FORMAT "%5.1" ECU_ADDRESS 0x7F9311 /end MEASUREMENT
/begin MEASUREMENT BPSCD_stTransStage "Status der transtion stage des Ladedrucksensors" UWORD OneToOne 1 100 0.00 65535.00 FORMAT "%8.2" ECU_ADDRESS 0x7F96C0 /end MEASUREMENT
/begin MEASUREMENT BPSCD_swtSig "Wert ob Signal ueber CAN/ADC kommt" UBYTE OneToOne 1 100 0.00 255.0 FORMAT "%5.1" ECU_ADDRESS 0x7F9312 /end MEASUREMENT
/begin MEASUREMENT BPSCD_uRawVal "Spannungsrohwert des Ladedrucksensors" SWORD Volt 1 100 -160156.4 160151.5 FORMAT "%8.1" ECU_ADDRESS 0x7F96C2 /end MEASUREMENT
/begin MEASUREMENT BrkCD_ctBREPLAU_mp "Entprellzaehler fuer dynamische Plausibilitätsprüfung Bremse" UWORD OneToOne 1 100 0.00 65535.00 FORMAT "%8.2" ECU_ADDRESS 0x9FE9C4 /end MEASUREMENT
/begin MEASUREMENT BrkCD_stDebDyn_mp "Fehlerzustand der dynamischen Bremsenplausibilität" UBYTE OneToOne 1 100 0.00 255.0 FORMAT "%5.1" ECU_ADDRESS 0x9FFA13 /end MEASUREMENT
/begin MEASUREMENT BrkCD_stMnSwtDebVal "Digitalsignal Bremskontakt entprellt" UBYTE OneToOne 1 100 0.00 255.0 FORMAT "%5.1" ECU_ADDRESS 0x7F9319 /end MEASUREMENT
/begin MEASUREMENT BrkCD_stMnSwtLogVal_mp "Digitalsignal redundanter Bremskontakt nicht entprellt" UBYTE OneToOne 1 100 0.00 255.0 FORMAT "%5.1" ECU_ADDRESS 0x9FFA14 /end MEASUREMENT
/begin MEASUREMENT BrkCD_stMnSwtRawVal "Rohwert Bremskontakt nicht entprellt" UBYTE OneToOne 1 100 0.00 255.0 FORMAT "%5.1" ECU_ADDRESS 0x7F931A /end MEASUREMENT
/begin MEASUREMENT BrkCD_stPlausCheckDef_mp "Status dynamische Plausibilitätsprüfung erlaubt" UBYTE OneToOne 1 100 0.00 255.0 FORMAT "%5.1" ECU_ADDRESS 0x9FFA15 /end MEASUREMENT
/begin MEASUREMENT BrkCD_stPlausCheckOk_mp "Status dynamische Plausibilitätsfehler-Heilung erlaubt" UBYTE OneToOne 1 100 0.00 255.0 FORMAT "%5.1" ECU_ADDRESS 0x9FFA16 /end MEASUREMENT
/begin MEASUREMENT BrkCD_stPressed "Meldung Bremse betätigt" UBYTE OneToOne 1 100 0.00 255.0 FORMAT "%5.1" ECU_ADDRESS 0x7F931B /end MEASUREMENT
/begin MEASUREMENT BrkCD_stRedSwtDebVal "Digitalsignal redundanter Bremskontakt entprellt" UBYTE OneToOne 1 100 0.00 255.0 FORMAT "%5.1" ECU_ADDRESS 0x7F931C /end MEASUREMENT
/begin MEASUREMENT BrkCD_stRedSwtLogVal_mp "Digitalsignal redundanter Bremskontakt nicht entprellt" UBYTE OneToOne 1 100 0.00 255.0 FORMAT "%5.1" ECU_ADDRESS 0x9FFA17 /end MEASUREMENT
/begin MEASUREMENT BrkCD_stRedSwtPresent "Redundanter Bremskontakt Aktivinformation" UBYTE OneToOne 1 100 0.00 255.0 FORMAT "%5.1" ECU_ADDRESS 0x7F931D /end MEASUREMENT
/begin MEASUREMENT BrkCD_stRedSwtRawVal "Rohwert redundanter Bremskontakt nicht entprellt" UBYTE OneToOne 1 100 0.00 255.0 FORMAT "%5.1" ECU_ADDRESS 0x7F931E /end MEASUREMENT
/begin MEASUREMENT BrkCD_stRun_mp "Laufzeitmesspunkt" UWORD OneToOne 1 100 0.00 65535.00 FORMAT "%8.2" ECU_ADDRESS 0x9FE9C6 /end MEASUREMENT
/begin MEASUREMENT BrkCD_swtBrkSig_mp "zeigt die Auswahl der verwendeten CAN Bremssignale an" UBYTE OneToOne 1 100 0.00 255.0 FORMAT "%5.1" ECU_ADDRESS 0x9FFA18 /end MEASUREMENT
/begin MEASUREMENT BrkCD_swtSig "Signalquelle Schalter - DIO/CAN" UBYTE OneToOne 1 100 0.00 255.0 FORMAT "%5.1" ECU_ADDRESS 0x7F931F /end MEASUREMENT
/begin MEASUREMENT BrkCD_uMnSwtLinVal "Linearisierter Analogwert des Bremskontaktes" SWORD Volt 1 100 -160156.4 160151.5 FORMAT "%8.1" ECU_ADDRESS 0x7F96EC /end MEASUREMENT
/begin MEASUREMENT BrkCD_uMnSwtNrmVal_mp "Mit Batteriespannungsfaktor korrigierter Spannungswert des Hauptbremsschalters" SWORD Volt 1 100 -160156.4 160151.5 FORMAT "%8.1" ECU_ADDRESS 0x9FE9C8 /end MEASUREMENT
/begin MEASUREMENT BrkCD_uMnSwtRawVal "Analogwert des Bremskontaktes" SWORD Volt 1 100 -160156.4 160151.5 FORMAT "%8.1" ECU_ADDRESS 0x7F96EE /end MEASUREMENT
/begin MEASUREMENT BrkCD_uMnSwtTrnsVal_mp "Spannung des Hauptbremsschalters nach Transstage und PT1-Filter" SWORD Volt 1 100 -160156.4 160151.5 FORMAT "%8.1" ECU_ADDRESS 0x9FE9CA /end MEASUREMENT
/begin MEASUREMENT BypEtk_ctStepDelayNsync_u8 "ETK Bypass Schritt drehzahlsynchron" UBYTE OneToOne 1 100 0.00 255.0 FORMAT "%5.1" ECU_ADDRESS 0x7FD73A /end MEASUREMENT
/begin MEASUREMENT BypEtk_ctStepDelayTsync_u8 "ETK Bypass Schritt zeitsynchron" UBYTE OneToOne 1 100 0.00 255.0 FORMAT "%5.1" ECU_ADDRESS 0x7FD73B /end MEASUREMENT
/begin MEASUREMENT BypEtk_stEcu_u8 "Status ETK-Bypass in SG (0: inaktiv im SG; 1: aktiv im SG; 2: wartet auf Kommunikation)" UBYTE OneToOne 1 100 0.00 255.0 FORMAT "%5.1" ECU_ADDRESS 0x7FD739 /end MEASUREMENT
/begin MEASUREMENT BypInt_stEcu_u8 "Status interner Bypass in SG (0: inaktiv im SG; 1: aktiv im SG; 2: wartet auf Kommunikation)" UBYTE OneToOne 1 100 0.00 255.0 FORMAT "%5.1" ECU_ADDRESS 0x7FD745 /end MEASUREMENT
/begin MEASUREMENT CARB_LSU_rLmbd0 "Lambda Wert für Carb Mode $1 PID 24" SWORD lambda 1 100 -32.76800 32.76700 FORMAT "%8.5" ECU_ADDRESS 0x7F96F0 /end MEASUREMENT
/begin MEASUREMENT CARB_Mode1PID1D "Sauerstoffsensor Position für Signal Applikation für Carb Mode $1 PID 1D" UBYTE OneToOne 1 100 0.00 255.0 FORMAT "%5.1" ECU_ADDRESS 0x7F9320 /end MEASUREMENT
/begin MEASUREMENT CARB_Mode1PID4F "Lambda Konfiguration für Carb Mode $1 PID 4F (Byte 1-4)" ULONG OneToOne 1 100 0.00 4294967295.00 FORMAT "%13.2" ECU_ADDRESS 0x7F9D50 /end MEASUREMENT
/begin MEASUREMENT CARB_Mode1PID4FB "Lambda Konfiguration for Carb Mode $1 PID 4F (Byte 5-6)" UWORD OneToOne 1 100 0.00 65535.00 FORMAT "%8.2" ECU_ADDRESS 0x7F96F2 /end MEASUREMENT
/begin MEASUREMENT CARB_rAPPCD_PID49 "Prozentwert des Pedalwertgeber D für OBD Mode 1 PID 49" UWORD Prc 1 100 0.00 655.3500 FORMAT "%8.4" ECU_ADDRESS 0x7F9700 /end MEASUREMENT
/begin MEASUREMENT CARB_rAPPCD_PID4A "Prozentwert des Pedalwertgebers E für OBD Mode 1 PID 4A" UWORD Prc 1 100 0.00 655.3500 FORMAT "%8.4" ECU_ADDRESS 0x7F9702 /end MEASUREMENT
/begin MEASUREMENT CARB_rNrmInvTVASCD "Invertierte ansolute Drosselklappenposition für PID 0x11" SWORD Prc 1 100 -327.6800 327.6700 FORMAT "%8.4" ECU_ADDRESS 0x7F9704 /end MEASUREMENT
/begin MEASUREMENT CARB_rRelThrVlvPos_PID45 "CARB PID $45 relative Drosselklappen Position" UWORD Prc 1 100 0.00 655.3500 FORMAT "%8.4" ECU_ADDRESS 0x7F9706 /end MEASUREMENT
/begin MEASUREMENT CARB_stRdyCurrABCD "Kombinierte readiness information aus PID$01 und PID$41" ULONG OneToOne 1 100 0.00 4294967295.00 FORMAT "%13.2" ECU_ADDRESS 0x7F9D54 /end MEASUREMENT
/begin MEASUREMENT CARB_TstNotUsedFalse "Signal für CARB Mode6 wenn unteres Limit für boolschen Test nicht verwendet" UWORD OneToOne 1 100 0.00 65535.00 FORMAT "%8.2" ECU_ADDRESS 0x7F96F4 /end MEASUREMENT
/begin MEASUREMENT CARB_TstNotUsedMaxS "Signal für CARB Mode6 wenn oberes Limit für signed Test nicht verwendet" SWORD OneToOne 1 100 -32768.00 32767.00 FORMAT "%8.2" ECU_ADDRESS 0x7F96F6 /end MEASUREMENT
/begin MEASUREMENT CARB_TstNotUsedMaxU "Signal für CARB Mode6 wenn oberes Limit für boolschen Test nicht verwendet" UWORD OneToOne 1 100 0.00 65535.00 FORMAT "%8.2" ECU_ADDRESS 0x7F96F8 /end MEASUREMENT
/begin MEASUREMENT CARB_TstNotUsedMinS "Signal für CARB Mode6 wenn unteres Limit für signed Test nicht verwendet" SWORD OneToOne 1 100 -32768.00 32767.00 FORMAT "%8.2" ECU_ADDRESS 0x7F96FA /end MEASUREMENT
/begin MEASUREMENT CARB_TstNotUsedMinU "Signal für CARB Mode6 wenn unteres Limit für unsigned Test nicht verwendet" UWORD OneToOne 1 100 0.00 65535.00 FORMAT "%8.2" ECU_ADDRESS 0x7F96FC /end MEASUREMENT
/begin MEASUREMENT CARB_TstNotUsedTrue "Signal für CARB Mode6 wenn oberes Limit für boolschen Test nicht verwendet" UWORD OneToOne 1 100 0.00 65535.00 FORMAT "%8.2" ECU_ADDRESS 0x7F96FE /end MEASUREMENT
/begin MEASUREMENT CaSCD_ctAddTooth_mp "Anzahl der zusätzlichen Zähne im Nockenwellensignal" UBYTE OneToOne 1 100 0.00 255.0 FORMAT "%5.1" ECU_ADDRESS 0x9FFA22 /end MEASUREMENT
/begin MEASUREMENT CaSCD_ctEdgCaSRev_mp "Anzahl sämtlicher Phasensignale während einer Nockenwellenumdrehung" UBYTE OneToOne 1 100 0.00 255.0 FORMAT "%5.1" ECU_ADDRESS 0x9FFA23 /end MEASUREMENT
/begin MEASUREMENT CaSCD_ctEdgOfs_mp "Zähler erkannter Nockenwellenflanken mit Verdrehung" UBYTE OneToOne 1 100 0.00 255.0 FORMAT "%5.1" ECU_ADDRESS 0x9FFA24 /end MEASUREMENT
/begin MEASUREMENT CaSCD_ctEdgOrd_mp "Zähler erkannter Nockenwellenflanken in korrekter Reihenfolge" UBYTE OneToOne 1 100 0.00 255.0 FORMAT "%5.1" ECU_ADDRESS 0x9FFA25 /end MEASUREMENT
/begin MEASUREMENT CaSCD_ctErrEdg_mp "Anzahl erkannter Störungen auf einer Nockenwellenumdrehung" UBYTE OneToOne 1 100 0.00 255.0 FORMAT "%5.1" ECU_ADDRESS 0x9FFA26 /end MEASUREMENT
/begin MEASUREMENT CaSCD_ctErrSegLen2Pos_mp "Anzahl der Flankenpositionen im Nockenwellensignal mit falscher zugeordneter Segmentlänge" UBYTE OneToOne 1 100 0.00 255.0 FORMAT "%5.1" ECU_ADDRESS 0x9FFA27 /end MEASUREMENT
/begin MEASUREMENT CaSCD_ctMissTooth_mp "Anzahl der fehlenden Zähne im Nockenwellensignal" UBYTE OneToOne 1 100 0.00 255.0 FORMAT "%5.1" ECU_ADDRESS 0x9FFA28 /end MEASUREMENT
/begin MEASUREMENT CaSCD_ctPhRevEdges_mp "Zähler der Phasengeberflanken über einer Phasengeberradumdrehung" UBYTE OneToOne 1 100 0.00 255.0 FORMAT "%5.1" ECU_ADDRESS 0x9FFA29 /end MEASUREMENT
/begin MEASUREMENT CaSCD_ctPhRev_mp "Umdrehungszähler des Phasengeberrades" UBYTE OneToOne 1 100 0.00 255.0 FORMAT "%5.1" ECU_ADDRESS 0x9FFA2A /end MEASUREMENT
/begin MEASUREMENT CaSCD_ctSegEdg_mp "Anzahl erkannter SEG Flanken" UBYTE OneToOne 1 100 0.00 255.0 FORMAT "%5.1" ECU_ADDRESS 0x9FFA2B /end MEASUREMENT
/begin MEASUREMENT CaSCD_ctSegLenOrd_mp "Anzahl der Segmentlängen, die in Reihenfolge erkannt wurden" UBYTE OneToOne 1 100 0.00 255.0 FORMAT "%5.1" ECU_ADDRESS 0x9FFA2C /end MEASUREMENT
/begin MEASUREMENT CaSCD_ctShftPos_mp "Zähler verschobene Nockenwellenflanken" UBYTE OneToOne 1 100 0.00 255.0 FORMAT "%5.1" ECU_ADDRESS 0x9FFA2D /end MEASUREMENT
/begin MEASUREMENT CaSCD_ctSyncEdg_mp "Anzahl erkannter SYNC Flanken" UBYTE OneToOne 1 100 0.00 255.0 FORMAT "%5.1" ECU_ADDRESS 0x9FFA2E /end MEASUREMENT
/begin MEASUREMENT CaSCD_ctTooth_mp "Der aktuelle Nockenwellenzahnindex" UBYTE OneToOne 1 100 0.00 255.0 FORMAT "%5.1" ECU_ADDRESS 0x9FFA19 /end MEASUREMENT
/begin MEASUREMENT CaSCD_idTooth_mp "Zahnkennung: typ (seg/sync), edge, number (CASCD_TOOTH_ID_SEG, CASCD_TOOTH_ID_SYNC, ...)" UBYTE OneToOne 1 100 0.00 255.0 FORMAT "%5.1" ECU_ADDRESS 0x9FFA1A /end MEASUREMENT
/begin MEASUREMENT CaSCD_nPeriod "Phasengeberraddrehzahl basierent auf einer konstanten Phasengebersegmentlänge" SWORD EngN 1 100 -32768.00 32767.00 FORMAT "%8.2" ECU_ADDRESS 0x7F972E /end MEASUREMENT
/begin MEASUREMENT CaSCD_nSeg "Die aktuelle Nockenwellensegmentdrehzahl im BackUp-Modus" SWORD EngN 1 100 -32768.00 32767.00 FORMAT "%8.2" ECU_ADDRESS 0x7F9730 /end MEASUREMENT
/begin MEASUREMENT CaSCD_nSegTmp_mp "Nockenwellensegmentdrehzahl" SWORD EngN 1 100 -32768.00 32767.00 FORMAT "%8.2" ECU_ADDRESS 0x9FE9CC /end MEASUREMENT
/begin MEASUREMENT CaSCD_numFrstInt_mp "Interruptart bei Start der Verifikation CaS/CrS" UBYTE OneToOne 1 100 0.00 255.0 FORMAT "%5.1" ECU_ADDRESS 0x9FFA2F /end MEASUREMENT
/begin MEASUREMENT CaSCD_numFrstTDC_mp "Zylinderzählerstand bei Start der Verifikation CaS/CrS" UBYTE OneToOne 1 100 0.00 255.0 FORMAT "%5.1" ECU_ADDRESS 0x9FFA30 /end MEASUREMENT
/begin MEASUREMENT CaSCD_numTeethOfs_mp "Anzahl der erfassten Offsetwerte" UBYTE OneToOne 1 100 0.00 255.0 FORMAT "%5.1" ECU_ADDRESS 0x9FFA1E /end MEASUREMENT
/begin MEASUREMENT CaSCD_period_0_mp "Periodenbuffer für eine ganze Nockenwellenumdrehung (backup mode)" SLONG OneToOne 1 100 -2147483648.00 2147483647.00 FORMAT "%13.2" ECU_ADDRESS 0x9FE41C /end MEASUREMENT
/begin MEASUREMENT CaSCD_period_1_mp "Periodenbuffer für eine ganze Nockenwellenumdrehung (backup mode)" SLONG OneToOne 1 100 -2147483648.00 2147483647.00 FORMAT "%13.2" ECU_ADDRESS 0x9FE420 /end MEASUREMENT
/begin MEASUREMENT CaSCD_period_2_mp "Periodenbuffer für eine ganze Nockenwellenumdrehung (backup mode)" SLONG OneToOne 1 100 -2147483648.00 2147483647.00 FORMAT "%13.2" ECU_ADDRESS 0x9FE424 /end MEASUREMENT
/begin MEASUREMENT CaSCD_period_3_mp "Periodenbuffer für eine ganze Nockenwellenumdrehung (backup mode)" SLONG OneToOne 1 100 -2147483648.00 2147483647.00 FORMAT "%13.2" ECU_ADDRESS 0x9FE428 /end MEASUREMENT
/begin MEASUREMENT CaSCD_period_4_mp "Periodenbuffer für eine ganze Nockenwellenumdrehung (backup mode)" SLONG OneToOne 1 100 -2147483648.00 2147483647.00 FORMAT "%13.2" ECU_ADDRESS 0x9FE42C /end MEASUREMENT
/begin MEASUREMENT CaSCD_period_5_mp "Periodenbuffer für eine ganze Nockenwellenumdrehung (backup mode)" SLONG OneToOne 1 100 -2147483648.00 2147483647.00 FORMAT "%13.2" ECU_ADDRESS 0x9FE430 /end MEASUREMENT
/begin MEASUREMENT CaSCD_period_6_mp "Periodenbuffer für eine ganze Nockenwellenumdrehung (backup mode)" SLONG OneToOne 1 100 -2147483648.00 2147483647.00 FORMAT "%13.2" ECU_ADDRESS 0x9FE434 /end MEASUREMENT
/begin MEASUREMENT CaSCD_period_7_mp "Periodenbuffer für eine ganze Nockenwellenumdrehung (backup mode)" SLONG OneToOne 1 100 -2147483648.00 2147483647.00 FORMAT "%13.2" ECU_ADDRESS 0x9FE438 /end MEASUREMENT
/begin MEASUREMENT CaSCD_period_8_mp "Periodenbuffer für eine ganze Nockenwellenumdrehung (backup mode)" SLONG OneToOne 1 100 -2147483648.00 2147483647.00 FORMAT "%13.2" ECU_ADDRESS 0x9FE43C /end MEASUREMENT
/begin MEASUREMENT CaSCD_phiAbsMaxCor_mp "max. Betrag der Segmentlängenabweichung" SWORD AngleCaS 1 100 -384.0000 383.9883 FORMAT "%8.4" ECU_ADDRESS 0x9FE9E6 /end MEASUREMENT
/begin MEASUREMENT CaSCD_phiCurr_mp "Aktuelle Winkelposition des Phasengebers" SWORD AngleCrS 1 100 -768.0000 767.9766 FORMAT "%8.4" ECU_ADDRESS 0x9FE9EA /end MEASUREMENT
/begin MEASUREMENT CaSCD_phiLenMaxCor_mp "Segmentlänge mit max. Abweichung" SWORD AngleCaS 1 100 -384.0000 383.9883 FORMAT "%8.4" ECU_ADDRESS 0x9FE9E8 /end MEASUREMENT
/begin MEASUREMENT CaSCD_phiLrnDvnSeg1_mp "gelernte Abweichung von Segmentzahn 1" SWORD AngleCaS 1 100 -384.0000 383.9883 FORMAT "%8.4" ECU_ADDRESS 0x9FE9CE /end MEASUREMENT
/begin MEASUREMENT CaSCD_phiLrnDvnSeg2_mp "gelernte Abweichung von Segmentzahn 2" SWORD AngleCaS 1 100 -384.0000 383.9883 FORMAT "%8.4" ECU_ADDRESS 0x9FE9D0 /end MEASUREMENT
/begin MEASUREMENT CaSCD_phiLrnDvnSeg3_mp "gelernte Abweichung von Segmentzahn 3" SWORD AngleCaS 1 100 -384.0000 383.9883 FORMAT "%8.4" ECU_ADDRESS 0x9FE9D2 /end MEASUREMENT
/begin MEASUREMENT CaSCD_phiLrnDvnSeg4_mp "gelernte Abweichung von Segmentzahn 4" SWORD AngleCaS 1 100 -384.0000 383.9883 FORMAT "%8.4" ECU_ADDRESS 0x9FE9D4 /end MEASUREMENT
/begin MEASUREMENT CaSCD_phiLrnDvnSeg5_mp "gelernte Abweichung von Segmentzahn 5" SWORD AngleCaS 1 100 -384.0000 383.9883 FORMAT "%8.4" ECU_ADDRESS 0x9FE9D6 /end MEASUREMENT
/begin MEASUREMENT CaSCD_phiLrnDvnSeg6_mp "gelernte Abweichung von Segmentzahn 6" SWORD AngleCaS 1 100 -384.0000 383.9883 FORMAT "%8.4" ECU_ADDRESS 0x9FE9D8 /end MEASUREMENT
/begin MEASUREMENT CaSCD_phiLstEdge_mp "Position der letzten Phasengeberflanke" SWORD AngleCrS 1 100 -768.0000 767.9766 FORMAT "%8.4" ECU_ADDRESS 0x9FE9EC /end MEASUREMENT
/begin MEASUREMENT CaSCD_phiLstOfs_mp "Offsetwert des letzten Segmentzahns" SWORD AngleCrS 1 100 -768.0000 767.9766 FORMAT "%8.4" ECU_ADDRESS 0x9FE9E2 /end MEASUREMENT
/begin MEASUREMENT CaSCD_phiLstSegTeeth_mp "Position des letzten Segmentzahns" SWORD AngleCrS 1 100 -768.0000 767.9766 FORMAT "%8.4" ECU_ADDRESS 0x9FE9E4 /end MEASUREMENT
/begin MEASUREMENT CaSCD_phiSeg_mp "Phasenwinkel an der Segmentmarke" SWORD AngleCaS 1 100 -384.0000 383.9883 FORMAT "%8.4" ECU_ADDRESS 0x9FE9DA /end MEASUREMENT
/begin MEASUREMENT CaSCD_phiTooth_mp "Der aktuelle Phasenwinkel an einem Nockenwellenzahl, Segment- oder Synchronisationszahn" SWORD AngleCaS 1 100 -384.0000 383.9883 FORMAT "%8.4" ECU_ADDRESS 0x9FE9DC /end MEASUREMENT
/begin MEASUREMENT CaSCD_rSeg2SegMax_mp "Maximaler Wert für das Zeitverhältnis zwischen zwei letzten Segmentperioden" SWORD Fact1 1 100 -256.0000 255.9922 FORMAT "%8.4" ECU_ADDRESS 0x9FE9DE /end MEASUREMENT
/begin MEASUREMENT CaSCD_rSeg2SegMin_mp "Minimaler Wert für das Zeitverhältnis zwischen zwei letzten Segmentperioden" SWORD Fact1 1 100 -256.0000 255.9922 FORMAT "%8.4" ECU_ADDRESS 0x9FE9E0 /end MEASUREMENT
/begin MEASUREMENT CaSCD_rSeg2Seg_mp "Zeitverhältnis zwischen zwei letzten Segmentperioden r = Ti-1 / Ti" SLONG Fact1 1 100 -16777216.0000 16777215.9922 FORMAT "%13.4" ECU_ADDRESS 0x9FE440 /end MEASUREMENT
/begin MEASUREMENT CaSCD_rSeg2SyncMax_mp "Maximaler Wert für das Zeitverhältnis zwischen der letzten Segment- und Synchronisationsperiode r = Ti-1 / Ti" SLONG Fact1 1 100 -16777216.0000 16777215.9922 FORMAT "%13.4" ECU_ADDRESS 0x9FE444 /end MEASUREMENT
/begin MEASUREMENT CaSCD_rSeg2SyncMin_mp "Minimaler Wert für das Zeitverhältnis zwischen der letzten Segment- und Synchronisationsperiode r = Ti-1 / Ti" SLONG Fact1 1 100 -16777216.0000 16777215.9922 FORMAT "%13.4" ECU_ADDRESS 0x9FE448 /end MEASUREMENT
/begin MEASUREMENT CaSCD_rSeg2Sync_mp "Zeitverhältnis zwischen der letzten Segment- und Synchronisationsperiode r = Ti-1 / Ti" SLONG Fact1 1 100 -16777216.0000 16777215.9922 FORMAT "%13.4" ECU_ADDRESS 0x9FE44C /end MEASUREMENT
/begin MEASUREMENT CaSCD_stBackup_mp "Zustand der Backup- Zustandsmaschine: CASCD_BACKUP_INIT, CASCD_BACKUP_SYNCHRON" UBYTE OneToOne 1 100 0.00 255.0 FORMAT "%5.1" ECU_ADDRESS 0x9FFA1B /end MEASUREMENT
/begin MEASUREMENT CaSCD_stLrnDvn_mp "Statusinformation der Zähnchenlern-Algorithmus" UBYTE OneToOne 1 100 0.00 255.0 FORMAT "%5.1" ECU_ADDRESS 0x9FFA1C /end MEASUREMENT
/begin MEASUREMENT CaSCD_stOfsSegTeeth_mp "Zustand der Berechnung der Phasensegmentverschiebung" UBYTE OneToOne 1 100 0.00 255.0 FORMAT "%5.1" ECU_ADDRESS 0x9FFA1F /end MEASUREMENT
/begin MEASUREMENT CaSCD_stPhaseErr_mp "Fehlerstatus des Phasensystems" UWORD OneToOne 1 100 0.00 65535.00 FORMAT "%8.2" ECU_ADDRESS 0x9FE9EE /end MEASUREMENT
/begin MEASUREMENT CaSCD_stPhaseSig_mp "Status des Phasengebersignals (Signalgüte)" UWORD OneToOne 1 100 0.00 65535.00 FORMAT "%8.2" ECU_ADDRESS 0x9FE9F0 /end MEASUREMENT
/begin MEASUREMENT CaSCD_stPhaseSync_mp "Status der Phasengebersynchronisation (Signalformerkennung)" UWORD OneToOne 1 100 0.00 65535.00 FORMAT "%8.2" ECU_ADDRESS 0x9FE9F2 /end MEASUREMENT
/begin MEASUREMENT CaSCD_stRlsSegCor_mp "Freigabe Segmentlängenanalyse" UBYTE OneToOne 1 100 0.00 255.0 FORMAT "%5.1" ECU_ADDRESS 0x9FFA20 /end MEASUREMENT
/begin MEASUREMENT CaSCD_stSegCor_mp "Status Zustandsautomat der Segmentlängenanalyse" UBYTE OneToOne 1 100 0.00 255.0 FORMAT "%5.1" ECU_ADDRESS 0x9FFA21 /end MEASUREMENT
/begin MEASUREMENT CaSCD_stSegCylEdg_mp "Status erkannter SEG Flanken" UWORD OneToOne 1 100 0.00 65535.00 FORMAT "%8.2" ECU_ADDRESS 0x9FE9F4 /end MEASUREMENT
/begin MEASUREMENT CaSCD_stSyncCylEdg_mp "Status erkannter SYNC Flanken" UWORD OneToOne 1 100 0.00 65535.00 FORMAT "%8.2" ECU_ADDRESS 0x9FE9F6 /end MEASUREMENT
/begin MEASUREMENT CaSCD_stTooth_mp "Zahnstatus, Status der Backup-Zustandsmaschine am letzten Zahn: CASCD_TOOTH_INIT, CASCD_TOOTH_SYNCHRON, ..." UBYTE OneToOne 1 100 0.00 255.0 FORMAT "%5.1" ECU_ADDRESS 0x9FFA1D /end MEASUREMENT
/begin MEASUREMENT CaSCD_swtSegCor "Schalter der ausgewählten Segmentapplikation für Motorpositionsbestimmung" UBYTE OneToOne 1 100 0.00 255.0 FORMAT "%5.1" ECU_ADDRESS 0x7F9329 /end MEASUREMENT
/begin MEASUREMENT CaSCD_tiDiffTimout_mp "Der aktuelle Timeout im Backup-Modus" ULONG Per_Dur 1 100 0.00 4294967295.00 FORMAT "%13.2" ECU_ADDRESS 0x9FE450 /end MEASUREMENT
/begin MEASUREMENT CaSCD_tiPeriodRev "Periodendauer einer Umdrehung des Phasengeberrades" SWORD Period_ms 1 100 -3276.800 3276.700 FORMAT "%8.3" ECU_ADDRESS 0x7F9732 /end MEASUREMENT
/begin MEASUREMENT CaSCD_tiPeriodRevHold "Vorletzte Periodendauer einer Umdrehung des Phasengeberrades" SWORD Period_ms 1 100 -3276.800 3276.700 FORMAT "%8.3" ECU_ADDRESS 0x7F9734 /end MEASUREMENT
/begin MEASUREMENT CaSCD_tiSeg "aktuelle Segmentzeit der Nockenwelle im Backup Mode" ULONG Per_Dur 1 100 0.00 4294967295.00 FORMAT "%13.2" ECU_ADDRESS 0x7F9D58 /end MEASUREMENT
/begin MEASUREMENT CaSCD_tiSegTimout_mp "Timeout für den nächsten Segmentzahn" ULONG Per_Dur_Ns 1 100 0.00 4294967295.00 FORMAT "%13.2" ECU_ADDRESS 0x9FE454 /end MEASUREMENT
/begin MEASUREMENT CaSCD_tiSegTmp_mp "Die aktuelle Zeit zwischen zwei Segmentzähnen" SLONG OneToOne 1 100 -2147483648.00 2147483647.00 FORMAT "%13.2" ECU_ADDRESS 0x9FE458 /end MEASUREMENT
/begin MEASUREMENT CaSCD_tiSigTimOut_mp "Timeoutwert des Phasengebersignals" SWORD Period_ms 1 100 -3276.800 3276.700 FORMAT "%8.3" ECU_ADDRESS 0x9FE9F8 /end MEASUREMENT
/begin MEASUREMENT CatSys_st "Regenerationsstatus des Katalysatorsystems" UBYTE OneToOne 1 100 0.00 255.0 FORMAT "%5.1" ECU_ADDRESS 0x7F932A /end MEASUREMENT
/begin MEASUREMENT CatSys_tCat "Katalysatortemperatur" SWORD Temp_Cels 1 100 -3549.940 3003.560 FORMAT "%8.3" ECU_ADDRESS 0x7F9736 /end MEASUREMENT
/begin MEASUREMENT CCAdp_ACCCD_aDrvDem "Fahrerwunschbeschleunigung" SWORD bfzg_sw_q4p239Em4 1 100 -13.8903552 13.8899313 ECU_ADDRESS 0x7F9708 /end MEASUREMENT
/begin MEASUREMENT CCAdp_ACCCD_aDrvDem_crctl "Fahrerwunschbeschleunigung" SWORD bfzg_sw_q4p239Em4 1 100 -13.8903552 13.8899313 ECU_ADDRESS 0x7FD574 /end MEASUREMENT
/begin MEASUREMENT CCAdp_ACCCD_phiRoad "Fahrbahnsteigung umgerechnet für CrCtl" SWORD fak_sw_b2 1 100 -2.000000 1.999939 FORMAT "%8.6" ECU_ADDRESS 0x7F970A /end MEASUREMENT
/begin MEASUREMENT CCAdp_ACCCD_rMVeh "Massenverhältnis aus beladenem und unbeladenem Fahrzeug" UBYTE fak_q0p03125 1 100 0.00 7.969 FORMAT "%5.3" ECU_ADDRESS 0x7F9321 /end MEASUREMENT
/begin MEASUREMENT CCAdp_ACCCD_rMVeh_crctl "relative Fahrzeugmasse (Gesamtgewicht / Leergewicht)" UBYTE fak_q0p03125 1 100 0.00 7.969 FORMAT "%5.3" ECU_ADDRESS 0x7FD57C /end MEASUREMENT
/begin MEASUREMENT CCAdp_BattCD_u "Batteriespannung umgerechnet für CrCtl" UBYTE spg_q0p1 1 100 0.00 25.50 FORMAT "%5.2" ECU_ADDRESS 0x7F9322 /end MEASUREMENT
/begin MEASUREMENT CCAdp_DrvTrn_rTransDT "Triebstrang-Übersetzung (Radmoment pro Motormoment) umgerechnet für CrCtl" UWORD fak_q0p02 1 100 0.00 1310.700 FORMAT "%8.3" ECU_ADDRESS 0x7F970C /end MEASUREMENT
/begin MEASUREMENT CCAdp_Eng_nAvrg "mittlere Motordrehzahl umgerechnet für CrCtl" UWORD nmot_uw_q0p25 1 100 0.00 16383.75 FORMAT "%8.2" ECU_ADDRESS 0x7F970E /end MEASUREMENT
/begin MEASUREMENT CCAdp_FrmMng_aTrans "Querbeschleunigung von BRK2 umgerechnet für CrCtl" SBYTE acc_q0p1 1 100 -12.80 12.70 FORMAT "%5.2" ECU_ADDRESS 0x7F9323 /end MEASUREMENT
/begin MEASUREMENT CCAdp_FrmMng_PwrMax "maximale Motorleistung umgerechnet für CrCtl" UWORD leist_q1_kW 1 100 0.00 65535.00 FORMAT "%8.2" ECU_ADDRESS 0x7F9710 /end MEASUREMENT
/begin MEASUREMENT CCAdp_FrmMng_PwrMax_crctl "Maximale Motorleistung" UWORD leist_q1_kW 1 100 0.00 65535.00 FORMAT "%8.2" ECU_ADDRESS 0x7FD576 /end MEASUREMENT
/begin MEASUREMENT CCAdp_FrmMng_vDsplTacho "Angezeigte Geschwindigkeit im Kombi" UWORD vfzg_q0p01 1 100 0.00 655.3500 FORMAT "%8.4" ECU_ADDRESS 0x7F9712 /end MEASUREMENT
/begin MEASUREMENT CCAdp_stFidShutOff "Status Freigaben Geschwindigkeitsregelanlage" UWORD dez 1 100 0.00 65535.00 FORMAT "%8.2" ECU_ADDRESS 0x7F971A /end MEASUREMENT
/begin MEASUREMENT CCAdp_VehDa_rVn "Verhältnis von Fahrgeschwindigkeit zur Motordrehzahl umgerechnet für CrCtl" UWORD qvn_q1Em5 1 100 0.00 0.6553500 FORMAT "%9.7" ECU_ADDRESS 0x7F9718 /end MEASUREMENT
/begin MEASUREMENT CCAdp_VSSCD_a "Fahrbeschleunigung umgerechnet für CrCtl" SWORD bfzg_sw_q4p239Em4 1 100 -13.8903552 13.8899313 ECU_ADDRESS 0x7F9714 /end MEASUREMENT
/begin MEASUREMENT CCAdp_VSSCD_a_crctl "Aktuelle Fahrzeuglängsbeschleunigung" SWORD bfzg_sw_q4p239Em4 1 100 -13.8903552 13.8899313 ECU_ADDRESS 0x7FD578 /end MEASUREMENT
/begin MEASUREMENT CCAdp_VSSCD_v "Fahrzeuggeschwindigkeit umgerechnet für CrCtl" UWORD vfzg_q0p01 1 100 0.00 655.3500 FORMAT "%8.4" ECU_ADDRESS 0x7F9716 /end MEASUREMENT
/begin MEASUREMENT CCAdp_VSSCD_v_crctl "Aktuelle Fahrzeuggeschwindigkeit" UWORD vfzg_q0p01 1 100 0.00 655.3500 FORMAT "%8.4" ECU_ADDRESS 0x7FD57A /end MEASUREMENT
/begin MEASUREMENT Clg_dtDynTst "Ansteig der Wassertemperatur seit start" SWORD TempDiff_Kelv 1 100 -3276.800 3276.700 FORMAT "%8.3" ECU_ADDRESS 0x7F9738 /end MEASUREMENT
/begin MEASUREMENT Clg_dtDynTstCARB "Anstieg der Kühlmitteltemperatur beim letzten Test" SWORD TempDiff_Kelv 1 100 -3276.800 3276.700 FORMAT "%8.3" ECU_ADDRESS 0x7F973A /end MEASUREMENT
/begin MEASUREMENT Clg_dtMinDynTstCARB "Kopie von Clg_dtMinDynTst_C für Tester" SWORD TempDiff_Kelv 1 100 -3276.800 3276.700 FORMAT "%8.3" ECU_ADDRESS 0x7F973C /end MEASUREMENT
/begin MEASUREMENT Clg_tClntStrtVal_mp "Wassertemperatur zu Beginn des dynamischen Plausibilitätstests" SWORD Temp_Cels 1 100 -3549.940 3003.560 FORMAT "%8.3" ECU_ADDRESS 0x9FE9FA /end MEASUREMENT
/begin MEASUREMENT Clg_tEndDynTst "CTSCD_tClnt am Ende des Tests" SWORD Temp_Cels 1 100 -3549.940 3003.560 FORMAT "%8.3" ECU_ADDRESS 0x7F973E /end MEASUREMENT
/begin MEASUREMENT Clg_tEndDynTstCARB "Kühlmitteltemperatur am Ende des letzten Tests" SWORD Temp_Cels 1 100 -3549.940 3003.560 FORMAT "%8.3" ECU_ADDRESS 0x7F9740 /end MEASUREMENT
/begin MEASUREMENT Clg_tiDynTst "Abgelaufene Zeit, seit der der dynamische plausibilitätstest aktiv ist" UWORD Time_DynTst 1 100 0.00 167769.6 FORMAT "%8.1" ECU_ADDRESS 0x7F9744 /end MEASUREMENT
/begin MEASUREMENT Clg_tiDynTstCARB "Dauer des letzten Tests" UWORD Time_DynTst 1 100 0.00 167769.6 FORMAT "%8.1" ECU_ADDRESS 0x7F9746 /end MEASUREMENT
/begin MEASUREMENT Clg_tiMaxDynTst "Maximal zulässige Testzeit des dynamischen Plausibilitätstest" UWORD Time_DynTst 1 100 0.00 167769.6 FORMAT "%8.1" ECU_ADDRESS 0x7F9748 /end MEASUREMENT
/begin MEASUREMENT Clg_tiMaxDynTstCARB "Maximale Testzeit beim letzten Test" UWORD Time_DynTst 1 100 0.00 167769.6 FORMAT "%8.1" ECU_ADDRESS 0x7F974A /end MEASUREMENT
/begin MEASUREMENT Clg_tMinClntDynTstCARB "Kopie von Clg_tMinClntDynTst_C für Tester" SWORD Temp_Cels 1 100 -3549.940 3003.560 FORMAT "%8.3" ECU_ADDRESS 0x7F9742 /end MEASUREMENT
/begin MEASUREMENT CmbChb_ctEngRevLogBuf1_mp "Anzahl der ausgewerteten Kurbelwellenumdrehungen, gespeichert im Puffer 1" UWORD OneToOne 1 100 0.00 65535.00 FORMAT "%8.2" ECU_ADDRESS 0x9FEA2A /end MEASUREMENT
/begin MEASUREMENT CmbChb_ctEngRevLogBuf2_mp "Anzahl der ausgewerteten Kurbelwellenumdrehungen, gespeichert im Puffer 2" UWORD OneToOne 1 100 0.00 65535.00 FORMAT "%8.2" ECU_ADDRESS 0x9FEA2C /end MEASUREMENT
/begin MEASUREMENT CmbChb_ctEngRevLogMem_mp "Anzahl der ausgewerteten Kurbelwellenumdrehungen" UWORD OneToOne 1 100 0.00 65535.00 FORMAT "%8.2" ECU_ADDRESS 0x9FEA2E /end MEASUREMENT
/begin MEASUREMENT CmbChb_ctEngRevPerBlk_mp "Warteperiode nach dem die Überwachungsbedingungen erfüllt sind: Anzahl der Kurbelwellenumdrehungen bis zur ersten Auswertung" UWORD OneToOne 1 100 0.00 65535.00 FORMAT "%8.2" ECU_ADDRESS 0x9FEA30 /end MEASUREMENT
/begin MEASUREMENT CmbChb_ctMifBuf1_mp "Anzahl der erkannten Zündaussetzer, ein Meßpunkt für jeden Zylinder, Puffer 1" UWORD OneToOne 1 100 0.00 65535.00 FORMAT "%8.2" ARRAY_SIZE 5 ECU_ADDRESS 0x9FE9FC /end MEASUREMENT
/begin MEASUREMENT CmbChb_ctMifBuf2_mp "Anzahl der erkannten Zündaussetzer, ein Meßpunkt für jeden Zylinder, Puffer 2" UWORD OneToOne 1 100 0.00 65535.00 FORMAT "%8.2" ARRAY_SIZE 5 ECU_ADDRESS 0x9FEA06 /end MEASUREMENT
/begin MEASUREMENT CmbChb_ctMifMem_mp "Anzahl der erkannten Zündaussetzer, ein Meßpunkt für jeden Zylinder" UWORD OneToOne 1 100 0.00 65535.00 FORMAT "%8.2" ARRAY_SIZE 5 ECU_ADDRESS 0x9FEA10 /end MEASUREMENT
/begin MEASUREMENT CmbChb_ctMisfireAvrg_mp "Durchschnittliche Anzahl von Zündaussetzern (EWMA) während der letzten Fahrzyklen, ein Meßpunkt pro Zylinder" UWORD OneToOne 1 100 0.00 65535.00 FORMAT "%8.2" ARRAY_SIZE 4 ECU_ADDRESS 0x9FEA1A /end MEASUREMENT
/begin MEASUREMENT CmbChb_ctMisfireTot_mp "Anzahl der detektieren Zündaussetzer im letzten bzw. derzeitigen Fahrzyklus (Key-Trip)" UWORD OneToOne 1 100 0.00 65535.00 FORMAT "%8.2" ARRAY_SIZE 4 ECU_ADDRESS 0x9FEA22 /end MEASUREMENT
/begin MEASUREMENT CmbChb_dnSegMinPerCyl_mp "Verhältnis von minimal zulässigem zum durchschnittlichen Drehzahlanstieg in Prozent: Empfindlichkeit der Aussetzererkennung" SWORD EngN 1 100 -32768.00 32767.00 FORMAT "%8.2" ECU_ADDRESS 0x9FEA32 /end MEASUREMENT
/begin MEASUREMENT CmbChb_nSegEven_mp "Summe der Drehzahlen der geradzahligen Segmente zweier Kurbelwellenumdrehungen" SWORD EngN 1 100 -32768.00 32767.00 FORMAT "%8.2" ECU_ADDRESS 0x9FEA34 /end MEASUREMENT
/begin MEASUREMENT CmbChb_nSegOdd_mp "Summe der Drehzahlen der ungerade Segmente zweier Kurbelwellenumdrehungen" SWORD EngN 1 100 -32768.00 32767.00 FORMAT "%8.2" ECU_ADDRESS 0x9FEA36 /end MEASUREMENT
/begin MEASUREMENT CmbChb_st "Status der Aussetzererkennung" UBYTE OneToOne 1 100 0.00 255.0 FORMAT "%5.1" ECU_ADDRESS 0x7F932B /end MEASUREMENT
/begin MEASUREMENT CmbChb_swtMonClutch "SW-Schalter Aktivierung/Deaktivierung Überwachung Zündaussetzererkennung" UBYTE OneToOne 1 100 0.00 3.000 FORMAT "%5.3" ECU_ADDRESS 0x7F932C /end MEASUREMENT
/begin MEASUREMENT CoDT_dtrqSlpLimErr_mp "Beschränkungsstörung der gewünschten Drehkraft" SWORD TrqPerSec 1 100 -32768.00 32767.00 FORMAT "%8.2" ECU_ADDRESS 0x9FEA38 /end MEASUREMENT
/begin MEASUREMENT CoDT_dtrqSlpLimLIGov_mp "GetriebeSteigungBeschränkung" SWORD TrqPerSec 1 100 -32768.00 32767.00 FORMAT "%8.2" ECU_ADDRESS 0x9FEA3A /end MEASUREMENT
/begin MEASUREMENT CoDT_dtrqSlpLimNeg_mp "negative Rampensteigung" ULONG RmpTrq 1 100 0.00 6553599.99847 FORMAT "%13.5" ECU_ADDRESS 0x9FE45C /end MEASUREMENT
/begin MEASUREMENT CoDT_dtrqSlpLimPos_mp "positive Rampensteigung" ULONG RmpTrq 1 100 0.00 6553599.99847 FORMAT "%13.5" ECU_ADDRESS 0x9FE460 /end MEASUREMENT
/begin MEASUREMENT CoDT_dtrqSlpLimSub_mp "Ersatzwert der Gradientenbegrenzung" SWORD TrqPerSec 1 100 -32768.00 32767.00 FORMAT "%8.2" ECU_ADDRESS 0x9FEA3C /end MEASUREMENT
/begin MEASUREMENT CoDT_Grip "Kraftschluß innerhalb Antrieb" UBYTE OneToOne 1 100 0.00 255.0 FORMAT "%5.1" ECU_ADDRESS 0x7F932D /end MEASUREMENT
/begin MEASUREMENT CoDT_nMax "Drehzahlforderung Maximalwert Triebstrangkoordinator" SWORD EngN 1 100 -32768.00 32767.00 FORMAT "%8.2" ECU_ADDRESS 0x7F974E /end MEASUREMENT
/begin MEASUREMENT CoDT_nMin "Drehzahlforderung Minimalwert Triebstrangkoordinator" SWORD EngN 1 100 -32768.00 32767.00 FORMAT "%8.2" ECU_ADDRESS 0x7F9750 /end MEASUREMENT
/begin MEASUREMENT CoDT_stGripDeb "Zustand der Kraftschlußentprellung" UBYTE OneToOne 1 100 0.00 255.0 FORMAT "%5.1" ECU_ADDRESS 0x7F932E /end MEASUREMENT
/begin MEASUREMENT CoDT_stOrd "Randbedingungen für physikalischen Auftrag" UBYTE OneToOne 1 100 0.00 255.0 FORMAT "%5.1" ECU_ADDRESS 0x7F932F /end MEASUREMENT
/begin MEASUREMENT CoDT_stPrpOvrRun_mp "Schubfall erkannt (0: kein Schub)" UWORD OneToOne 1 100 0.00 65535.00 FORMAT "%8.2" ECU_ADDRESS 0x9FEA4C /end MEASUREMENT
/begin MEASUREMENT CoDT_stRampDir_mp "Zustand der Rampe" SBYTE OneToOne 1 100 -128.0 127.0 FORMAT "%5.1" ECU_ADDRESS 0x9FFA31 /end MEASUREMENT
/begin MEASUREMENT CoDT_swtCoType "0: conventional; 1: mastershift" UBYTE OneToOne 1 100 0.00 255.0 FORMAT "%5.1" ECU_ADDRESS 0x7F9330 /end MEASUREMENT
/begin MEASUREMENT CoDT_trq "aktuelles Getriebeausgangsmoment" SLONG TrqPrpHigh 1 100 -214748364.800 214748364.700 FORMAT "%13.3" ECU_ADDRESS 0x7F9D5C /end MEASUREMENT
/begin MEASUREMENT CoDT_trqAcsMax_mp "maximales Nebenaggregatmoment" SWORD Trq 1 100 -3276.800 3276.700 FORMAT "%8.3" ECU_ADDRESS 0x9FEA4E /end MEASUREMENT
/begin MEASUREMENT CoDT_trqAcsMin "minimaler Momentenbedarf der Nebenaggregate" SWORD Trq 1 100 -3276.800 3276.700 FORMAT "%8.3" ECU_ADDRESS 0x7F9752 /end MEASUREMENT
/begin MEASUREMENT CoDT_trqAcsRaw_mp "Zielwert Momentenbedarf der Nebenaggregate" SWORD Trq 1 100 -3276.800 3276.700 FORMAT "%8.3" ECU_ADDRESS 0x9FEA50 /end MEASUREMENT
/begin MEASUREMENT CoDT_trqAcs_mp "ungefilterter Momentenbedarf der Nebenaggregate" SWORD Trq 1 100 -3276.800 3276.700 FORMAT "%8.3" ECU_ADDRESS 0x9FEA52 /end MEASUREMENT
/begin MEASUREMENT CoDT_trqActAcs_mp "aktuelle Momentenanforderung der Nebenaggregate" SWORD Trq 1 100 -3276.800 3276.700 FORMAT "%8.3" ECU_ADDRESS 0x9FEA4A /end MEASUREMENT
/begin MEASUREMENT CoDT_trqCurr "Momentenanforderung Triebstrang Vorhaltewert" SWORD Trq 1 100 -3276.800 3276.700 FORMAT "%8.3" ECU_ADDRESS 0x7F9754 /end MEASUREMENT
/begin MEASUREMENT CoDT_trqDes "Momentenanforderung Triebstrangkoordinator Wunschwert" SWORD Trq 1 100 -3276.800 3276.700 FORMAT "%8.3" ECU_ADDRESS 0x7F9760 /end MEASUREMENT
/begin MEASUREMENT CoDT_trqDrv "Momentforderung Triebstangkoordinator ohne ext. Eingriffe" SWORD Trq 1 100 -3276.800 3276.700 FORMAT "%8.3" ECU_ADDRESS 0x7F9762 /end MEASUREMENT
/begin MEASUREMENT CoDT_trqDTInCurr "Momentenanforderung Vorhalt Triebstrangkoordinator (Kupplungseingang) (curr-Pfad)" SWORD Trq 1 100 -3276.800 3276.700 FORMAT "%8.3" ECU_ADDRESS 0x7F9756 /end MEASUREMENT
/begin MEASUREMENT CoDT_trqDTInDecCurr_mp "Momentenanforderung Triebstrang nach Reduzierenden Getriebeeingriffen Vorhaltewert (Curr Pfad)" SWORD Trq 1 100 -3276.800 3276.700 FORMAT "%8.3" ECU_ADDRESS 0x9FEA42 /end MEASUREMENT
/begin MEASUREMENT CoDT_trqDTInDecLead_mp "Momentenanforderung Triebstrang nach reduzierenden Getriebeeingriffen" SWORD Trq 1 100 -3276.800 3276.700 FORMAT "%8.3" ECU_ADDRESS 0x9FEA44 /end MEASUREMENT
/begin MEASUREMENT CoDT_trqDTInDes "Momentenanforderung Triebstrang (Kupplungseingang) Wunschwert" SWORD Trq 1 100 -3276.800 3276.700 FORMAT "%8.3" ECU_ADDRESS 0x7F9758 /end MEASUREMENT
/begin MEASUREMENT CoDT_trqDTInDrv "Sollwert Triebstrangmoment (Kupplungseingang) ohne ext. Eingriffe" SWORD Trq 1 100 -3276.800 3276.700 FORMAT "%8.3" ECU_ADDRESS 0x7F975A /end MEASUREMENT
/begin MEASUREMENT CoDT_trqDTInLead "Momentenanforderung Triebstrang (Kupplungseingang) Vorhaltewert" SWORD Trq 1 100 -3276.800 3276.700 FORMAT "%8.3" ECU_ADDRESS 0x7F975C /end MEASUREMENT
/begin MEASUREMENT CoDT_trqDTInPCtl "Momentenanforderung Triebstrang (Kupplungseingang) ohne ext. Eingriffe" SWORD Trq 1 100 -3276.800 3276.700 FORMAT "%8.3" ECU_ADDRESS 0x7F975E /end MEASUREMENT
/begin MEASUREMENT CoDT_trqGbx "aktuelles Eingangsmoment Getriebe" SWORD Trq 1 100 -3276.800 3276.700 FORMAT "%8.3" ECU_ADDRESS 0x7F9764 /end MEASUREMENT
/begin MEASUREMENT CoDT_trqGbxMax "maximales Getriebeeingangsmoment" SWORD Trq 1 100 -3276.800 3276.700 FORMAT "%8.3" ECU_ADDRESS 0x7F9766 /end MEASUREMENT
/begin MEASUREMENT CoDT_trqGbxMin "minimales Getriebeeingangsmoment" SWORD Trq 1 100 -3276.800 3276.700 FORMAT "%8.3" ECU_ADDRESS 0x7F9768 /end MEASUREMENT
/begin MEASUREMENT CoDT_trqGearbxDes "Getriebeeingangsmoment Fahrerwunsch" SWORD Trq 1 100 -3276.800 3276.700 FORMAT "%8.3" ECU_ADDRESS 0x7F976A /end MEASUREMENT
/begin MEASUREMENT CoDT_trqGearbxDrv "Fahrerwunsch Getriebeeingangsmoment ohne ext. Eingriffe" SWORD Trq 1 100 -3276.800 3276.700 FORMAT "%8.3" ECU_ADDRESS 0x7F976C /end MEASUREMENT
/begin MEASUREMENT CoDT_trqGearbxLead_mp "Getriebeeingangsmoment Vorhaltewert" SWORD Trq 1 100 -3276.800 3276.700 FORMAT "%8.3" ECU_ADDRESS 0x9FEA46 /end MEASUREMENT
/begin MEASUREMENT CoDT_trqGearbxPCtl "Ungefilterter Fahrerwunsch Getriebeeingangsmoment ohne ext. Eingriffe" SWORD Trq 1 100 -3276.800 3276.700 FORMAT "%8.3" ECU_ADDRESS 0x7F976E /end MEASUREMENT
/begin MEASUREMENT CoDT_trqIncLim_mp "erhöhender Momenteneingriff." SWORD Trq 1 100 -3276.800 3276.700 FORMAT "%8.3" ECU_ADDRESS 0x9FEA3E /end MEASUREMENT
/begin MEASUREMENT CoDT_trqLead "Momentenanforderung Vorhaltewert" SWORD Trq 1 100 -3276.800 3276.700 FORMAT "%8.3" ECU_ADDRESS 0x7F9770 /end MEASUREMENT
/begin MEASUREMENT CoDT_trqLeadDec_mp "Vorhalt Begrenzungsmoment Getriebe" SWORD Trq 1 100 -3276.800 3276.700 FORMAT "%8.3" ECU_ADDRESS 0x9FEA48 /end MEASUREMENT
/begin MEASUREMENT CoDT_trqMax "maximal mögliches Antriebsmoment (Getriebeausgang)" SLONG TrqPrpHigh 1 100 -214748364.800 214748364.700 FORMAT "%13.3" ECU_ADDRESS 0x7F9D60 /end MEASUREMENT
/begin MEASUREMENT CoDT_trqMin "minimal mögliches Antriebsmoment (Getriebeausgang)" SLONG TrqPrpHigh 1 100 -214748364.800 214748364.700 FORMAT "%13.3" ECU_ADDRESS 0x7F9D64 /end MEASUREMENT
/begin MEASUREMENT CoDT_trqMinInr "Minimal mögliches innerses Motorantriebsmoment" SWORD Trq 1 100 -3276.800 3276.700 FORMAT "%8.3" ECU_ADDRESS 0x7F9772 /end MEASUREMENT
/begin MEASUREMENT CoDT_trqPCtl "Ungefilterter Fahrerwunschmoment ohne ext. Eingriffe" SWORD Trq 1 100 -3276.800 3276.700 FORMAT "%8.3" ECU_ADDRESS 0x7F9774 /end MEASUREMENT
/begin MEASUREMENT CoDT_trqPlaus "Moment zur Plausibilisierung Master/Slave" SWORD Trq 1 100 -3276.800 3276.700 FORMAT "%8.3" ECU_ADDRESS 0x7F9776 /end MEASUREMENT
/begin MEASUREMENT CoDT_trqRampInit_mp "Initialisierungswert der Rampenfunktion" SWORD Trq 1 100 -3276.800 3276.700 FORMAT "%8.3" ECU_ADDRESS 0x9FEA40 /end MEASUREMENT
/begin MEASUREMENT CoDT_trqRampOut "Gradientenbegrenztes Getriebeeingangsmoment Fahrer-wunsch" SWORD Trq 1 100 -3276.800 3276.700 FORMAT "%8.3" ECU_ADDRESS 0x7F9778 /end MEASUREMENT
/begin MEASUREMENT CoEng_CoordPrioALS_mp "Dynamische Priorität der Adaption Lambdasonde im Schubkoordinator" UWORD OneToOne 1 100 0.00 65535.00 FORMAT "%8.2" ECU_ADDRESS 0x9FEA54 /end MEASUREMENT
/begin MEASUREMENT CoEng_CoordPrioFBC_mp "Dynamische Priorität der Mengenausgleichsregelung im Schubkoordinator" UWORD OneToOne 1 100 0.00 65535.00 FORMAT "%8.2" ECU_ADDRESS 0x9FEA56 /end MEASUREMENT
/begin MEASUREMENT CoEng_CoordPrioTAA_mp "Dynamische Priorität des Inkrementwinkellernens im Schubkoordinator" UWORD OneToOne 1 100 0.00 65535.00 FORMAT "%8.2" ECU_ADDRESS 0x9FEA58 /end MEASUREMENT
/begin MEASUREMENT CoEng_CoordPrioZFC_mp "Dynamische Priorität der Nullmengenkalibrierung im Schubkoordinator" UWORD OneToOne 1 100 0.00 65535.00 FORMAT "%8.2" ECU_ADDRESS 0x9FEA5A /end MEASUREMENT
/begin MEASUREMENT CoEng_ctUnpla "Zähler für Überwachungsebene 1 und 2 Unplausibilität" UBYTE OneToOne 1 100 0.00 255.0 FORMAT "%5.1" ECU_ADDRESS 0x7F9331 /end MEASUREMENT
/begin MEASUREMENT CoEng_dvolFlConsAll "aktueller Verbrauch für Gesamteinspritzmenge in l/h" SWORD FlConsum_l_h 1 100 -327.6800 327.6700 FORMAT "%8.4" ECU_ADDRESS 0x7F977A /end MEASUREMENT
/begin MEASUREMENT CoEng_dvolFlConsAllTot "aktueller Gesamtkraftstoffverbrauch in l/h" SWORD FlConsum_l_h 1 100 -327.6800 327.6700 FORMAT "%8.4" ECU_ADDRESS 0x7F977C /end MEASUREMENT
/begin MEASUREMENT CoEng_dvolFlConsum "Kraftstoffverbrauch" SWORD FlConsum_l_h 1 100 -327.6800 327.6700 FORMAT "%8.4" ECU_ADDRESS 0x7F977E /end MEASUREMENT
/begin MEASUREMENT CoEng_dvolFlConsumFlt "mit DT1- und PT1-Regler gefilterter Kraftstoffverbrauch" SWORD FlConsum_l_h 1 100 -327.6800 327.6700 FORMAT "%8.4" ECU_ADDRESS 0x7F9780 /end MEASUREMENT
/begin MEASUREMENT CoEng_dvolPerStroke_mp "Kraftstoffverbrauch in [mm^3/hub]" SWORD InjQnt 1 100 -3276.800 3276.700 FORMAT "%8.3" ECU_ADDRESS 0x9FEA92 /end MEASUREMENT
/begin MEASUREMENT CoEng_facAdj "EEPROM Abgleichwert zur Korrektur des Begrenzungsmomentes" SWORD Fact 1 100 -4.000000 3.999878 FORMAT "%8.6" ECU_ADDRESS 0x7F9782 /end MEASUREMENT
/begin MEASUREMENT CoEng_facAdj_mp "EEPROM Abgleichswert zur Korrektur des Begrenzungsmomentes CoEng_trqLim" SWORD Fact 1 100 -4.000000 3.999878 FORMAT "%8.6" ECU_ADDRESS 0x9FEA88 /end MEASUREMENT
/begin MEASUREMENT CoEng_nMax "Drehzahlintervall Maximum" SWORD EngN 1 100 -32768.00 32767.00 FORMAT "%8.2" ECU_ADDRESS 0x7F9784 /end MEASUREMENT
/begin MEASUREMENT CoEng_nMin "Drehzahlintervall Minimum" SWORD EngN 1 100 -32768.00 32767.00 FORMAT "%8.2" ECU_ADDRESS 0x7F9786 /end MEASUREMENT
/begin MEASUREMENT CoEng_qSetUnBalTrim_mp "getrimmte Einspritzmenge [mg/Hub]" SWORD InjMass 1 100 -327.6800 327.6700 FORMAT "%8.4" ECU_ADDRESS 0x9FEA94 /end MEASUREMENT
/begin MEASUREMENT CoEng_qTotTrim_mp "korrigierte Einspritzmenge in  mg/Hub für Gesamteinspritzmenge" SWORD InjMass 1 100 -327.6800 327.6700 FORMAT "%8.4" ECU_ADDRESS 0x9FEA96 /end MEASUREMENT
/begin MEASUREMENT CoEng_rTrq "Verhältnis aktuelles Moment zu Maximalmoment" SWORD Prc 1 100 -327.6800 327.6700 FORMAT "%8.4" ECU_ADDRESS 0x7F9788 /end MEASUREMENT
/begin MEASUREMENT CoEng_stAftRun "nachlauf-interner Nachlauf-Zustand" UBYTE OneToOne 1 100 0.00 255.0 FORMAT "%5.1" ECU_ADDRESS 0x7F9332 /end MEASUREMENT
/begin MEASUREMENT CoEng_stAftRunPath "Abschaltpfade aufgrund Motorzustand Nachlauf" ULONG OneToOne 1 100 0.00 4294967295.00 FORMAT "%13.2" ECU_ADDRESS 0x7F9D68 /end MEASUREMENT
/begin MEASUREMENT CoEng_stCompTst "Status ob Kompressionstest aktiv/nicht aktiv" UBYTE OneToOne 1 100 0.00 255.0 FORMAT "%5.1" ECU_ADDRESS 0x7F9333 /end MEASUREMENT
/begin MEASUREMENT CoEng_stCoordALS_mp "Statusanzeige Schubkoordinator für Adaption Lambdasonde" UWORD OneToOne 1 100 0.00 65535.00 FORMAT "%8.2" ECU_ADDRESS 0x9FEA5C /end MEASUREMENT
/begin MEASUREMENT CoEng_stCoordFBC_mp "Statusanzeige Schubkoordinator für Mengenausgleichsregelung" UWORD OneToOne 1 100 0.00 65535.00 FORMAT "%8.2" ECU_ADDRESS 0x9FEA5E /end MEASUREMENT
/begin MEASUREMENT CoEng_stCoordTAA_mp "Statusanzeige Schubkoordinator für Inkrementwinkellernen" UWORD OneToOne 1 100 0.00 65535.00 FORMAT "%8.2" ECU_ADDRESS 0x9FEA60 /end MEASUREMENT
/begin MEASUREMENT CoEng_stCoordZFC_mp "Statusanzeige Schubkoordinator für Nullmengenkalibrierung" UWORD OneToOne 1 100 0.00 65535.00 FORMAT "%8.2" ECU_ADDRESS 0x9FEA62 /end MEASUREMENT
/begin MEASUREMENT CoEng_stCurrLimActive "Statusword zur Markierung der wirksamen niedrigsten Begrenzungsmomente" ULONG OneToOne 1 100 0.00 4294967295.00 FORMAT "%13.2" ECU_ADDRESS 0x7F9D6C /end MEASUREMENT
/begin MEASUREMENT CoEng_stEEPStore_mp "Speicherstatus für EEPROM während Nachlauf" UBYTE OneToOne 1 100 0.00 255.0 FORMAT "%5.1" ECU_ADDRESS 0x9FFA32 /end MEASUREMENT
/begin MEASUREMENT CoEng_stEng "aktueller Motorzustand [-]" UBYTE OneToOne 1 100 0.00 255.0 FORMAT "%5.1" ECU_ADDRESS 0x7F9335 /end MEASUREMENT
/begin MEASUREMENT CoEng_stEngNext "nächster Motorstatus (20ms) für Startbit Auswertung" UBYTE OneToOne 1 100 0.00 255.0 FORMAT "%5.1" ECU_ADDRESS 0x7F9336 /end MEASUREMENT
/begin MEASUREMENT CoEng_stEngOld "Motorstatus vor aktuellem Status" UBYTE OneToOne 1 100 0.00 255.0 FORMAT "%5.1" ECU_ADDRESS 0x7F9337 /end MEASUREMENT
/begin MEASUREMENT CoEng_stENGSlpInd "Steuergerät im Nachlauf" UBYTE OneToOne 1 100 0.00 255.0 FORMAT "%5.1" ECU_ADDRESS 0x7F9334 /end MEASUREMENT
/begin MEASUREMENT CoEng_stExtWait "Zustand ""warten auf externe Ereignisse vor Schreiben des EEPROM""" UWORD OneToOne 1 100 0.00 65535.00 FORMAT "%8.2" ECU_ADDRESS 0x7F978A /end MEASUREMENT
/begin MEASUREMENT CoEng_stIRevShutOff "irreversible Abschaltursachen (nach Maskierung)" ULONG OneToOne 1 100 0.00 4294967295.00 FORMAT "%13.2" ECU_ADDRESS 0x7F9D70 /end MEASUREMENT
/begin MEASUREMENT CoEng_stLayer12 "Indikator für Ebene 1 und 2 Unplausibilität" UBYTE OneToOne 1 100 0.00 255.0 FORMAT "%5.1" ECU_ADDRESS 0x7F9338 /end MEASUREMENT
/begin MEASUREMENT CoEng_stMonActrPrt "Zustand der Steuerung Stellerschutz" UBYTE OneToOne 1 100 0.00 255.0 FORMAT "%5.1" ECU_ADDRESS 0x7F9339 /end MEASUREMENT
/begin MEASUREMENT CoEng_stMonShOff "aktueller Zustand der Abstellsteuerung im Nachlauf" UBYTE OneToOne 1 100 0.00 255.0 FORMAT "%5.1" ECU_ADDRESS 0x7F933A /end MEASUREMENT
/begin MEASUREMENT CoEng_stOvrRun "Zustand Schuberkennung (0: kein Schub, 1: Schub)" UBYTE OneToOne 1 100 0.00 255.0 FORMAT "%5.1" ECU_ADDRESS 0x7F933B /end MEASUREMENT
/begin MEASUREMENT CoEng_stOvrRunCoord "Status Schuberkennung des Schubkoordinators (0: kein Schub; 1: Schub)" UBYTE OneToOne 1 100 0.00 255.0 FORMAT "%5.1" ECU_ADDRESS 0x7F933C /end MEASUREMENT
/begin MEASUREMENT CoEng_stPwrStgEnaCond "Steuergerätestatus, der für die Abschaltung der Endstufe/Endstufenfehlerdiagnose relevant ist" UBYTE OneToOne 1 100 0.00 255.0 FORMAT "%5.1" ECU_ADDRESS 0x7F933D /end MEASUREMENT
/begin MEASUREMENT CoEng_stRevShutOff "reversible Abschaltursachen (nach Maskierung)" ULONG OneToOne 1 100 0.00 4294967295.00 FORMAT "%13.2" ECU_ADDRESS 0x7F9D74 /end MEASUREMENT
/begin MEASUREMENT CoEng_stShutOff "Typ der wirksamen Abschaltursache (0: Nachlauf; 1: reversibel; 2: irreversibel)" UBYTE OneToOne 1 100 0.00 255.0 FORMAT "%5.1" ECU_ADDRESS 0x7F933E /end MEASUREMENT
/begin MEASUREMENT CoEng_stShutOffPath "aktive Abstellpfade resultierend aus aktiven reversiblen, irreversiblen und Nachlauf-Abstellpfaden" ULONG OneToOne 1 100 0.00 4294967295.00 FORMAT "%13.2" ECU_ADDRESS 0x7F9D78 /end MEASUREMENT
/begin MEASUREMENT CoEng_stSlpLim_mp "Statusbits für Turboschubbegrenzung" UBYTE OneToOne 1 100 0.00 255.0 FORMAT "%5.1" ECU_ADDRESS 0x9FFA33 /end MEASUREMENT
/begin MEASUREMENT CoEng_stTMFWShOff "Status Message ob Abschaltanforderung für das Zweimassenschwungrad notwendig ist" UBYTE OneToOne 1 100 0.00 255.0 FORMAT "%5.1" ECU_ADDRESS 0x7F933F /end MEASUREMENT
/begin MEASUREMENT CoEng_stTrqLimBit "Status Begrenzungsmoment im Bi-Turbo-Systemfehlerfall. Bit0: Begrenzung aktiv" UBYTE OneToOne 1 100 0.00 255.0 FORMAT "%5.1" ECU_ADDRESS 0x7F9341 /end MEASUREMENT
/begin MEASUREMENT CoEng_stTrqLimErr "Status Begrenzungsmoment im Systemfehlerfall. Bit0: Begrenzung aktiv; Bit1: Rampe von/zu Begrenzungswert aktiv" UBYTE OneToOne 1 100 0.00 255.0 FORMAT "%5.1" ECU_ADDRESS 0x7F9342 /end MEASUREMENT
/begin MEASUREMENT CoEng_stTst "Zustand des Motortestkoordinators (= aktiver Testmodus)" UBYTE OneToOne 1 100 0.00 255.0 FORMAT "%5.1" ECU_ADDRESS 0x7F9343 /end MEASUREMENT
/begin MEASUREMENT CoEng_stTVAClsd "Status für Drosselklappe im Nachlauf zur Vermeidung von Abstellschlagen" UBYTE OneToOne 1 100 0.00 255.0 FORMAT "%5.1" ECU_ADDRESS 0x7F9340 /end MEASUREMENT
/begin MEASUREMENT CoEng_swtAWDLimEna "Softwareschalter zum Deaktivieren des Einflusses des Allrad-Status auf die Rauchbegrenzung" UBYTE OneToOne 1 100 0.00 255.0 FORMAT "%5.1" ECU_ADDRESS 0x7F9344 /end MEASUREMENT
/begin MEASUREMENT CoEng_tiAfterrun "Zeit seit Erreichen des Motorzustands Nachlauf (COENG_STAFTERRUN)" ULONG Time_ms 1 100 0.00 42949672950.0 FORMAT "%13.1" ECU_ADDRESS 0x7F9D7C /end MEASUREMENT
/begin MEASUREMENT CoEng_tiNormal "Zeit seit Erreichen des Zustands NORMAL" ULONG Time_ms 1 100 0.00 42949672950.0 FORMAT "%13.1" ECU_ADDRESS 0x7F9D80 /end MEASUREMENT
/begin MEASUREMENT CoEng_tiStandby "Zeit seit Erriechen Zustand STANDBY" ULONG Time_ms 1 100 0.00 42949672950.0 FORMAT "%13.1" ECU_ADDRESS 0x7F9D84 /end MEASUREMENT
/begin MEASUREMENT CoEng_tiStart "Zeit seit Erreichen Motorzustand START (0x02)" ULONG Time_ms 1 100 0.00 42949672950.0 FORMAT "%13.1" ECU_ADDRESS 0x7F9D88 /end MEASUREMENT
/begin MEASUREMENT CoEng_trq "aktuelles Motorausgangsmoment" SWORD Trq 1 100 -3276.800 3276.700 FORMAT "%8.3" ECU_ADDRESS 0x7F978C /end MEASUREMENT
/begin MEASUREMENT CoEng_trqASDdcGvnr_mp "Moment des Führungsformers in Berücksichtigung des Lastschlagreglers" SWORD Trq 1 100 -3276.800 3276.700 FORMAT "%8.3" ECU_ADDRESS 0x9FEA68 /end MEASUREMENT
/begin MEASUREMENT CoEng_trqInrAct "inneres Motormoment ohne Ruckeldämpfer (coeng_trqinrltd + coeng_trqliltd)" SWORD Trq 1 100 -3276.800 3276.700 FORMAT "%8.3" ECU_ADDRESS 0x7F978E /end MEASUREMENT
/begin MEASUREMENT CoEng_trqInrActDrv "inneres Moment Wunschwert plus begrenztes LLR-Moment ohne ext. Eingriffe" SWORD Trq 1 100 -3276.800 3276.700 FORMAT "%8.3" ECU_ADDRESS 0x7F9790 /end MEASUREMENT
/begin MEASUREMENT CoEng_trqInrCurr "inneres Moment aktueller Wert" SWORD Trq 1 100 -3276.800 3276.700 FORMAT "%8.3" ECU_ADDRESS 0x7F9792 /end MEASUREMENT
/begin MEASUREMENT CoEng_trqInrCurrFast "inneres Wunschmoment (schneller Pfad) erzeugt aus CoDT_trqCurr" SWORD Trq 1 100 -3276.800 3276.700 FORMAT "%8.3" ECU_ADDRESS 0x7F9794 /end MEASUREMENT
/begin MEASUREMENT CoEng_trqInrCurrFastBase_mp "inneres schnelles Wunschmoment im Curr-Pfad" SWORD Trq 1 100 -3276.800 3276.700 FORMAT "%8.3" ECU_ADDRESS 0x9FEA78 /end MEASUREMENT
/begin MEASUREMENT CoEng_trqInrCurrFastByp_mp "Bypass label für CoEng_trqInrCurrFast" SWORD Trq 1 100 -3276.800 3276.700 FORMAT "%8.3" ECU_ADDRESS 0x9FEA7A /end MEASUREMENT
/begin MEASUREMENT CoEng_trqInrCurrLim "aktuell kleinstes Begrenzungsmoment (inneres Motormoment)" SWORD Trq 1 100 -3276.800 3276.700 FORMAT "%8.3" ECU_ADDRESS 0x7F9796 /end MEASUREMENT
/begin MEASUREMENT CoEng_trqInrCurrPre_mp "aktuelles inneres Moment ahne Leerlaufreglerstellgrösse" SWORD Trq 1 100 -3276.800 3276.700 FORMAT "%8.3" ECU_ADDRESS 0x9FEA6A /end MEASUREMENT
/begin MEASUREMENT CoEng_trqInrDes "Wunschmoment (inneres Motormoment)" SWORD Trq 1 100 -3276.800 3276.700 FORMAT "%8.3" ECU_ADDRESS 0x7F9798 /end MEASUREMENT
/begin MEASUREMENT CoEng_trqInrDesFast "Wunschmoment (inneres Motormoment) (schneller Pfad) erzeugt aus CoDT_trqLead" SWORD Trq 1 100 -3276.800 3276.700 FORMAT "%8.3" ECU_ADDRESS 0x7F979A /end MEASUREMENT
/begin MEASUREMENT CoEng_trqInrDesFastBase_mp "inneres schnelles Wunschmoment ohne Veränderung" SWORD Trq 1 100 -3276.800 3276.700 FORMAT "%8.3" ECU_ADDRESS 0x9FEA7C /end MEASUREMENT
/begin MEASUREMENT CoEng_trqInrDesFastByp_mp "Bypass label für CoEng_trqInrDesFast" SWORD Trq 1 100 -3276.800 3276.700 FORMAT "%8.3" ECU_ADDRESS 0x9FEA7E /end MEASUREMENT
/begin MEASUREMENT CoEng_trqInrDesSlow "inneres Moment Wunschwert (normaler Pfad) erzeugt aus CoDT_trqDes" SWORD Trq 1 100 -3276.800 3276.700 FORMAT "%8.3" ECU_ADDRESS 0x7F979C /end MEASUREMENT
/begin MEASUREMENT CoEng_trqInrDesSlowBase_mp "inneres langsames Wunschmoment ohne Veränderung" SWORD Trq 1 100 -3276.800 3276.700 FORMAT "%8.3" ECU_ADDRESS 0x9FEA6C /end MEASUREMENT
/begin MEASUREMENT CoEng_trqInrDesSlowByp_mp "Bypass label für CoEng_trqInrDesSlow" SWORD Trq 1 100 -3276.800 3276.700 FORMAT "%8.3" ECU_ADDRESS 0x9FEA6E /end MEASUREMENT
/begin MEASUREMENT CoEng_trqInrDrvSlow "Wunschmoment des Antriebsstrangs (inneres Moment) ohne ext. Eingriffe" SWORD Trq 1 100 -3276.800 3276.700 FORMAT "%8.3" ECU_ADDRESS 0x7F979E /end MEASUREMENT
/begin MEASUREMENT CoEng_trqInrDrvSlowBase_mp "Grundwert inneres Sollmoment ohne ext. Eingriffe" SWORD Trq 1 100 -3276.800 3276.700 FORMAT "%8.3" ECU_ADDRESS 0x9FEA80 /end MEASUREMENT
/begin MEASUREMENT CoEng_trqInrDrvSlowByp_mp "Bypass für CoEng_trqInrDrvSlow" SWORD Trq 1 100 -3276.800 3276.700 FORMAT "%8.3" ECU_ADDRESS 0x9FEA82 /end MEASUREMENT
/begin MEASUREMENT CoEng_trqInrGearbxInMax_mp "maximales Getriebeeingangsmoment als inneres Motormoment" SWORD Trq 1 100 -3276.800 3276.700 FORMAT "%8.3" ECU_ADDRESS 0x9FEA64 /end MEASUREMENT
/begin MEASUREMENT CoEng_trqInrLim "Begrenzungsmoment (inneres Motormoment)" SWORD Trq 1 100 -3276.800 3276.700 FORMAT "%8.3" ECU_ADDRESS 0x7F97A0 /end MEASUREMENT
/begin MEASUREMENT CoEng_trqInrLimDes "Begrenzungsmoment als inneres Motormoment, korrigiert um Leerlaufreglerstellgröße" SWORD Trq 1 100 -3276.800 3276.700 FORMAT "%8.3" ECU_ADDRESS 0x7F97A2 /end MEASUREMENT
/begin MEASUREMENT CoEng_trqInrLimDyn "Dynamisches Begrenzungsmoment" SWORD Trq 1 100 -3276.800 3276.700 FORMAT "%8.3" ECU_ADDRESS 0x7F97A4 /end MEASUREMENT
/begin MEASUREMENT CoEng_trqInrLimLead "Begrenzungsmoment mit lang anhaltenden Begrenzungen" SWORD Trq 1 100 -3276.800 3276.700 FORMAT "%8.3" ECU_ADDRESS 0x7F97A6 /end MEASUREMENT
/begin MEASUREMENT CoEng_trqInrLimNoSmk "virtuelles Momentenlimit ohne Rauchbegrenzung" SWORD Trq 1 100 -3276.800 3276.700 FORMAT "%8.3" ECU_ADDRESS 0x7F97A8 /end MEASUREMENT
/begin MEASUREMENT CoEng_trqInrLimStat "Statisches Begrenzungsmoment" SWORD Trq 1 100 -3276.800 3276.700 FORMAT "%8.3" ECU_ADDRESS 0x7F97AA /end MEASUREMENT
/begin MEASUREMENT CoEng_trqInrLtd "inneres Moment Sollwert nach Begrenzung, vor Eingriff ARD-Störungsregler" SWORD Trq 1 100 -3276.800 3276.700 FORMAT "%8.3" ECU_ADDRESS 0x7F97AC /end MEASUREMENT
/begin MEASUREMENT CoEng_trqInrLtdDrv "begrenztes Sollmoment (inneres Moment) vor Aktiver Ruckel-dämpfer ohne ext. Eingriffe" SWORD Trq 1 100 -3276.800 3276.700 FORMAT "%8.3" ECU_ADDRESS 0x7F97AE /end MEASUREMENT
/begin MEASUREMENT CoEng_trqInrPCtl "Vorsteuermoment" SWORD Trq 1 100 -3276.800 3276.700 FORMAT "%8.3" ECU_ADDRESS 0x7F97B0 /end MEASUREMENT
/begin MEASUREMENT CoEng_trqInrPCtlByp_mp "Bypass für CoEng_trqInrPCtl" SWORD Trq 1 100 -3276.800 3276.700 FORMAT "%8.3" ECU_ADDRESS 0x9FEA84 /end MEASUREMENT
/begin MEASUREMENT CoEng_trqInrPCtlULtd "Vorsteuermoment ohne Beschränkungen" SWORD Trq 1 100 -3276.800 3276.700 FORMAT "%8.3" ECU_ADDRESS 0x7F97B2 /end MEASUREMENT
/begin MEASUREMENT CoEng_trqInrPCtl_mp "Ungefiltertes Fahrerwunschmoment ohne ext. Eingriffe" SWORD Trq 1 100 -3276.800 3276.700 FORMAT "%8.3" ECU_ADDRESS 0x9FEA86 /end MEASUREMENT
/begin MEASUREMENT CoEng_trqInrPrpLimErr_mp "Begrenzungsmoment für Vortrieb im Falle eines Systemfehlers als inneres Motormoment" SWORD Trq 1 100 -3276.800 3276.700 FORMAT "%8.3" ECU_ADDRESS 0x9FEA66 /end MEASUREMENT
/begin MEASUREMENT CoEng_trqInrRaw "inneres Moment Rohwert" SWORD Trq 1 100 -3276.800 3276.700 FORMAT "%8.3" ECU_ADDRESS 0x7F97B4 /end MEASUREMENT
/begin MEASUREMENT CoEng_trqInrRawPre_mp "Rohwet inneres Moment ohne Leerlaufreglerstellgrösse" SWORD Trq 1 100 -3276.800 3276.700 FORMAT "%8.3" ECU_ADDRESS 0x9FEA70 /end MEASUREMENT
/begin MEASUREMENT CoEng_trqInrSet "inneres Moment Sollwert (>Mengenberechnung)" SWORD Trq 1 100 -3276.800 3276.700 FORMAT "%8.3" ECU_ADDRESS 0x7F97B6 /end MEASUREMENT
/begin MEASUREMENT CoEng_trqLiLtd "begrenztes Leerlaufreglermoment" SWORD Trq 1 100 -3276.800 3276.700 FORMAT "%8.3" ECU_ADDRESS 0x7F97B8 /end MEASUREMENT
/begin MEASUREMENT CoEng_trqLimASDdc_mp "Sollmoment nach Eingriff des Ruckeldämfers nach zweiter Begrenzung" SWORD Trq 1 100 -3276.800 3276.700 FORMAT "%8.3" ECU_ADDRESS 0x9FEA72 /end MEASUREMENT
/begin MEASUREMENT CoEng_trqLimBit "Begrenzungsmoment im Bi-Turbo-Fehlerfall" SWORD Trq 1 100 -3276.800 3276.700 FORMAT "%8.3" ECU_ADDRESS 0x7F97BA /end MEASUREMENT
/begin MEASUREMENT CoEng_trqLimBitSwt "Ausgang des Ramp-Switch-Blocks zur Momentbegrenzung im Bi-Turbo-Fehlerfall" SWORD Trq 1 100 -3276.800 3276.700 FORMAT "%8.3" ECU_ADDRESS 0x7F97BC /end MEASUREMENT
/begin MEASUREMENT CoEng_trqLimCorr "Begrenzungsmoment nach der Multiplikationskorrektur" SWORD Trq 1 100 -3276.800 3276.700 FORMAT "%8.3" ECU_ADDRESS 0x7F97BE /end MEASUREMENT
/begin MEASUREMENT CoEng_trqLimErr "Begrenzungsmoment im Falle eines Systemfehlers" SWORD Trq 1 100 -3276.800 3276.700 FORMAT "%8.3" ECU_ADDRESS 0x7F97C0 /end MEASUREMENT
/begin MEASUREMENT CoEng_trqLimMax_mp "Begrenzungsmoment nach der Volllasterhöhung" SWORD Trq 1 100 -3276.800 3276.700 FORMAT "%8.3" ECU_ADDRESS 0x9FEA8C /end MEASUREMENT
/begin MEASUREMENT CoEng_trqLimMin_mp "Begrenzungsmoment, falls kein momentenbegrenzender Systemfehler vorliegt (Minimum aus Rauchgrenze un Motormech.schutz)" SWORD Trq 1 100 -3276.800 3276.700 FORMAT "%8.3" ECU_ADDRESS 0x9FEA8A /end MEASUREMENT
/begin MEASUREMENT CoEng_trqLimOffs_mp "aktueller Momentgrenzwert mit Offset f. ARD" SWORD Trq 1 100 -3276.800 3276.700 FORMAT "%8.3" ECU_ADDRESS 0x9FEA74 /end MEASUREMENT
/begin MEASUREMENT CoEng_trqLimSwt "Ausgang des RampSwitch-Block zur Momentbegrenzung im Systemfehlerfall" SWORD Trq 1 100 -3276.800 3276.700 FORMAT "%8.3" ECU_ADDRESS 0x7F97C2 /end MEASUREMENT
/begin MEASUREMENT CoEng_trqLoss "Motorverlustmomente" SWORD Trq 1 100 -3276.800 3276.700 FORMAT "%8.3" ECU_ADDRESS 0x7F97C4 /end MEASUREMENT
/begin MEASUREMENT CoEng_trqMax "Momentintervall Maximum" SWORD Trq 1 100 -3276.800 3276.700 FORMAT "%8.3" ECU_ADDRESS 0x7F97C6 /end MEASUREMENT
/begin MEASUREMENT CoEng_trqMin "Schleppmoment" SWORD Trq 1 100 -3276.800 3276.700 FORMAT "%8.3" ECU_ADDRESS 0x7F97C8 /end MEASUREMENT
/begin MEASUREMENT CoEng_trqMinInMax_mp "Minimum Moment für Maximum Auswahl" SWORD Trq 1 100 -3276.800 3276.700 FORMAT "%8.3" ECU_ADDRESS 0x9FEA76 /end MEASUREMENT
/begin MEASUREMENT CoEng_trqNGvnrNeg "möglich begrenztes Moment im Fall eines negativen Lastschlages" SWORD Trq 1 100 -3276.800 3276.700 FORMAT "%8.3" ECU_ADDRESS 0x7F97CA /end MEASUREMENT
/begin MEASUREMENT CoEng_trqNGvnrPos "möglich begrenztes Moment im Fall eines positiven Lastschlages" SWORD Trq 1 100 -3276.800 3276.700 FORMAT "%8.3" ECU_ADDRESS 0x7F97CC /end MEASUREMENT
/begin MEASUREMENT CoEng_trqNGvnrPosUnLim "Unbegrenztes Ausgangsmoment bei positiven Lastschlag" SWORD Trq 1 100 -3276.800 3276.700 FORMAT "%8.3" ECU_ADDRESS 0x7F97CE /end MEASUREMENT
/begin MEASUREMENT CoEng_trqOffs "Offset auf Begrenzungsmoment, um Arbeitsbereich für ARDsr zu schaffen" SWORD Trq 1 100 -3276.800 3276.700 FORMAT "%8.3" ECU_ADDRESS 0x7F97D0 /end MEASUREMENT
/begin MEASUREMENT CoEng_trqOutRamp_mp "Ausgang der Rampe (Anstiegsbegrenzung" SWORD Trq 1 100 -3276.800 3276.700 FORMAT "%8.3" ECU_ADDRESS 0x9FEA8E /end MEASUREMENT
/begin MEASUREMENT CoEng_trqSetASDUnLim "Sollmoment nach Eingriff Ruckeldämpfer(Störregler) vor 2.Begrenzung" SWORD Trq 1 100 -3276.800 3276.700 FORMAT "%8.3" ECU_ADDRESS 0x7F97D2 /end MEASUREMENT
/begin MEASUREMENT CoEng_trqSlpLim "Begrenzungsmoment für Rauchbegrenzung nach Turboschubbegrenzung" SWORD Trq 1 100 -3276.800 3276.700 FORMAT "%8.3" ECU_ADDRESS 0x7F97D4 /end MEASUREMENT
/begin MEASUREMENT CoEng_trqSlpLimByp_mp "Meßpunkt für Bypass Freischnitt" SWORD Trq 1 100 -3276.800 3276.700 FORMAT "%8.3" ECU_ADDRESS 0x9FEA90 /end MEASUREMENT
/begin MEASUREMENT CoEng_volFlConsAll "Gesamtverbrauchberechnung aus Gesamteinspritzmenge" SLONG FlConsum_ul 1 100 -2147483648.00 2147483647.00 FORMAT "%13.2" ECU_ADDRESS 0x7F9D8C /end MEASUREMENT
/begin MEASUREMENT CoEng_volFlConsAllDT_mp "aktueller Verbrauch in [ul/20ms] für Gesamteinspritzmenge" SLONG FlConsum_ul 1 100 -2147483648.00 2147483647.00 FORMAT "%13.2" ECU_ADDRESS 0x9FE464 /end MEASUREMENT
/begin MEASUREMENT CoEng_volFlConsAllTotDT_mp "aktueller Verbrauch in [ul/20ms] für Gesamteinspritzmenge" SLONG FlConsum_ul_High 1 100 -107374182.400 107374182.350 FORMAT "%13.3" ECU_ADDRESS 0x9FE468 /end MEASUREMENT
/begin MEASUREMENT CoEng_volFlConsAllTot_mp "Gesamter Kraftstoffverbrauch in [ul] für Gesamteinspritzmenge" SLONG FlConsum_ul 1 100 -2147483648.00 2147483647.00 FORMAT "%13.2" ECU_ADDRESS 0x9FE46C /end MEASUREMENT
/begin MEASUREMENT CoEng_volFlConsDspl "Anzeige des Gesamtverbrauchs" SLONG FlConsum_ul 1 100 -2147483648.00 2147483647.00 FORMAT "%13.2" ECU_ADDRESS 0x7F9D90 /end MEASUREMENT
/begin MEASUREMENT CoEng_volFlConsTotDT_mp "aktueller Verbrauch in [ul/20ms]" SLONG FlConsum_ul_High 1 100 -107374182.400 107374182.350 FORMAT "%13.3" ECU_ADDRESS 0x9FE470 /end MEASUREMENT
/begin MEASUREMENT CoEng_volFlConsTot_mp "Verbrauch pro Fahrzyklus in ul" SLONG FlConsum_ul 1 100 -2147483648.00 2147483647.00 FORMAT "%13.2" ECU_ADDRESS 0x9FE474 /end MEASUREMENT
/begin MEASUREMENT ComVar_stDebClaEn "Status der verriegelten Debounce Klassen." UWORD OneToOne 1 100 0.00 65535.00 FORMAT "%8.2" ECU_ADDRESS 0x7F97FE /end MEASUREMENT
/begin MEASUREMENT ComVar_stK2Com "Status der K-Line Kommunikation" UBYTE OneToOne 1 100 0.00 255.0 FORMAT "%5.1" ECU_ADDRESS 0x7F934D /end MEASUREMENT
/begin MEASUREMENT ComVar_swtRemote "Status des Remote Schalters" UBYTE OneToOne 1 100 0.00 255.0 FORMAT "%5.1" ECU_ADDRESS 0x7F934E /end MEASUREMENT
/begin MEASUREMENT ConvCD_ctClutchDfct_mp "Defektzähler von Plausibitätfehler des Kupplungssignals" UWORD OneToOne 1 100 0.00 65535.00 FORMAT "%8.2" ECU_ADDRESS 0x9FEA9E /end MEASUREMENT
/begin MEASUREMENT ConvCD_stClth "Kupplungszustand" UBYTE OneToOne 1 100 0.00 255.0 FORMAT "%5.1" ECU_ADDRESS 0x7F934F /end MEASUREMENT
/begin MEASUREMENT ConvCD_stClth_mp "Messpunkt für Kupplung Status" UBYTE OneToOne 1 100 0.00 255.0 FORMAT "%5.1" ECU_ADDRESS 0x9FFA37 /end MEASUREMENT
/begin MEASUREMENT ConvCD_stClutchRecord "Message zur Kupplungsstatus Wechsel ( 0 --> 1)" UBYTE OneToOne 1 100 0.00 255.0 FORMAT "%5.1" ECU_ADDRESS 0x7F9350 /end MEASUREMENT
/begin MEASUREMENT ConvCD_stDioDebVal "Entprellter Kupplungstatus über DIO signal" UBYTE OneToOne 1 100 0.00 255.0 FORMAT "%5.1" ECU_ADDRESS 0x7F9351 /end MEASUREMENT
/begin MEASUREMENT ConvCD_stIlsDebVal "Entprellter Interlock Status" UBYTE OneToOne 1 100 0.00 255.0 FORMAT "%5.1" ECU_ADDRESS 0x7F9352 /end MEASUREMENT
/begin MEASUREMENT ConvCD_stIlsRawVal "Interlock Rohwert" UBYTE OneToOne 1 100 0.00 255.0 FORMAT "%5.1" ECU_ADDRESS 0x7F9353 /end MEASUREMENT
/begin MEASUREMENT ConvCD_stIntDebVal "Entprellt Kupplung Status zur internen Verwendung" UBYTE OneToOne 1 100 0.00 255.0 FORMAT "%5.1" ECU_ADDRESS 0x7F9354 /end MEASUREMENT
/begin MEASUREMENT ConvCD_stLastDebVal "Letzter Kupplungssignalstatus." UBYTE OneToOne 1 100 0.00 255.0 FORMAT "%5.1" ECU_ADDRESS 0x7F9355 /end MEASUREMENT
/begin MEASUREMENT ConvCD_stLastGear "Gang von den letzten Zyklus [k-1]" SBYTE OneToOne 1 100 -128.0 127.0 FORMAT "%5.1" ECU_ADDRESS 0x7F9356 /end MEASUREMENT
/begin MEASUREMENT ConvCD_stOldGear "Letzte gültigen Gang" SBYTE OneToOne 1 100 -128.0 127.0 FORMAT "%5.1" ECU_ADDRESS 0x7F9357 /end MEASUREMENT
/begin MEASUREMENT ConvCD_stRawVal "Kupplungssignal Rohwert" UBYTE OneToOne 1 100 0.00 255.0 FORMAT "%5.1" ECU_ADDRESS 0x7F9358 /end MEASUREMENT
/begin MEASUREMENT ConvCD_swtIlsDigInPVal "Interlock vorhanden" UBYTE OneToOne 1 100 0.00 255.0 FORMAT "%5.1" ECU_ADDRESS 0x7F9359 /end MEASUREMENT
/begin MEASUREMENT ConvCD_swtSig "Schalter für Kupplungssignalquelle (DIO/CAN)." UBYTE OneToOne 1 100 0.00 255.0 FORMAT "%5.1" ECU_ADDRESS 0x7F935A /end MEASUREMENT
/begin MEASUREMENT Conv_nDiff_mp "Drehzahldifferenz zw. Motor und Getriebe-Eingang" SWORD EngN 1 100 -32768.00 32767.00 FORMAT "%8.2" ECU_ADDRESS 0x9FEA98 /end MEASUREMENT
/begin MEASUREMENT Conv_rTrans "Übertragungsverhältins Momentenwandler (Kupplung)" SWORD TransR 1 100 -327.6800 327.6700 FORMAT "%8.4" ECU_ADDRESS 0x7F9800 /end MEASUREMENT
/begin MEASUREMENT Conv_stClthPrtDisbl_mp "Status der Funktions-Deaktivierung (1=deaktiviert)" UBYTE OneToOne 1 100 0.00 255.0 FORMAT "%5.1" ECU_ADDRESS 0x9FFA34 /end MEASUREMENT
/begin MEASUREMENT Conv_stSlipDet_mp "Status der Schlupferkennung" UBYTE OneToOne 1 100 0.00 255.0 FORMAT "%5.1" ECU_ADDRESS 0x9FFA35 /end MEASUREMENT
/begin MEASUREMENT Conv_stTrqLimActv "Status der Begrenzung (1=Begrenzung aktiv)" UBYTE OneToOne 1 100 0.00 255.0 FORMAT "%5.1" ECU_ADDRESS 0x7F935B /end MEASUREMENT
/begin MEASUREMENT Conv_stTrqLimDem_mp "Status der Begrenzungsanforderung" UBYTE OneToOne 1 100 0.00 255.0 FORMAT "%5.1" ECU_ADDRESS 0x9FFA36 /end MEASUREMENT
/begin MEASUREMENT Conv_trqClthPrtLim "Begrenzungsmoment" SWORD Trq 1 100 -3276.800 3276.700 FORMAT "%8.3" ECU_ADDRESS 0x7F9802 /end MEASUREMENT
/begin MEASUREMENT Conv_trqClthPrtLimRaw_mp "Ausgang der Begrenzungsrampe" SWORD Trq 1 100 -3276.800 3276.700 FORMAT "%8.3" ECU_ADDRESS 0x9FEA9A /end MEASUREMENT
/begin MEASUREMENT Conv_wLossInteg_mp "aktueller Integratorwert" SWORD Energy_J 1 100 -32768.00 32767.00 FORMAT "%8.2" ECU_ADDRESS 0x9FEA9C /end MEASUREMENT
/begin MEASUREMENT COTSCD_tClnt "Kühlmitteltemperatur am Kühleraustritt" SWORD Temp_Cels 1 100 -3549.940 3003.560 FORMAT "%8.3" ECU_ADDRESS 0x7F971C /end MEASUREMENT
/begin MEASUREMENT COTSCD_tClntLin "linearisierter Wert aus HWK vorm Aufruf der Übergangsfunktion" SWORD Temp_Cels 1 100 -3549.940 3003.560 FORMAT "%8.3" ECU_ADDRESS 0x7F971E /end MEASUREMENT
/begin MEASUREMENT COTSCD_uRaw "Rohwert des Senorsignals" SWORD Volt 1 100 -160156.4 160151.5 FORMAT "%8.1" ECU_ADDRESS 0x7F9720 /end MEASUREMENT
/begin MEASUREMENT CoVeh_dnLvl1_mp "Offsetwerte für stufe 1" SWORD EngN 1 100 -32768.00 32767.00 FORMAT "%8.2" ECU_ADDRESS 0x9FEAA0 /end MEASUREMENT
/begin MEASUREMENT CoVeh_dnLvl2_mp "Offsetwerte für stufe 2" SWORD EngN 1 100 -32768.00 32767.00 FORMAT "%8.2" ECU_ADDRESS 0x9FEAA2 /end MEASUREMENT
/begin MEASUREMENT CoVeh_nAcsMax "maximale Drehzahl Nebenaggregate" SWORD EngN 1 100 -32768.00 32767.00 FORMAT "%8.2" ECU_ADDRESS 0x7F97E2 /end MEASUREMENT
/begin MEASUREMENT CoVeh_nAcsMin "minimale Drehzahl Nebenaggregate" SWORD EngN 1 100 -32768.00 32767.00 FORMAT "%8.2" ECU_ADDRESS 0x7F97E4 /end MEASUREMENT
/begin MEASUREMENT CoVeh_nAcsMinRequest "erhöhte Leerlaufsolldrehzahl für Nebenaggregaten" SWORD EngN 1 100 -32768.00 32767.00 FORMAT "%8.2" ECU_ADDRESS 0x7F97E6 /end MEASUREMENT
/begin MEASUREMENT CoVeh_nENGMax_mp "Sollwert für LL-Drehzahlanhebung mit Fahrereinbezug" SWORD EngN 1 100 -32768.00 32767.00 FORMAT "%8.2" ECU_ADDRESS 0x9FEAA4 /end MEASUREMENT
/begin MEASUREMENT CoVeh_nMax "Auftrag maximale Motordrehzahl" SWORD EngN 1 100 -32768.00 32767.00 FORMAT "%8.2" ECU_ADDRESS 0x7F97E8 /end MEASUREMENT
/begin MEASUREMENT CoVeh_nMin "Auftrag minimale Motordrehzahl" SWORD EngN 1 100 -32768.00 32767.00 FORMAT "%8.2" ECU_ADDRESS 0x7F97EA /end MEASUREMENT
/begin MEASUREMENT CoVeh_nRampDes_mp "Sollwert für LL-Drehzahlanhebung über Rampe" SWORD EngN 1 100 -32768.00 32767.00 FORMAT "%8.2" ECU_ADDRESS 0x9FEAA6 /end MEASUREMENT
/begin MEASUREMENT CoVeh_nRgnIdle "LL- Solldrehzahl bei Regenerationsbetrieb." SWORD EngN 1 100 -32768.00 32767.00 FORMAT "%8.2" ECU_ADDRESS 0x7F97EC /end MEASUREMENT
/begin MEASUREMENT CoVeh_nRmpAcsMin "erhöhte Leerlaufsolldrehzahl über Rampe für Nebenaggregate" SWORD EngN 1 100 -32768.00 32767.00 FORMAT "%8.2" ECU_ADDRESS 0x7F97EE /end MEASUREMENT
/begin MEASUREMENT CoVeh_pwrAcsDes "Nebenaggregatleistung Auftrag" SWORD Pwr 1 100 -308831.1 308821.7 FORMAT "%8.1" ECU_ADDRESS 0x7F97F0 /end MEASUREMENT
/begin MEASUREMENT CoVeh_pwrAcsLead "Vorhalt Nebenaggregatleistung Auftrag" SWORD Pwr 1 100 -308831.1 308821.7 FORMAT "%8.1" ECU_ADDRESS 0x7F97F2 /end MEASUREMENT
/begin MEASUREMENT CoVeh_stActSafe_mp "Momentenbegrenzung aus Brettfunktion aktiv" UBYTE OneToOne 1 100 0.00 255.0 FORMAT "%5.1" ECU_ADDRESS 0x9FFA3E /end MEASUREMENT
/begin MEASUREMENT CoVeh_stDem_mp "Status Anforderung Leerlaufdrehzahlanhebung" UBYTE OneToOne 1 100 0.00 255.0 FORMAT "%5.1" ECU_ADDRESS 0x9FFA38 /end MEASUREMENT
/begin MEASUREMENT CoVeh_stInputs_mp "Eingabebedingungen für Statemachine Brettfunktion" UBYTE OneToOne 1 100 0.00 255.0 FORMAT "%5.1" ECU_ADDRESS 0x9FFA3F /end MEASUREMENT
/begin MEASUREMENT CoVeh_stLIInc "Status der Leerlaufanhebung (Stufe1/2)" UBYTE OneToOne 1 100 0.00 255.0 FORMAT "%5.1" ECU_ADDRESS 0x7F934A /end MEASUREMENT
/begin MEASUREMENT CoVeh_stOrd "Randbedingungen für physikalischen Auftrag" UBYTE OneToOne 1 100 0.00 255.0 FORMAT "%5.1" ECU_ADDRESS 0x7F934B /end MEASUREMENT
/begin MEASUREMENT CoVeh_stRampFreeAuto_mp "Status Freigabe Rampe Automatik" UBYTE OneToOne 1 100 0.00 255.0 FORMAT "%5.1" ECU_ADDRESS 0x9FFA39 /end MEASUREMENT
/begin MEASUREMENT CoVeh_stRampFreeManuell_mp "Status Freigabe Rampe Handschaltung" UBYTE OneToOne 1 100 0.00 255.0 FORMAT "%5.1" ECU_ADDRESS 0x9FFA3A /end MEASUREMENT
/begin MEASUREMENT CoVeh_stRampFree_mp "Status Freigabe Rampe" UBYTE OneToOne 1 100 0.00 255.0 FORMAT "%5.1" ECU_ADDRESS 0x9FFA3B /end MEASUREMENT
/begin MEASUREMENT CoVeh_stSelfhold_mp "Meßpunkt für Momentenbegrenzung größer als Schwelle" UBYTE OneToOne 1 100 0.00 255.0 FORMAT "%5.1" ECU_ADDRESS 0x9FFA40 /end MEASUREMENT
/begin MEASUREMENT CoVeh_stState_mp "Status der Brettfunktion" UBYTE OneToOne 1 100 0.00 255.0 FORMAT "%5.1" ECU_ADDRESS 0x9FFA41 /end MEASUREMENT
/begin MEASUREMENT CoVeh_stThres_mp "Meßpunkt für PWG Wert größer als Schwelle" UBYTE OneToOne 1 100 0.00 255.0 FORMAT "%5.1" ECU_ADDRESS 0x9FFA42 /end MEASUREMENT
/begin MEASUREMENT CoVeh_stTrqLimErr "Status der Vortriebsbegrenzung" UBYTE OneToOne 1 100 0.00 255.0 FORMAT "%5.1" ECU_ADDRESS 0x7F934C /end MEASUREMENT
/begin MEASUREMENT CoVeh_swtStep1_mp "Status Anforderung Stufe1" UBYTE OneToOne 1 100 0.00 255.0 FORMAT "%5.1" ECU_ADDRESS 0x9FFA3C /end MEASUREMENT
/begin MEASUREMENT CoVeh_swtStep2_mp "Status Anforderung Stufe2" UBYTE OneToOne 1 100 0.00 255.0 FORMAT "%5.1" ECU_ADDRESS 0x9FFA3D /end MEASUREMENT
/begin MEASUREMENT CoVeh_trqAcs "Momentenanforderung der Nebenaggregate" SWORD Trq 1 100 -3276.800 3276.700 FORMAT "%8.3" ECU_ADDRESS 0x7F97F4 /end MEASUREMENT
/begin MEASUREMENT CoVeh_trqAcsDes "Momentenanforderung Nebenaggregate Wunschwert" SWORD Trq 1 100 -3276.800 3276.700 FORMAT "%8.3" ECU_ADDRESS 0x7F97F6 /end MEASUREMENT
/begin MEASUREMENT CoVeh_trqAcsLead "Momentenanforderung Nebenaggregate Vorhaltewert" SWORD Trq 1 100 -3276.800 3276.700 FORMAT "%8.3" ECU_ADDRESS 0x7F97F8 /end MEASUREMENT
/begin MEASUREMENT CoVeh_trqAcsPerm "Momentenbedarf permanente Nebenaggregate" SWORD Trq 1 100 -3276.800 3276.700 FORMAT "%8.3" ECU_ADDRESS 0x7F97FA /end MEASUREMENT
/begin MEASUREMENT CoVeh_trqAcsTemp "Momentenbedarf zuschaltbare Nebenaggregate" SWORD Trq 1 100 -3276.800 3276.700 FORMAT "%8.3" ECU_ADDRESS 0x7F97FC /end MEASUREMENT
/begin MEASUREMENT CoVeh_trqLimSafe_mp "Momentenbegrenzung aus Brettfunktion" SLONG TrqPrpHigh 1 100 -214748364.800 214748364.700 FORMAT "%13.3" ECU_ADDRESS 0x9FE478 /end MEASUREMENT
/begin MEASUREMENT CoVeh_trqPrpDes "Vortriebsmoment Wunschwert" SLONG TrqPrpHigh 1 100 -214748364.800 214748364.700 FORMAT "%13.3" ECU_ADDRESS 0x7F9DAC /end MEASUREMENT
/begin MEASUREMENT CoVeh_trqPrpDrv "Wunsch Vortriebsmoment ohne ext. Eingriffe" SLONG TrqPrpHigh 1 100 -214748364.800 214748364.700 FORMAT "%13.3" ECU_ADDRESS 0x7F9DB0 /end MEASUREMENT
/begin MEASUREMENT CoVeh_trqPrpLead "Vortriebsmoment Vorhaltewert" SLONG TrqPrpHigh 1 100 -214748364.800 214748364.700 FORMAT "%13.3" ECU_ADDRESS 0x7F9DB4 /end MEASUREMENT
/begin MEASUREMENT CoVeh_trqPrpLimErr "Begrenzungsmoment für Vortrieb im Falle eines Systemfehlers" SLONG TrqPrpHigh 1 100 -214748364.800 214748364.700 FORMAT "%13.3" ECU_ADDRESS 0x7F9DB8 /end MEASUREMENT
/begin MEASUREMENT CoVeh_trqPrpLimErrAct_mp "Meßpunkt für eigentliches Antriebsbegrenzungsmoment im Falle eines Systemfehlers" SLONG TrqPrpHigh 1 100 -214748364.800 214748364.700 FORMAT "%13.3" ECU_ADDRESS 0x9FE47C /end MEASUREMENT
/begin MEASUREMENT CoVeh_trqPrpPCtl "Vorhalt Vortriebsmoment ohne ext. Eingriffe" SLONG TrqPrpHigh 1 100 -214748364.800 214748364.700 FORMAT "%13.3" ECU_ADDRESS 0x7F9DBC /end MEASUREMENT
/begin MEASUREMENT CoVM_amAKT_mp "Integral des Drehmomenteingriffes MSR (Drehimpuls)" UWORD TrqDT 1 100 0.00 65535.00 FORMAT "%8.2" ECU_ADDRESS 0x9FEAA8 /end MEASUREMENT
/begin MEASUREMENT CoVM_stActDem "Status aktiv wirkender Fahrdynamikeingriffe" UBYTE OneToOne 1 100 0.00 255.0 FORMAT "%5.1" ECU_ADDRESS 0x7F9345 /end MEASUREMENT
/begin MEASUREMENT CoVM_stDCS "Momenteneingriff durch DCS" SWORD OneToOne 1 100 -32768.00 32767.00 FORMAT "%8.2" ECU_ADDRESS 0x7F97D6 /end MEASUREMENT
/begin MEASUREMENT CoVM_stDemCheck "Steuerbits der Abschaltsteuerung der Fahrdynamikeingriffe" UBYTE OneToOne 1 100 0.00 255.0 FORMAT "%5.1" ECU_ADDRESS 0x7F9346 /end MEASUREMENT
/begin MEASUREMENT CoVM_stOrd "Randbedingungen für physikalischen Auftrag" UBYTE OneToOne 1 100 0.00 255.0 FORMAT "%5.1" ECU_ADDRESS 0x7F9348 /end MEASUREMENT
/begin MEASUREMENT CoVM_stTCS "Momenteneingriff durch TCS" SWORD OneToOne 1 100 -32768.00 32767.00 FORMAT "%8.2" ECU_ADDRESS 0x7F97DA /end MEASUREMENT
/begin MEASUREMENT CoVM_swtSlipCtl "Fahrdynamik-Konfiguration (0: ASR aus, MSR aus; 1: ASR an, MSR aus;  2: ASR aus, MSR an;  3: ASR an, MSR an)" UBYTE OneToOne 1 100 0.00 255.0 FORMAT "%5.1" ECU_ADDRESS 0x7F9349 /end MEASUREMENT
/begin MEASUREMENT CoVM_trqDec "Momenteneingriff von ASR" SLONG TrqPrpHigh 1 100 -214748364.800 214748364.700 FORMAT "%13.3" ECU_ADDRESS 0x7F9D94 /end MEASUREMENT
/begin MEASUREMENT CoVM_trqDecDfl_mp "Abschaltmoment ASR" SLONG TrqPrpHigh 1 100 -214748364.800 214748364.700 FORMAT "%13.3" ECU_ADDRESS 0x9FE488 /end MEASUREMENT
/begin MEASUREMENT CoVM_trqDesIncMax_mp "Messpunkt des Maximumwertes zwischen PrpBrk_trqDes & CoVM_trqInc" SLONG TrqPrpHigh 1 100 -214748364.800 214748364.700 FORMAT "%13.3" ECU_ADDRESS 0x9FE480 /end MEASUREMENT
/begin MEASUREMENT CoVM_trqGearbxMax "Momentbegrenzung reduzierender Getriebeeingriff" SWORD Trq 1 100 -3276.800 3276.700 FORMAT "%8.3" ECU_ADDRESS 0x7F97DE /end MEASUREMENT
/begin MEASUREMENT CoVM_trqGearbxMin "Momentbegrenzung erhöhender Getriebeeingriff" SWORD Trq 1 100 -3276.800 3276.700 FORMAT "%8.3" ECU_ADDRESS 0x7F97E0 /end MEASUREMENT
/begin MEASUREMENT CoVM_trqInc "Momenteneingriff von MSR" SLONG TrqPrpHigh 1 100 -214748364.800 214748364.700 FORMAT "%13.3" ECU_ADDRESS 0x7F9D98 /end MEASUREMENT
/begin MEASUREMENT CoVM_trqIncDfl_mp "Abschaltmoment MSR" SLONG TrqPrpHigh 1 100 -214748364.800 214748364.700 FORMAT "%13.3" ECU_ADDRESS 0x9FE48C /end MEASUREMENT
/begin MEASUREMENT CoVM_trqLeadIncMax_mp "Messpunkt des Maximumwertes zwischen PrpBrk_trqLead & CoVM_trqInc" SLONG TrqPrpHigh 1 100 -214748364.800 214748364.700 FORMAT "%13.3" ECU_ADDRESS 0x9FE484 /end MEASUREMENT
/begin MEASUREMENT CoVM_trqPrpDes "Wunsch Vortriebsmoment" SLONG TrqPrpHigh 1 100 -214748364.800 214748364.700 FORMAT "%13.3" ECU_ADDRESS 0x7F9D9C /end MEASUREMENT
/begin MEASUREMENT CoVM_trqPrpDrv "Wunsch Vortriebsmoment ohne ext. Eingriffe" SLONG TrqPrpHigh 1 100 -214748364.800 214748364.700 FORMAT "%13.3" ECU_ADDRESS 0x7F9DA0 /end MEASUREMENT
/begin MEASUREMENT CoVM_trqPrpLead "Vorhalt Vortriebsmoment" SLONG TrqPrpHigh 1 100 -214748364.800 214748364.700 FORMAT "%13.3" ECU_ADDRESS 0x7F9DA4 /end MEASUREMENT
/begin MEASUREMENT CoVM_trqPrpPCtl "Vorhalt Vortriebsmoment ohne ext. Eingriffe" SLONG TrqPrpHigh 1 100 -214748364.800 214748364.700 FORMAT "%13.3" ECU_ADDRESS 0x7F9DA8 /end MEASUREMENT
/begin MEASUREMENT CrCCD_st6Pos "6-Positionen-Bedienteil wird verwendet" UBYTE OneToOne 1 100 0.00 255.0 FORMAT "%5.1" ECU_ADDRESS 0x7F935C /end MEASUREMENT
/begin MEASUREMENT CrCCD_stCrErr "Fehlerresultat des Bedienteils" UBYTE OneToOne 1 100 0.00 255.0 FORMAT "%5.1" ECU_ADDRESS 0x7F935D /end MEASUREMENT
/begin MEASUREMENT CrCCD_stCrPan "Resultat der Bedienteilauswertung" UWORD OneToOne 1 100 0.00 65535.00 FORMAT "%8.2" ECU_ADDRESS 0x7F9804 /end MEASUREMENT
/begin MEASUREMENT CrCCD_stFourPosPressed_mp "Meßpunkt ob eine Taste des Vierpositionsbedienteils gedrückt ist" UBYTE OneToOne 1 100 0.00 255.0 FORMAT "%5.1" ECU_ADDRESS 0x9FFA43 /end MEASUREMENT
/begin MEASUREMENT CrCCD_stKey "Rückgabewert ""Taste gedrückt""" UBYTE OneToOne 1 100 0.00 255.0 FORMAT "%5.1" ECU_ADDRESS 0x7F935E /end MEASUREMENT
/begin MEASUREMENT CrCCD_stKeyByp_mp "Bypass für CrCCD_stKey" UBYTE OneToOne 1 100 0.00 255.0 FORMAT "%5.1" ECU_ADDRESS 0x9FFA44 /end MEASUREMENT
/begin MEASUREMENT CrCCD_stKeySig "Tasten der Fahrgeschwindigkeitsregelung" UBYTE OneToOne 1 100 0.00 255.0 FORMAT "%5.1" ECU_ADDRESS 0x7F935F /end MEASUREMENT
/begin MEASUREMENT CrCCD_stMainSwitchOff "Status des Ausschalters" UBYTE OneToOne 1 100 0.00 255.0 FORMAT "%5.1" ECU_ADDRESS 0x7F9360 /end MEASUREMENT
/begin MEASUREMENT CrCCD_stPanelErr "Status der Vebaukodierung" UBYTE OneToOne 1 100 0.00 255.0 FORMAT "%5.1" ECU_ADDRESS 0x7F9361 /end MEASUREMENT
/begin MEASUREMENT CrCCD_stPanelVer "Art der Verbauvariante des Fahrgeschwindigkeitsreglers" UBYTE OneToOne 1 100 0.00 255.0 FORMAT "%5.1" ECU_ADDRESS 0x7F9362 /end MEASUREMENT
/begin MEASUREMENT CrCCD_stPlsPanErr_mp "Status des Pl.Fehlers" UWORD OneToOne 1 100 0.00 65535.00 FORMAT "%8.2" ECU_ADDRESS 0x9FEAAA /end MEASUREMENT
/begin MEASUREMENT CrCCD_stReadyOff_mp "Status der Bedingungen für Abschaltung" UBYTE OneToOne 1 100 0.00 255.0 FORMAT "%5.1" ECU_ADDRESS 0x9FFA45 /end MEASUREMENT
/begin MEASUREMENT CrCCD_stReadyOn_mp "Status der Bedingungen für Einschalten" UBYTE OneToOne 1 100 0.00 255.0 FORMAT "%5.1" ECU_ADDRESS 0x9FFA46 /end MEASUREMENT
/begin MEASUREMENT CrCCD_stSpdLim "Taste Speed Limiter am Bedienteil aktiv" UBYTE OneToOne 1 100 0.00 255.0 FORMAT "%5.1" ECU_ADDRESS 0x7F9363 /end MEASUREMENT
/begin MEASUREMENT CrCtl_aAct "aktuelle Sollbeschleunigung" SWORD Acc 1 100 -32.76800 32.76700 FORMAT "%8.5" ECU_ADDRESS 0x7F9806 /end MEASUREMENT
/begin MEASUREMENT CrCtl_aDecDemVal "Sollverzögerungswert" SWORD Acc 1 100 -32.76800 32.76700 FORMAT "%8.5" ECU_ADDRESS 0x7F9364 /end MEASUREMENT
/begin MEASUREMENT CrCtl_aDemLim "Demand value from GRA(+)" SWORD Acc 1 100 -32.76800 32.76700 FORMAT "%8.5" ECU_ADDRESS 0x7F9808 /end MEASUREMENT
/begin MEASUREMENT CrCtl_aDemLimPreFilt "Soll-Beschleunigung vor PT1-Filter" SWORD bfzg_sw_q4p239Em4 1 100 -13.8903552 13.8899313 ECU_ADDRESS 0x7FD584 /end MEASUREMENT
/begin MEASUREMENT CrCtl_aDemLimRmp "Begrenzte Soll-Beschleunigung Rampe" SWORD bfzg_sw_q4p239Em4 1 100 -13.8903552 13.8899313 ECU_ADDRESS 0x7FD586 /end MEASUREMENT
/begin MEASUREMENT CrCtl_aDemLim_CCAdp "begrenzte Soll-Beschleunigung CrCtl-Adapter" SWORD bfzg_sw_q4p239Em4 1 100 -13.8903552 13.8899313 ECU_ADDRESS 0x7FD588 /end MEASUREMENT
/begin MEASUREMENT CrCtl_aDemUnlim "Unbegrenzte Beschleunigungsanforderung der GRA" SWORD bfzg_sw_q4p239Em4 1 100 -13.8903552 13.8899313 ECU_ADDRESS 0x7FD58A /end MEASUREMENT
/begin MEASUREMENT CrCtl_aTransAbs "Querbeschleunigung" UBYTE acc_q0p1 1 100 0.00 25.50 FORMAT "%5.2" ECU_ADDRESS 0x7FD5A8 /end MEASUREMENT
/begin MEASUREMENT CrCtl_aTransFlt "Gefilterte Fahrzeugquerbeschleunigung für CrCtl" SBYTE acc_q0p1 1 100 -12.80 12.70 FORMAT "%5.2" ECU_ADDRESS 0x7FD55C /end MEASUREMENT
/begin MEASUREMENT CrCtl_dvSetPointNeg "Delta-v neg. Richtung für Rampe GRA-Zielgeschwindigkeit" UWORD vfzg_q0p01 1 100 0.00 655.3500 FORMAT "%8.4" ECU_ADDRESS 0x7FD58C /end MEASUREMENT
/begin MEASUREMENT CrCtl_dvSetPointPos "Delta-v pos. Richtung für Rampe GRA-Zielgeschwindigkeit" UWORD vfzg_q0p01 1 100 0.00 655.3500 FORMAT "%8.4" ECU_ADDRESS 0x7FD58E /end MEASUREMENT
/begin MEASUREMENT CrCtl_facADemCor "Korrekturfaktor für CrCtl- Beschleunigungsanforderung" UWORD fak_q0p0009766 1 100 0.00 63.99902 FORMAT "%8.5" ECU_ADDRESS 0x7FD546 /end MEASUREMENT
/begin MEASUREMENT CrCtl_facVScroll "Faktor für Geschwindigkeit bei TipUp/TipDown bei Scrollen" UBYTE fak_q0p0625 1 100 0.06250 15.94 FORMAT "%5.2" ECU_ADDRESS 0x7FD5D4 /end MEASUREMENT
/begin MEASUREMENT CrCtl_lastState "Letzter GRA-Zustand" UBYTE dez 1 100 0.00 255.0 FORMAT "%5.1" ECU_ADDRESS 0x7FD5A9 /end MEASUREMENT
/begin MEASUREMENT CrCtl_phiRoadFlt "Gefilterte Fahrbahnsteigung für CrCtl" SWORD fak_sw_b2 1 100 -2.000000 1.999939 FORMAT "%8.6" ECU_ADDRESS 0x7FD548 /end MEASUREMENT
/begin MEASUREMENT CrCtl_rTransDTlok "Gesamtübersetzungsverhältnis (16Bit)" SWORD fak_q0p02 1 100 -655.3600 655.3400 FORMAT "%8.4" ECU_ADDRESS 0x7FD590 /end MEASUREMENT
/begin MEASUREMENT CrCtl_rVnBeg "Verhältnis Geschwindigkeit zu Drehzahl bei Aktivierung FGR" UWORD qvn_q1Em5 1 100 0.00 0.6553500 FORMAT "%9.7" ECU_ADDRESS 0x7FD592 /end MEASUREMENT
/begin MEASUREMENT CrCtl_stActive "Flag aktiver FGR" UBYTE OneToOne 1 100 0.00 255.0 FORMAT "%5.1" ECU_ADDRESS 0x7F9366 /end MEASUREMENT
/begin MEASUREMENT CrCtl_stAStateMch "aktueller Arbeitsstatus des Zustandsautomaten" UBYTE OneToOne 1 100 0.00 255.0 FORMAT "%5.1" ECU_ADDRESS 0x7F9365 /end MEASUREMENT
/begin MEASUREMENT CrCtl_stBlocking "Aktivierung Fahrgeschwindigkeitsregelung gesperrt" UBYTE OneToOne 1 100 0.00 255.0 FORMAT "%5.1" ECU_ADDRESS 0x7F9368 /end MEASUREMENT
/begin MEASUREMENT CrCtl_stBlockingByp_mp "Meßpunkt für Bypass" UBYTE OneToOne 1 100 0.00 255.0 FORMAT "%5.1" ECU_ADDRESS 0x9FFA47 /end MEASUREMENT
/begin MEASUREMENT CrCtl_stBRKShutOffIrevPlus "Zustand der irrev. Abschaltungen BRK/CrCtl+" UWORD dez 1 100 0.00 65535.00 FORMAT "%8.2" ECU_ADDRESS 0x7F980A /end MEASUREMENT
/begin MEASUREMENT CrCtl_stBRKShutOffRevPlus "Zustand der rev. Abschaltungen BRK/CrCtl+" UBYTE dez 1 100 0.00 255.0 FORMAT "%5.1" ECU_ADDRESS 0x7F9367 /end MEASUREMENT
/begin MEASUREMENT CrCtl_stCCSel "Status GRA/ACC Codierung" UBYTE default 1 100 0.00 255.0 FORMAT "%5.1" ECU_ADDRESS 0x7FD508 /end MEASUREMENT
/begin MEASUREMENT CrCtl_stCrCtl "Status of GRA(+)" UBYTE OneToOne 1 100 0.00 255.0 FORMAT "%5.1" ECU_ADDRESS 0x7F9369 /end MEASUREMENT
/begin MEASUREMENT CrCtl_stCrCtlConf "Aktuelle Konfigurationseinstellung der GRA" UBYTE OneToOne 1 100 0.00 255.0 FORMAT "%5.1" ECU_ADDRESS 0x7F936A /end MEASUREMENT
/begin MEASUREMENT CrCtl_stCrCtlConf_CCAdp "Aktuelle Konfigurationseinstellung der GRA" UBYTE dez 1 100 0.00 255.0 FORMAT "%5.1" ECU_ADDRESS 0x7FD55D /end MEASUREMENT
/begin MEASUREMENT CrCtl_stCrCtlMode "Bitcodierte variante der GRA : GRA mit Bremseingriff" UBYTE OneToOne 1 100 0.00 255.0 FORMAT "%5.1" ECU_ADDRESS 0x7F936B /end MEASUREMENT
/begin MEASUREMENT CrCtl_stCrCtl_CCAdp "Status GRA" UBYTE dez 1 100 0.00 255.0 FORMAT "%5.1" ECU_ADDRESS 0x7FD5AA /end MEASUREMENT
/begin MEASUREMENT CrCtl_stDecDemLocked "Verbot des GRA-Bremseingriffs" UBYTE default 1 100 0.00 255.0 FORMAT "%5.1" ECU_ADDRESS 0x7FD5CC /end MEASUREMENT
/begin MEASUREMENT CrCtl_stDecDemRls "Bit Freigabe Verzögerungsanforderung" UBYTE OneToOne 1 100 0.00 255.0 FORMAT "%5.1" ECU_ADDRESS 0x7F936C /end MEASUREMENT
/begin MEASUREMENT CrCtl_stDsplHighLine "Status ""High-Line""-Kombi erkannt" UBYTE OneToOne 1 100 0.00 255.0 FORMAT "%5.1" ECU_ADDRESS 0x7F936D /end MEASUREMENT
/begin MEASUREMENT CrCtl_stDsplHighLine_CCAdp "Status ""High-Line""-Kombi erkannt" UBYTE default 1 100 0.00 255.0 FORMAT "%5.1" ECU_ADDRESS 0x7FD538 /end MEASUREMENT
/begin MEASUREMENT CrCtl_stErrHighLine "Fehler in Erkennung ""High-Line"" Kombi" UBYTE default 1 100 0.00 255.0 FORMAT "%5.1" ECU_ADDRESS 0x7FD539 /end MEASUREMENT
/begin MEASUREMENT CrCtl_stESPRls "ESP Funktionszustand in ACC1 message" UBYTE OneToOne 1 100 0.00 255.0 FORMAT "%5.1" ECU_ADDRESS 0x7F936E /end MEASUREMENT
/begin MEASUREMENT CrCtl_stGRAPlusFF "Status irreversible GRA+ Abschaltbedingungen (nach Maskierung)" UBYTE default 1 100 0.00 255.0 FORMAT "%5.1" ECU_ADDRESS 0x7FD5CD /end MEASUREMENT
/begin MEASUREMENT CrCtl_stGRAPlusRevFF "Status reversible GRA+ Abschaltbedingungen (nach Maskierung)" UBYTE default 1 100 0.00 255.0 FORMAT "%5.1" ECU_ADDRESS 0x7FD5CE /end MEASUREMENT
/begin MEASUREMENT CrCtl_stHighLineEna "Statuf für Freigabe High-Line" UBYTE default 1 100 0.00 255.0 FORMAT "%5.1" ECU_ADDRESS 0x7FD53A /end MEASUREMENT
/begin MEASUREMENT CrCtl_stKeyStateSig "Tasten und Zustand der Fahrgeschwindigkeitsregelung" UBYTE OneToOne 1 100 0.00 255.0 FORMAT "%5.1" ECU_ADDRESS 0x7F936F /end MEASUREMENT
/begin MEASUREMENT CrCtl_stKeyStateSigByp_mp "Meßpunkt für Bypass" UBYTE OneToOne 1 100 0.00 255.0 FORMAT "%5.1" ECU_ADDRESS 0x9FFA48 /end MEASUREMENT
/begin MEASUREMENT CrCtl_stLevelCRUISE "Aktueller Unterzustand des GRA-Zustandes Cruise" UBYTE dez 1 100 0.00 255.0 FORMAT "%5.1" ECU_ADDRESS 0x7FD5AB /end MEASUREMENT
/begin MEASUREMENT CrCtl_stLevelHOLD "Aktueller Unterzustand des GRA-Zustandes Hold" UBYTE dez 1 100 0.00 255.0 FORMAT "%5.1" ECU_ADDRESS 0x7FD5AC /end MEASUREMENT
/begin MEASUREMENT CrCtl_stLevelMain "Aktueller Hauptzustand der GRA" UBYTE dez 1 100 0.00 255.0 FORMAT "%5.1" ECU_ADDRESS 0x7FD5AD /end MEASUREMENT
/begin MEASUREMENT CrCtl_stLevelON "Aktueller Unterzustand des GRA-Zustandes MainSwitchOn" UBYTE dez 1 100 0.00 255.0 FORMAT "%5.1" ECU_ADDRESS 0x7FD5AE /end MEASUREMENT
/begin MEASUREMENT CrCtl_stLevelOvrd "Aktueller Unterzustand des GRA-Zustandes Override" UBYTE dez 1 100 0.00 255.0 FORMAT "%5.1" ECU_ADDRESS 0x7FD5AF /end MEASUREMENT
/begin MEASUREMENT CrCtl_stNoSetPoint "Bedingung Aktuell keine GRA-Zielgeschwindigkeit gespeichert" UBYTE default 1 100 0.00 255.0 FORMAT "%5.1" ECU_ADDRESS 0x7FD53B /end MEASUREMENT
/begin MEASUREMENT CrCtl_stOpFunc "Arbeitsstatus der Fahrgeschwindigkeitsregelung" UBYTE OneToOne 1 100 0.00 255.0 FORMAT "%5.1" ECU_ADDRESS 0x7F9370 /end MEASUREMENT
/begin MEASUREMENT CrCtl_stOvrRun "Status der CrCtl Schuberkennung (0: kein Schub, 1: Schub)" UBYTE OneToOne 1 100 0.00 255.0 FORMAT "%5.1" ECU_ADDRESS 0x7F9371 /end MEASUREMENT
/begin MEASUREMENT CrCtl_stOvrRunByp_mp "Meßpunkt für Bypass" UBYTE OneToOne 1 100 0.00 255.0 FORMAT "%5.1" ECU_ADDRESS 0x9FFA49 /end MEASUREMENT
/begin MEASUREMENT CrCtl_stOvrRunCut "Unterdrückung der Schubabschaltung" UBYTE OneToOne 1 100 0.00 255.0 FORMAT "%5.1" ECU_ADDRESS 0x7F9372 /end MEASUREMENT
/begin MEASUREMENT CrCtl_stOvrRunCut_CCAdp "Verhindern Schubabschaltung aus der GRA" UBYTE default 1 100 0.00 255.0 FORMAT "%5.1" ECU_ADDRESS 0x7FD580 /end MEASUREMENT
/begin MEASUREMENT CrCtl_stRelSet "Setzen einer neuen Zielgeschw. erlaubt" UBYTE default 1 100 0.00 255.0 FORMAT "%5.1" ECU_ADDRESS 0x7FD581 /end MEASUREMENT
/begin MEASUREMENT CrCtl_stScrollTip "Status Tip- Auslösung bei Scrollen" UBYTE default 1 100 0.00 255.0 FORMAT "%5.1" ECU_ADDRESS 0x7FD5CF /end MEASUREMENT
/begin MEASUREMENT CrCtl_stShutOff "Abschaltbedingungen für Anzeige im Messwerteblock" UBYTE OneToOne 1 100 0.00 255.0 FORMAT "%5.1" ECU_ADDRESS 0x7F9373 /end MEASUREMENT
/begin MEASUREMENT CrCtl_stShutOffirev "Bitleiste der irreversiblen Abschaltbedingungen" UBYTE dez 1 100 0.00 255.0 FORMAT "%5.1" ECU_ADDRESS 0x7FD514 /end MEASUREMENT
/begin MEASUREMENT CrCtl_stShutOffIrevMasked "Status maskierte irreversible Abschaltbedingungen für GRA" UBYTE dez 1 100 0.00 255.0 FORMAT "%5.1" ECU_ADDRESS 0x7FD515 /end MEASUREMENT
/begin MEASUREMENT CrCtl_stShutOffIrevPlus "Status irreversible Abschaltbedingungen für GRA+" UBYTE dez 1 100 0.00 255.0 FORMAT "%5.1" ECU_ADDRESS 0x7F9374 /end MEASUREMENT
/begin MEASUREMENT CrCtl_stShutOffirevSig "Bitposition der irreversiblen Abschaltfehler" UBYTE OneToOne 1 100 0.00 255.0 FORMAT "%5.1" ECU_ADDRESS 0x7F9375 /end MEASUREMENT
/begin MEASUREMENT CrCtl_stShutOffirevSig_CCAdp "Status letzte aktive irreversible Abschaltbedingungen für GRA (Bitposition)" UBYTE dez 1 100 0.00 255.0 FORMAT "%5.1" ECU_ADDRESS 0x7FD516 /end MEASUREMENT
/begin MEASUREMENT CrCtl_stShutOffrev "Bitleiste der reversiblen Abschaltbedingungen" ULONG dez 1 100 0.00 4294967295.00 FORMAT "%13.2" ECU_ADDRESS 0x7FD50C /end MEASUREMENT
/begin MEASUREMENT CrCtl_stShutOffRevMasked "Status maskierte reversible Abschaltbedingungen für GRA" ULONG dez 1 100 0.00 4294967295.00 FORMAT "%13.2" ECU_ADDRESS 0x7FD510 /end MEASUREMENT
/begin MEASUREMENT CrCtl_stShutOffrevSig "Bitposition der reversiblen Abschaltfehler" UBYTE OneToOne 1 100 0.00 255.0 FORMAT "%5.1" ECU_ADDRESS 0x7F9376 /end MEASUREMENT
/begin MEASUREMENT CrCtl_stShutOffrevSig_CCAdp "Status letzte aktive reversible Abschaltbedingungen für GRA (Bitposition)" UBYTE dez 1 100 0.00 255.0 FORMAT "%5.1" ECU_ADDRESS 0x7FD517 /end MEASUREMENT
/begin MEASUREMENT CrCtl_stSpdWin1 "Bedingung Geschwindigkeitsfenster 1 für GRA" UBYTE default 1 100 0.00 255.0 FORMAT "%5.1" ECU_ADDRESS 0x7FD53C /end MEASUREMENT
/begin MEASUREMENT CrCtl_stSpdWin2 "Bedingung Geschwindigkeitsfenster 2 für GRA" UBYTE default 1 100 0.00 255.0 FORMAT "%5.1" ECU_ADDRESS 0x7FD53D /end MEASUREMENT
/begin MEASUREMENT CrCtl_stSpdWin3 "Bedingung Geschwindigkeitsfenster 3 für GRA" UBYTE default 1 100 0.00 255.0 FORMAT "%5.1" ECU_ADDRESS 0x7FD53E /end MEASUREMENT
/begin MEASUREMENT CrCtl_stSpdWin4 "Bedingung Geschwindigkeitsfenster 4 für GRA" UBYTE default 1 100 0.00 255.0 FORMAT "%5.1" ECU_ADDRESS 0x7FD53F /end MEASUREMENT
/begin MEASUREMENT CrCtl_stSpdWin5 "Bedingung Geschwindigkeitsfenster 5 für GRA" UBYTE default 1 100 0.00 255.0 FORMAT "%5.1" ECU_ADDRESS 0x7FD540 /end MEASUREMENT
/begin MEASUREMENT CrCtl_stSpdWin6 "Bedingung Geschwindigkeitsfenster 6 für GRA" UBYTE default 1 100 0.00 255.0 FORMAT "%5.1" ECU_ADDRESS 0x7FD541 /end MEASUREMENT
/begin MEASUREMENT CrCtl_stSpdWin7 "Bedingung Geschwindigkeitsfenster 7 für GRA" UBYTE default 1 100 0.00 255.0 FORMAT "%5.1" ECU_ADDRESS 0x7FD542 /end MEASUREMENT
/begin MEASUREMENT CrCtl_stSpdWin8 "Bedingung Geschwindigkeitsfenster 8 für GRA" UBYTE default 1 100 0.00 255.0 FORMAT "%5.1" ECU_ADDRESS 0x7FD543 /end MEASUREMENT
/begin MEASUREMENT CrCtl_stStateMch "aktueller Arbeitsstatus des Zustandsautomaten" ULONG OneToOne 1 100 0.00 4294967295.00 FORMAT "%13.2" ECU_ADDRESS 0x7F9DC0 /end MEASUREMENT
/begin MEASUREMENT CrCtl_stStateMch_CCAdp "Aktueller Status des GRA-Zustandsautomaten" UBYTE dez 1 100 0.00 255.0 FORMAT "%5.1" ECU_ADDRESS 0x7FD5B0 /end MEASUREMENT
/begin MEASUREMENT CrCtl_stStateP "Status der Cruise Control Plus" UBYTE OneToOne 1 100 0.00 255.0 FORMAT "%5.1" ECU_ADDRESS 0x7F9377 /end MEASUREMENT
/begin MEASUREMENT CrCtl_stSwitchSig "Status der Schalterstellungen 2 für Diagnose" UBYTE OneToOne 1 100 0.00 255.0 FORMAT "%5.1" ECU_ADDRESS 0x7F9378 /end MEASUREMENT
/begin MEASUREMENT CrCtl_stTrans "Aktuelle GRA-Zustands¿ubergangsbedingungen" ULONG dez 1 100 0.00 4294967295.00 FORMAT "%13.2" ECU_ADDRESS 0x7FD5D0 /end MEASUREMENT
/begin MEASUREMENT CrCtl_stTrqNegLim "Temporäres Verbot der Bremse über ADR-Schub" UBYTE default 1 100 0.00 255.0 FORMAT "%5.1" ECU_ADDRESS 0x7FD582 /end MEASUREMENT
/begin MEASUREMENT CrCtl_stVDispNotPlaus_CCAdp "Angezeigte Geschwindigkeit nicht plausibel" UBYTE default 1 100 0.00 255.0 FORMAT "%5.1" ECU_ADDRESS 0x7FD544 /end MEASUREMENT
/begin MEASUREMENT CrCtl_swtAAG "Anhängersteuergerät (AAG) verbaut oder nicht" UBYTE OneToOne 1 100 0.00 255.0 FORMAT "%5.1" ECU_ADDRESS 0x7F9379 /end MEASUREMENT
/begin MEASUREMENT CrCtl_tiSwtOffRmp "Rampenzeit für die Rampe beim Erreichen des States INACTIVE im Falle CrCtl oder CrCtl+ ist selektiert" UWORD Time_s 1 100 0.00 655.3500 FORMAT "%8.4" ECU_ADDRESS 0x7F980C /end MEASUREMENT
/begin MEASUREMENT CrCtl_tiSwtOffRmp_CCAdp "Zeit für GRA-Abschaltrampe" UBYTE t20msxs_ub_b5p1 1 100 0.00 5.100 FORMAT "%5.3" ECU_ADDRESS 0x7FD5B1 /end MEASUREMENT
/begin MEASUREMENT CrCtl_trqDes "Momentenanforderung FGR" SLONG TrqPrpHigh 1 100 -214748364.800 214748364.700 FORMAT "%13.3" ECU_ADDRESS 0x7F9DC4 /end MEASUREMENT
/begin MEASUREMENT CrCtl_trqDesByp_mp "Meßpunkt für Bypass" SLONG TrqPrpHigh 1 100 -214748364.800 214748364.700 FORMAT "%13.3" ECU_ADDRESS 0x9FE490 /end MEASUREMENT
/begin MEASUREMENT CrCtl_trqLead "Vorhaltmoment des FGR" SLONG TrqPrpHigh 1 100 -214748364.800 214748364.700 FORMAT "%13.3" ECU_ADDRESS 0x7F9DC8 /end MEASUREMENT
/begin MEASUREMENT CrCtl_trqLeadByp_mp "Meßpunkt für Bypass" SLONG TrqPrpHigh 1 100 -214748364.800 214748364.700 FORMAT "%13.3" ECU_ADDRESS 0x9FE494 /end MEASUREMENT
/begin MEASUREMENT CrCtl_trqLimAct "aktuelle Momentenbegrenzung für die Fahrgeschwindigkeitsregelung" SLONG TrqPrpHigh 1 100 -214748364.800 214748364.700 FORMAT "%13.3" ECU_ADDRESS 0x7F9DCC /end MEASUREMENT
/begin MEASUREMENT CrCtl_vAlwMax "Obere Grenze für FGR-Sollgeschwindigkeit" UWORD vfzg_q0p01 1 100 0.00 655.3500 FORMAT "%8.4" ECU_ADDRESS 0x7FD54A /end MEASUREMENT
/begin MEASUREMENT CrCtl_vAlwMaxAus "obere Abschaltschwelle inklusive Offset" UWORD vfzg_q0p01 1 100 0.00 655.3500 FORMAT "%8.4" ECU_ADDRESS 0x7FD54C /end MEASUREMENT
/begin MEASUREMENT CrCtl_vAlwMin "min. mögliche Setzgeschwindigkeit" UWORD vfzg_q0p01 1 100 0.00 655.3500 FORMAT "%8.4" ECU_ADDRESS 0x7FD54E /end MEASUREMENT
/begin MEASUREMENT CrCtl_vAlwMinAus "untere Abschaltschwelle inklusive Offset" UWORD vfzg_q0p01 1 100 0.00 655.3500 FORMAT "%8.4" ECU_ADDRESS 0x7FD550 /end MEASUREMENT
/begin MEASUREMENT CrCtl_vCrCtl "Aktuelle Fahrzeuggeschwindigkeit für GRA" UWORD vfzg_q0p01 1 100 0.00 655.3500 FORMAT "%8.4" ECU_ADDRESS 0x7FD552 /end MEASUREMENT
/begin MEASUREMENT CrCtl_vCrCtl_sint "Geschwindigkeit für GRA" SWORD vfzg_q0p01 1 100 -327.6800 327.6700 FORMAT "%8.4" ECU_ADDRESS 0x7FD554 /end MEASUREMENT
/begin MEASUREMENT CrCtl_vCtlPKp "P-Reglerparameter für GRA im Zustand Cruise/Hold" UBYTE fak_q0p005 1 100 0.00 1.275 FORMAT "%5.3" ECU_ADDRESS 0x7FD5B2 /end MEASUREMENT
/begin MEASUREMENT CrCtl_vDev "Aktuelle Regelabweichung GRA" SWORD vfzg_q0p01 1 100 -327.6800 327.6700 FORMAT "%8.4" ECU_ADDRESS 0x7FD594 /end MEASUREMENT
/begin MEASUREMENT CrCtl_vDevAbs "Betrag der aktuellen Regelabweichung GRA" UWORD vfzg_q0p01 1 100 0.00 655.3500 FORMAT "%8.4" ECU_ADDRESS 0x7FD596 /end MEASUREMENT
/begin MEASUREMENT CrCtl_vDevOvrd "Aktuelle Regelabweichung GRA im Zustand Override" SWORD vfzg_q0p01 1 100 -327.6600 327.6700 FORMAT "%8.4" ECU_ADDRESS 0x7FD598 /end MEASUREMENT
/begin MEASUREMENT CrCtl_vinitRampResume "Initialisierungswert für Rampe GRA-Zielgeschwindigkeit" UWORD vfzg_q0p01 1 100 0.00 655.3500 FORMAT "%8.4" ECU_ADDRESS 0x7FD59A /end MEASUREMENT
/begin MEASUREMENT CrCtl_vSetPointBase "Basis für neue GRA-Zielgeschwindigkeit" UWORD vfzg_q0p01 1 100 0.00 655.3500 FORMAT "%8.4" ECU_ADDRESS 0x7FD556 /end MEASUREMENT
/begin MEASUREMENT CrCtl_vSetPointKorr "Setzwertkorrektur" SWORD vfzg_q0p01 1 100 -327.6800 327.6700 FORMAT "%8.4" ECU_ADDRESS 0x7FD558 /end MEASUREMENT
/begin MEASUREMENT CrCtl_vSetPointKorrFlt "Geschwindigkeitswert für Setzwertkorrektur, gefiltert" SWORD vfzg_q0p01 1 100 -327.6800 327.6700 FORMAT "%8.4" ECU_ADDRESS 0x7FD55A /end MEASUREMENT
/begin MEASUREMENT CrCtl_vSetPointOld "GRA-Zielgeschwindigkeit bei Beginn Accel/Decel" UWORD vfzg_q0p01 1 100 0.00 655.3500 FORMAT "%8.4" ECU_ADDRESS 0x7FD59C /end MEASUREMENT
/begin MEASUREMENT CrCtl_vSetPointTrgt "Zielgeschwindigkeit für die Fahrgeschwindigkeitsregelung" SWORD Vel 1 100 -327.6800 327.6700 FORMAT "%8.4" ECU_ADDRESS 0x7F9810 /end MEASUREMENT
/begin MEASUREMENT CrCtl_vSetPointTrgtByp_mp "Meßpunkt für Bypass" SWORD Vel 1 100 -327.6800 327.6700 FORMAT "%8.4" ECU_ADDRESS 0x9FEAAC /end MEASUREMENT
/begin MEASUREMENT CrCtl_vSetPointTrgtDspl "Aktuelle GRA-Zielgeschwindigkeit für Anzeige Kombi" UBYTE OneToOne 1 100 0.00 255.0 FORMAT "%5.1" ECU_ADDRESS 0x7F937A /end MEASUREMENT
/begin MEASUREMENT CrCtl_vSetPointTrgtDsplMphRd "Anzuzeigende Zielgeschwindigkeit im Kombi in Meilen (gerundet)" UWORD vfzg_q0p01 1 100 0.00 655.3500 FORMAT "%8.4" ECU_ADDRESS 0x7FD59E /end MEASUREMENT
/begin MEASUREMENT CrCtl_vSetPointTrgtDsplRaw "Anzuzeigende Zielgeschwindigkeit im Kombi (Rohwert)" UWORD vfzg_q0p01 1 100 0.00 655.3500 FORMAT "%8.4" ECU_ADDRESS 0x7FD5A0 /end MEASUREMENT
/begin MEASUREMENT CrCtl_vSetPointTrgtRamp "GRA-Zielgeschwindigkeit nach Sollwertformer (Rampe)" UWORD vfzg_q0p01 1 100 0.00 655.3500 FORMAT "%8.4" ECU_ADDRESS 0x7FD5A2 /end MEASUREMENT
/begin MEASUREMENT CrCtl_vSetPointTrgt_CCAdp "Aktuelle GRA-Zielgeschwindigkeit" UWORD vfzg_q0p01 1 100 0.00 655.3500 FORMAT "%8.4" ECU_ADDRESS 0x7FD5A4 /end MEASUREMENT
/begin MEASUREMENT CrCtl_vSetPTrgtDspl "Aktuelle GRA-Zielgeschwindigkeit für Anzeige im Kombi (16 bit)" UWORD OneToOne 1 100 0.00 65535.00 FORMAT "%8.2" ECU_ADDRESS 0x7F980E /end MEASUREMENT
/begin MEASUREMENT CrCtl_vSetPTrgtDspl_CCAdp "Beschleunigungswert für Initialisierungen bei Setzen" UWORD vfzg_q1p0 1 100 0.00 65535.00 FORMAT "%8.2" ECU_ADDRESS 0x7FD5A6 /end MEASUREMENT
/begin MEASUREMENT CrSCD_ctBufEntryBackUp_mp "Aktuelles Inkrement, welches gerade bei der Inkrementplausibilisierung geprüft wird" SLONG OneToOne 1 100 -2147483648.00 2147483647.00 FORMAT "%13.2" ECU_ADDRESS 0x9FE4A4 /end MEASUREMENT
/begin MEASUREMENT CrSCD_ctGapPlausBackUp_mp "Anzahl der Lücken während der Inkrementplausibilisierung im Backup Mode" SLONG OneToOne 1 100 -2147483648.00 2147483647.00 FORMAT "%13.2" ECU_ADDRESS 0x9FE4A8 /end MEASUREMENT
/begin MEASUREMENT CrSCD_dSegMisf "Verschiebung Segmentsystem für Aussetzererkennung" SBYTE OneToOne 1 100 -128.0 127.0 FORMAT "%5.1" ECU_ADDRESS 0x7F937B /end MEASUREMENT
/begin MEASUREMENT CrSCD_incNextIntDelta_mp "Anzahl der Inkrements bis zum nächsten statischen  Interrupt" SWORD OneToOne 1 100 -32768.00 32767.00 FORMAT "%8.2" ECU_ADDRESS 0x9FEAB4 /end MEASUREMENT
/begin MEASUREMENT CrSCD_incNextInt_mp "Anzahl der Inkrements bis zum nächsten statischen  Interrupt" SBYTE OneToOne 1 100 -128.0 127.0 FORMAT "%5.1" ECU_ADDRESS 0x9FFA4B /end MEASUREMENT
/begin MEASUREMENT CrSCD_nAvrg "gemittelte Kurbelwellendrehzahl des letzten und vorletzten segmentes" SWORD EngN 1 100 -32768.00 32767.00 FORMAT "%8.2" ECU_ADDRESS 0x7F9812 /end MEASUREMENT
/begin MEASUREMENT CrSCD_nAvrgHiRes "Gemittelte hochauflösende Drehzahl" SLONG EngN_HiRes 1 100 -67108864.0000 67108863.9688 FORMAT "%13.4" ECU_ADDRESS 0x7F9DD4 /end MEASUREMENT
/begin MEASUREMENT CrSCD_nCurr "aktuelle Motordrehzahl aus der letzten Segmentperiode" SWORD EngN 1 100 -32768.00 32767.00 FORMAT "%8.2" ECU_ADDRESS 0x7F9814 /end MEASUREMENT
/begin MEASUREMENT CrSCD_nCurrHiRes "Aktuelle hochauflösende Drehzahl" SLONG EngN_HiRes 1 100 -67108864.0000 67108863.9688 FORMAT "%13.4" ECU_ADDRESS 0x7F9DD8 /end MEASUREMENT
/begin MEASUREMENT CrSCD_nDyn "aktuelle Motordrehzahl mit Filter für Segment der Dekompressionsphase" SWORD EngN 1 100 -32768.00 32767.00 FORMAT "%8.2" ECU_ADDRESS 0x7F9816 /end MEASUREMENT
/begin MEASUREMENT CrSCD_nHold "aktuelle Motordrehzahl des vorletzten Segmentes" SWORD EngN 1 100 -32768.00 32767.00 FORMAT "%8.2" ECU_ADDRESS 0x7F9818 /end MEASUREMENT
/begin MEASUREMENT CrSCD_nIncr "Motordrehzahl aus Inkrementperiode" SWORD EngN 1 100 -32768.00 32767.00 FORMAT "%8.2" ECU_ADDRESS 0x7F981A /end MEASUREMENT
/begin MEASUREMENT CrSCD_nMisf "Drehzahlsignal für ODB-Zündaussetzererkennung" SWORD EngN 1 100 -32768.00 32767.00 FORMAT "%8.2" ECU_ADDRESS 0x7F981C /end MEASUREMENT
/begin MEASUREMENT CrSCD_numIncBufEntries_mp "Aktuelle Anzahl der Einträge im Inkrement Puffer" SLONG OneToOne 1 100 -2147483648.00 2147483647.00 FORMAT "%13.2" ECU_ADDRESS 0x9FE4AC /end MEASUREMENT
/begin MEASUREMENT CrSCD_numIncsBackUp_mp "Anzahl der Inkremente nach der Lücke" SLONG OneToOne 1 100 -2147483648.00 2147483647.00 FORMAT "%13.2" ECU_ADDRESS 0x9FE4B0 /end MEASUREMENT
/begin MEASUREMENT CrSCD_numMinIncBufEntries_mp "Minimale Anzahl der Inkrementpuffer-Einträge" SLONG OneToOne 1 100 -2147483648.00 2147483647.00 FORMAT "%13.2" ECU_ADDRESS 0x9FE4B4 /end MEASUREMENT
/begin MEASUREMENT CrSCD_numSeg "aktuelle Segmentnummer  (Segment 0 ist bei OT 1)" UBYTE OneToOne 1 100 0.00 255.0 FORMAT "%5.1" ECU_ADDRESS 0x7F937C /end MEASUREMENT
/begin MEASUREMENT CrSCD_phiCurr_mp "Aktueller Winkel basierent auf dem Inkrementsystem" SWORD AngleCrS 1 100 -768.0000 767.9766 FORMAT "%8.4" ECU_ADDRESS 0x9FEAB6 /end MEASUREMENT
/begin MEASUREMENT CrSCD_phiIncCor "aktuelle Phasenkorrektur des Inkrementsystems der Kurbelwelle" SWORD AngleCrS 1 100 -768.0000 767.9766 FORMAT "%8.4" ECU_ADDRESS 0x7F981E /end MEASUREMENT
/begin MEASUREMENT CrSCD_phiIncr "Winkel eines Inkrements in Grad Kurbelwelle" SWORD AngleCrS 1 100 -768.0000 767.9766 FORMAT "%8.4" ECU_ADDRESS 0x7F9820 /end MEASUREMENT
/begin MEASUREMENT CrSCD_phiSegGrid_mp "Berechnete Drehzahlsegmentlänge" SWORD AngleCrS 1 100 -768.0000 767.9766 FORMAT "%8.4" ECU_ADDRESS 0x9FEAB8 /end MEASUREMENT
/begin MEASUREMENT CrSCD_stCrSReal_mp "Rückgabewert der Inkrementplausibilisierung" SLONG OneToOne 1 100 -2147483648.00 2147483647.00 FORMAT "%13.2" ECU_ADDRESS 0x9FE4B8 /end MEASUREMENT
/begin MEASUREMENT CrSCD_stErrPlausBackUp_mp "Fehlerzustand der Inkrementplausibilisierung im Backup Mode" SLONG OneToOne 1 100 -2147483648.00 2147483647.00 FORMAT "%13.2" ECU_ADDRESS 0x9FE4BC /end MEASUREMENT
/begin MEASUREMENT CrSCD_stIncErr_mp "Fehlerstatus des Inkrementgebersignals (Signalstöhrungen, Frequenzstatus, Inkrementpufferstatus)" UBYTE OneToOne 1 100 0.00 255.0 FORMAT "%5.1" ECU_ADDRESS 0x9FFA4C /end MEASUREMENT
/begin MEASUREMENT CrSCD_stIncSig_mp "Status des Inkrementgeber Signalauswertung (Plausibilisierung der Zahnflankenzeiten und -anzahl)" UBYTE OneToOne 1 100 0.00 255.0 FORMAT "%5.1" ECU_ADDRESS 0x9FFA4D /end MEASUREMENT
/begin MEASUREMENT CrSCD_stIncSyncInc_mp "Synchronisationsstatus des Inkrementgebersignals nach Aufruf von CrSCD_UpdPos (Intern, Debugging)" UBYTE OneToOne 1 100 0.00 255.0 FORMAT "%5.1" ECU_ADDRESS 0x9FFA4E /end MEASUREMENT
/begin MEASUREMENT CrSCD_stIncSyncPhase_mp "Synchronisationsstatus des Inkrementgebersignals nach Aufruf von CaSCD_GetPos (Intern, Debugging)" UBYTE OneToOne 1 100 0.00 255.0 FORMAT "%5.1" ECU_ADDRESS 0x9FFA4F /end MEASUREMENT
/begin MEASUREMENT CrSCD_tiGapPlausHighBackUp_mp "Kennlinienwert der oberen Lückenplausibilisierung im Backup Mode" ULONG OneToOne 1 100 0.00 4294967295.00 FORMAT "%13.2" ECU_ADDRESS 0x9FE4C0 /end MEASUREMENT
/begin MEASUREMENT CrSCD_tiGapPlausLowBackUp_mp "Kennlinienwert der unteren Lückenplausibilisierung im Backup Mode" ULONG OneToOne 1 100 0.00 4294967295.00 FORMAT "%13.2" ECU_ADDRESS 0x9FE4C4 /end MEASUREMENT
/begin MEASUREMENT CrSCD_tiIncPerBackUp_mp "Inkrementperiodenzeit im Backup Mode" SLONG OneToOne 1 100 -2147483648.00 2147483647.00 FORMAT "%13.2" ECU_ADDRESS 0x9FE4C8 /end MEASUREMENT
/begin MEASUREMENT CrSCD_tiIncPlausHighBackUp_mp "Kennlinienwert der oberen Inkrementplausibilisierung im Backup Mode" ULONG OneToOne 1 100 0.00 4294967295.00 FORMAT "%13.2" ECU_ADDRESS 0x9FE4CC /end MEASUREMENT
/begin MEASUREMENT CrSCD_tiIncPlausLowBackUp_mp "Kennlinienwert der oberen Inkrementplausibilisierung im Backup Mode" ULONG OneToOne 1 100 0.00 4294967295.00 FORMAT "%13.2" ECU_ADDRESS 0x9FE4D0 /end MEASUREMENT
/begin MEASUREMENT CrSCD_tiIncr "aktuelle Inkrementperiode (1 Inkrement = Winkelbereich aus 360°KW/CrSCD_ctIncs_C, Abtastung = 2ms)" UWORD TimeDT 1 100 0.00 65535.00 FORMAT "%8.2" ECU_ADDRESS 0x7F9822 /end MEASUREMENT
/begin MEASUREMENT CrSCD_tiSeg "aktuelle Segmentperiode (1 Segment = Winkelbereich der über CrSCD_phiSeg_C appliziert ist, Abtastung = n-sync.)" ULONG Per_Dur 1 100 0.00 4294967295.00 FORMAT "%13.2" ECU_ADDRESS 0x7F9DDC /end MEASUREMENT
/begin MEASUREMENT CrS_ctInjStrt_mp "Anzahl der durchgeführten Testeinspritzungen" UWORD OneToOne 1 100 0.00 65535.00 FORMAT "%8.2" ECU_ADDRESS 0x9FEAAE /end MEASUREMENT
/begin MEASUREMENT CrS_facSegTime_mp "Verhältnis der Segmentzeiten" SLONG Fact1 1 100 -16777216.0000 16777215.9922 FORMAT "%13.4" ECU_ADDRESS 0x9FE498 /end MEASUREMENT
/begin MEASUREMENT CrS_numTDCStrtLst_mp "Zeigt den Zylinder an, in den als letztes eingespritzt wurde" UWORD OneToOne 1 100 0.00 65535.00 FORMAT "%8.2" ECU_ADDRESS 0x9FEAB0 /end MEASUREMENT
/begin MEASUREMENT CrS_numTDCStrt_mp "Zeigt die Zylinder an, in die bereits eingespritzt wurde" UWORD OneToOne 1 100 0.00 65535.00 FORMAT "%8.2" ECU_ADDRESS 0x9FEAB2 /end MEASUREMENT
/begin MEASUREMENT CrS_stStrt_mp "Messpunkt für Zustandsautomat" UBYTE OneToOne 1 100 0.00 255.0 FORMAT "%5.1" ECU_ADDRESS 0x9FFA4A /end MEASUREMENT
/begin MEASUREMENT CrS_tiSegOld_mp "Segmentzeit vor einer Testeinspritzung" SLONG Per_Dur 1 100 -2147483648.00 2147483647.00 FORMAT "%13.2" ECU_ADDRESS 0x9FE49C /end MEASUREMENT
/begin MEASUREMENT CrS_tiSeg_mp "Segmentzeit nach einer Testeinspritzung" SLONG Per_Dur 1 100 -2147483648.00 2147483647.00 FORMAT "%13.2" ECU_ADDRESS 0x9FE4A0 /end MEASUREMENT
/begin MEASUREMENT CtApCD_rHWE_mp "Ausgabetastverhältnis zur HWK" SWORD DtyCyc 1 100 -327.6800 327.6700 FORMAT "%8.4" ECU_ADDRESS 0x7FDDE0 /end MEASUREMENT
/begin MEASUREMENT CtApCD_rHWE_mpByp_mp "Bypass message für CtApCD_rHWE_mp" SWORD DtyCyc 1 100 -327.6800 327.6700 FORMAT "%8.4" ECU_ADDRESS 0x9FEABA /end MEASUREMENT
/begin MEASUREMENT CtApCD_stVarDef_mp "Status fuer Ausgabe ueber PWM- oder Digitalendstufe" UBYTE OneToOne 1 100 0.00 255.0 FORMAT "%5.1" ECU_ADDRESS 0x9FFA50 /end MEASUREMENT
/begin MEASUREMENT CTSCD_stCanSndTemp "Status Kühlmitteltemperatur für CAN" UBYTE OneToOne 1 100 0.00 255.0 FORMAT "%5.1" ECU_ADDRESS 0x7F9325 /end MEASUREMENT
/begin MEASUREMENT CTSCD_stCTSPrt "Ansteuerung der Kühlwassertemperatur-Heißleuchte" UBYTE OneToOne 1 100 0.00 255.0 FORMAT "%5.1" ECU_ADDRESS 0x7F9324 /end MEASUREMENT
/begin MEASUREMENT CTSCD_stCTSZoomOn_mp "Meßpunkt für Status Zoom-Funktion Hysterese" UBYTE OneToOne 1 100 0.00 255.0 FORMAT "%5.1" ECU_ADDRESS 0x9FFA51 /end MEASUREMENT
/begin MEASUREMENT CTSCD_stPullup "Status Zoom-Anforderung" UBYTE OneToOne 1 100 0.00 255.0 FORMAT "%5.1" ECU_ADDRESS 0x7F9326 /end MEASUREMENT
/begin MEASUREMENT CTSCD_stPullupDem_mp "Meßpunkt für Zoom-Funktion Anforderung" UBYTE OneToOne 1 100 0.00 255.0 FORMAT "%5.1" ECU_ADDRESS 0x9FFA52 /end MEASUREMENT
/begin MEASUREMENT CTSCD_swtSig "Wassertemperatur über CAN oder ADC" UBYTE OneToOne 1 100 0.00 255.0 FORMAT "%5.1" ECU_ADDRESS 0x7F9327 /end MEASUREMENT
/begin MEASUREMENT CTSCD_swtTempDfl "Schalterwert für Ersatzwert von FTS/OTS" UBYTE OneToOne 1 100 0.00 255.0 FORMAT "%5.1" ECU_ADDRESS 0x7F9328 /end MEASUREMENT
/begin MEASUREMENT CTSCD_tClnt "Kühlmitteltemperatur" SWORD Temp_Cels 1 100 -3549.940 3003.560 FORMAT "%8.3" ECU_ADDRESS 0x7F9722 /end MEASUREMENT
/begin MEASUREMENT CTSCD_tClntCan "Kühlmitteltemperatur über CAN" SWORD Temp_Cels 1 100 -3549.940 3003.560 FORMAT "%8.3" ECU_ADDRESS 0x7F9724 /end MEASUREMENT
/begin MEASUREMENT CTSCD_tClntLin "linearisierter Wert aus HWK vorm Aufruf der Übergangsfunktion" SWORD Temp_Cels 1 100 -3549.940 3003.560 FORMAT "%8.3" ECU_ADDRESS 0x7F9726 /end MEASUREMENT
/begin MEASUREMENT CTSCD_tClntLinZoom "linearisierter Wert aus HWK vor dem Aufruf der Übergangsfunktion bei zoom-in" SWORD Temp_Cels 1 100 -3549.940 3003.560 FORMAT "%8.3" ECU_ADDRESS 0x7F9728 /end MEASUREMENT
/begin MEASUREMENT CTSCD_tClntNoZoom_mp "Meßpunkt für Temperatur ohne Zoom-in" SWORD Temp_Cels 1 100 -3549.940 3003.560 FORMAT "%8.3" ECU_ADDRESS 0x9FEABC /end MEASUREMENT
/begin MEASUREMENT CTSCD_uRaw "Wassertemperatur Spannungsrohwert" SWORD Volt 1 100 -160156.4 160151.5 FORMAT "%8.1" ECU_ADDRESS 0x7F972A /end MEASUREMENT
/begin MEASUREMENT CTSCD_uRawZoom "Wassertemperatur Spannungsrohwert für Zoom-in" SWORD Volt 1 100 -160156.4 160151.5 FORMAT "%8.1" ECU_ADDRESS 0x7F972C /end MEASUREMENT
/begin MEASUREMENT CtTCD_rHWE_mp "Ausgabetastverhältnis zur HWK" SWORD DtyCyc 1 100 -327.6800 327.6700 FORMAT "%8.4" ECU_ADDRESS 0x9FEACC /end MEASUREMENT
/begin MEASUREMENT CtTCtl_dcycDes_mp "Sollwert des Tastverhältnisses" SWORD DtyCyc 1 100 -327.6800 327.6700 FORMAT "%8.4" ECU_ADDRESS 0x9FEACE /end MEASUREMENT
/begin MEASUREMENT CtTCtl_dcycI_mp "begrenzter Wert des I-Glieds" SWORD DtyCyc 1 100 -327.6800 327.6700 FORMAT "%8.4" ECU_ADDRESS 0x9FEAD0 /end MEASUREMENT
/begin MEASUREMENT CtTCtl_dcycThst "Ansteuertastverhältnis für den Komponententreiber" SWORD DtyCyc 1 100 -327.6800 327.6700 FORMAT "%8.4" ECU_ADDRESS 0x7F9824 /end MEASUREMENT
/begin MEASUREMENT CtTCtl_dcycThstByp_mp "Bypass message für  CtTCtl_dcycThst" SWORD DtyCyc 1 100 -327.6800 327.6700 FORMAT "%8.4" ECU_ADDRESS 0x9FEAD2 /end MEASUREMENT
/begin MEASUREMENT CtTCtl_dtClntDiff "Regelabweichen der Kühlmittelsolltemperatur" SWORD TempDiff_Kelv 1 100 -3276.800 3276.700 FORMAT "%8.3" ECU_ADDRESS 0x7F9826 /end MEASUREMENT
/begin MEASUREMENT CtTCtl_stCOTSHys_mp "Status der Hysterese COTSCD_tClnt, Umschaltung auf Vorgabewert bei Wert true" UBYTE OneToOne 1 100 0.00 255.0 FORMAT "%5.1" ECU_ADDRESS 0x9FFA53 /end MEASUREMENT
/begin MEASUREMENT CtTCtl_stCtl "bitcodierter Status der Kühlmittelthermostatsteuerung" UBYTE OneToOne 1 100 0.00 255.0 FORMAT "%5.1" ECU_ADDRESS 0x7F937D /end MEASUREMENT
/begin MEASUREMENT CtTCtl_tAirCurr_mp "Lufttemperatur des verwendeten Sensors" SWORD Temp_Cels 1 100 -3549.940 3003.560 FORMAT "%8.3" ECU_ADDRESS 0x9FEAD4 /end MEASUREMENT
/begin MEASUREMENT CtTCtl_tClntCurr_mp "aktuelle Kühlmitteltemperatur" SWORD Temp_Cels 1 100 -3549.940 3003.560 FORMAT "%8.3" ECU_ADDRESS 0x9FEAD6 /end MEASUREMENT
/begin MEASUREMENT CtTCtl_tClntDes "Sollkühlmitteltemperatur" SWORD Temp_Cels 1 100 -3549.940 3003.560 FORMAT "%8.3" ECU_ADDRESS 0x7F9828 /end MEASUREMENT
/begin MEASUREMENT CtTCtl_tClntDes1_mp "Kühlmittelsollwert aus CtTCtl_tBase_MAP" SWORD Temp_Cels 1 100 -3549.940 3003.560 FORMAT "%8.3" ECU_ADDRESS 0x9FEAD8 /end MEASUREMENT
/begin MEASUREMENT CtTCtl_tClntDes2_mp "Kühlmittelsollwert aus CtTCtl_tClntKor1_MAP" SWORD Temp_Cels 1 100 -3549.940 3003.560 FORMAT "%8.3" ECU_ADDRESS 0x9FEADA /end MEASUREMENT
/begin MEASUREMENT CtTCtl_tClntDes3_mp "Kühlmittelsollwert aus CtTCtl_tClntKor2_CUR" SWORD Temp_Cels 1 100 -3549.940 3003.560 FORMAT "%8.3" ECU_ADDRESS 0x9FEADC /end MEASUREMENT
/begin MEASUREMENT CtTCtl_tClntDes4_mp "Kühlmittelsollwert aus CtTCtl_tClntKor2_CUR oder Vorgabewert" SWORD Temp_Cels 1 100 -3549.940 3003.560 FORMAT "%8.3" ECU_ADDRESS 0x9FEADE /end MEASUREMENT
/begin MEASUREMENT CtTCtl_tClntDes5_mp "maximaler Wert oder Vorgabewert" SWORD Temp_Cels 1 100 -3549.940 3003.560 FORMAT "%8.3" ECU_ADDRESS 0x9FEAE0 /end MEASUREMENT
/begin MEASUREMENT CtTCtl_tClntDes6_mp "gestufte Kühlleistungsanhebung vom Getriebesteuergerät" SWORD Temp_Cels 1 100 -3549.940 3003.560 FORMAT "%8.3" ECU_ADDRESS 0x9FEAE2 /end MEASUREMENT
/begin MEASUREMENT CtTCtl_tClntDes7_mp "Ungefilterter Wert des Kühlmitteltemperatursollwertes" SWORD Temp_Cels 1 100 -3549.940 3003.560 FORMAT "%8.3" ECU_ADDRESS 0x9FEAE4 /end MEASUREMENT
/begin MEASUREMENT CtT_dtDec_mp "Summe Dekremente Wärmeabfuhr vom Wassertemperaturmodell" SLONG Temp_Kelv_Sec_CtT_Mod 1 100 -52428.8000000 52428.7999756 FORMAT "%13.7" ECU_ADDRESS 0x9FE4D4 /end MEASUREMENT
/begin MEASUREMENT CtT_dtInc_mp "Summe Inkremente Wärmezufuhr zum Wassertemperaturmodell" SLONG Temp_Kelv_Sec_CtT_Mod 1 100 -52428.8000000 52428.7999756 FORMAT "%13.7" ECU_ADDRESS 0x9FE4D8 /end MEASUREMENT
/begin MEASUREMENT CtT_dt_mp "Inkrement für Integration Wassertemperaturmodell" SLONG Temp_Kelv_Sec_CtT_Mod 1 100 -52428.8000000 52428.7999756 FORMAT "%13.7" ECU_ADDRESS 0x9FE4DC /end MEASUREMENT
/begin MEASUREMENT CtT_dvolFlConsumPT1_mp "Gefilterter Verbrauch für Thermostatdiagnose" SWORD FlConsum_l_h 1 100 -327.6800 327.6700 FORMAT "%8.4" ECU_ADDRESS 0x9FEABE /end MEASUREMENT
/begin MEASUREMENT CtT_stCondMon "Abschaltbedingungen Thermostatdiagnose" UWORD OneToOne 1 100 0.00 65535.00 FORMAT "%8.2" ECU_ADDRESS 0x7F982A /end MEASUREMENT
/begin MEASUREMENT CtT_stNumMon_mp "Status der Thermostatdiagnose" UWORD OneToOne 1 100 0.00 65535.00 FORMAT "%8.2" ECU_ADDRESS 0x9FEAC0 /end MEASUREMENT
/begin MEASUREMENT CtT_tAir "Differenz Wassertemperatur - Umgebungstemperatur" SWORD Temp_Cels 1 100 -3549.940 3003.560 FORMAT "%8.3" ECU_ADDRESS 0x7F982C /end MEASUREMENT
/begin MEASUREMENT CtT_tAirCorrPT1_mp "Gefilterte druckkorrigierte Ansauglufttemperatur" SWORD Temp_Cels 1 100 -3549.940 3003.560 FORMAT "%8.3" ECU_ADDRESS 0x9FEAC2 /end MEASUREMENT
/begin MEASUREMENT CtT_tAirCorr_mp "Druckkorrigierte Ansauglufttemperatur" SWORD Temp_Cels 1 100 -3549.940 3003.560 FORMAT "%8.3" ECU_ADDRESS 0x9FEAC4 /end MEASUREMENT
/begin MEASUREMENT CtT_tAirMod "Modellberechnung der Umgebungstemperatur EATSCD_tAir" SWORD Temp_Cels 1 100 -3549.940 3003.560 FORMAT "%8.3" ECU_ADDRESS 0x7F982E /end MEASUREMENT
/begin MEASUREMENT CtT_tClntEDCInitVal_mp "1. gültiger Wert der Wassertemperatur nach Init EDC" SWORD Temp_Cels 1 100 -3549.940 3003.560 FORMAT "%8.3" ECU_ADDRESS 0x9FEAC6 /end MEASUREMENT
/begin MEASUREMENT CtT_tClntMod "Modellberechnung der Wassertemperatur CTSCD_tClnt" SWORD Temp_Cels 1 100 -3549.940 3003.560 FORMAT "%8.3" ECU_ADDRESS 0x7F9830 /end MEASUREMENT
/begin MEASUREMENT CtT_tClntModCur_mp "Wassertemperatureinfluss auf Umgebungstemperaturmodell" SWORD Temp_Cels 1 100 -3549.940 3003.560 FORMAT "%8.3" ECU_ADDRESS 0x9FEAC8 /end MEASUREMENT
/begin MEASUREMENT CtT_tClntPT1_mp "Gefilterte Wassertemperatur" SWORD Temp_Cels 1 100 -3549.940 3003.560 FORMAT "%8.3" ECU_ADDRESS 0x9FEACA /end MEASUREMENT
/begin MEASUREMENT DfpErrCol_mp "Meßpunkt der für alle Fehlerpfade die Fehlerinformation gesammelt zur Verfügung stellt." UWORD OneToOne 1 100 0.00 65535.00 FORMAT "%8.2" ARRAY_SIZE 26 ECU_ADDRESS 0x9FEEBC /end MEASUREMENT
/begin MEASUREMENT DFPM_stFCMChkCause "Message für DSM internen gebrauch (unterstützung bei DSM problemen)" UBYTE FCMChkCause 1 100 1.00000000000 15.0000000000 FORMAT "%13.10" ECU_ADDRESS 0x7FA940 /end MEASUREMENT
/begin MEASUREMENT DfpZpfCol_mp "Messpunkt enthält die Cycle bits (getestet) aller Fehlerpfade seit der letzten Abschaltung" UWORD OneToOne 1 100 0.00 65535.00 FORMAT "%8.2" ARRAY_SIZE 26 ECU_ADDRESS 0x9FEEF0 /end MEASUREMENT
/begin MEASUREMENT DfpZyfCol_mp "Meßpunkt der gesammelt für alle Fehlerpfade das Zyklus Bit (getested Info) zur Verfügung stellt." UWORD OneToOne 1 100 0.00 65535.00 FORMAT "%8.2" ARRAY_SIZE 26 ECU_ADDRESS 0x9FEF24 /end MEASUREMENT
/begin MEASUREMENT Dfp_ACCCDBrkErr_mp "Messpunkt des Fehlerpfades ""Bremsenfehler""" UWORD OneToOne 1 100 0.00 65535.00 FORMAT "%8.2" ECU_ADDRESS 0x9FEB92 /end MEASUREMENT
/begin MEASUREMENT Dfp_ACCCDBrkNPL_mp "Messpunkt des Fehlerpfades ""Unplausibiltät der Bremse""" UWORD OneToOne 1 100 0.00 65535.00 FORMAT "%8.2" ECU_ADDRESS 0x9FEB94 /end MEASUREMENT
/begin MEASUREMENT Dfp_ACCCDSensErr_mp "Messpunkt des Fehlerpfades ""Fehler des ACC sensor""" UWORD OneToOne 1 100 0.00 65535.00 FORMAT "%8.2" ECU_ADDRESS 0x9FEB96 /end MEASUREMENT
/begin MEASUREMENT Dfp_ACCCDWrongCoded_mp "Fehlerpfad falsch codiertes MSG" UWORD OneToOne 1 100 0.00 65535.00 FORMAT "%8.2" ECU_ADDRESS 0x9FEB98 /end MEASUREMENT
/begin MEASUREMENT Dfp_ACCCD_mp "Messpunkt für Fehlerpfad Dpf_ACCCD" UWORD OneToOne 1 100 0.00 65535.00 FORMAT "%8.2" ECU_ADDRESS 0x9FEB9A /end MEASUREMENT
/begin MEASUREMENT Dfp_ACCD_mp "Messpunkt fuer Fehlerpfad  Dfp_ACCD" UWORD OneToOne 1 100 0.00 65535.00 FORMAT "%8.2" ECU_ADDRESS 0x9FEB9C /end MEASUREMENT
/begin MEASUREMENT Dfp_ACCD_PAC_mp "Fehlerpfad PWM-Input Kältemitteldruck" UWORD OneToOne 1 100 0.00 65535.00 FORMAT "%8.2" ECU_ADDRESS 0x9FEB9E /end MEASUREMENT
/begin MEASUREMENT Dfp_ACCD_pCAN_mp "Meßpunkt für Fehlerpfad Dfp_ACCD_pCAN" UWORD OneToOne 1 100 0.00 65535.00 FORMAT "%8.2" ECU_ADDRESS 0x9FEBA0 /end MEASUREMENT
/begin MEASUREMENT Dfp_ACCD_trqCAN_mp "Meßpunkt für Fehlerpfad Dfp_ACCD_trqCAN" UWORD OneToOne 1 100 0.00 65535.00 FORMAT "%8.2" ECU_ADDRESS 0x9FEBA2 /end MEASUREMENT
/begin MEASUREMENT Dfp_ACCIRevPanErr_mp "ACC Fehlerpfad für irreversible Abschaltbedingungen der ACC - Bedienteilfehler" UWORD OneToOne 1 100 0.00 65535.00 FORMAT "%8.2" ECU_ADDRESS 0x9FEBA4 /end MEASUREMENT
/begin MEASUREMENT Dfp_ACCIRevShOff_mp "ACC Fehlerpfad für irreversible Abschaltbedingungen der ACC" UWORD OneToOne 1 100 0.00 65535.00 FORMAT "%8.2" ECU_ADDRESS 0x9FEBA6 /end MEASUREMENT
/begin MEASUREMENT Dfp_ACCnotPlaus_mp "Fehlerpfad für nicht plausibles ACC-Steuergerät" UWORD OneToOne 1 100 0.00 65535.00 FORMAT "%8.2" ECU_ADDRESS 0x9FEBA8 /end MEASUREMENT
/begin MEASUREMENT Dfp_AccPedPlausBrk_mp "Fehlerpfad für Unplausibilität AccPed-Brk" UWORD OneToOne 1 100 0.00 65535.00 FORMAT "%8.2" ECU_ADDRESS 0x9FEBAA /end MEASUREMENT
/begin MEASUREMENT Dfp_ADCMon_mp "Messpunkt fuer Fehlerpfad  Dfp_ADCMon" UWORD OneToOne 1 100 0.00 65535.00 FORMAT "%8.2" ECU_ADDRESS 0x9FEBAC /end MEASUREMENT
/begin MEASUREMENT Dfp_AFSCD_PlOffsDrft_mp "Messpunkt fuer Fehlerpfad  Dfp_AFSCD_PlOffsDrft" UWORD OneToOne 1 100 0.00 65535.00 FORMAT "%8.2" ECU_ADDRESS 0x9FEBAE /end MEASUREMENT
/begin MEASUREMENT Dfp_AFSCD_PlSetyDrft_mp "Messpunkt fuer Fehlerpfad  Dfp_AFSCD_PlSetyDrft" UWORD OneToOne 1 100 0.00 65535.00 FORMAT "%8.2" ECU_ADDRESS 0x9FEBB0 /end MEASUREMENT
/begin MEASUREMENT Dfp_AFSCD_SRCAirm_mp "Fehlerpfad für SRC des Luftmassenrohwerts" UWORD OneToOne 1 100 0.00 65535.00 FORMAT "%8.2" ECU_ADDRESS 0x9FEBB2 /end MEASUREMENT
/begin MEASUREMENT Dfp_AFVCD_Actr_mp "Messpunkt für Fehlerpfad aus der HWK" UWORD OneToOne 1 100 0.00 65535.00 FORMAT "%8.2" ECU_ADDRESS 0x9FEBB4 /end MEASUREMENT
/begin MEASUREMENT Dfp_AirbCDCrashCrCtl_mp "Meßpunkt für Fehlerpfad Abschaltung CrCtl durch Airbag" UWORD OneToOne 1 100 0.00 65535.00 FORMAT "%8.2" ECU_ADDRESS 0x9FEBB6 /end MEASUREMENT
/begin MEASUREMENT Dfp_AirbCDCrashPSP_mp "Meßpunkt für Fehlerpfad Abschaltung PSP durch Airbag" UWORD OneToOne 1 100 0.00 65535.00 FORMAT "%8.2" ECU_ADDRESS 0x9FEBB8 /end MEASUREMENT
/begin MEASUREMENT Dfp_AirbCDCrash_mp "Meßpunkt für Fehlerpfad tatsächlicher Crash durch Airbag erkannt" UWORD OneToOne 1 100 0.00 65535.00 FORMAT "%8.2" ECU_ADDRESS 0x9FEBBA /end MEASUREMENT
/begin MEASUREMENT Dfp_AirCtl_GovDevMax_mp "Messpunkt fuer Fehlerpfad  Dfp_AirCtl_GovDevMax" UWORD OneToOne 1 100 0.00 65535.00 FORMAT "%8.2" ECU_ADDRESS 0x9FEBBC /end MEASUREMENT
/begin MEASUREMENT Dfp_AirCtl_GovDevMin_mp "Messpunkt fuer Fehlerpfad  Dfp_AirCtl_GovDevMin" UWORD OneToOne 1 100 0.00 65535.00 FORMAT "%8.2" ECU_ADDRESS 0x9FEBBE /end MEASUREMENT
/begin MEASUREMENT Dfp_AirCtl_GovDevRgnMax_mp "Permanente AirCtl Reglerabweichung im Regenerationsmodus" UWORD OneToOne 1 100 0.00 65535.00 FORMAT "%8.2" ECU_ADDRESS 0x9FEBC0 /end MEASUREMENT
/begin MEASUREMENT Dfp_AirCtl_GovDevRgnMin_mp "Permanente AirCtl Reglerabweichung im Regenerations modus" UWORD OneToOne 1 100 0.00 65535.00 FORMAT "%8.2" ECU_ADDRESS 0x9FEBC2 /end MEASUREMENT
/begin MEASUREMENT Dfp_AltCDExc_mp "Meßpunkt für Fehlerpfad Dfp_AltCDExc" UWORD OneToOne 1 100 0.00 65535.00 FORMAT "%8.2" ECU_ADDRESS 0x9FEBC4 /end MEASUREMENT
/begin MEASUREMENT Dfp_AltCD_Load_mp "Messpunkt fuer Fehlerpfad  Dfp_AltCD_Load" UWORD OneToOne 1 100 0.00 65535.00 FORMAT "%8.2" ECU_ADDRESS 0x9FEBC6 /end MEASUREMENT
/begin MEASUREMENT Dfp_AltPwrCan_mp "Fehlerpfad für Generatorleistung über CAN" UWORD OneToOne 1 100 0.00 65535.00 FORMAT "%8.2" ECU_ADDRESS 0x9FEBC8 /end MEASUREMENT
/begin MEASUREMENT Dfp_AOHtCDHt1_mp "Messpunkt fuer Fehlerpfad  Dfp_AOHtCDHt1" UWORD OneToOne 1 100 0.00 65535.00 FORMAT "%8.2" ECU_ADDRESS 0x9FEBCA /end MEASUREMENT
/begin MEASUREMENT Dfp_AOHtCDHt2_mp "Messpunkt fuer Fehlerpfad  Dfp_AOHtCDHt2" UWORD OneToOne 1 100 0.00 65535.00 FORMAT "%8.2" ECU_ADDRESS 0x9FEBCC /end MEASUREMENT
/begin MEASUREMENT Dfp_AOHtCDHt3_mp "Messpunkt fuer Fehlerpfad  Dfp_AOHtCDHt3" UWORD OneToOne 1 100 0.00 65535.00 FORMAT "%8.2" ECU_ADDRESS 0x9FEBCE /end MEASUREMENT
/begin MEASUREMENT Dfp_APP1_mp "Messpunkt fuer Fehlerpfad  Dfp_APP1" UWORD OneToOne 1 100 0.00 65535.00 FORMAT "%8.2" ECU_ADDRESS 0x9FEBD0 /end MEASUREMENT
/begin MEASUREMENT Dfp_APP2_mp "Messpunkt fuer Fehlerpfad  Dfp_APP2" UWORD OneToOne 1 100 0.00 65535.00 FORMAT "%8.2" ECU_ADDRESS 0x9FEBD2 /end MEASUREMENT
/begin MEASUREMENT Dfp_APPCD_KickDown_mp "Messpunkt fuer Fehlerpfad  Dfp_APPCD_KickDown" UWORD OneToOne 1 100 0.00 65535.00 FORMAT "%8.2" ECU_ADDRESS 0x9FEBD4 /end MEASUREMENT
/begin MEASUREMENT Dfp_APPCD_PWGDrft_mp "Fehlerpfad für PWG-Drift" UWORD OneToOne 1 100 0.00 65535.00 FORMAT "%8.2" ECU_ADDRESS 0x9FEBD6 /end MEASUREMENT
/begin MEASUREMENT Dfp_APPSync_mp "Messpunkt für Fehlerpfad Dfp_APPSync" UWORD OneToOne 1 100 0.00 65535.00 FORMAT "%8.2" ECU_ADDRESS 0x9FEBD8 /end MEASUREMENT
/begin MEASUREMENT Dfp_APP_Npl_mp "Messpunkt fuer Fehlerpfad  Dfp_APP_Npl" UWORD OneToOne 1 100 0.00 65535.00 FORMAT "%8.2" ECU_ADDRESS 0x9FEBDA /end MEASUREMENT
/begin MEASUREMENT Dfp_APSCD_mp "Messpunkt fuer Fehlerpfad  Dfp_APSCD" UWORD OneToOne 1 100 0.00 65535.00 FORMAT "%8.2" ECU_ADDRESS 0x9FEBDC /end MEASUREMENT
/begin MEASUREMENT Dfp_BattCD_mp "Messpunkt fuer Fehlerpfad  Dfp_BattCD" UWORD OneToOne 1 100 0.00 65535.00 FORMAT "%8.2" ECU_ADDRESS 0x9FEBDE /end MEASUREMENT
/begin MEASUREMENT Dfp_BIP01_mp "BIP-Fehler am SV in Zylinder 1" UWORD OneToOne 1 100 0.00 65535.00 FORMAT "%8.2" ECU_ADDRESS 0x9FEBE0 /end MEASUREMENT
/begin MEASUREMENT Dfp_BIP02_mp "BIP-Fehler am SV in Zylinder 2" UWORD OneToOne 1 100 0.00 65535.00 FORMAT "%8.2" ECU_ADDRESS 0x9FEBE2 /end MEASUREMENT
/begin MEASUREMENT Dfp_BIP03_mp "BIP-Fehler am SV in Zylinder 3" UWORD OneToOne 1 100 0.00 65535.00 FORMAT "%8.2" ECU_ADDRESS 0x9FEBE4 /end MEASUREMENT
/begin MEASUREMENT Dfp_BIP04_mp "BIP-Fehler am SV in Zylinder 4" UWORD OneToOne 1 100 0.00 65535.00 FORMAT "%8.2" ECU_ADDRESS 0x9FEBE6 /end MEASUREMENT
/begin MEASUREMENT Dfp_BIP05_mp "BIP-Fehler am SV in Zylinder 5" UWORD OneToOne 1 100 0.00 65535.00 FORMAT "%8.2" ECU_ADDRESS 0x9FEBE8 /end MEASUREMENT
/begin MEASUREMENT Dfp_BIP06_mp "BIP-Fehler am SV in Zylinder 6" UWORD OneToOne 1 100 0.00 65535.00 FORMAT "%8.2" ECU_ADDRESS 0x9FEBEA /end MEASUREMENT
/begin MEASUREMENT Dfp_BIP07_mp "BIP-Fehler am SV in Zylinder 7" UWORD OneToOne 1 100 0.00 65535.00 FORMAT "%8.2" ECU_ADDRESS 0x9FEBEC /end MEASUREMENT
/begin MEASUREMENT Dfp_BIP08_mp "BIP-Fehler am SV in Zylinder 8" UWORD OneToOne 1 100 0.00 65535.00 FORMAT "%8.2" ECU_ADDRESS 0x9FEBEE /end MEASUREMENT
/begin MEASUREMENT Dfp_BIP09_mp "BIP-Fehler am SV in Zylinder 9" UWORD OneToOne 1 100 0.00 65535.00 FORMAT "%8.2" ECU_ADDRESS 0x9FEBF0 /end MEASUREMENT
/begin MEASUREMENT Dfp_BIP10_mp "BIP-Fehler am SV in Zylinder 10" UWORD OneToOne 1 100 0.00 65535.00 FORMAT "%8.2" ECU_ADDRESS 0x9FEBF2 /end MEASUREMENT
/begin MEASUREMENT Dfp_BIP11_mp "BIP-Fehler am SV in Zylinder 11" UWORD OneToOne 1 100 0.00 65535.00 FORMAT "%8.2" ECU_ADDRESS 0x9FEBF4 /end MEASUREMENT
/begin MEASUREMENT Dfp_BIP12_mp "BIP-Fehler am SV in Zylinder 12" UWORD OneToOne 1 100 0.00 65535.00 FORMAT "%8.2" ECU_ADDRESS 0x9FEBF6 /end MEASUREMENT
/begin MEASUREMENT Dfp_BIP_Con_mp "Ausfall der AD-Wandlung des SV-Stromverlaufs" UWORD OneToOne 1 100 0.00 65535.00 FORMAT "%8.2" ECU_ADDRESS 0x9FEBF8 /end MEASUREMENT
/begin MEASUREMENT Dfp_BPACD_Max2_mp "Messpunkt fuer Fehlerpfad  Dfp_BPACD_Max2" UWORD OneToOne 1 100 0.00 65535.00 FORMAT "%8.2" ECU_ADDRESS 0x9FEBFA /end MEASUREMENT
/begin MEASUREMENT Dfp_BPACD_Max_mp "Fehlerpfad für Kurzschluss nach Batteriespannung des Ladedruckstrellers" UWORD OneToOne 1 100 0.00 65535.00 FORMAT "%8.2" ECU_ADDRESS 0x9FEBFC /end MEASUREMENT
/begin MEASUREMENT Dfp_BPACD_Min2_mp "Messpunkt fuer Fehlerpfad  Dfp_BPACD_Min2" UWORD OneToOne 1 100 0.00 65535.00 FORMAT "%8.2" ECU_ADDRESS 0x9FEBFE /end MEASUREMENT
/begin MEASUREMENT Dfp_BPACD_Min_mp "Fehlerpfad für Kurzschluss nach Masse des Ladedruckstellers" UWORD OneToOne 1 100 0.00 65535.00 FORMAT "%8.2" ECU_ADDRESS 0x9FEC00 /end MEASUREMENT
/begin MEASUREMENT Dfp_BPACD_SigNpl2_mp "Messpunkt fuer Fehlerpfad  Dfp_BPACD_SigNpl2" UWORD OneToOne 1 100 0.00 65535.00 FORMAT "%8.2" ECU_ADDRESS 0x9FEC02 /end MEASUREMENT
/begin MEASUREMENT Dfp_BPACD_SigNpl_mp "Fehlerpfad für Lastabfall und Übertemperatur des Ladedruckstellers" UWORD OneToOne 1 100 0.00 65535.00 FORMAT "%8.2" ECU_ADDRESS 0x9FEC04 /end MEASUREMENT
/begin MEASUREMENT Dfp_BPASCD_mp "Messpunkt fuer Fehlerpfad  Dfp_BPASCD" UWORD OneToOne 1 100 0.00 65535.00 FORMAT "%8.2" ECU_ADDRESS 0x9FEC06 /end MEASUREMENT
/begin MEASUREMENT Dfp_BPSCDPlaus_mp "Dfp nur für die APS-BPS Plausibilisierung des BPSCD" UWORD OneToOne 1 100 0.00 65535.00 FORMAT "%8.2" ECU_ADDRESS 0x9FEC08 /end MEASUREMENT
/begin MEASUREMENT Dfp_BPSCD_mp "Messpunkt fuer Fehlerpfad  Dfp_BPSCD" UWORD OneToOne 1 100 0.00 65535.00 FORMAT "%8.2" ECU_ADDRESS 0x9FEC0A /end MEASUREMENT
/begin MEASUREMENT Dfp_BrkCDBPTInvld_mp "Messpunkt fuer Fehlerpfad  Dfp_BrkCDBPTInvld" UWORD OneToOne 1 100 0.00 65535.00 FORMAT "%8.2" ECU_ADDRESS 0x9FEC0C /end MEASUREMENT
/begin MEASUREMENT Dfp_BrkCDdynPl_mp "Messpunkt fuer Fehlerpfad  Dfp_BrkCDdynPl" UWORD OneToOne 1 100 0.00 65535.00 FORMAT "%8.2" ECU_ADDRESS 0x9FEC0E /end MEASUREMENT
/begin MEASUREMENT Dfp_BrkCD_mp "Messpunkt fuer Fehlerpfad  Dfp_BrkCD" UWORD OneToOne 1 100 0.00 65535.00 FORMAT "%8.2" ECU_ADDRESS 0x9FEC10 /end MEASUREMENT
/begin MEASUREMENT Dfp_CANA_mp "Messpunkt fuer Fehlerpfad  Dfp_CANA" UWORD OneToOne 1 100 0.00 65535.00 FORMAT "%8.2" ECU_ADDRESS 0x9FEC12 /end MEASUREMENT
/begin MEASUREMENT Dfp_CANBus1_mp "Messpunkt fuer Fehlerpfad  Bus1" UWORD OneToOne 1 100 0.00 65535.00 FORMAT "%8.2" ECU_ADDRESS 0x9FEC14 /end MEASUREMENT
/begin MEASUREMENT Dfp_CANBus2_mp "Messpunkt fuer Fehlerpfad  Bus2" UWORD OneToOne 1 100 0.00 65535.00 FORMAT "%8.2" ECU_ADDRESS 0x9FEC16 /end MEASUREMENT
/begin MEASUREMENT Dfp_CANBus3_mp "Messpunkt fuer Fehlerpfad  Bus3" UWORD OneToOne 1 100 0.00 65535.00 FORMAT "%8.2" ECU_ADDRESS 0x9FEC18 /end MEASUREMENT
/begin MEASUREMENT Dfp_CANB_mp "Messpunkt fuer Fehlerpfad  Dfp_CANB" UWORD OneToOne 1 100 0.00 65535.00 FORMAT "%8.2" ECU_ADDRESS 0x9FEC1A /end MEASUREMENT
/begin MEASUREMENT Dfp_CANC_mp "Messpunkt fuer Fehlerpfad  Dfp_CANC" UWORD OneToOne 1 100 0.00 65535.00 FORMAT "%8.2" ECU_ADDRESS 0x9FEC1C /end MEASUREMENT
/begin MEASUREMENT Dfp_CANErrActA_mp "Messpunkt fuer Fehlerpfad  Dfp_CANErrActA" UWORD OneToOne 1 100 0.00 65535.00 FORMAT "%8.2" ECU_ADDRESS 0x9FEC1E /end MEASUREMENT
/begin MEASUREMENT Dfp_CANErrActB_mp "Messpunkt fuer Fehlerpfad  Dfp_CANErrActB" UWORD OneToOne 1 100 0.00 65535.00 FORMAT "%8.2" ECU_ADDRESS 0x9FEC20 /end MEASUREMENT
/begin MEASUREMENT Dfp_CANErrActC_mp "Messpunkt fuer Fehlerpfad  Dfp_CANErrActC" UWORD OneToOne 1 100 0.00 65535.00 FORMAT "%8.2" ECU_ADDRESS 0x9FEC22 /end MEASUREMENT
/begin MEASUREMENT Dfp_Clg_DynTst_mp "Messpunkt fuer Fehlerpfad  Dfp_Clg_DynTst" UWORD OneToOne 1 100 0.00 65535.00 FORMAT "%8.2" ECU_ADDRESS 0x9FEC24 /end MEASUREMENT
/begin MEASUREMENT Dfp_CmbChbMisfire1_mp "Fehlerpfad Zündaussetzer in Zylinder 1" UWORD OneToOne 1 100 0.00 65535.00 FORMAT "%8.2" ECU_ADDRESS 0x9FEC26 /end MEASUREMENT
/begin MEASUREMENT Dfp_CmbChbMisfire2_mp "Fehlerpfad Zündaussetzer in Zylinder 2" UWORD OneToOne 1 100 0.00 65535.00 FORMAT "%8.2" ECU_ADDRESS 0x9FEC28 /end MEASUREMENT
/begin MEASUREMENT Dfp_CmbChbMisfire3_mp "Fehlerpfad Zündaussetzer in Zylinder 3" UWORD OneToOne 1 100 0.00 65535.00 FORMAT "%8.2" ECU_ADDRESS 0x9FEC2A /end MEASUREMENT
/begin MEASUREMENT Dfp_CmbChbMisfire4_mp "Fehlerpfad Zündaussetzer in Zylinder 4" UWORD OneToOne 1 100 0.00 65535.00 FORMAT "%8.2" ECU_ADDRESS 0x9FEC2C /end MEASUREMENT
/begin MEASUREMENT Dfp_CmbChbMisfire5_mp "Fehlerpfad Zündaussetzer in Zylinder 5" UWORD OneToOne 1 100 0.00 65535.00 FORMAT "%8.2" ECU_ADDRESS 0x9FEC2E /end MEASUREMENT
/begin MEASUREMENT Dfp_CmbChbMisfire6_mp "Fehlerpfad Zündaussetzer in Zylinder 6" UWORD OneToOne 1 100 0.00 65535.00 FORMAT "%8.2" ECU_ADDRESS 0x9FEC30 /end MEASUREMENT
/begin MEASUREMENT Dfp_CmbChbMisfireMul_mp "Fehlerpfad Zündaussetzer in mehreren Zylindern" UWORD OneToOne 1 100 0.00 65535.00 FORMAT "%8.2" ECU_ADDRESS 0x9FEC32 /end MEASUREMENT
/begin MEASUREMENT Dfp_ConvCD_ConvErr_mp "Meßpunkt für Fehlerpfad Dfp_ConvCD_ConvErr" UWORD OneToOne 1 100 0.00 65535.00 FORMAT "%8.2" ECU_ADDRESS 0x9FEC34 /end MEASUREMENT
/begin MEASUREMENT Dfp_ConvCD_EPB1_mp "Messpunkt fuer Fehlerpfad  Dfp_ConvCD_EPB1" UWORD OneToOne 1 100 0.00 65535.00 FORMAT "%8.2" ECU_ADDRESS 0x9FEC36 /end MEASUREMENT
/begin MEASUREMENT Dfp_ConvCD_mp "Messpunkt fuer Fehlerpfad  Dfp_ConvCD" UWORD OneToOne 1 100 0.00 65535.00 FORMAT "%8.2" ECU_ADDRESS 0x9FEC38 /end MEASUREMENT
/begin MEASUREMENT Dfp_COTSCD_mp "Fehlerpfad des WTK-Sensors" UWORD OneToOne 1 100 0.00 65535.00 FORMAT "%8.2" ECU_ADDRESS 0x9FEC3A /end MEASUREMENT
/begin MEASUREMENT Dfp_CoVehLvl2_mp "Fehlerpfad für Leerlaufdrehzahlerhöhung der Stufe 2" UWORD OneToOne 1 100 0.00 65535.00 FORMAT "%8.2" ECU_ADDRESS 0x9FEC3C /end MEASUREMENT
/begin MEASUREMENT Dfp_CoVMDCSErr_mp "Bedingungsfehler im DCS Eingriff" UWORD OneToOne 1 100 0.00 65535.00 FORMAT "%8.2" ECU_ADDRESS 0x9FEC3E /end MEASUREMENT
/begin MEASUREMENT Dfp_CoVMDCSh_mp "Fehlerpfade physikalische Unplausibilität der  Motorschlupfregelung" UWORD OneToOne 1 100 0.00 65535.00 FORMAT "%8.2" ECU_ADDRESS 0x9FEC40 /end MEASUREMENT
/begin MEASUREMENT Dfp_CoVMDCSp_mp "Status des Fehlerpfades funktionale Plausibilität Motorschlupfregelung mit Geschwindigkeit über Grund" UWORD OneToOne 1 100 0.00 65535.00 FORMAT "%8.2" ECU_ADDRESS 0x9FEC42 /end MEASUREMENT
/begin MEASUREMENT Dfp_CoVMSumErr_mp "Status des Fehlerpfades Plausibilitätsverletzung TCS Eingriff" UWORD OneToOne 1 100 0.00 65535.00 FORMAT "%8.2" ECU_ADDRESS 0x9FEC44 /end MEASUREMENT
/begin MEASUREMENT Dfp_CoVMTCSErr_mp "Bedingungsfehler im TCS Eingriff" UWORD OneToOne 1 100 0.00 65535.00 FORMAT "%8.2" ECU_ADDRESS 0x9FEC46 /end MEASUREMENT
/begin MEASUREMENT Dfp_CrCCDPanErrMSG_mp "Fehler im Cruise Control Bedienteil" UWORD OneToOne 1 100 0.00 65535.00 FORMAT "%8.2" ECU_ADDRESS 0x9FEC48 /end MEASUREMENT
/begin MEASUREMENT Dfp_CrCCDPanErrSMLS_mp "MAX Fehler im Cruise Control Bedienteil" UWORD OneToOne 1 100 0.00 65535.00 FORMAT "%8.2" ECU_ADDRESS 0x9FEC4A /end MEASUREMENT
/begin MEASUREMENT Dfp_CrCCDPanMainSwtErr_mp "Plausibilitätsfehler Cruise Control Hauptschalter" UWORD OneToOne 1 100 0.00 65535.00 FORMAT "%8.2" ECU_ADDRESS 0x9FEC4C /end MEASUREMENT
/begin MEASUREMENT Dfp_CrCtlDsplErrPat_mp "Dfp für GRA-Zielgeschwindigkeit für Anzeige im Kombi" UWORD OneToOne 1 100 0.00 65535.00 FORMAT "%8.2" ECU_ADDRESS 0x9FEC4E /end MEASUREMENT
/begin MEASUREMENT Dfp_CrCtlDsplNotPlaus_mp "Fehlerpfad für Fehler im High-Line-Kombi-Status" UWORD OneToOne 1 100 0.00 65535.00 FORMAT "%8.2" ECU_ADDRESS 0x9FEC50 /end MEASUREMENT
/begin MEASUREMENT Dfp_CrCtlPECDErr_mp "Messpunkt fuer Fehlerpfad  Dfp_CrCtlPECDErr" UWORD OneToOne 1 100 0.00 65535.00 FORMAT "%8.2" ECU_ADDRESS 0x9FEC52 /end MEASUREMENT
/begin MEASUREMENT Dfp_CrCtlPLmpDef_mp "Dfp für Bremslicht-Fehler" UWORD OneToOne 1 100 0.00 65535.00 FORMAT "%8.2" ECU_ADDRESS 0x9FEC54 /end MEASUREMENT
/begin MEASUREMENT Dfp_CrCtlPShutOff_mp "Dfp für Abschaltbedingungen der  CrCtl und CrCtl+" UWORD OneToOne 1 100 0.00 65535.00 FORMAT "%8.2" ECU_ADDRESS 0x9FEC56 /end MEASUREMENT
/begin MEASUREMENT Dfp_CrCtlPTlrDef_mp "Dfp für Bremslichtfehler am Anhängerr" UWORD OneToOne 1 100 0.00 65535.00 FORMAT "%8.2" ECU_ADDRESS 0x9FEC58 /end MEASUREMENT
/begin MEASUREMENT Dfp_CrCtlVDsplNotPlaus_mp "Dfp für GRA-Zielgeschwindigkeit" UWORD OneToOne 1 100 0.00 65535.00 FORMAT "%8.2" ECU_ADDRESS 0x9FEC5A /end MEASUREMENT
/begin MEASUREMENT Dfp_CtApCD_mp "Messpunkt fuer Fehlerpfad  Dfp_CtApCD" UWORD OneToOne 1 100 0.00 65535.00 FORMAT "%8.2" ECU_ADDRESS 0x9FEC5C /end MEASUREMENT
/begin MEASUREMENT Dfp_CTSCDCanInac_mp "Messpunkt fuer Fehlerpfad  Dfp_CTSCDCanInac" UWORD OneToOne 1 100 0.00 65535.00 FORMAT "%8.2" ECU_ADDRESS 0x9FEC5E /end MEASUREMENT
/begin MEASUREMENT Dfp_CTSCDCanSig_mp "Messpunkt fuer Fehlerpfad  Dfp_CTSCDCanSig" UWORD OneToOne 1 100 0.00 65535.00 FORMAT "%8.2" ECU_ADDRESS 0x9FEC60 /end MEASUREMENT
/begin MEASUREMENT Dfp_CTSCD_mp "Messpunkt fuer Fehlerpfad  Dfp_CTSCD" UWORD OneToOne 1 100 0.00 65535.00 FORMAT "%8.2" ECU_ADDRESS 0x9FEC62 /end MEASUREMENT
/begin MEASUREMENT Dfp_CtTCD_mp "Messpunkt fuer Fehlerpfad  Dfp_CtTCD" UWORD OneToOne 1 100 0.00 65535.00 FORMAT "%8.2" ECU_ADDRESS 0x9FEC64 /end MEASUREMENT
/begin MEASUREMENT Dfp_CtT_Mon_mp "Fehlerpfad Thermostatdiagnose" UWORD OneToOne 1 100 0.00 65535.00 FORMAT "%8.2" ECU_ADDRESS 0x9FEC66 /end MEASUREMENT
/begin MEASUREMENT Dfp_DifftrqLimErrPat_mp "Fehlerpfad für physikalisches Fehlermuster in Message" UWORD OneToOne 1 100 0.00 65535.00 FORMAT "%8.2" ECU_ADDRESS 0x9FEC68 /end MEASUREMENT
/begin MEASUREMENT Dfp_EATSCDCanInac_mp "Messpunkt fuer Fehlerpfad  Dfp_EATSCDCanInac" UWORD OneToOne 1 100 0.00 65535.00 FORMAT "%8.2" ECU_ADDRESS 0x9FEC6A /end MEASUREMENT
/begin MEASUREMENT Dfp_EATSCDCanSig_mp "Messpunkt fuer Fehlerpfad  Dfp_EATSCDCanSig" UWORD OneToOne 1 100 0.00 65535.00 FORMAT "%8.2" ECU_ADDRESS 0x9FEC6C /end MEASUREMENT
/begin MEASUREMENT Dfp_EATSCD_mp "Messpunkt fuer Fehlerpfad  Dfp_EATSCD" UWORD OneToOne 1 100 0.00 65535.00 FORMAT "%8.2" ECU_ADDRESS 0x9FEC6E /end MEASUREMENT
/begin MEASUREMENT Dfp_EEPCDVarMng_mp "Messpunkt fuer Fehlerpfad  Dfp_EEPCDVarMng" UWORD OneToOne 1 100 0.00 65535.00 FORMAT "%8.2" ECU_ADDRESS 0x9FEC70 /end MEASUREMENT
/begin MEASUREMENT Dfp_EGPpCDTPreTrbn_mp "Messpunkt fuer Fehlerpfad  Dfp_EgPpCD" UWORD OneToOne 1 100 0.00 65535.00 FORMAT "%8.2" ECU_ADDRESS 0x9FEC72 /end MEASUREMENT
/begin MEASUREMENT Dfp_EGRCD_CBV_mp "Fehlerpfad für den EGR-Kühler Bypass Ventil Komponententreibers" UWORD OneToOne 1 100 0.00 65535.00 FORMAT "%8.2" ECU_ADDRESS 0x9FEC74 /end MEASUREMENT
/begin MEASUREMENT Dfp_EGRCD_Max_mp "Fehlerpfad für Kurzschluss nach Batteriespannung des Abgasrückführstellers" UWORD OneToOne 1 100 0.00 65535.00 FORMAT "%8.2" ECU_ADDRESS 0x9FEC76 /end MEASUREMENT
/begin MEASUREMENT Dfp_EGRCD_Min_mp "Fehlerpfad für Kurzschluss nach Masse des Abgasrückführstellers" UWORD OneToOne 1 100 0.00 65535.00 FORMAT "%8.2" ECU_ADDRESS 0x9FEC78 /end MEASUREMENT
/begin MEASUREMENT Dfp_EGRCD_SigNpl_mp "Fehlerpfad für Lastabfall und Übertemperatur des Abgasrückführstellers" UWORD OneToOne 1 100 0.00 65535.00 FORMAT "%8.2" ECU_ADDRESS 0x9FEC7A /end MEASUREMENT
/begin MEASUREMENT Dfp_EGRCD_Sig_mp "Messpunkt fuer Fehlerpfad  Dfp_EGRCD_Sig" UWORD OneToOne 1 100 0.00 65535.00 FORMAT "%8.2" ECU_ADDRESS 0x9FEC7C /end MEASUREMENT
/begin MEASUREMENT Dfp_EGRSCD_JamVlv_mp "Fehlerpfad für den verklemmten Zustand des Ventils" UWORD OneToOne 1 100 0.00 65535.00 FORMAT "%8.2" ECU_ADDRESS 0x9FEC7E /end MEASUREMENT
/begin MEASUREMENT Dfp_EGRSCD_LgTimeDrft_mp "Fehlerpfad für den Langzeitdriftfehler" UWORD OneToOne 1 100 0.00 65535.00 FORMAT "%8.2" ECU_ADDRESS 0x9FEC80 /end MEASUREMENT
/begin MEASUREMENT Dfp_EGRSCD_mp "Messpunkt fuer Fehlerpfad  Dfp_EGRSCD" UWORD OneToOne 1 100 0.00 65535.00 FORMAT "%8.2" ECU_ADDRESS 0x9FEC82 /end MEASUREMENT
/begin MEASUREMENT Dfp_EGRSCD_ShTimeDrft_mp "Fehlerpfad für den Kurzzeitdriftfehler" UWORD OneToOne 1 100 0.00 65535.00 FORMAT "%8.2" ECU_ADDRESS 0x9FEC84 /end MEASUREMENT
/begin MEASUREMENT Dfp_EGRVlvGvnrDvt_mp "Messpunkt fuer Fehlerpfad  Dfp_EGRVlvGvnrDvt" UWORD OneToOne 1 100 0.00 65535.00 FORMAT "%8.2" ECU_ADDRESS 0x9FEC86 /end MEASUREMENT
/begin MEASUREMENT Dfp_EGRVlv_JamVlv_mp "Messpunkt fuer Fehlerpfad  Dfp_EGRVlv_JamVlv" UWORD OneToOne 1 100 0.00 65535.00 FORMAT "%8.2" ECU_ADDRESS 0x9FEC88 /end MEASUREMENT
/begin MEASUREMENT Dfp_EMCCD_MLS1_mp "Messpunkt fuer Fehlerpfad  Dfp_EMCCD_MLS1" UWORD OneToOne 1 100 0.00 65535.00 FORMAT "%8.2" ECU_ADDRESS 0x9FEC8A /end MEASUREMENT
/begin MEASUREMENT Dfp_EngMBackUp_mp "Der Fehlerpfad Dfp_EngMBackUp_mp wird gesetzt sobald der BackUp mode aktiv ist" UWORD OneToOne 1 100 0.00 65535.00 FORMAT "%8.2" ECU_ADDRESS 0x9FEC8C /end MEASUREMENT
/begin MEASUREMENT Dfp_EngMCaS1_mp "Meßpunkt für Fehlerpfad Dfp_EngMCaS1" UWORD OneToOne 1 100 0.00 65535.00 FORMAT "%8.2" ECU_ADDRESS 0x9FEC8E /end MEASUREMENT
/begin MEASUREMENT Dfp_EngMCaSDrv_mp "Meßpunkt fuer Fehlerpfad Dfp_EngMCaSDrv" UWORD OneToOne 1 100 0.00 65535.00 FORMAT "%8.2" ECU_ADDRESS 0x9FEC90 /end MEASUREMENT
/begin MEASUREMENT Dfp_EngMCrS1_mp "Meßpunkt für Fehlerpfad Dfp_EngMCrS1" UWORD OneToOne 1 100 0.00 65535.00 FORMAT "%8.2" ECU_ADDRESS 0x9FEC92 /end MEASUREMENT
/begin MEASUREMENT Dfp_EngMOfsCaSCrS_mp "Meßpunkt fuer Fehlerpfad Dfp_EngMOfsCaSCrS" UWORD OneToOne 1 100 0.00 65535.00 FORMAT "%8.2" ECU_ADDRESS 0x9FEC94 /end MEASUREMENT
/begin MEASUREMENT Dfp_EngMonIrrCmb_mp "Messpunkt für Fehlerpfad der Verbrennungserkennung mit Lambda-Sonde" UWORD OneToOne 1 100 0.00 65535.00 FORMAT "%8.2" ECU_ADDRESS 0x9FEC96 /end MEASUREMENT
/begin MEASUREMENT Dfp_EngPrt_mp "Überdrehzahl-Fehler" UWORD OneToOne 1 100 0.00 65535.00 FORMAT "%8.2" ECU_ADDRESS 0x9FEC98 /end MEASUREMENT
/begin MEASUREMENT Dfp_ErLpCDMILReqON_mp "Fehlerpfad bei permanentem EIN-Zustand der MIL-Lampe" UWORD OneToOne 1 100 0.00 65535.00 FORMAT "%8.2" ECU_ADDRESS 0x9FEC9A /end MEASUREMENT
/begin MEASUREMENT Dfp_FanCD_Fan1Ctlr1_mp "Messpunkt fuer Fehlerpfad  Dfp_FanCD_Fan1Ctlr1" UWORD OneToOne 1 100 0.00 65535.00 FORMAT "%8.2" ECU_ADDRESS 0x9FEC9C /end MEASUREMENT
/begin MEASUREMENT Dfp_FanCD_Fan1Ctlr2_mp "Messpunkt fuer Fehlerpfad  Dfp_FanCD_Fan1Ctlr2" UWORD OneToOne 1 100 0.00 65535.00 FORMAT "%8.2" ECU_ADDRESS 0x9FEC9E /end MEASUREMENT
/begin MEASUREMENT Dfp_FanCD_Fan2Ctlr1_mp "Messpunkt fuer Fehlerpfad  Dfp_FanCD_Fan2Ctlr1" UWORD OneToOne 1 100 0.00 65535.00 FORMAT "%8.2" ECU_ADDRESS 0x9FECA0 /end MEASUREMENT
/begin MEASUREMENT Dfp_FanCD_Fan2Ctlr2_mp "Messpunkt fuer Fehlerpfad  Dfp_FanCD_Fan2Ctlr2" UWORD OneToOne 1 100 0.00 65535.00 FORMAT "%8.2" ECU_ADDRESS 0x9FECA2 /end MEASUREMENT
/begin MEASUREMENT Dfp_FanCD_FanCtlr1_mp "Messpunkt fuer Fehlerpfad  Dfp_FanCD_FanCtlr1" UWORD OneToOne 1 100 0.00 65535.00 FORMAT "%8.2" ECU_ADDRESS 0x9FECA4 /end MEASUREMENT
/begin MEASUREMENT Dfp_FanCD_FanCtlr2_mp "Messpunkt fuer Fehlerpfad  Dfp_FanCD_FanCtlr2" UWORD OneToOne 1 100 0.00 65535.00 FORMAT "%8.2" ECU_ADDRESS 0x9FECA6 /end MEASUREMENT
/begin MEASUREMENT Dfp_FanCD_OutFanCtlr1_mp "Messpunkt fuer Fehlerpfad  Dfp_FanCD_OutFanCtlr1" UWORD OneToOne 1 100 0.00 65535.00 FORMAT "%8.2" ECU_ADDRESS 0x9FECA8 /end MEASUREMENT
/begin MEASUREMENT Dfp_FanCD_OutFanCtlr2_mp "Messpunkt fuer Fehlerpfad  Dfp_FanCD_OutFanCtlr2" UWORD OneToOne 1 100 0.00 65535.00 FORMAT "%8.2" ECU_ADDRESS 0x9FECAA /end MEASUREMENT
/begin MEASUREMENT Dfp_FlClgCD_mp "Dfp für das Ventil für die Kühlmittelzufuhr zum Kraftstoffkühler" UWORD OneToOne 1 100 0.00 65535.00 FORMAT "%8.2" ECU_ADDRESS 0x9FECAC /end MEASUREMENT
/begin MEASUREMENT Dfp_FlPpCD_mp "Messpunkt fuer Fehlerpfad  Dfp_FlPpCD" UWORD OneToOne 1 100 0.00 65535.00 FORMAT "%8.2" ECU_ADDRESS 0x9FECAE /end MEASUREMENT
/begin MEASUREMENT Dfp_FlSCDT1_mp "Messpunkt fuer Fehlerpfad  Dfp_FlSCDT1" UWORD OneToOne 1 100 0.00 65535.00 FORMAT "%8.2" ECU_ADDRESS 0x9FECB0 /end MEASUREMENT
/begin MEASUREMENT Dfp_FMAErrMod_mp "Messpunkt fuer Fehlerpfad  Dfp_FMAErrMod" UWORD OneToOne 1 100 0.00 65535.00 FORMAT "%8.2" ECU_ADDRESS 0x9FECB2 /end MEASUREMENT
/begin MEASUREMENT Dfp_FMTC_NonMonotonMap_mp "Prüfung Monotonie der Mengenstützpunkte über Moment in FMTC_trq2qBas_MAP" UWORD OneToOne 1 100 0.00 65535.00 FORMAT "%8.2" ECU_ADDRESS 0x9FECB4 /end MEASUREMENT
/begin MEASUREMENT Dfp_FQlSCD_mp "Messpunkt fuer Fehlerpfad  Dfp_FQlSCD" UWORD OneToOne 1 100 0.00 65535.00 FORMAT "%8.2" ECU_ADDRESS 0x9FECB6 /end MEASUREMENT
/begin MEASUREMENT Dfp_FQTSCD_mp "Fehlerpfad des Kraftstofftemperatur- und Kraftstoffqualitätssignals" UWORD OneToOne 1 100 0.00 65535.00 FORMAT "%8.2" ECU_ADDRESS 0x9FECB8 /end MEASUREMENT
/begin MEASUREMENT Dfp_FrmMngAAGNpl_mp "Messpunkt für Fehlerpfad FrmMngAAGNpl (Botschaftszähler Fehler)" UWORD OneToOne 1 100 0.00 65535.00 FORMAT "%8.2" ECU_ADDRESS 0x9FECBA /end MEASUREMENT
/begin MEASUREMENT Dfp_FrmMngAAGTO_mp "Timeout-Fehlerpfad Botschaft AAG" UWORD OneToOne 1 100 0.00 65535.00 FORMAT "%8.2" ECU_ADDRESS 0x9FECBC /end MEASUREMENT
/begin MEASUREMENT Dfp_FrmMngAC1Npl_mp "Messpunkt für Fehlerpfad FrmMngAC1Npl (DLC-Fehler)" UWORD OneToOne 1 100 0.00 65535.00 FORMAT "%8.2" ECU_ADDRESS 0x9FECBE /end MEASUREMENT
/begin MEASUREMENT Dfp_FrmMngAC1TO_mp "Messpunkt fuer Fehlerpfad  Dfp_FrmMngAC1TO" UWORD OneToOne 1 100 0.00 65535.00 FORMAT "%8.2" ECU_ADDRESS 0x9FECC0 /end MEASUREMENT
/begin MEASUREMENT Dfp_FrmMngACCNpl_mp "Messpunkt für Fehlerpfad FrmMngACCNpl (Botschaftszähler und Checksummen Fehler)" UWORD OneToOne 1 100 0.00 65535.00 FORMAT "%8.2" ECU_ADDRESS 0x9FECC2 /end MEASUREMENT
/begin MEASUREMENT Dfp_FrmMngACCTO_mp "Fehlerpfad für Timeout der Can-Massage ACC-System" UWORD OneToOne 1 100 0.00 65535.00 FORMAT "%8.2" ECU_ADDRESS 0x9FECC4 /end MEASUREMENT
/begin MEASUREMENT Dfp_FrmMngAIRBGNpl_mp "Messpunkt für Fehlerpfad FrmMngAIRBG (Botschaftszähler und Checksummen Fehler)" UWORD OneToOne 1 100 0.00 65535.00 FORMAT "%8.2" ECU_ADDRESS 0x9FECC6 /end MEASUREMENT
/begin MEASUREMENT Dfp_FrmMngAIRBGTO_mp "Messpunkt fuer Fehlerpfad Dfp_FrmMngAIRBGTO" UWORD OneToOne 1 100 0.00 65535.00 FORMAT "%8.2" ECU_ADDRESS 0x9FECC8 /end MEASUREMENT
/begin MEASUREMENT Dfp_FrmMngAWD1Npl_mp "Messpunkt für Fehlerpfad FrmMngAWD1Npl (Botschaftszähler Fehler)" UWORD OneToOne 1 100 0.00 65535.00 FORMAT "%8.2" ECU_ADDRESS 0x9FECCA /end MEASUREMENT
/begin MEASUREMENT Dfp_FrmMngAWD1TO_mp "Messpunkt fuer Fehlerpfad  Dfp_FrmMngAWD1TO" UWORD OneToOne 1 100 0.00 65535.00 FORMAT "%8.2" ECU_ADDRESS 0x9FECCC /end MEASUREMENT
/begin MEASUREMENT Dfp_FrmMngBEM1Npl_mp "Messpunkt für Fehlerpfad FrmMngBEM1Npl (Botschaftszähler und Checksummen Fehler)" UWORD OneToOne 1 100 0.00 65535.00 FORMAT "%8.2" ECU_ADDRESS 0x9FECCE /end MEASUREMENT
/begin MEASUREMENT Dfp_FrmMngBEM1TO_mp "Fehlerpfad für Timeout-Fehler von Energiemanager (BEM1)-Botschaft" UWORD OneToOne 1 100 0.00 65535.00 FORMAT "%8.2" ECU_ADDRESS 0x9FECD0 /end MEASUREMENT
/begin MEASUREMENT Dfp_FrmMngBRK1Npl_mp "Messpunkt für Fehlerpfad FrmMngBRK1Npl (Botschaftszähler Fehler)" UWORD OneToOne 1 100 0.00 65535.00 FORMAT "%8.2" ECU_ADDRESS 0x9FECD2 /end MEASUREMENT
/begin MEASUREMENT Dfp_FrmMngBRK1TO_mp "Messpunkt fuer Fehlerpfad  Dfp_FrmMngBRK1TO" UWORD OneToOne 1 100 0.00 65535.00 FORMAT "%8.2" ECU_ADDRESS 0x9FECD4 /end MEASUREMENT
/begin MEASUREMENT Dfp_FrmMngBRK2Npl_mp "Messpunkt für Fehlerpfad FrmMngBRK2Npl (DLC-Fehler)" UWORD OneToOne 1 100 0.00 65535.00 FORMAT "%8.2" ECU_ADDRESS 0x9FECD6 /end MEASUREMENT
/begin MEASUREMENT Dfp_FrmMngBRK2TO_mp "Messpunkt fuer DSM Dfp_FrmMngBRK2TO_mp" UWORD OneToOne 1 100 0.00 65535.00 FORMAT "%8.2" ECU_ADDRESS 0x9FECD8 /end MEASUREMENT
/begin MEASUREMENT Dfp_FrmMngBRK8Npl_mp "Messpunkt für Fehlerpfad FrmMngBRK8Npl (Botschaftszähler und Checksummen Fehler)" UWORD OneToOne 1 100 0.00 65535.00 FORMAT "%8.2" ECU_ADDRESS 0x9FECDA /end MEASUREMENT
/begin MEASUREMENT Dfp_FrmMngBRK8TO_mp "Messpunkt fuer Fehlerpfad  Dfp_FrmMngBRK8TO" UWORD OneToOne 1 100 0.00 65535.00 FORMAT "%8.2" ECU_ADDRESS 0x9FECDC /end MEASUREMENT
/begin MEASUREMENT Dfp_FrmMngBSG3TO_mp "Fehlerpfad Timeout-Fehler der Botschaft BSG3" UWORD OneToOne 1 100 0.00 65535.00 FORMAT "%8.2" ECU_ADDRESS 0x9FECDE /end MEASUREMENT
/begin MEASUREMENT Dfp_FrmMngCANVerErr_mp "Fehlerpfad für falsche CAN-Version" UWORD OneToOne 1 100 0.00 65535.00 FORMAT "%8.2" ECU_ADDRESS 0x9FECE0 /end MEASUREMENT
/begin MEASUREMENT Dfp_FrmMngCCSel_mp "Plausibility Error => Audi-ACC" UWORD OneToOne 1 100 0.00 65535.00 FORMAT "%8.2" ECU_ADDRESS 0x9FECE2 /end MEASUREMENT
/begin MEASUREMENT Dfp_FrmMngCCTLNpl_mp "Messpunkt für Fehlerpfad FrmMngCCTLNpl (Botschaftszähler und Checksummen Fehler)" UWORD OneToOne 1 100 0.00 65535.00 FORMAT "%8.2" ECU_ADDRESS 0x9FECE4 /end MEASUREMENT
/begin MEASUREMENT Dfp_FrmMngCCTLTO_mp "Messpunkt fuer Fehlerpfad  Dfp_FrmMngCCTLTO" UWORD OneToOne 1 100 0.00 65535.00 FORMAT "%8.2" ECU_ADDRESS 0x9FECE6 /end MEASUREMENT
/begin MEASUREMENT Dfp_FrmMngChrgr1A_mp "Fehlerpfad für Chrgr1 Lage Regelabweichung" UWORD OneToOne 1 100 0.00 65535.00 FORMAT "%8.2" ECU_ADDRESS 0x9FECE8 /end MEASUREMENT
/begin MEASUREMENT Dfp_FrmMngChrgr1C_mp "Fehlerpfad für Chrgr1 Treiberstrom" UWORD OneToOne 1 100 0.00 65535.00 FORMAT "%8.2" ECU_ADDRESS 0x9FECEA /end MEASUREMENT
/begin MEASUREMENT Dfp_FrmMngCHRGR1Npl_mp "Messpunkt für Fehlerpfad FrmMngCHRGR1Npl (DLC-Fehler)" UWORD OneToOne 1 100 0.00 65535.00 FORMAT "%8.2" ECU_ADDRESS 0x9FECEC /end MEASUREMENT
/begin MEASUREMENT Dfp_FrmMngChrgr1N_mp "Fehlerpfad für Chrgr1 CAN Kommunikation" UWORD OneToOne 1 100 0.00 65535.00 FORMAT "%8.2" ECU_ADDRESS 0x9FECEE /end MEASUREMENT
/begin MEASUREMENT Dfp_FrmMngCHRGR1TO_mp "Fehlerpfad für Timeout der CAN-Message CHRGR1" UWORD OneToOne 1 100 0.00 65535.00 FORMAT "%8.2" ECU_ADDRESS 0x9FECF0 /end MEASUREMENT
/begin MEASUREMENT Dfp_FrmMngChrgr1T_mp "Fehlerpfad für Chrgr1 Treiberübertemperatur" UWORD OneToOne 1 100 0.00 65535.00 FORMAT "%8.2" ECU_ADDRESS 0x9FECF2 /end MEASUREMENT
/begin MEASUREMENT Dfp_FrmMngChrgr1V_mp "Fehlerpfad für Chrgr1 SRC Versorgungsspannung" UWORD OneToOne 1 100 0.00 65535.00 FORMAT "%8.2" ECU_ADDRESS 0x9FECF4 /end MEASUREMENT
/begin MEASUREMENT Dfp_FrmMngChrgr2A_mp "Fehlerpfad für Chrgr2 Lage Regelabweichung" UWORD OneToOne 1 100 0.00 65535.00 FORMAT "%8.2" ECU_ADDRESS 0x9FECF6 /end MEASUREMENT
/begin MEASUREMENT Dfp_FrmMngChrgr2C_mp "Fehlerpfad für Chrgr2 Treiberstrom" UWORD OneToOne 1 100 0.00 65535.00 FORMAT "%8.2" ECU_ADDRESS 0x9FECF8 /end MEASUREMENT
/begin MEASUREMENT Dfp_FrmMngCHRGR2Npl_mp "Messpunkt für Fehlerpfad FrmMngCHRGR2Npl (DLC-Fehler)" UWORD OneToOne 1 100 0.00 65535.00 FORMAT "%8.2" ECU_ADDRESS 0x9FECFA /end MEASUREMENT
/begin MEASUREMENT Dfp_FrmMngChrgr2N_mp "Fehlerpfad für Chrgr2 CAN Kommunikation" UWORD OneToOne 1 100 0.00 65535.00 FORMAT "%8.2" ECU_ADDRESS 0x9FECFC /end MEASUREMENT
/begin MEASUREMENT Dfp_FrmMngCHRGR2TO_mp "Fehlerpfad für Timeout der CAN-Message CHRGR2" UWORD OneToOne 1 100 0.00 65535.00 FORMAT "%8.2" ECU_ADDRESS 0x9FECFE /end MEASUREMENT
/begin MEASUREMENT Dfp_FrmMngChrgr2T_mp "Fehlerpfad für Chrgr2 Treiberübertemperatur" UWORD OneToOne 1 100 0.00 65535.00 FORMAT "%8.2" ECU_ADDRESS 0x9FED00 /end MEASUREMENT
/begin MEASUREMENT Dfp_FrmMngChrgr2V_mp "Fehlerpfad für Chrgr2 SRC Versorgungsspannung" UWORD OneToOne 1 100 0.00 65535.00 FORMAT "%8.2" ECU_ADDRESS 0x9FED02 /end MEASUREMENT
/begin MEASUREMENT Dfp_FrmMngDIA1Npl_mp "Messpunkt für Fehlerpfad FrmMngDIA1Npl (DLC-Fehler)" UWORD OneToOne 1 100 0.00 65535.00 FORMAT "%8.2" ECU_ADDRESS 0x9FED04 /end MEASUREMENT
/begin MEASUREMENT Dfp_FrmMngDIA1TO_mp "Fehlerpfad für Timeout-Fehler von Diagnose(DIA1)-Botschaft" UWORD OneToOne 1 100 0.00 65535.00 FORMAT "%8.2" ECU_ADDRESS 0x9FED06 /end MEASUREMENT
/begin MEASUREMENT Dfp_FrmMngDSP1Npl_mp "Messpunkt für Fehlerpfad FrmMngDSP1Npl (Botschaftszähler Fehler)" UWORD OneToOne 1 100 0.00 65535.00 FORMAT "%8.2" ECU_ADDRESS 0x9FED08 /end MEASUREMENT
/begin MEASUREMENT Dfp_FrmMngDSP1TO_mp "Messpunkt fuer Fehlerpfad  Dfp_FrmMngDSP1TO" UWORD OneToOne 1 100 0.00 65535.00 FORMAT "%8.2" ECU_ADDRESS 0x9FED0A /end MEASUREMENT
/begin MEASUREMENT Dfp_FrmMngDSP2Npl_mp "Messpunkt für Fehlerpfad FrmMngDSP2Npl (DLC-Fehler)" UWORD OneToOne 1 100 0.00 65535.00 FORMAT "%8.2" ECU_ADDRESS 0x9FED0C /end MEASUREMENT
/begin MEASUREMENT Dfp_FrmMngDSP2TO_mp "Messpunkt fuer Fehlerpfad  Dfp_FrmMngDSP2TO" UWORD OneToOne 1 100 0.00 65535.00 FORMAT "%8.2" ECU_ADDRESS 0x9FED0E /end MEASUREMENT
/begin MEASUREMENT Dfp_FrmMngDSP3Npl_mp "Messpunkt fuer Fehlerpfad  Dfp_FrmMngDSP3Npl" UWORD OneToOne 1 100 0.00 65535.00 FORMAT "%8.2" ECU_ADDRESS 0x9FED10 /end MEASUREMENT
/begin MEASUREMENT Dfp_FrmMngDSP3TO_mp "Messpunkt fuer Fehlerpfad  Dfp_FrmMngDSP3TO" UWORD OneToOne 1 100 0.00 65535.00 FORMAT "%8.2" ECU_ADDRESS 0x9FED12 /end MEASUREMENT
/begin MEASUREMENT Dfp_FrmMngEPB1Npl_mp "Fehlerpfad DLC-,Checksummen-, Botschaftszählerfehler der Botschaft EPB1" UWORD OneToOne 1 100 0.00 65535.00 FORMAT "%8.2" ECU_ADDRESS 0x9FED14 /end MEASUREMENT
/begin MEASUREMENT Dfp_FrmMngEPB1TO_mp "Fehlerpfad Timeout der Botschaft EPB1" UWORD OneToOne 1 100 0.00 65535.00 FORMAT "%8.2" ECU_ADDRESS 0x9FED16 /end MEASUREMENT
/begin MEASUREMENT Dfp_FrmMngErrValDFM_mp "Fehlerpfad Fehlerwert am ""Klemme DFM""-Signal empfangen" UWORD OneToOne 1 100 0.00 65535.00 FORMAT "%8.2" ECU_ADDRESS 0x9FED18 /end MEASUREMENT
/begin MEASUREMENT Dfp_FrmMngESCUNpl_mp "Messpunkt für Fehlerpfad FrmMngESCUNpl (DLC-Fehler)" UWORD OneToOne 1 100 0.00 65535.00 FORMAT "%8.2" ECU_ADDRESS 0x9FED1A /end MEASUREMENT
/begin MEASUREMENT Dfp_FrmMngESCUTO_mp "Messpunkt fuer Fehlerpfad  Dfp_FrmMngESCUTO" UWORD OneToOne 1 100 0.00 65535.00 FORMAT "%8.2" ECU_ADDRESS 0x9FED1C /end MEASUREMENT
/begin MEASUREMENT Dfp_FrmMngGW1Npl_mp "Messpunkt für Fehlerpfad FrmMngGW1Npl (DLC-Fehler)" UWORD OneToOne 1 100 0.00 65535.00 FORMAT "%8.2" ECU_ADDRESS 0x9FED1E /end MEASUREMENT
/begin MEASUREMENT Dfp_FrmMngGW1TO_mp "Fehlerpfad für Timeout-Fehler von Gateway (GW1)-Botschaft" UWORD OneToOne 1 100 0.00 65535.00 FORMAT "%8.2" ECU_ADDRESS 0x9FED20 /end MEASUREMENT
/begin MEASUREMENT Dfp_FrmMngILMNpl_mp "Messpunkt für Fehlerpfad FrmMngILMNpl (Botschaftszähler Fehler)" UWORD OneToOne 1 100 0.00 65535.00 FORMAT "%8.2" ECU_ADDRESS 0x9FED22 /end MEASUREMENT
/begin MEASUREMENT Dfp_FrmMngILMTO_mp "Timeout-Fehlerpfad Botschaft ILM" UWORD OneToOne 1 100 0.00 65535.00 FORMAT "%8.2" ECU_ADDRESS 0x9FED24 /end MEASUREMENT
/begin MEASUREMENT Dfp_FrmMngLICHT1TO_mp "Fehlerpfad Timeout-Fehler der Botschaft  LICHT1" UWORD OneToOne 1 100 0.00 65535.00 FORMAT "%8.2" ECU_ADDRESS 0x9FED26 /end MEASUREMENT
/begin MEASUREMENT Dfp_FrmMngLICHT2TO_mp "Fehlerpfad Timeout-Fehler der Botschaft  LICHT2" UWORD OneToOne 1 100 0.00 65535.00 FORMAT "%8.2" ECU_ADDRESS 0x9FED28 /end MEASUREMENT
/begin MEASUREMENT Dfp_FrmMngNIV1WrngCod_mp "Fehlerpfad für falsch codiertes NIVEAU Steuergerät" UWORD OneToOne 1 100 0.00 65535.00 FORMAT "%8.2" ECU_ADDRESS 0x9FED2A /end MEASUREMENT
/begin MEASUREMENT Dfp_FrmMngNIVEAU1Npl_mp "Messpunkt für Fehlerpfad FrmMngNIVEAU1Npl (Botschaftszähler und Checksummen Fehler)" UWORD OneToOne 1 100 0.00 65535.00 FORMAT "%8.2" ECU_ADDRESS 0x9FED2C /end MEASUREMENT
/begin MEASUREMENT Dfp_FrmMngNIVEAU1TO_mp "Messpunkt fuer Fehlerpfad  Dfp_FrmMngNIVEAU1TO" UWORD OneToOne 1 100 0.00 65535.00 FORMAT "%8.2" ECU_ADDRESS 0x9FED2E /end MEASUREMENT
/begin MEASUREMENT Dfp_FrmMngSA1Npl_mp "Messpunkt für Fehlerpfad FrmMngSA1Npl (Botschaftszähler und DLC Fehler)" UWORD OneToOne 1 100 0.00 65535.00 FORMAT "%8.2" ECU_ADDRESS 0x9FED30 /end MEASUREMENT
/begin MEASUREMENT Dfp_FrmMngSA1TO_mp "Messpunkt fuer Fehlerpfad  Dfp_FrmMngSA1TO" UWORD OneToOne 1 100 0.00 65535.00 FORMAT "%8.2" ECU_ADDRESS 0x9FED32 /end MEASUREMENT
/begin MEASUREMENT Dfp_FrmMngSTIGNNpl_mp "Messpunkt für Fehlerpfad FrmMngSTIGNNpl (DLC-Fehler)" UWORD OneToOne 1 100 0.00 65535.00 FORMAT "%8.2" ECU_ADDRESS 0x9FED34 /end MEASUREMENT
/begin MEASUREMENT Dfp_FrmMngStIgnTO_mp "Messpunkt fuer Fehlerpfad  Dfp_FrmMngStIgnTO" UWORD OneToOne 1 100 0.00 65535.00 FORMAT "%8.2" ECU_ADDRESS 0x9FED36 /end MEASUREMENT
/begin MEASUREMENT Dfp_FrmMngTOSNpl_mp "Messpunkt für Fehlerpfad FrmMngTOSNpl (DLC-Fehler)" UWORD OneToOne 1 100 0.00 65535.00 FORMAT "%8.2" ECU_ADDRESS 0x9FED38 /end MEASUREMENT
/begin MEASUREMENT Dfp_FrmMngTOSTO_mp "Fehlerpfad für Timeout-Fehler von TOG(TOS)-Botschaft" UWORD OneToOne 1 100 0.00 65535.00 FORMAT "%8.2" ECU_ADDRESS 0x9FED3A /end MEASUREMENT
/begin MEASUREMENT Dfp_FrmMngTrbnSpdErr_mp "Messpunkt fuer Fehlerpfad  Dfp_FrmMngTrbnSpdErr" UWORD OneToOne 1 100 0.00 65535.00 FORMAT "%8.2" ECU_ADDRESS 0x9FED3C /end MEASUREMENT
/begin MEASUREMENT Dfp_FrmMngTSC1Npl_mp "Messpunkt für Fehlerpfad FrmMngTSC1Npl (Botschaftszähler Fehler)" UWORD OneToOne 1 100 0.00 65535.00 FORMAT "%8.2" ECU_ADDRESS 0x9FED3E /end MEASUREMENT
/begin MEASUREMENT Dfp_FrmMngTSC1TO_mp "Messpunkt fuer Fehlerpfad  Dfp_FrmMngTSC1TO" UWORD OneToOne 1 100 0.00 65535.00 FORMAT "%8.2" ECU_ADDRESS 0x9FED40 /end MEASUREMENT
/begin MEASUREMENT Dfp_FrmMngTSC2Npl_mp "Messpunkt für Fehlerpfad FrmMngTSC2Npl (Botschaftszähler Fehler)" UWORD OneToOne 1 100 0.00 65535.00 FORMAT "%8.2" ECU_ADDRESS 0x9FED42 /end MEASUREMENT
/begin MEASUREMENT Dfp_FrmMngTSC2TO_mp "Messpunkt fuer Fehlerpfad  Dfp_FrmMngTSC2TO" UWORD OneToOne 1 100 0.00 65535.00 FORMAT "%8.2" ECU_ADDRESS 0x9FED44 /end MEASUREMENT
/begin MEASUREMENT Dfp_FrmMngTSC3Npl_mp "Messpunkt für Fehlerpfad FrmMngTSC3Npl (Botschaftszähler und Checksummen Fehler)" UWORD OneToOne 1 100 0.00 65535.00 FORMAT "%8.2" ECU_ADDRESS 0x9FED46 /end MEASUREMENT
/begin MEASUREMENT Dfp_FrmMngTSC3TO_mp "Messpunkt fuer Fehlerpfad Dfp_FrmMngTSC3TO" UWORD OneToOne 1 100 0.00 65535.00 FORMAT "%8.2" ECU_ADDRESS 0x9FED48 /end MEASUREMENT
/begin MEASUREMENT Dfp_FrmMngTSC6Npl_mp "Messpunkt fuer Fehlerpfad  Dfp_FrmMngTSC6Npl" UWORD OneToOne 1 100 0.00 65535.00 FORMAT "%8.2" ECU_ADDRESS 0x9FED4A /end MEASUREMENT
/begin MEASUREMENT Dfp_FrmMngTSC6TO_mp "Messpunkt fuer Fehlerpfad  Dfp_FrmMngTSC6TO" UWORD OneToOne 1 100 0.00 65535.00 FORMAT "%8.2" ECU_ADDRESS 0x9FED4C /end MEASUREMENT
/begin MEASUREMENT Dfp_FrmMngWIPERTO_mp "Fehlerpfad Timeout-Fehler der Botschaft WIPER" UWORD OneToOne 1 100 0.00 65535.00 FORMAT "%8.2" ECU_ADDRESS 0x9FED4E /end MEASUREMENT
/begin MEASUREMENT Dfp_FTSCDNpl_mp "Messpunkt fuer Fehlerpfad  Dfp_FTSCDNpl" UWORD OneToOne 1 100 0.00 65535.00 FORMAT "%8.2" ECU_ADDRESS 0x9FED50 /end MEASUREMENT
/begin MEASUREMENT Dfp_FTSCD_mp "Messpunkt fuer Fehlerpfad  Dfp_FTSCD" UWORD OneToOne 1 100 0.00 65535.00 FORMAT "%8.2" ECU_ADDRESS 0x9FED52 /end MEASUREMENT
/begin MEASUREMENT Dfp_GbSSCD_HW_mp "Fehlerpfad für Hardware fehler" UWORD OneToOne 1 100 0.00 65535.00 FORMAT "%8.2" ECU_ADDRESS 0x9FED54 /end MEASUREMENT
/begin MEASUREMENT Dfp_GbSSCD_mp "Fehlerpfad Drehzahlerfassung am Getriebeingang" UWORD OneToOne 1 100 0.00 65535.00 FORMAT "%8.2" ECU_ADDRESS 0x9FED56 /end MEASUREMENT
/begin MEASUREMENT Dfp_GearbxClthPlaus_mp "Fehlerpfad für Kupplungsplausibilität" UWORD OneToOne 1 100 0.00 65535.00 FORMAT "%8.2" ECU_ADDRESS 0x9FED58 /end MEASUREMENT
/begin MEASUREMENT Dfp_GearbxCVTnMax_mp "Drehzahl limit für die Deaktivierung des TII-Eingriffs beim CVT wurde überschritten" UWORD OneToOne 1 100 0.00 65535.00 FORMAT "%8.2" ECU_ADDRESS 0x9FED5A /end MEASUREMENT
/begin MEASUREMENT Dfp_GearbxINCCup_mp "Fehlerpfad für AST Integralmoment zu hoch (Tasse Diesel)" UWORD OneToOne 1 100 0.00 65535.00 FORMAT "%8.2" ECU_ADDRESS 0x9FED5C /end MEASUREMENT
/begin MEASUREMENT Dfp_GearbxNMinMon_mp "Dfp für die Leerlaufdrehzahlanhebung" UWORD OneToOne 1 100 0.00 65535.00 FORMAT "%8.2" ECU_ADDRESS 0x9FED5E /end MEASUREMENT
/begin MEASUREMENT Dfp_GearbxTransConv_mp "Dfpfehlerstatus der übermittelten Triebstrangübersetzung FrmMng_rTransConv" UWORD OneToOne 1 100 0.00 65535.00 FORMAT "%8.2" ECU_ADDRESS 0x9FED60 /end MEASUREMENT
/begin MEASUREMENT Dfp_GearbxTSC_mp "Status des Fehlerpfades Elektronische Getriebesteuerung zeitliche Begrenzung" UWORD OneToOne 1 100 0.00 65535.00 FORMAT "%8.2" ECU_ADDRESS 0x9FED62 /end MEASUREMENT
/begin MEASUREMENT Dfp_GearbxTypeMTErr_mp "Fehlerpfad für Getriebetypwert MT" UWORD OneToOne 1 100 0.00 65535.00 FORMAT "%8.2" ECU_ADDRESS 0x9FED64 /end MEASUREMENT
/begin MEASUREMENT Dfp_GlwCDDIAG_mp "Fehlerpfad zur GSK3-Protokollfehler" UWORD OneToOne 1 100 0.00 65535.00 FORMAT "%8.2" ECU_ADDRESS 0x9FED66 /end MEASUREMENT
/begin MEASUREMENT Dfp_GlwCDErr1_mp "Fehlerpfad zur fehlenden Kl30 (GSK3)" UWORD OneToOne 1 100 0.00 65535.00 FORMAT "%8.2" ECU_ADDRESS 0x9FED68 /end MEASUREMENT
/begin MEASUREMENT Dfp_GlwCDErr2_mp "Fehlerpfad zum Glühmodul-Fehler (GCU-T)" UWORD OneToOne 1 100 0.00 65535.00 FORMAT "%8.2" ECU_ADDRESS 0x9FED6A /end MEASUREMENT
/begin MEASUREMENT Dfp_GlwCDEvalCod_mp "Fehlerpfad zur GSK3- Kodierung" UWORD OneToOne 1 100 0.00 65535.00 FORMAT "%8.2" ECU_ADDRESS 0x9FED6C /end MEASUREMENT
/begin MEASUREMENT Dfp_GlwCDGSK2_mp "Fehlerpfad des physikalischen GSK2-Ausgangs" UWORD OneToOne 1 100 0.00 65535.00 FORMAT "%8.2" ECU_ADDRESS 0x9FED6E /end MEASUREMENT
/begin MEASUREMENT Dfp_GlwCDGSK3_mp "Fehlerpfad des physikalischen GSK3-Ausgangs" UWORD OneToOne 1 100 0.00 65535.00 FORMAT "%8.2" ECU_ADDRESS 0x9FED70 /end MEASUREMENT
/begin MEASUREMENT Dfp_GlwCDLmp_mp "Fehlerpfad für Glühlampe" UWORD OneToOne 1 100 0.00 65535.00 FORMAT "%8.2" ECU_ADDRESS 0x9FED72 /end MEASUREMENT
/begin MEASUREMENT Dfp_GlwCDPLUG0_mp "Fehlerpfad zur GSK3-Glühkerze 0" UWORD OneToOne 1 100 0.00 65535.00 FORMAT "%8.2" ECU_ADDRESS 0x9FED74 /end MEASUREMENT
/begin MEASUREMENT Dfp_GlwCDPLUG1_mp "Fehlerpfad zur GSK3-Glühkerze 1" UWORD OneToOne 1 100 0.00 65535.00 FORMAT "%8.2" ECU_ADDRESS 0x9FED76 /end MEASUREMENT
/begin MEASUREMENT Dfp_GlwCDPLUG2_mp "Fehlerpfad zur GSK3-Glühkerze 2" UWORD OneToOne 1 100 0.00 65535.00 FORMAT "%8.2" ECU_ADDRESS 0x9FED78 /end MEASUREMENT
/begin MEASUREMENT Dfp_GlwCDPLUG3_mp "Fehlerpfad zur GSK3-Glühkerze 3" UWORD OneToOne 1 100 0.00 65535.00 FORMAT "%8.2" ECU_ADDRESS 0x9FED7A /end MEASUREMENT
/begin MEASUREMENT Dfp_GlwCDPLUG4_mp "Fehlerpfad zur GSK3-Glühkerze 4" UWORD OneToOne 1 100 0.00 65535.00 FORMAT "%8.2" ECU_ADDRESS 0x9FED7C /end MEASUREMENT
/begin MEASUREMENT Dfp_GlwCDPLUG5_mp "Fehlerpfad zur GSK3-Glühkerze 5" UWORD OneToOne 1 100 0.00 65535.00 FORMAT "%8.2" ECU_ADDRESS 0x9FED7E /end MEASUREMENT
/begin MEASUREMENT Dfp_GlwCDsfd_mp "Fehlerpfad zum Summenfehler (GSK2)" UWORD OneToOne 1 100 0.00 65535.00 FORMAT "%8.2" ECU_ADDRESS 0x9FED80 /end MEASUREMENT
/begin MEASUREMENT Dfp_GlwCD_LampCan_mp "Messpunkt fuer Fehlerpfad  Dfp_GlwCD_LampCan" UWORD OneToOne 1 100 0.00 65535.00 FORMAT "%8.2" ECU_ADDRESS 0x9FED82 /end MEASUREMENT
/begin MEASUREMENT Dfp_HDSCD_mp "Messpunkt fuer Fehlerpfad  Dfp_HDSCD" UWORD OneToOne 1 100 0.00 65535.00 FORMAT "%8.2" ECU_ADDRESS 0x9FED84 /end MEASUREMENT
/begin MEASUREMENT Dfp_HWEMonCom_Low "LowByte von Dfp_HWEMonCom_mp" UBYTE OneToOne 1 100 0.00 255.0 FORMAT "%5.1" ECU_ADDRESS 0x7F938A /end MEASUREMENT
/begin MEASUREMENT Dfp_HWEMonCom_mp "Messpunkt fuer Fehlerpfad  Dfp_HWEMonCom" UWORD OneToOne 1 100 0.00 65535.00 FORMAT "%8.2" ECU_ADDRESS 0x9FED86 /end MEASUREMENT
/begin MEASUREMENT Dfp_HWEMonEEPROM_Low "LowByte of Dfp_HWEMonEEPROM_mp" UBYTE OneToOne 1 100 0.00 255.0 FORMAT "%5.1" ECU_ADDRESS 0x7F938B /end MEASUREMENT
/begin MEASUREMENT Dfp_HWEMonEEPROM_mp "Messpunkt fuer Fehlerpfad  Dfp_HWEMonEEPROM" UWORD OneToOne 1 100 0.00 65535.00 FORMAT "%8.2" ECU_ADDRESS 0x9FED88 /end MEASUREMENT
/begin MEASUREMENT Dfp_HWEMonRcyLocked_mp "Messpunkt fuer Fehlerpfad  Dfp_HWEMonRcyLocked" UWORD OneToOne 1 100 0.00 65535.00 FORMAT "%8.2" ECU_ADDRESS 0x9FED8A /end MEASUREMENT
/begin COMPU_METHOD Acc "Fahrzeugbeschleunigung" RAT_FUNC "%6.5" "[m/s^2]" COEFFS 0 1000 0 0 0 1 /end COMPU_METHOD
/begin COMPU_METHOD acc_q0p1 "Umrechnung für GS/DS-CrCtl-Adapter" RAT_FUNC "%6.3" "m/(s^2)" COEFFS 0 1 0 0 0 0.1 /end COMPU_METHOD
/begin COMPU_METHOD AngleCaS "Winkel Nockenwelle" RAT_FUNC "%6.4" "[deg CaS]" COEFFS 0 85.3333333333334 0 0 0 1 /end COMPU_METHOD
/begin COMPU_METHOD AngleCrS "Winkel Kurbelwelle" RAT_FUNC "%6.4" "[deg CrS]" COEFFS 0 42.6666666666667 0 0 0 1 /end COMPU_METHOD
/begin COMPU_METHOD ASD_GvrnDT1T1_float "Zeitkonstante T1 (in s) für PT1, DT1 beim ARD" RAT_FUNC "%6.2" "s" COEFFS 0 1 0 0 0 1 /end COMPU_METHOD
/begin COMPU_METHOD bfzg_sw_q4p239Em4 "Umrechnung für GS/DS-CrCtl-Adapter" RAT_FUNC "%10.7" "m/s^2" COEFFS 0 1 0 0 0 0.0004239 /end COMPU_METHOD
/begin COMPU_METHOD dez "K3 Umwandlungen" RAT_FUNC "%6.2" "" COEFFS 0 1 0 0 0 1 /end COMPU_METHOD
/begin COMPU_METHOD dTrq "Umrtechnungsformel dTrq/dTime" RAT_FUNC "%6.3" "Nm/s" COEFFS 0 10 0 0 0 1 /end COMPU_METHOD
/begin COMPU_METHOD DtyCyc "Tastverhaeltnis" RAT_FUNC "%6.4" "[%]" COEFFS 0 100 0 0 0 1 /end COMPU_METHOD
/begin COMPU_METHOD EGTFact "Umrechnung für EGT_TempGvnr Ausgabeschnittstellen und Messpunkte" RAT_FUNC "%6.5" "-" COEFFS 0 1000 0 0 0 1 /end COMPU_METHOD
/begin COMPU_METHOD EGTSwt "Umrechnung für EGT Rampenschalter (1 / 1000*2^14 )" RAT_FUNC "%10.9" "-" COEFFS 0 16384000 0 0 0 1 /end COMPU_METHOD
/begin COMPU_METHOD Energy_J "Energie in jouls" RAT_FUNC "%6.2" "[J]" COEFFS 0 1 0 0 0 1 /end COMPU_METHOD
/begin COMPU_METHOD EngN "Motordrehzahl" RAT_FUNC "%6.2" "[rpm]" COEFFS 0 1 0 0 0 1 /end COMPU_METHOD
/begin COMPU_METHOD EngN_HiRes "Motordrehzahl, höhere Auflösung als EngM" RAT_FUNC "%6.4" "[rpm]" COEFFS 0 32 0 0 0 1 /end COMPU_METHOD
/begin COMPU_METHOD Fact "Faktor mit Auflösung 1 / 8192, hauptsächlich für einen Faktorenbereich 0...1 verwendet" RAT_FUNC "%6.5" "[-]" COEFFS 0 8192 0 0 0 1 /end COMPU_METHOD
/begin COMPU_METHOD Fact1 "Faktor mit Auflösung 0,01 (100 mal höherer Bereich als Fact)" RAT_FUNC "%6.4" "[-]" COEFFS 0 128 0 0 0 1 /end COMPU_METHOD
/begin COMPU_METHOD Fact_BIP "Auflösung der BIP-Berechnungen" RAT_FUNC "%6.5" "[-]" COEFFS 0 4096 0 0 0 1 /end COMPU_METHOD
/begin COMPU_METHOD Fact_HFM6 "Umrechnung für einen Faktor mit 14 Bit Auflösung" RAT_FUNC "%7.6" "-" COEFFS 0 16384 0 0 0 1 /end COMPU_METHOD
/begin COMPU_METHOD fak_q0p0009766 "Umrechnung für GS/DS-CrCtl-Adapter" RAT_FUNC "%6.5" "-" COEFFS 0 65536 0 0 0 64 /end COMPU_METHOD
/begin COMPU_METHOD fak_q0p005 "Umrechnung für GS/DS-CrCtl-Adapter" RAT_FUNC "%6.4" "" COEFFS 0 200 0 0 0 1 /end COMPU_METHOD
/begin COMPU_METHOD fak_q0p02 "Umrechnung für GS/DS-CrCtl-Adapter" RAT_FUNC "%6.4" "" COEFFS 0 50 0 0 0 1 /end COMPU_METHOD
/begin COMPU_METHOD fak_q0p03125 "Umrechnung für GS/DS-CrCtl-Adapter" RAT_FUNC "%6.4" "" COEFFS 0 32 0 0 0 1 /end COMPU_METHOD
/begin COMPU_METHOD fak_q0p0625 "Umrechnung für GS/DS-CrCtl-Adapter" RAT_FUNC "%6.4" "-" COEFFS 0 16 0 0 0 1 /end COMPU_METHOD
/begin COMPU_METHOD fak_sw_b2 "Umrechnung für GS/DS-CrCtl-Adapter" RAT_FUNC "%7.6" "-" COEFFS 0 65536 0 0 0 4 /end COMPU_METHOD
/begin COMPU_METHOD FCMChkCause "Verbale Umrechnung für Message für DSM internen gebrauch (unterstützung bei DSM problemen)" TAB_VERB "%6.3" "" COMPU_TAB_REF FCMChkCause /end COMPU_METHOD
/begin COMPU_VTAB FCMChkCause "Verbale Umrechnung für Message für DSM internen gebrauch (unterstützung bei DSM problemen)" TAB_VERB 15 1 "fcmEnd npl: fcmEnd > FCM_TAB_SIZE" 2 "Erf and Typ npl" 3 "fcmEnd npl: line == fcmEnd" 4 "Mem set but no entry" 5 "No Mem set but entry" 6 "Mem npl class blocked" 7 "class npl" 8 "Mil npl 1" 9 "Mil npl 2" 10 "Scatt npl" 11 "Flc npl" 12 "Hlc npl" 13 "Fcm blocked" 14 "complement npl" 15 "dpfToClear are blocked" /end COMPU_VTAB
/begin COMPU_METHOD FlConsum_l_h "Kraftstoffverbrauch" RAT_FUNC "%6.4" "[l/h]" COEFFS 0 100 0 0 0 1 /end COMPU_METHOD
/begin COMPU_METHOD FlConsum_ul "Verbrauchsintegral (in Mikroliter)" RAT_FUNC "%6.2" "[ul]" COEFFS 0 1 0 0 0 1 /end COMPU_METHOD
/begin COMPU_METHOD FlConsum_ul_High "Treibstoffverbrauch" RAT_FUNC "%6.4" "[ul]" COEFFS 0 20 0 0 0 1 /end COMPU_METHOD
/begin COMPU_METHOD Flvol_ml_fine "Kraftstoffmenge hohe auflösung [ml]" RAT_FUNC "%6.5" "[ml]" COEFFS 0 1000 0 0 0 1 /end COMPU_METHOD
/begin COMPU_METHOD Fl_2 "Umrechnung for getting 16 bit  total fuel consumption" RAT_FUNC "%6.1" "l" COEFFS 0 0.1 0 0 0 1 /end COMPU_METHOD
/begin COMPU_METHOD Fl_Vol "Kraftstoffverbrauch pro 100 km" RAT_FUNC "%6.5" "l/100km" COEFFS 0 1000 0 0 0 1 /end COMPU_METHOD
/begin COMPU_METHOD InjMass "Einspritzmenge" RAT_FUNC "%6.4" "[mg/hub]" COEFFS 0 100 0 0 0 1 /end COMPU_METHOD
/begin COMPU_METHOD InjMassHCI "Einspritzmenge pro Sekunde für HC-Einspritzung" RAT_FUNC "%6.4" "[mg]" COEFFS 0 100 0 0 0 1 /end COMPU_METHOD
/begin COMPU_METHOD InjMassPerMolHCI "Einspritzungmasse pro Mol in g/mol" RAT_FUNC "%6.4" "[g/mol]" COEFFS 0 200 0 0 0 1 /end COMPU_METHOD
/begin COMPU_METHOD InjMassPerSec "Steigung der Einspritzungmasse im Zyklus 20ms" RAT_FUNC "%6.4" "[g/s]" COEFFS 0 100 0 0 0 1 /end COMPU_METHOD
/begin COMPU_METHOD InjQnt "Einspritzvolumen/Hub" RAT_FUNC "%6.3" "[mm^3/hub]" COEFFS 0 10 0 0 0 1 /end COMPU_METHOD
/begin COMPU_METHOD InjTime_us "Zeit in Microsekunden für das Einspritztiming" RAT_FUNC "%6.2" "[us]" COEFFS 0 1 0 0 0 1 /end COMPU_METHOD
/begin COMPU_METHOD J_Sec_HCI "Kraftstoffenergie in j/s" RAT_FUNC "%6.2" "[j/s]" COEFFS 0 1 0 0 0 1 /end COMPU_METHOD
/begin COMPU_METHOD Kd "Differentialverstärkung Kd (gleiche Einheit/Umrechnungsformel an Ein- und Ausgang)" RAT_FUNC "%7.6" "[1/1]" COEFFS 0 65536 0 0 0 1 /end COMPU_METHOD
/begin COMPU_METHOD Kd_1 "Differentialverstärkung Kd (gleiche Einheit/Umrechnungsregel an Ein- und Ausgang; Umrechnung für sint16-Werte)" RAT_FUNC "%6.4" "[1/1]" COEFFS 0 512 0 0 0 1 /end COMPU_METHOD
/begin COMPU_METHOD Ki_1 "Integrale Verstärkung Ki (gleiche Einheit/Umrechnungsregel an Ein- und Ausgang; Umrechnung für sint16-Werte)" RAT_FUNC "%6.4" "[1/s]" COEFFS 0 67.108864 0 0 0 1 /end COMPU_METHOD
/begin COMPU_METHOD KI_LMBD2PRC "Verstärkungkonstante des Integrators (Lambdawert zu Prozent)" RAT_FUNC "%6.4" "[%/s]" COEFFS 0 26.8435456 0 0 0 1 /end COMPU_METHOD
/begin COMPU_METHOD lambda "Lambda" RAT_FUNC "%6.5" "[-]" COEFFS 0 1000 0 0 0 1 /end COMPU_METHOD
/begin COMPU_METHOD leist_q1_kW "Leistung in kW" RAT_FUNC "%6.2" "kW" COEFFS 0 1 0 0 0 1 /end COMPU_METHOD
/begin COMPU_METHOD nmot_uw_q0p25 "K3 Umwandlungen" RAT_FUNC "%6.3" "1/min" COEFFS 0 1 0 0 0 0.25 /end COMPU_METHOD
/begin COMPU_METHOD OneToOne "eins zu eins (physikalischer Wert ist gleich dem internen Wert)" RAT_FUNC "%6.2" "[-]" COEFFS 0 1 0 0 0 1 /end COMPU_METHOD
/begin COMPU_METHOD Period_ms "Periodendauer in ms" RAT_FUNC "%6.3" "[ms]" COEFFS 0 10 0 0 0 1 /end COMPU_METHOD
/begin COMPU_METHOD Per_Dur "Periodendauer Segmentzeit" RAT_FUNC "%6.2" "[usec]" COEFFS 0 1 0 0 0 1 /end COMPU_METHOD
/begin COMPU_METHOD Per_Dur_Ns "Periodendauer Segmentzeit (ns)" RAT_FUNC "%6.2" "nsec" COEFFS 0 1 0 0 0 1 /end COMPU_METHOD
/begin COMPU_METHOD Prc "Prozent, gleiche interne Auflösung wie Fact, aber Darstellung in Prozent (0...100%)" RAT_FUNC "%6.4" "[%]" COEFFS 0 100 0 0 0 1 /end COMPU_METHOD
/begin COMPU_METHOD Pres_hPa "Druck (angezeigt in [hPa])" RAT_FUNC "%6.2" "[hPa]" COEFFS 0 1 0 0 0 1 /end COMPU_METHOD
/begin COMPU_METHOD Pwr "Leistung" RAT_FUNC "%6.2" "[W]" COEFFS 0 0.10610329539459 0 0 0 1 /end COMPU_METHOD
/begin COMPU_METHOD qvn_q1Em5 "Umrechnung für GS/DS-CrCtl-Adapter" RAT_FUNC "%8.7" "-" COEFFS 0 1 0 0 0 1e-05 /end COMPU_METHOD
/begin COMPU_METHOD RmpEngN_LIGov "Motordrehzahlgradient für Leerlaufreglerrampe" RAT_FUNC "%6.4" "[rpm/s]" COEFFS 0 458.752 0 0 0 1 /end COMPU_METHOD
/begin COMPU_METHOD RmpTrq "Rampengradient für Motormoment" RAT_FUNC "%6.4" "[Nm/s]" COEFFS 0 655.36 0 0 0 1 /end COMPU_METHOD
/begin COMPU_METHOD spg_q0p1 "Umrechnung für GS/DS-CrCtl-Adapter" RAT_FUNC "%6.3" "V" COEFFS 0 1 0 0 0 0.1 /end COMPU_METHOD
/begin COMPU_METHOD t20msxs_ub_b5p1 "K3 Umwandlungen" RAT_FUNC "%6.4" "s" COEFFS 0 1 0 0 0 0.02 /end COMPU_METHOD
/begin COMPU_METHOD TempDiff_Kelv "Offsettemperatur dargestellt in [K]" RAT_FUNC "%6.3" "[ deg C ]" COEFFS 0 10 0 0 0 1 /end COMPU_METHOD
/begin COMPU_METHOD Temp_Cels "Temperatur dargestellt in °C (gleiche interne Darstellung wie Temp_Kelv)" RAT_FUNC "%6.1" "[deg C]" COEFFS 0 10 2731.4 0 0 1 /end COMPU_METHOD
/begin COMPU_METHOD Temp_Kelv_Sec_CtT_Mod "Temperaturerhöhung für Thermostatdiagnose" RAT_FUNC "%7.6" "[deg C/s]" COEFFS 0 40960 0 0 0 1 /end COMPU_METHOD
/begin COMPU_METHOD TimeDelay_s "Zeitkonstante T1 (in s) für PT1, DT1, etc." RAT_FUNC "%9.3" "[s]" COEFFS 0 0 1 0 0.00023283064365387 0 /end COMPU_METHOD
/begin COMPU_METHOD TimeDT "Abtastzeit (in us) für Library Regler, Filter, etc." RAT_FUNC "%6.2" "[us]" COEFFS 0 1 0 0 0 1 /end COMPU_METHOD
/begin COMPU_METHOD Time_DynTst "Zeitumrechung für dynamischen test mit geringerer Auflösung, damit es für KL Ausgang passt" RAT_FUNC "%6.2" "[s]" COEFFS 0 0.390625 0 0 0 1 /end COMPU_METHOD
/begin COMPU_METHOD Time_ms "Zeit in ms für Fehlerentprellung (DSM) und SW-Timer" RAT_FUNC "%6.1" "[ms]" COEFFS 0 0.1 0 0 0 1 /end COMPU_METHOD
/begin COMPU_METHOD Time_s "Zeit in s für Fehlerentprellung (DSM) und SW-Timer" RAT_FUNC "%6.4" "[s]" COEFFS 0 100 0 0 0 1 /end COMPU_METHOD
/begin COMPU_METHOD TransR "Übersetzungsverhältnis (Getriebe etc.)" RAT_FUNC "%6.4" "[-]" COEFFS 0 100 0 0 0 1 /end COMPU_METHOD
/begin COMPU_METHOD Trq "Motormoment" RAT_FUNC "%6.3" "[Nm]" COEFFS 0 10 0 0 0 1 /end COMPU_METHOD
/begin COMPU_METHOD TrqDT "zeitlich aufintegriertes Kupplungsmoment" RAT_FUNC "%6.2" "[Nm*s]" COEFFS 0 1 0 0 0 1 /end COMPU_METHOD
/begin COMPU_METHOD TrqPerSec "Motormomentengradient" RAT_FUNC "%6.2" "[Nm/s]" COEFFS 0 1 0 0 0 1 /end COMPU_METHOD
/begin COMPU_METHOD TrqPrpHigh "vortriebsmoment" RAT_FUNC "%6.3" "[Nm]" COEFFS 0 10 0 0 0 1 /end COMPU_METHOD
/begin COMPU_METHOD UI_Curr "Magnetventilstrom fuer Pumpe-Duese-Element" RAT_FUNC "%6.1" "[mA]" COEFFS 0 0.0300346940351333 0 0 0 1 /end COMPU_METHOD
/begin COMPU_METHOD Vel "Fahrzeuggeschwindigkeit, gleiche interne Auflösung wie Vel_SI" RAT_FUNC "%6.4" "[km/h]" COEFFS 0 100 0 0 0 1 /end COMPU_METHOD
/begin COMPU_METHOD vfzg_q0p01 "Umrechnung für GS/DS-CrCtl-Adapter" RAT_FUNC "%6.4" "km/h" COEFFS 0 1 0 0 0 0.01 /end COMPU_METHOD
/begin COMPU_METHOD vfzg_q1p0 "Umrechnung für GS/DS-CrCtl-Adapter" RAT_FUNC "%6.2" "km/h" COEFFS 0 1 0 0 0 1 /end COMPU_METHOD
/begin COMPU_METHOD Volt "Spannung in V (von ADC)" RAT_FUNC "%6.2" "[mV]" COEFFS 0 0.2046 0 0 0 1 /end COMPU_METHOD
/begin COMPU_METHOD Volt_Batt "Batteriespannung" RAT_FUNC "%6.1" "[mV]" COEFFS 0 0.0492252911173131 0 0 0 1 /end COMPU_METHOD
/begin COMPU_METHOD default "" RAT_FUNC "%6.2" "" COEFFS 0 1 0 0 0 1 /end COMPU_METHOD
/end MODULE
/end PROJECT
