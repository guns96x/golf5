ASAP2_VERSION 1 3
/begin PROJECT X447 "EDC16U34"
/begin HEADER "" VERSION "VAA1" PROJECT_NO X447 /end HEADER
/begin MODULE DIM ""
/begin MOD_COMMON "" BYTE_ORDER MSB_FIRST ALIGNMENT_BYTE 1 ALIGNMENT_WORD 2 ALIGNMENT_LONG 4 ALIGNMENT_FLOAT32_IEEE 4 /end MOD_COMMON
/begin CHARACTERISTIC Clg_stCtl_C "Bitcodierter Schalter für das Modul:Kühlung" VALUE 0x1CCA40 Kw_Wu8 255.0 OneToOne 0.00 255.0 FORMAT "%5.1" /end CHARACTERISTIC
/begin CHARACTERISTIC EngPrt_dfacBoostPos_C "Positive Rampensteigung für Boost-Faktor" VALUE 0x1D45B8 Kw_Wu32 7999.99399856 Rmp_Fact 0.00599958002567 7999.99999814 FORMAT "%13.8" EXTENDED_LIMITS 0.00 7999.99999814 /end CHARACTERISTIC
/begin CHARACTERISTIC EngPrt_dfacBoostNeg_C "Negative Rampensteigung für Boost-Faktor" VALUE 0x1D45BC Kw_Wu32 7999.99399856 Rmp_Fact 0.00599958002567 7999.99999814 FORMAT "%13.8" EXTENDED_LIMITS 0.00 7999.99999814 /end CHARACTERISTIC
/begin CHARACTERISTIC EngPrt_dfacChgrUp_C "Rampenparameter für defekten Lader" VALUE 0x1D49C4 Kw_Wu32 7999.99399856 Rmp_Fact 0.00599958002567 7999.99999814 FORMAT "%13.8" EXTENDED_LIMITS 0.00 7999.99999814 /end CHARACTERISTIC
/begin CHARACTERISTIC EngPrt_dfacChgrDwn_C "Rampenparameter für defekten Lader" VALUE 0x1D49C8 Kw_Wu32 7999.99399856 Rmp_Fact 0.00599958002567 7999.99999814 FORMAT "%13.8" EXTENDED_LIMITS 0.00 7999.99999814 /end CHARACTERISTIC
/begin CHARACTERISTIC EngPrt_dfacCTOvhtUp_C "Rampensteigung bei Kochschutz aktiv" VALUE 0x1D49CC Kw_Wu32 7999.99399856 Rmp_Fact 0.00599958002567 7999.99999814 FORMAT "%13.8" EXTENDED_LIMITS 0.00 7999.99999814 /end CHARACTERISTIC
/begin CHARACTERISTIC EngPrt_dfacCTOvhtDwn_C "Rampensteigung bei Kochschutz aktiv" VALUE 0x1D49D0 Kw_Wu32 7999.99399856 Rmp_Fact 0.00599958002567 7999.99999814 FORMAT "%13.8" EXTENDED_LIMITS 0.00 7999.99999814 /end CHARACTERISTIC
/begin CHARACTERISTIC EngPrt_facFlClgDSPHysXLow_C "Untere Grenze Hysterese" VALUE 0x1D49D4 Kw_Ws16 1.000000 Fact 0.00 1.000000 FORMAT "%8.6" EXTENDED_LIMITS -4.000000 3.999878 /end CHARACTERISTIC
/begin CHARACTERISTIC EngPrt_facFlClgDSPHysXHigh_C "Obere Grenze Hysterese" VALUE 0x1D49D6 Kw_Ws16 1.000000 Fact 0.00 1.000000 FORMAT "%8.6" EXTENDED_LIMITS -4.000000 3.999878 /end CHARACTERISTIC
/begin CHARACTERISTIC EngPrt_stFlClgDSPHysYLow_C "Unterer Ausgangswert Hysterese" VALUE 0x1D49D8 Kw_Ws16 1.000000 OneToOne 0.00 1.000000 FORMAT "%8.6" EXTENDED_LIMITS -32768.00 32767.00 /end CHARACTERISTIC
/begin CHARACTERISTIC EngPrt_stFlClgDSPHysYHigh_C "Oberer Ausgangswert Hysterese" VALUE 0x1D49DA Kw_Ws16 1.000000 OneToOne 0.00 1.000000 FORMAT "%8.6" EXTENDED_LIMITS -32768.00 32767.00 /end CHARACTERISTIC
/begin CHARACTERISTIC EngPrt_facAirOvhtPrv_MAP "Überhitzungsschutz Ladeluft-Kennfeld" MAP 0x1D49DC Kf_Xs16_Ys16_Ws16 3.999878 Fact 0.00 3.999878 FORMAT "%8.6" EXTENDED_LIMITS -4.000000 3.999878
 /begin AXIS_DESCR STD_AXIS IATSCD_tAir Temp_Cels 10 -50.14000 199.8600 FORMAT "%8.4" EXTENDED_LIMITS -3549.940 3003.560 DEPOSIT ABSOLUTE /end AXIS_DESCR
 /begin AXIS_DESCR STD_AXIS Eng_nAvrg EngN 10 0.00 6000.000 FORMAT "%8.3" EXTENDED_LIMITS -32768.00 32767.00 DEPOSIT ABSOLUTE /end AXIS_DESCR
/end CHARACTERISTIC
/begin CHARACTERISTIC EngPrt_facAPCorr_MAP "Höhenabhängiges Drehzahl-Kennfeld" MAP 0x1D4AD0 Kf_Xs16_Ys16_Ws16 3.999878 Fact 0.00 3.999878 FORMAT "%8.6" EXTENDED_LIMITS -4.000000 3.999878
 /begin AXIS_DESCR STD_AXIS APSCD_pVal Pres_hPa 10 -32768.00 32767.00 FORMAT "%8.2" DEPOSIT ABSOLUTE /end AXIS_DESCR
 /begin AXIS_DESCR STD_AXIS Eng_nAvrg EngN 10 0.00 6000.000 FORMAT "%8.3" EXTENDED_LIMITS -32768.00 32767.00 DEPOSIT ABSOLUTE /end AXIS_DESCR
/end CHARACTERISTIC
/begin CHARACTERISTIC EngPrt_facBoost1_MAP "MAP zur Faktorbestimmung aufgrund Fahrpedal- und An-sauglufttemp-" MAP 0x1D45C0 Kf_Xs16_Ys16_Ws16 3.999878 Fact 0.00 3.999878 FORMAT "%8.6" EXTENDED_LIMITS -4.000000 3.999878
 /begin AXIS_DESCR STD_AXIS APPCD_rFlt Prc 2 -327.6800 327.6700 FORMAT "%8.4" DEPOSIT ABSOLUTE /end AXIS_DESCR
 /begin AXIS_DESCR STD_AXIS IATSCD_tAir Temp_Cels 2 -3549.940 3003.560 FORMAT "%8.3" DEPOSIT ABSOLUTE /end AXIS_DESCR
/end CHARACTERISTIC
/begin CHARACTERISTIC EngPrt_facBoost2_MAP "MAP zur Faktorbestimmung aufgrund Fahrzeuggeschwindig-keit" MAP 0x1D45D4 Kf_Xs16_Ys16_Ws16 3.999878 Fact 0.00 3.999878 FORMAT "%8.6" EXTENDED_LIMITS -4.000000 3.999878
 /begin AXIS_DESCR STD_AXIS VSSCD_v Vel 2 -327.6800 327.6700 FORMAT "%8.4" DEPOSIT ABSOLUTE /end AXIS_DESCR
 /begin AXIS_DESCR STD_AXIS VSSCD_a Acc 2 -32.76800 32.76700 FORMAT "%8.5" DEPOSIT ABSOLUTE /end AXIS_DESCR
/end CHARACTERISTIC
/begin CHARACTERISTIC EngPrt_facBPAPIncLoadCorr_MAP "Kennfeld zur Korrektur der Volllasterhöhung" MAP 0x1D4BC4 Kf_Xs16_Ys16_Ws16 3.999878 Fact 0.00 3.999878 FORMAT "%8.6" EXTENDED_LIMITS -4.000000 3.999878
 /begin AXIS_DESCR STD_AXIS Eng_tEng Temp_Cels 4 -50.14000 199.8600 FORMAT "%8.4" EXTENDED_LIMITS -3549.940 3003.560 DEPOSIT ABSOLUTE /end AXIS_DESCR
 /begin AXIS_DESCR STD_AXIS EngPrt_pVal_mp Pres_hPa 5 0.00 3500.000 FORMAT "%8.3" EXTENDED_LIMITS -32768.00 32767.00 DEPOSIT ABSOLUTE /end AXIS_DESCR
/end CHARACTERISTIC
/begin CHARACTERISTIC EngPrt_facChgrPrt_CUR "Kennlinie für Begrenzungsfaktor bei defektem Lader" CURVE 0x1D4C02 Kl_Xs16_Ws16 3.999878 Fact 0.00 3.999878 FORMAT "%8.6" EXTENDED_LIMITS -4.000000 3.999878
 /begin AXIS_DESCR STD_AXIS PCR_pBGDev Pres_hPa 8 -32768.00 32767.00 FORMAT "%8.2" DEPOSIT ABSOLUTE /end AXIS_DESCR
/end CHARACTERISTIC
/begin CHARACTERISTIC EngPrt_facCTOvhtPrv_MAP "Kennfeld Überhitzungsschutz aus Motortemperatur und Fahrgeschwindigkeit" MAP 0x1D4C24 Kf_Xs16_Ys16_Ws16 3.999878 Fact 0.00 3.999878 FORMAT "%8.6" EXTENDED_LIMITS -4.000000 3.999878
 /begin AXIS_DESCR STD_AXIS CTSCD_tClntCan Temp_Cels 6 -50.14000 149.8600 FORMAT "%8.4" EXTENDED_LIMITS -3549.940 3003.560 DEPOSIT ABSOLUTE /end AXIS_DESCR
 /begin AXIS_DESCR STD_AXIS VSSCD_v Vel 10 0.00 300.0000 FORMAT "%8.4" EXTENDED_LIMITS -327.6800 327.6700 DEPOSIT ABSOLUTE /end AXIS_DESCR
/end CHARACTERISTIC
/begin CHARACTERISTIC EngPrt_facFlTempLim_MAP "Überhitzungsschutz Kraftstoff-Kennfeld" MAP 0x1D4CC0 Kf_Xs16_Ys16_Ws16 3.999878 Fact 0.00 3.999878 FORMAT "%8.6" EXTENDED_LIMITS -4.000000 3.999878
 /begin AXIS_DESCR STD_AXIS EngPrt_tFuel_mp Temp_Cels 10 -50.14000 149.8600 FORMAT "%8.4" EXTENDED_LIMITS -3549.940 3003.560 DEPOSIT ABSOLUTE /end AXIS_DESCR
 /begin AXIS_DESCR STD_AXIS Eng_nAvrg EngN 10 0.00 6000.000 FORMAT "%8.3" EXTENDED_LIMITS -32768.00 32767.00 DEPOSIT ABSOLUTE /end AXIS_DESCR
/end CHARACTERISTIC
/begin CHARACTERISTIC EngPrt_facOilOvhtPrv_MAP "Kennfeld Überhitzungsschutz Oil" MAP 0x1D4DB4 Kf_Xs16_Ys16_Ws16 3.999878 Fact 0.00 3.999878 FORMAT "%8.6" EXTENDED_LIMITS -4.000000 3.999878
 /begin AXIS_DESCR STD_AXIS OTSCD_tEngOil Temp_Cels 10 -3549.940 3003.560 FORMAT "%8.3" DEPOSIT ABSOLUTE /end AXIS_DESCR
 /begin AXIS_DESCR STD_AXIS Eng_nAvrg EngN 10 0.00 6000.000 FORMAT "%8.3" EXTENDED_LIMITS -32768.00 32767.00 DEPOSIT ABSOLUTE /end AXIS_DESCR
/end CHARACTERISTIC
/begin CHARACTERISTIC EngPrt_facTempBoostPreTrbn_MAP "MAP für Abregelfaktor bei Boost aktiv" MAP 0x1D4EA8 Kf_Xs16_Ys16_Ws16 3.999878 Fact 0.00 3.999878 FORMAT "%8.6" EXTENDED_LIMITS -4.000000 3.999878
 /begin AXIS_DESCR STD_AXIS EngPrt_tPreTrbn Temp_Cels 2 -45.04000 1049.960 FORMAT "%8.3" EXTENDED_LIMITS -3549.940 3003.560 DEPOSIT ABSOLUTE /end AXIS_DESCR
 /begin AXIS_DESCR STD_AXIS Eng_nAvrg EngN 2 0.00 6000.000 FORMAT "%8.3" EXTENDED_LIMITS -32768.00 32767.00 DEPOSIT ABSOLUTE /end AXIS_DESCR
/end CHARACTERISTIC
/begin CHARACTERISTIC EngPrt_facTempPreTrbn_MAP "Kennfeld zur Ermittlung des Momenten-Begrenzungsfaktors zur Limitierung der Temperatur vor der Abgasturbine" MAP 0x1D4EBC Kf_Xs16_Ys16_Ws16 3.999878 Fact 0.00 3.999878 FORMAT "%8.6" EXTENDED_LIMITS -4.000000 3.999878
 /begin AXIS_DESCR STD_AXIS EngPrt_tPreTrbn Temp_Cels 8 -45.04000 1049.960 FORMAT "%8.3" EXTENDED_LIMITS -3549.940 3003.560 DEPOSIT ABSOLUTE /end AXIS_DESCR
 /begin AXIS_DESCR STD_AXIS Eng_nAvrg EngN 8 0.00 6000.000 FORMAT "%8.3" EXTENDED_LIMITS -32768.00 32767.00 DEPOSIT ABSOLUTE /end AXIS_DESCR
/end CHARACTERISTIC
/begin CHARACTERISTIC EngPrt_nIncLoadHigh_C "Obere Drehzahlgrenze der motortemperaturabhängigen Volllasterhöhung" VALUE 0x1D4F60 Kw_Ws16 6000.000 EngN 0.00 6000.000 FORMAT "%8.3" EXTENDED_LIMITS -32768.00 32767.00 /end CHARACTERISTIC
/begin CHARACTERISTIC EngPrt_nIncLoadLow_C "Untere Drehzahlgrenze der motortemperaturabhängigen Volllasterhöhung" VALUE 0x1D4F62 Kw_Ws16 6000.000 EngN 0.00 6000.000 FORMAT "%8.3" EXTENDED_LIMITS -32768.00 32767.00 /end CHARACTERISTIC
/begin CHARACTERISTIC EngPrt_nOvhtThresHigh_C "Obere Drehzahlschwelle für Wassertemperaturüberhitzungsschutz" VALUE 0x1D4F64 Kw_Ws16 6000.000 EngN 0.00 6000.000 FORMAT "%8.3" EXTENDED_LIMITS -32768.00 32767.00 /end CHARACTERISTIC
/begin CHARACTERISTIC EngPrt_nOvhtThresLow_C "Untere Drehzahlschwelle für Wassertemperaturüberhitzungsschutz" VALUE 0x1D4F66 Kw_Ws16 6000.000 EngN 0.00 6000.000 FORMAT "%8.3" EXTENDED_LIMITS -32768.00 32767.00 /end CHARACTERISTIC
/begin CHARACTERISTIC EngPrt_tiPreTrbnPT1_C "Zeitkonstante des PT1-Filters zur Filterung des Begrenzungsfaktors der Abgastemperatur vor der Turbine" VALUE 0x1D4F68 Kw_Wu32 4294.9673 TimeDelay_s 0.0000010000000 4294.9673 FORMAT "%9.4" /end CHARACTERISTIC
/begin CHARACTERISTIC EngPrt_qLimPBoost_MAP "Kennfeld für das Mengenbasierende Motorschutzmoment im Boostfall" MAP 0x1D45EE Kf_Xs16_Ys16_Ws16 327.6700 InjMass 0.00 327.6700 FORMAT "%8.4" EXTENDED_LIMITS -327.6800 327.6700
 /begin AXIS_DESCR STD_AXIS APSCD_pVal Pres_hPa 2 0.00 3500.000 FORMAT "%8.3" EXTENDED_LIMITS -32768.00 32767.00 DEPOSIT ABSOLUTE /end AXIS_DESCR
 /begin AXIS_DESCR STD_AXIS Eng_nAvrg EngN 2 40.00000 6000.000 FORMAT "%8.3" EXTENDED_LIMITS -32768.00 32767.00 DEPOSIT ABSOLUTE /end AXIS_DESCR
/end CHARACTERISTIC
/begin CHARACTERISTIC EngPrt_qLimP_MAP "Motorschutz Mengenbegrenzung durch Atmosphärendruck" MAP 0x1D4602 Kf_Xs16_Ys16_Ws16 327.6700 InjMass 0.00 327.6700 FORMAT "%8.4" EXTENDED_LIMITS -327.6800 327.6700
 /begin AXIS_DESCR STD_AXIS APSCD_pVal Pres_hPa 4 0.00 3500.000 FORMAT "%8.3" EXTENDED_LIMITS -32768.00 32767.00 DEPOSIT ABSOLUTE /end AXIS_DESCR
 /begin AXIS_DESCR STD_AXIS Eng_nAvrg EngN 25 40.00000 6000.000 FORMAT "%8.3" EXTENDED_LIMITS -32768.00 32767.00 DEPOSIT ABSOLUTE /end AXIS_DESCR
/end CHARACTERISTIC
/begin CHARACTERISTIC EngPrt_rDvtChgrMax_C "maximale Regelabweichung Turbolader" VALUE 0x1D4F6C Kw_Ws16 200.0000 DtyCyc -100.0000 100.0000 FORMAT "%8.4" EXTENDED_LIMITS -327.6800 327.6700 /end CHARACTERISTIC
/begin CHARACTERISTIC EngPrt_dtrqUpNLim_C "Rampenanstieg von Ersatzkennlinie auf Normalkennlinie der Motordrehzahlbegrenzung" VALUE 0x1D4708 Kw_Wu32 6553594.99817 RmpTrq 5.00030517578 6553599.99847 FORMAT "%13.5" EXTENDED_LIMITS 0.00 6553599.99847 /end CHARACTERISTIC
/begin CHARACTERISTIC EngPrt_dtrqDwnNLim_C "Rampenanstieg von Normalkennlinie zur Ersatzkennlinie der Motordrehzahlbegrenzung" VALUE 0x1D470C Kw_Wu32 6553594.99817 RmpTrq 5.00030517578 6553599.99847 FORMAT "%13.5" EXTENDED_LIMITS 0.00 6553599.99847 /end CHARACTERISTIC
/begin CHARACTERISTIC EngPrt_swtAPBP_C "Schalter zur Wahl des Drucks für Volllasterhöhung (0: BPACD_pOutVal, 1: APSCD_pVal)" VALUE 0x1D4F6E Kw_Wu8 1.000 OneToOne 0.00 1.000 FORMAT "%5.3" EXTENDED_LIMITS 0.00 255.0 /end CHARACTERISTIC
/begin CHARACTERISTIC EngPrt_swtEGSys2_C "Schalter für Auswahr ein- oder zweiflutiges Abgassystem" VALUE 0x1D4F6F Kw_Wu8 1.000 OneToOne 0.00 1.000 FORMAT "%5.3" EXTENDED_LIMITS 0.00 255.0 /end CHARACTERISTIC
/begin CHARACTERISTIC EngPrt_swtFlTempVirtEna_C "Schalter zur Aktivierung der virtuellen Kraftstofftemperatur" VALUE 0x1D4F70 Kw_Wu8 1.000 OneToOne 0.00 1.000 FORMAT "%5.3" EXTENDED_LIMITS 0.00 255.0 /end CHARACTERISTIC
/begin CHARACTERISTIC EngPrt_swtLimPMap_C "Motorschutz Begrenzungs Schalter für Atmosphärendruckkennfelder" VALUE 0x1D4714 Kw_Wu8 1.000 OneToOne 0.00 1.000 FORMAT "%5.3" EXTENDED_LIMITS 0.00 255.0 /end CHARACTERISTIC
/begin CHARACTERISTIC EngPrt_swtOilOvhtPrevVal_C "Softwareschalter Öltemperaturüberhitzungsschutz" VALUE 0x1D4F71 Kw_Wu8 1.000 OneToOne 0.00 1.000 FORMAT "%5.3" EXTENDED_LIMITS 0.00 255.0 /end CHARACTERISTIC
/begin CHARACTERISTIC EngPrt_swtOilOvhtPrevType_C "Auswahl Wert aus Datensatz oder EEPROM für Softwareschalter Öltemperaturüberhitzungsschutz" VALUE 0x1D4F72 Kw_Wu8 0.00 OneToOne 2.000 2.000 FORMAT "%5.3" EXTENDED_LIMITS 0.00 255.0 /end CHARACTERISTIC
/begin CHARACTERISTIC EngPrt_swtTempPreTrbnVal_C "Schalterwerte zum Auswählen der Temperatur entweder aus Modellrechnung (1) oder vom Sensor (0)" VALUE 0x1D4F73 Kw_Wu8 1.000 OneToOne 0.00 1.000 FORMAT "%5.3" EXTENDED_LIMITS 0.00 255.0 /end CHARACTERISTIC
/begin CHARACTERISTIC EngPrt_swtTempPreTrbnType_C "Schaltertyp zum Auswählen der Temperatur entweder aus Modellrechnung (1) oder vom Sensor (0)" VALUE 0x1D4F74 Kw_Wu8 0.00 OneToOne 2.000 2.000 FORMAT "%5.3" EXTENDED_LIMITS 0.00 255.0 /end CHARACTERISTIC
/begin CHARACTERISTIC EngPrt_tAirHysShiftHigh_C "obere Hystereseschwelle - Ansauglufttemperatrur" VALUE 0x1D4F76 Kw_Ws16 250.0000 Temp_Cels -50.14000 199.8600 FORMAT "%8.4" EXTENDED_LIMITS -3549.940 3003.560 /end CHARACTERISTIC
/begin CHARACTERISTIC EngPrt_tAirHysShiftLow_C "Untere Hystereseschwelle - Ansauglufttemperatrur" VALUE 0x1D4F78 Kw_Ws16 250.0000 Temp_Cels -50.14000 199.8600 FORMAT "%8.4" EXTENDED_LIMITS -3549.940 3003.560 /end CHARACTERISTIC
/begin CHARACTERISTIC EngPrt_tClntHysShiftHigh_C "obere Hystereseschwelle - Wassertemperatrur" VALUE 0x1D4F7A Kw_Ws16 200.0000 Temp_Cels -50.14000 149.8600 FORMAT "%8.4" EXTENDED_LIMITS -3549.940 3003.560 /end CHARACTERISTIC
/begin CHARACTERISTIC EngPrt_tClntHysShiftLow_C "Untere Hystereseschwelle - Wassertemperatrur" VALUE 0x1D4F7C Kw_Ws16 200.0000 Temp_Cels -50.14000 149.8600 FORMAT "%8.4" EXTENDED_LIMITS -3549.940 3003.560 /end CHARACTERISTIC
/begin CHARACTERISTIC EngPrt_tEngOilHysShiftHigh_C "Obere Hystereseschwelle - Motoröltemperatur" VALUE 0x1D4F7E Kw_Ws16 330.0000 Temp_Cels -53.14000 276.8600 FORMAT "%8.4" EXTENDED_LIMITS -3549.940 3003.560 /end CHARACTERISTIC
/begin CHARACTERISTIC EngPrt_tEngOilHysShiftLow_C "Untere Hystereseschwelle - Motoröltemperatur" VALUE 0x1D4F80 Kw_Ws16 330.0000 Temp_Cels -53.14000 276.8600 FORMAT "%8.4" EXTENDED_LIMITS -3549.940 3003.560 /end CHARACTERISTIC
/begin CHARACTERISTIC EngPrt_tFuelVirt_MAP "Map zur Berechnung der virtuellen Kraftstofftemperatur" MAP 0x1D4F82 Kf_Xs16_Ys16_Ws16 3699.800 Temp_Cels -3549.940 149.8600 FORMAT "%8.3" EXTENDED_LIMITS -3549.940 3003.560
 /begin AXIS_DESCR STD_AXIS EngM_ctRevSta OneToOne 3 0.00 32767.00 FORMAT "%8.2" EXTENDED_LIMITS -32768.00 32767.00 DEPOSIT ABSOLUTE /end AXIS_DESCR
 /begin AXIS_DESCR STD_AXIS FTSCD_tFuel Temp_Cels 5 -50.14000 149.8600 FORMAT "%8.4" EXTENDED_LIMITS -3549.940 3003.560 DEPOSIT ABSOLUTE /end AXIS_DESCR
/end CHARACTERISTIC
/begin CHARACTERISTIC EngPrt_tiBoostLock_C "Sperrzeit wenn Boost-Zeit voll ausgeschöpft" VALUE 0x1D4716 Kw_Wu16 655.3500 Time_s 0.00 655.3500 FORMAT "%8.4" /end CHARACTERISTIC
/begin CHARACTERISTIC EngPrt_tiBoostMax_C "Maximale Zeit für Boost aktiv" VALUE 0x1D4718 Kw_Wu16 10.00000 Time_s 0.00 10.00000 FORMAT "%8.5" EXTENDED_LIMITS 0.00 655.3500 /end CHARACTERISTIC
/begin CHARACTERISTIC EngPrt_tiChgr_C "Entprellzeit für erkennung auf Regelabweichung Turbolader" VALUE 0x1D4FB4 Kw_Wu16 650000.0 Time_ms 0.00 650000.0 FORMAT "%8.1" EXTENDED_LIMITS 0.00 655350.0 /end CHARACTERISTIC
/begin CHARACTERISTIC EngPrt_trqIncLoad_MAP "Motortemperaturabhängiges Volllasterhöhungskennfeld" MAP 0x1D4FB6 Kf_Xs16_Ys16_Ws16 1000.000 Trq 0.00 1000.000 FORMAT "%8.3" EXTENDED_LIMITS -3276.800 3276.700
 /begin AXIS_DESCR STD_AXIS Eng_nAvrg EngN 11 0.00 6000.000 FORMAT "%8.3" EXTENDED_LIMITS -32768.00 32767.00 DEPOSIT ABSOLUTE /end AXIS_DESCR
 /begin AXIS_DESCR STD_AXIS Eng_tEng Temp_Cels 10 -50.14000 199.8600 FORMAT "%8.4" EXTENDED_LIMITS -3549.940 3003.560 DEPOSIT ABSOLUTE /end AXIS_DESCR
/end CHARACTERISTIC
/begin CHARACTERISTIC EngPrt_trqLimPBoost_MAP "MAP für Motorschutzmoment bei Boost aktiv" MAP 0x1D471E Kf_Xs16_Ys16_Ws16 1000.000 Trq 0.00 1000.000 FORMAT "%8.3" EXTENDED_LIMITS -3276.800 3276.700
 /begin AXIS_DESCR STD_AXIS APSCD_pVal Pres_hPa 2 0.00 3500.000 FORMAT "%8.3" EXTENDED_LIMITS -32768.00 32767.00 DEPOSIT ABSOLUTE /end AXIS_DESCR
 /begin AXIS_DESCR STD_AXIS Eng_nAvrg EngN 2 40.00000 6000.000 FORMAT "%8.3" EXTENDED_LIMITS -32768.00 32767.00 DEPOSIT ABSOLUTE /end AXIS_DESCR
/end CHARACTERISTIC
/begin CHARACTERISTIC EngPrt_trqLimP_MAP "Kennfeld zur Begrenzung aufgrund des Atmosphärendrucks und der Drehzahl" MAP 0x1D4732 Kf_Xs16_Ys16_Ws16 1000.000 Trq 0.00 1000.000 FORMAT "%8.3" EXTENDED_LIMITS -3276.800 3276.700
 /begin AXIS_DESCR STD_AXIS APSCD_pVal Pres_hPa 4 0.00 3500.000 FORMAT "%8.3" EXTENDED_LIMITS -32768.00 32767.00 DEPOSIT ABSOLUTE /end AXIS_DESCR
 /begin AXIS_DESCR STD_AXIS Eng_nAvrg EngN 25 40.00000 6000.000 FORMAT "%8.3" EXTENDED_LIMITS -32768.00 32767.00 DEPOSIT ABSOLUTE /end AXIS_DESCR
/end CHARACTERISTIC
/begin CHARACTERISTIC EngPrt_trqLimrVnNoPI_MAP "Kennfeld zur Begrenzung bei Voreinspritzung inaktiv" MAP 0x1D4838 Kf_Xs16_Ys16_Ws16 1000.000 Trq 0.00 1000.000 FORMAT "%8.3" EXTENDED_LIMITS -3276.800 3276.700
 /begin AXIS_DESCR STD_AXIS VehDa_rVn VelToN 3 -0.3276800 0.3276700 FORMAT "%9.7" DEPOSIT ABSOLUTE /end AXIS_DESCR
 /begin AXIS_DESCR STD_AXIS Eng_nAvrg EngN 21 40.00000 6000.000 FORMAT "%8.3" EXTENDED_LIMITS -32768.00 32767.00 DEPOSIT ABSOLUTE /end AXIS_DESCR
/end CHARACTERISTIC
/begin CHARACTERISTIC EngPrt_trqNLimShTrp_CUR "Kennlinie für Drehzahlbegrenzung im Shtrp (inneres Motormoment)" CURVE 0x1D48EA Kl_Xs16_Ws16 3276.700 Trq 0.00 3276.700 FORMAT "%8.3" EXTENDED_LIMITS -3276.800 3276.700
 /begin AXIS_DESCR STD_AXIS Eng_nAvrg EngN 3 0.00 32767.00 FORMAT "%8.2" EXTENDED_LIMITS -32768.00 32767.00 DEPOSIT ABSOLUTE /end AXIS_DESCR
/end CHARACTERISTIC
/begin CHARACTERISTIC EngPrt_trqNLimSpr_CUR "Kennlinie für Motordrehzahlbegrenzung bei Systemfehler (als Begrenzungsmoment)" CURVE 0x1D48F8 Kl_Xs16_Ws16 3276.700 Trq 0.00 3276.700 FORMAT "%8.3" EXTENDED_LIMITS -3276.800 3276.700
 /begin AXIS_DESCR STD_AXIS Eng_nAvrg EngN 25 0.00 32767.00 FORMAT "%8.2" EXTENDED_LIMITS -32768.00 32767.00 DEPOSIT ABSOLUTE /end AXIS_DESCR
/end CHARACTERISTIC
/begin CHARACTERISTIC EngPrt_trqNLim_CUR "Kennlinie für Drehzahlbegrenzung im Normalbetrieb (inneres Motormoment)" CURVE 0x1D495E Kl_Xs16_Ws16 3276.700 Trq 0.00 3276.700 FORMAT "%8.3" EXTENDED_LIMITS -3276.800 3276.700
 /begin AXIS_DESCR STD_AXIS Eng_nAvrg EngN 25 0.00 32767.00 FORMAT "%8.2" EXTENDED_LIMITS -32768.00 32767.00 DEPOSIT ABSOLUTE /end AXIS_DESCR
/end CHARACTERISTIC
/begin CHARACTERISTIC Eng_ctEngSpdDiffCalc_C "Anzahl der Drehzahlwerte zur Mittelung" VALUE 0x1D4296 Kw_Wu8 4.000 OneToOne 1.000 5.000 FORMAT "%5.3" EXTENDED_LIMITS 0.00 255.0 /end CHARACTERISTIC
/begin CHARACTERISTIC Eng_dtEng_MAP "Temperaturkennfeld zur Korrektur der Motortemperatur" MAP 0x1D42FE Kf_Xs16_Ys16_Ws16 300.0000 TempDiff_Kelv -150.0000 150.0000 FORMAT "%8.4" EXTENDED_LIMITS -3276.800 3276.700
 /begin AXIS_DESCR STD_AXIS EngM_ctRevSta OneToOne 4 0.00 32767.00 FORMAT "%8.2" EXTENDED_LIMITS -32768.00 32767.00 DEPOSIT ABSOLUTE /end AXIS_DESCR
 /begin AXIS_DESCR STD_AXIS Eng_dtEngSub_mp TempDiff_Kelv 6 -150.0000 150.0000 FORMAT "%8.4" EXTENDED_LIMITS -3276.800 3276.700 DEPOSIT ABSOLUTE /end AXIS_DESCR
/end CHARACTERISTIC
/begin CHARACTERISTIC Eng_swtTempSub_C "Schalter zum Auswählen eines Korrekturwertes zur Berechnung der Motortemperatur" VALUE 0x1D4346 Kw_Wu8 3.000 OneToOne 0.00 3.000 FORMAT "%5.3" EXTENDED_LIMITS 0.00 255.0 /end CHARACTERISTIC
/begin CHARACTERISTIC Eng_trqSpd_CUR "Drehmomentkennlinie" CURVE 0x1D4298 Kl_Xs16_Ws16 3276.700 Trq 0.00 3276.700 FORMAT "%8.3" EXTENDED_LIMITS -3276.800 3276.700
 /begin AXIS_DESCR STD_AXIS Eng_nAvrg EngN 25 0.00 6000.000 FORMAT "%8.3" EXTENDED_LIMITS -32768.00 32767.00 DEPOSIT ABSOLUTE /end AXIS_DESCR
/end CHARACTERISTIC
/begin CHARACTERISTIC Eng_tThresAirtEngCor_C "Ansauglufttemperaturabschaltschwelle zur Abschaltung der Korrektur der Motortemperatur" VALUE 0x1D4348 Kw_Ws16 250.0000 Temp_Cels -50.14000 199.8600 FORMAT "%8.4" EXTENDED_LIMITS -3549.940 3003.560 /end CHARACTERISTIC
/begin CHARACTERISTIC Eng_tThresClnttEngCor_C "Kühlmitteltemperaturabschaltschwelle zur Abschaltung der Korrektur der Motortemperatur" VALUE 0x1D434A Kw_Ws16 200.0000 Temp_Cels -50.14000 149.8600 FORMAT "%8.4" EXTENDED_LIMITS -3549.940 3003.560 /end CHARACTERISTIC
/begin CHARACTERISTIC Eng_tThresFueltEngCor_C "Kraftstofftemperaturabschaltschwelle zur Abschaltung der Korrektur der Motortemperatur" VALUE 0x1D434C Kw_Ws16 200.0000 Temp_Cels -50.14000 149.8600 FORMAT "%8.4" EXTENDED_LIMITS -3549.940 3003.560 /end CHARACTERISTIC
/begin CHARACTERISTIC ErLpCD_ctMilPwrStgOnMax_C "Maximaler Zähler für Powerstage On im Fehlerfall" VALUE 0x1D50C0 Kw_Wu16 65535.00 OneToOne 0.00 65535.00 FORMAT "%8.2" /end CHARACTERISTIC
/begin CHARACTERISTIC ErLpCD_ctSysLmpPwrStgOnMax_C "Maximaler Zähler für Powerstage On im Fehlerfall" VALUE 0x1D50C2 Kw_Wu16 65535.00 OneToOne 0.00 65535.00 FORMAT "%8.2" /end CHARACTERISTIC
/begin CHARACTERISTIC ErLpCD_stMilInvOut_C "Invertierung des Ausgangssignals" VALUE 0x1D50C8 Kw_Wu8 1.000 OneToOne 0.00 1.000 FORMAT "%5.3" EXTENDED_LIMITS 0.00 255.0 /end CHARACTERISTIC
/begin CHARACTERISTIC ErLpCD_stMilSPICtl_C "Parameter zur Anzeige der verwendeten Endstufenart (1 = SPI kontrolliert, 0 = nicht SPI kontrolliert)" VALUE 0x1D50C9 Kw_Wu8 1.000 OneToOne 0.00 1.000 FORMAT "%5.3" EXTENDED_LIMITS 0.00 255.0 /end CHARACTERISTIC
/begin CHARACTERISTIC ErLpCD_stPwrStgLampActv_C "Spezifikation des Abschaltverhaltens der Lamp-Endstufe" VALUE 0x1D50CA Kw_Wu8 255.0 OneToOne 0.00 255.0 FORMAT "%5.1" /end CHARACTERISTIC
/begin CHARACTERISTIC ErLpCD_stPwrStgLampDia_C "Spezifikation des Diagnoseabschaltverhaltens der Lamp-Endstufe" VALUE 0x1D50CB Kw_Wu8 255.0 OneToOne 0.00 255.0 FORMAT "%5.1" /end CHARACTERISTIC
/begin CHARACTERISTIC ErLpCD_stPwrStgMilActv_C "Spezifikation des Abschaltverhaltens der MIL-Endstufe" VALUE 0x1D50CC Kw_Wu8 255.0 OneToOne 0.00 255.0 FORMAT "%5.1" /end CHARACTERISTIC
/begin CHARACTERISTIC ErLpCD_stPwrStgMilDia_C "Spezifikation des Diagnoseabschaltverhaltens der MIL-Endstufe" VALUE 0x1D50CD Kw_Wu8 255.0 OneToOne 0.00 255.0 FORMAT "%5.1" /end CHARACTERISTIC
/begin CHARACTERISTIC ErLpCD_stSysLampInvOut_C "Invertierung des Ausgangssignals" VALUE 0x1D50CE Kw_Wu8 1.000 OneToOne 0.00 1.000 FORMAT "%5.3" EXTENDED_LIMITS 0.00 255.0 /end CHARACTERISTIC
/begin CHARACTERISTIC ErLpCD_stSysLmpSPICtl_C "Parameter zur Anzeige der verwendeten Endstufenart (1 = SPI kontrolliert, 0 = nicht SPI kontrolliert)" VALUE 0x1D50CF Kw_Wu8 1.000 OneToOne 0.00 1.000 FORMAT "%5.3" EXTENDED_LIMITS 0.00 255.0 /end CHARACTERISTIC
/begin CHARACTERISTIC ErLpCD_swtMILVal_C "Datensatzwert für den Schalter ErLpCD_swtMIL" VALUE 0x1D50D0 Kw_Wu8 1.000 OneToOne 0.00 1.000 FORMAT "%5.3" EXTENDED_LIMITS 0.00 255.0 /end CHARACTERISTIC
/begin CHARACTERISTIC ErLpCD_swtMILType_C "Parameter zur Auswahl des Schaltertyps (soll Wert aus Datensatz oder aus EEPROM kommen)" VALUE 0x1D50D1 Kw_Wu8 0.00 OneToOne 2.000 2.000 FORMAT "%5.3" EXTENDED_LIMITS 0.00 255.0 /end CHARACTERISTIC
/begin CHARACTERISTIC ErLpCD_swtSYSVal_C "Datensatzwert für den Schalter ErLpCD_swtSYS" VALUE 0x1D50D2 Kw_Wu8 1.000 OneToOne 0.00 1.000 FORMAT "%5.3" EXTENDED_LIMITS 0.00 255.0 /end CHARACTERISTIC
/begin CHARACTERISTIC ErLpCD_swtSYSType_C "Parameter zur Auswahl des Schaltertyps (soll Wert aus Datensatz oder aus EEPROM kommen)" VALUE 0x1D50D3 Kw_Wu8 0.00 OneToOne 2.000 2.000 FORMAT "%5.3" EXTENDED_LIMITS 0.00 255.0 /end CHARACTERISTIC
/begin CHARACTERISTIC ErLpCD_tiBtwTstMil_C "Zeitabstand, in dem die Endstufe im Fehlerfall getestet wird" VALUE 0x1D50D4 Kw_Wu16 29900.00 Time_ms 100.0000 30000.00 FORMAT "%8.2" EXTENDED_LIMITS 0.00 655350.0 /end CHARACTERISTIC
/begin CHARACTERISTIC ErLpCD_tiBtwTstSysLmp_C "Zeitabstand, in dem die Endstufe im Fehlerfall getestet wird" VALUE 0x1D50D6 Kw_Wu16 29900.00 Time_ms 100.0000 30000.00 FORMAT "%8.2" EXTENDED_LIMITS 0.00 655350.0 /end CHARACTERISTIC
/begin CHARACTERISTIC ErLpCD_tiMilPwrStgOn_C "Zeit für welche die Endstufe im Fehlerfall eingeschalten wird (nur nicht SPI kontrolliert)" VALUE 0x1D50D8 Kw_Wu16 500.0000 Time_ms 0.00 500.0000 FORMAT "%8.4" EXTENDED_LIMITS 0.00 655350.0 /end CHARACTERISTIC
/begin CHARACTERISTIC ErLpCD_tiSysLampBlkDia_C "Blinkfrequenz bei externer Diagnoseanforderung" VALUE 0x1D50DA Kw_Wu16 655350.0 Time_ms 0.00 655350.0 FORMAT "%8.1" /end CHARACTERISTIC
/begin CHARACTERISTIC ErLpCD_tiSysLmpPwrStgOn_C "Zeit für welche die Endstufe im Fehlerfall eingeschalten wird (nur nicht SPI kontrolliert)" VALUE 0x1D50DC Kw_Wu16 500.0000 Time_ms 0.00 500.0000 FORMAT "%8.4" EXTENDED_LIMITS 0.00 655350.0 /end CHARACTERISTIC
/begin CHARACTERISTIC ErLp_tiMilDefectTime_C "Zeit für MIL Defekterkennung (Endstufenüberwachung)" VALUE 0x1D50DE Kw_Wu16 655350.0 Time_ms 0.00 655350.0 FORMAT "%8.1" /end CHARACTERISTIC
/begin CHARACTERISTIC ErLp_tiMilOkTime_C "Zeit für MIL in Ordnung Erkennung (Endstufenüberwachung)" VALUE 0x1D50E0 Kw_Wu16 655350.0 Time_ms 0.00 655350.0 FORMAT "%8.1" /end CHARACTERISTIC
/begin CHARACTERISTIC ErLp_MilEngN_C "Drehzahlgrenze für MIL-Test" VALUE 0x1D50E2 Kw_Ws16 65535.00 EngN -32768.00 32767.00 FORMAT "%8.2" /end CHARACTERISTIC
/begin CHARACTERISTIC ErLp_tiMilMax_C "Zeitgrenze für MIL-Test" VALUE 0x1D50E4 Kw_Wu16 655350.0 Time_ms 0.00 655350.0 FORMAT "%8.1" /end CHARACTERISTIC
/begin CHARACTERISTIC ErLp_tiMilTst_C "zusätzliche MIL Test Zeit nach Überschreiten Drehzahlschwelle" VALUE 0x1D50E6 Kw_Wu16 655350.0 Time_ms 0.00 655350.0 FORMAT "%8.1" /end CHARACTERISTIC
/begin CHARACTERISTIC ErLp_tiMilDel_C "Verzögerung der MIL Anzeige nach Lampentest" VALUE 0x1D50E8 Kw_Wu16 655350.0 Time_ms 0.00 655350.0 FORMAT "%8.1" /end CHARACTERISTIC
/begin CHARACTERISTIC ErLp_tiMilBlk_C "halbe Periodendauer  der MIL-Blinkphase" VALUE 0x1D50EA Kw_Wu16 655350.0 Time_ms 0.00 655350.0 FORMAT "%8.1" /end CHARACTERISTIC
/begin CHARACTERISTIC ErLp_swtMilEn_C "MIL Freigabe Schalter" VALUE 0x1D50EC Kw_Wu8 1.000 OneToOne 0.00 1.000 FORMAT "%5.3" EXTENDED_LIMITS 0.00 255.0 /end CHARACTERISTIC
/begin CHARACTERISTIC ErLp_swtSysEqGlwLamp_C "SysLamp entspricht Glühlampe (Signalumleitung)" VALUE 0x1D50EE Kw_Wu8 1.000 OneToOne 0.00 1.000 FORMAT "%5.3" EXTENDED_LIMITS 0.00 255.0 /end CHARACTERISTIC
/begin CHARACTERISTIC ErLp_tiSysLampDefectTime_C "Zeit für SysLamp Defekterkennung (Endstufenüberwachung)" VALUE 0x1D50F0 Kw_Wu16 655350.0 Time_ms 0.00 655350.0 FORMAT "%8.1" /end CHARACTERISTIC
/begin CHARACTERISTIC ErLp_tiSysLampOkTime_C "Zeit für SysLamp in Ordnung Erkennung (Endstufenüberwachung)" VALUE 0x1D50F2 Kw_Wu16 655350.0 Time_ms 0.00 655350.0 FORMAT "%8.1" /end CHARACTERISTIC
/begin CHARACTERISTIC ErLp_SysLampEngN_C "Drehzahlgrenze für SysLamp-Test" VALUE 0x1D50F4 Kw_Ws16 65535.00 EngN -32768.00 32767.00 FORMAT "%8.2" /end CHARACTERISTIC
/begin CHARACTERISTIC ErLp_tiSysLampMax_C "Zeitgrenze für SysLamp-Test" VALUE 0x1D50F6 Kw_Wu16 655350.0 Time_ms 0.00 655350.0 FORMAT "%8.1" /end CHARACTERISTIC
/begin CHARACTERISTIC ErLp_tiSysLampTst_C "zusätzliche SysLamp Test Zeit nach Überschreiten Drehzahlschwelle" VALUE 0x1D50F8 Kw_Wu16 655350.0 Time_ms 0.00 655350.0 FORMAT "%8.1" /end CHARACTERISTIC
/begin CHARACTERISTIC ErLp_tiSysLampDel_C "Verzögerung der SysLamp Anzeige nach Lampentest" VALUE 0x1D50FA Kw_Wu16 655350.0 Time_ms 0.00 655350.0 FORMAT "%8.1" /end CHARACTERISTIC
/begin CHARACTERISTIC ErLp_tiSysLampBlk_C "halbe Periodendauer der Systemlampen-Blinkphase" VALUE 0x1D50FC Kw_Wu16 655350.0 Time_ms 0.00 655350.0 FORMAT "%8.1" /end CHARACTERISTIC
/begin CHARACTERISTIC ErLp_swtSysLampEn_C "SysLamp Freigabe Schalter" VALUE 0x1D50FE Kw_Wu8 1.000 OneToOne 0.00 1.000 FORMAT "%5.3" EXTENDED_LIMITS 0.00 255.0 /end CHARACTERISTIC
/begin CHARACTERISTIC FanCD_ctShutOffPeriods_C "Anzahl der Perioden für die Lüfterabschaltsequenz" VALUE 0x1D5112 Kw_Wu8 125.0 OneToOne 0.00 125.0 FORMAT "%5.1" EXTENDED_LIMITS 0.00 255.0 /end CHARACTERISTIC
/begin CHARACTERISTIC FanCD_tiDebFan1Ctlr1Def_C "Fehlerentprellzeiten für Lüftersteuergerät 1 Lüfter 1" VALUE 0x1D5114 Kw_Wu16 655350.0 Time_ms 0.00 655350.0 FORMAT "%8.1" /end CHARACTERISTIC
/begin CHARACTERISTIC FanCD_tiDebFan1Ctlr1Ok_C "Fehlerentprellzeiten für Lüftersteuergerät 1 Lüfter 1" VALUE 0x1D5116 Kw_Wu16 655350.0 Time_ms 0.00 655350.0 FORMAT "%8.1" /end CHARACTERISTIC
/begin CHARACTERISTIC FanCD_tiDebFan1Ctlr2Def_C "Fehlerentprellzeiten für Lüftersteuergerät 2 Lüfter 1" VALUE 0x1D5118 Kw_Wu16 655350.0 Time_ms 0.00 655350.0 FORMAT "%8.1" /end CHARACTERISTIC
/begin CHARACTERISTIC FanCD_tiDebFan1Ctlr2Ok_C "Fehlerentprellzeiten für Lüftersteuergerät 2 Lüfter 1" VALUE 0x1D511A Kw_Wu16 655350.0 Time_ms 0.00 655350.0 FORMAT "%8.1" /end CHARACTERISTIC
/begin CHARACTERISTIC FanCD_tiDebFan2Ctlr1Def_C "Fehlerentprellzeiten für Lüftersteuergerät 1 Lüfter 2" VALUE 0x1D511C Kw_Wu16 655350.0 Time_ms 0.00 655350.0 FORMAT "%8.1" /end CHARACTERISTIC
/begin CHARACTERISTIC FanCD_tiDebFan2Ctlr1Ok_C "Fehlerentprellzeiten für Lüftersteuergerät 1 Lüfter 2" VALUE 0x1D511E Kw_Wu16 655350.0 Time_ms 0.00 655350.0 FORMAT "%8.1" /end CHARACTERISTIC
/begin CHARACTERISTIC FanCD_tiDebFan2Ctlr2Def_C "Fehlerentprellzeiten für Lüftersteuergerät 2 Lüfter 2" VALUE 0x1D5120 Kw_Wu16 655350.0 Time_ms 0.00 655350.0 FORMAT "%8.1" /end CHARACTERISTIC
/begin CHARACTERISTIC FanCD_tiDebFan2Ctlr2Ok_C " Fehlerentprellzeiten für Lüftersteuergerät 2 Lüfter 2" VALUE 0x1D5122 Kw_Wu16 655350.0 Time_ms 0.00 655350.0 FORMAT "%8.1" /end CHARACTERISTIC
/begin CHARACTERISTIC FanCD_tiDebFanCtlr1Def_C "Defektentprellzeit des Lüftersteuergerätes 1" VALUE 0x1D5124 Kw_Wu16 655350.0 Time_ms 0.00 655350.0 FORMAT "%8.1" /end CHARACTERISTIC
/begin CHARACTERISTIC FanCD_tiDebFanCtlr1Ok_C "Heilungsentprellzeit des Lüftersteuergerätes 1" VALUE 0x1D5126 Kw_Wu16 655350.0 Time_ms 0.00 655350.0 FORMAT "%8.1" /end CHARACTERISTIC
/begin CHARACTERISTIC FanCD_tiDebFanCtlr2Def_C "Defektentprellzeit des Lüftersteuergerätes 2" VALUE 0x1D5128 Kw_Wu16 655350.0 Time_ms 0.00 655350.0 FORMAT "%8.1" /end CHARACTERISTIC
/begin CHARACTERISTIC FanCD_tiDebFanCtlr2Ok_C "Heilungsentprellzeit des Lüftersteuergerätes 2" VALUE 0x1D512A Kw_Wu16 655350.0 Time_ms 0.00 655350.0 FORMAT "%8.1" /end CHARACTERISTIC
/begin CHARACTERISTIC FanCD_Fan1DebExcTempDef_C "Fehlerentprellzeit für Übertemperaturfehler Fan1" VALUE 0x1D512C Kw_Wu16 655350.0 Time_ms 0.00 655350.0 FORMAT "%8.1" /end CHARACTERISTIC
/begin CHARACTERISTIC FanCD_Fan1DebExcTempOk_C "Heilungsentrpellzeit für Übertemperaturfehler von Fan1" VALUE 0x1D512E Kw_Wu16 655350.0 Time_ms 0.00 655350.0 FORMAT "%8.1" /end CHARACTERISTIC
/begin CHARACTERISTIC FanCD_Fan1DebNoLoadDef_C "Fehlerentprellzeit für Leerlauf Fan1" VALUE 0x1D5130 Kw_Wu16 655350.0 Time_ms 0.00 655350.0 FORMAT "%8.1" /end CHARACTERISTIC
/begin CHARACTERISTIC FanCD_Fan1DebNoLoadOk_C "Heilungsentprellzeit für Leerlauf Fan1" VALUE 0x1D5132 Kw_Wu16 655350.0 Time_ms 0.00 655350.0 FORMAT "%8.1" /end CHARACTERISTIC
/begin CHARACTERISTIC FanCD_Fan1DebShortCircBatDef_C "Fehlerentprellzeit für Kurzschluß nach UBatt Fan1" VALUE 0x1D5134 Kw_Wu16 655350.0 Time_ms 0.00 655350.0 FORMAT "%8.1" /end CHARACTERISTIC
/begin CHARACTERISTIC FanCD_Fan1DebShortCircBatOk_C "Heilungsentprellzeit für Kurzschluß nach UBatt Fan1" VALUE 0x1D5136 Kw_Wu16 655350.0 Time_ms 0.00 655350.0 FORMAT "%8.1" /end CHARACTERISTIC
/begin CHARACTERISTIC FanCD_Fan1DebShortCircGndDef_C "Fehlerentprellzeit für Kurzschluß nach Masse Fan1" VALUE 0x1D5138 Kw_Wu16 655350.0 Time_ms 0.00 655350.0 FORMAT "%8.1" /end CHARACTERISTIC
/begin CHARACTERISTIC FanCD_Fan1DebShortCircGndOk_C "Heilungsentprellzeit für Kurzschluß nach Masse Fan1" VALUE 0x1D513A Kw_Wu16 655350.0 Time_ms 0.00 655350.0 FORMAT "%8.1" /end CHARACTERISTIC
/begin CHARACTERISTIC FanCD_Fan2DebExcTempDefVar2_C "Fehlerentprellzeit für Übertemperatur für Lüfter 2, Variante 2 (Funktionscodierung)" VALUE 0x1D513C Kw_Wu16 655350.0 Time_ms 0.00 655350.0 FORMAT "%8.1" /end CHARACTERISTIC
/begin CHARACTERISTIC FanCD_Fan2DebExcTempOkVar2_C "Heilungsentprellzeit für Übertemperatur Lüfter 2, Variante 2 (Funktionscodierung)" VALUE 0x1D513E Kw_Wu16 655350.0 Time_ms 0.00 655350.0 FORMAT "%8.1" /end CHARACTERISTIC
/begin CHARACTERISTIC FanCD_Fan2DebExcTempDef_C "Fehlerentprellzeit für Übertemperatur Fan2" VALUE 0x1D5140 Kw_Wu16 655350.0 Time_ms 0.00 655350.0 FORMAT "%8.1" /end CHARACTERISTIC
/begin CHARACTERISTIC FanCD_Fan2DebExcTempOk_C "Heilungsentprellzeit für Übertemperatur Fan2" VALUE 0x1D5142 Kw_Wu16 655350.0 Time_ms 0.00 655350.0 FORMAT "%8.1" /end CHARACTERISTIC
/begin CHARACTERISTIC FanCD_Fan2DebNoLoadDefVar2_C "Fehlerentprellzeit für Leerlauf Lüfter 2, variant 2 (Funktionscodierung)" VALUE 0x1D5144 Kw_Wu16 655350.0 Time_ms 0.00 655350.0 FORMAT "%8.1" /end CHARACTERISTIC
/begin CHARACTERISTIC FanCD_Fan2DebNoLoadOkVar2_C "Heilungsentprellzeit Leerlauf Lüfter 2, Variante 2 (Funktionscodierung)" VALUE 0x1D5146 Kw_Wu16 655350.0 Time_ms 0.00 655350.0 FORMAT "%8.1" /end CHARACTERISTIC
/begin CHARACTERISTIC FanCD_Fan2DebNoLoadDef_C "Fehlerentprellzeit Leerlauf Fan2" VALUE 0x1D5148 Kw_Wu16 655350.0 Time_ms 0.00 655350.0 FORMAT "%8.1" /end CHARACTERISTIC
/begin CHARACTERISTIC FanCD_Fan2DebNoLoadOk_C "Heilungsentprellzeit Leerlauf Fan2" VALUE 0x1D514A Kw_Wu16 655350.0 Time_ms 0.00 655350.0 FORMAT "%8.1" /end CHARACTERISTIC
/begin CHARACTERISTIC FanCD_Fan2DebShortBatDefVar2_C "Fehlerentprellzeit für Lüfter 2 Kurzschluß nach Batterie, Variante 2" VALUE 0x1D514C Kw_Wu16 655350.0 Time_ms 0.00 655350.0 FORMAT "%8.1" /end CHARACTERISTIC
/begin CHARACTERISTIC FanCD_Fan2DebShortBatOkVar2_C "Heilentprellzeit für Kurzschluß nach Batterie Lüfter 2, Variante 2" VALUE 0x1D514E Kw_Wu16 655350.0 Time_ms 0.00 655350.0 FORMAT "%8.1" /end CHARACTERISTIC
/begin CHARACTERISTIC FanCD_Fan2DebShortCircBatDef_C "Fehlerentprellzeit für Kurzschluß nach UBatt Fan2" VALUE 0x1D5150 Kw_Wu16 655350.0 Time_ms 0.00 655350.0 FORMAT "%8.1" /end CHARACTERISTIC
/begin CHARACTERISTIC FanCD_Fan2DebShortCircBatOk_C "Heilungsentprellzeit für Kurzschluß nach UBatt Fan2" VALUE 0x1D5152 Kw_Wu16 655350.0 Time_ms 0.00 655350.0 FORMAT "%8.1" /end CHARACTERISTIC
/begin CHARACTERISTIC FanCD_Fan2DebShortCircGndDef_C "Fehlerentprellzeit für Kurzschluß nach Masse Fan2" VALUE 0x1D5154 Kw_Wu16 655350.0 Time_ms 0.00 655350.0 FORMAT "%8.1" /end CHARACTERISTIC
/begin CHARACTERISTIC FanCD_Fan2DebShortCircGndOk_C "Heilungsentprellzeit für Kurzschluß nach Masse Fan2" VALUE 0x1D5156 Kw_Wu16 655350.0 Time_ms 0.00 655350.0 FORMAT "%8.1" /end CHARACTERISTIC
/begin CHARACTERISTIC FanCD_Fan2DebShortGndDefVar2_C "Fehlerentprellzeit für Kurzschluß nach Masse Lüfter 2, Variante 2" VALUE 0x1D5158 Kw_Wu16 655350.0 Time_ms 0.00 655350.0 FORMAT "%8.1" /end CHARACTERISTIC
/begin CHARACTERISTIC FanCD_Fan2DebShortGndOkVar2_C "Heilungsentprellzeit für Kurzschluß nach Masse Lüfter 2, Variante 2" VALUE 0x1D515A Kw_Wu16 655350.0 Time_ms 0.00 655350.0 FORMAT "%8.1" /end CHARACTERISTIC
/begin CHARACTERISTIC FanCD_tiFanCtlr1Min_C "Minimum des ersten Signalfensters für Fehlersignale des Lüfter-SG" VALUE 0x1D515C Kw_Wu16 655350.0 Time_ms 0.00 655350.0 FORMAT "%8.1" /end CHARACTERISTIC
/begin CHARACTERISTIC FanCD_tiFanCtlr1Max_C "Maximum des ersten Signalfensters für Fehlersignale des Lüfter-SG" VALUE 0x1D515E Kw_Wu16 655350.0 Time_ms 0.00 655350.0 FORMAT "%8.1" /end CHARACTERISTIC
/begin CHARACTERISTIC FanCD_tiFanCtlr2Min_C "Minimum des zweiten Signalfensters für Fehlersignale des Lüfter-SG" VALUE 0x1D5160 Kw_Wu16 655350.0 Time_ms 0.00 655350.0 FORMAT "%8.1" /end CHARACTERISTIC
/begin CHARACTERISTIC FanCD_tiFanCtlr2Max_C "Maximum des zweiten Signalfensters für Fehlersignale des Lüfter-SG" VALUE 0x1D5162 Kw_Wu16 655350.0 Time_ms 0.00 655350.0 FORMAT "%8.1" /end CHARACTERISTIC
/begin CHARACTERISTIC FanCD_tiFanCtlr3Min_C "Minimum des dritten Signalfensters für Fehlersignale des Lüfter-SG" VALUE 0x1D5164 Kw_Wu16 655350.0 Time_ms 0.00 655350.0 FORMAT "%8.1" /end CHARACTERISTIC
/begin CHARACTERISTIC FanCD_tiFanCtlr3Max_C "Maximum des dritten Signalfensters für Fehlersignale des Lüfter-SG" VALUE 0x1D5166 Kw_Wu16 655350.0 Time_ms 0.00 655350.0 FORMAT "%8.1" /end CHARACTERISTIC
/begin CHARACTERISTIC FanCD_tiFanCtlr4Min_C "Signalfenstergröße für Fehlerart 4 eines Lüfter-SG" VALUE 0x1D5168 Kw_Wu16 655350.0 Time_ms 0.00 655350.0 FORMAT "%8.1" /end CHARACTERISTIC
/begin CHARACTERISTIC FanCD_tiFanCtlr4Max_C "Signalfenstergröße für Fehlerart 4 eines Lüfter-SG" VALUE 0x1D516A Kw_Wu16 655350.0 Time_ms 0.00 655350.0 FORMAT "%8.1" /end CHARACTERISTIC
/begin CHARACTERISTIC FanCD_tiFanCtlr5Min_C "Signalfenstergröße für Fehlerart 5 eines Lüfter-SG" VALUE 0x1D516C Kw_Wu16 655350.0 Time_ms 0.00 655350.0 FORMAT "%8.1" /end CHARACTERISTIC
/begin CHARACTERISTIC FanCD_tiFanCtlr5Max_C "Signalfenstergröße für Fehlerart 5 eines Lüfter-SG" VALUE 0x1D516E Kw_Wu16 655350.0 Time_ms 0.00 655350.0 FORMAT "%8.1" /end CHARACTERISTIC
/begin CHARACTERISTIC FanCD_tiFanCtlr6Min_C "Signalfenstergröße für Fehlerart 6 eines Lüfter-SG" VALUE 0x1D5170 Kw_Wu16 655350.0 Time_ms 0.00 655350.0 FORMAT "%8.1" /end CHARACTERISTIC
/begin CHARACTERISTIC FanCD_tiFanCtlr6Max_C "Signalfenstergröße für Fehlerart 6 eines Lüfter-SG" VALUE 0x1D5172 Kw_Wu16 655350.0 Time_ms 0.00 655350.0 FORMAT "%8.1" /end CHARACTERISTIC
/begin CHARACTERISTIC FanCD_tiFanCtlrErrIdlMin_C "Debounce Zeit für fan Controller Fan1" VALUE 0x1D5174 Kw_Wu16 655350.0 Time_ms 0.00 655350.0 FORMAT "%8.1" /end CHARACTERISTIC
/begin CHARACTERISTIC FanCD_tiFanCtlrErrIdlMax_C "Debounce Zeit für Fan Controller Fan1" VALUE 0x1D5176 Kw_Wu16 655350.0 Time_ms 0.00 655350.0 FORMAT "%8.1" /end CHARACTERISTIC
/begin CHARACTERISTIC FanCD_numErrThres_C "Die Anzahl, wie oft ein Fehler über LOW Pegel  mindestens gesendet werden muß, bevor ein entsprechender Fehler eingetragen wird." VALUE 0x1D5178 Kw_Wu16 10.00000 OneToOne 0.00 10.00000 FORMAT "%8.5" EXTENDED_LIMITS 0.00 65535.00 /end CHARACTERISTIC
/begin CHARACTERISTIC FanCD_rFan1Tst_C "Testimpuls-TV bei Endstufenfehler Lüfter SG 1" VALUE 0x1D517A Kw_Ws16 100.0000 DtyCyc 0.00 100.0000 FORMAT "%8.4" EXTENDED_LIMITS -327.6800 327.6700 /end CHARACTERISTIC
/begin CHARACTERISTIC FanCD_rFan2Tst_C "Testimpuls-TV bei Endstufenfehler Lüfter SG 2" VALUE 0x1D517C Kw_Ws16 100.0000 DtyCyc 0.00 100.0000 FORMAT "%8.4" EXTENDED_LIMITS -327.6800 327.6700 /end CHARACTERISTIC
/begin CHARACTERISTIC FanCD_rShutOff_CA "Tastverhältnisse für Lüfterabschaltsequenz (high/low Phasen für die Abschaltsequenz)" VAL_BLK 0x1D517E Kwb_Ws16 100.0000 DtyCyc 0.00 100.0000 FORMAT "%8.4" EXTENDED_LIMITS -327.6800 327.6700 NUMBER 2 /end CHARACTERISTIC
/begin CHARACTERISTIC FanCD_stStage1InvOut_C "Invertierung des Ausgangssignals" VALUE 0x1D5182 Kw_Wu8 1.000 OneToOne 0.00 1.000 FORMAT "%5.3" EXTENDED_LIMITS 0.00 255.0 /end CHARACTERISTIC
/begin CHARACTERISTIC FanCD_tiStage1Per_C "Periodenzeit der Ausgangsstufe 1" VALUE 0x1D5184 Kw_Ws16 120.0000 Period 30.00000 150.0000 FORMAT "%8.4" EXTENDED_LIMITS -3276.800 3276.700 /end CHARACTERISTIC
/begin CHARACTERISTIC FanCD_stStage2InvOut_C "Invertierung des Ausgangssignals" VALUE 0x1D5186 Kw_Wu8 1.000 OneToOne 0.00 1.000 FORMAT "%5.3" EXTENDED_LIMITS 0.00 255.0 /end CHARACTERISTIC
/begin CHARACTERISTIC FanCD_tiStage2Per_C "Periodenzeit der Ausgangsstufe 2" VALUE 0x1D5188 Kw_Ws16 120.0000 Period 30.00000 150.0000 FORMAT "%8.4" EXTENDED_LIMITS -3276.800 3276.700 /end CHARACTERISTIC
/begin CHARACTERISTIC FanCD_stFanCtlr1DfpEna_C "Bitmaske zum Aktivieren der Lüfterfehlerdiagnose des 1 Lüftersteuergerätes" VALUE 0x1D518A Kw_Wu8 255.0 OneToOne 0.00 255.0 FORMAT "%5.1" /end CHARACTERISTIC
/begin CHARACTERISTIC FanCD_stFanCtlr2DfpEna_C "Bitmaske zum Aktivieren der Lüfterfehlerdiagnose des 2 Lüftersteuergerätes" VALUE 0x1D518B Kw_Wu8 255.0 OneToOne 0.00 255.0 FORMAT "%5.1" /end CHARACTERISTIC
/begin CHARACTERISTIC FanCD_swtFanShutOffVal_C "Schalterwerte zur Deaktivierung der Lüfterabschaltung bei Nicht- Öffnen  des Hauptrelais." VALUE 0x1D518C Kw_Wu8 1.000 OneToOne 0.00 1.000 FORMAT "%5.3" EXTENDED_LIMITS 0.00 255.0 /end CHARACTERISTIC
/begin CHARACTERISTIC FanCD_swtFanShutOffType_C "Schaltertyp zur Deaktivierung der Lüfterabschaltung bei Nicht- Öffnen des Hauptrelais." VALUE 0x1D518D Kw_Wu8 0.00 OneToOne 2.000 2.000 FORMAT "%5.3" EXTENDED_LIMITS 0.00 255.0 /end CHARACTERISTIC
/begin CHARACTERISTIC FanCD_tiFan1BtwTst_C "Zeit zwischen Endstufentests bei erkanntem Fehler" VALUE 0x1D518E Kw_Wu16 29980.00 Time_ms 20.00000 30000.00 FORMAT "%8.2" EXTENDED_LIMITS 0.00 655350.0 /end CHARACTERISTIC
/begin CHARACTERISTIC FanCD_tiFan2BtwTst_C "Zeit zwischen Endstufentests bei erkanntem Fehler" VALUE 0x1D5190 Kw_Wu16 29980.00 Time_ms 20.00000 30000.00 FORMAT "%8.2" EXTENDED_LIMITS 0.00 655350.0 /end CHARACTERISTIC
/begin CHARACTERISTIC FanCD_tiFANcheckDfpTmr_C "Ansteuerdauer der Endstufe bei Abschaltung im Fehlerfall" VALUE 0x1D5192 Kw_Wu16 655350.0 Time_ms 0.00 655350.0 FORMAT "%8.1" /end CHARACTERISTIC
/begin CHARACTERISTIC FanCD_tiFanOFFTmr_C "Abschaltzeit der Endstufe im Fehlerfall" VALUE 0x1D5194 Kw_Wu16 655350.0 Time_ms 0.00 655350.0 FORMAT "%8.1" /end CHARACTERISTIC
/begin CHARACTERISTIC FanCD_tiShutOffBreak_C "Timeout für Lüfterabschaltsequenz - Normalbetrieb wird nach Ablauf dieser Zeit nach Beendigung der Abschaltsequenz aufgenommen" VALUE 0x1D5196 Kw_Wu16 900.0000 Time_ms 100.0000 1000.000 FORMAT "%8.3" EXTENDED_LIMITS 0.00 655350.0 /end CHARACTERISTIC
/begin CHARACTERISTIC FanCD_tiShutOffPeriod_C "Periodendauer der Lüfterabschaltsequenz" VALUE 0x1D5198 Kw_Wu16 200.0000 Time_ms 700.0000 900.0000 FORMAT "%8.4" EXTENDED_LIMITS 0.00 655350.0 /end CHARACTERISTIC
/begin CHARACTERISTIC FanCtl_dcycAcouLim_C "Akustikgrenze der Lüfter" VALUE 0x1D519C Kw_Ws16 100.0000 DtyCyc 0.00 100.0000 FORMAT "%8.4" EXTENDED_LIMITS -327.6800 327.6700 /end CHARACTERISTIC
/begin CHARACTERISTIC FanCtl_dcycBSGmax_C "Ansteuerwertt bei BSG-Lüfteranforderung" VALUE 0x1D519E Kw_Ws16 100.0000 DtyCyc 0.00 100.0000 FORMAT "%8.4" EXTENDED_LIMITS -327.6800 327.6700 /end CHARACTERISTIC
/begin CHARACTERISTIC FanCtl_dcycCtTThres1_C "Schwellwert 1 des Thermostat-TV" VALUE 0x1D51A0 Kw_Ws16 100.0000 DtyCyc 0.00 100.0000 FORMAT "%8.4" EXTENDED_LIMITS -327.6800 327.6700 /end CHARACTERISTIC
/begin CHARACTERISTIC FanCtl_dcycCtTThres2_C "Schwellwert 2 des Thermostat-TV" VALUE 0x1D51A2 Kw_Ws16 100.0000 DtyCyc 0.00 100.0000 FORMAT "%8.4" EXTENDED_LIMITS -327.6800 327.6700 /end CHARACTERISTIC
/begin CHARACTERISTIC FanCtl_dcycFan1HiLim_C "maximaler Ansteuerwert des Lüfters 1" VALUE 0x1D51A4 Kw_Ws16 100.0000 DtyCyc 0.00 100.0000 FORMAT "%8.4" EXTENDED_LIMITS -327.6800 327.6700 /end CHARACTERISTIC
/begin CHARACTERISTIC FanCtl_dcycFan1LoLim_C "minimaler Ansteuerwert des Lüfters 1" VALUE 0x1D51A6 Kw_Ws16 100.0000 DtyCyc 0.00 100.0000 FORMAT "%8.4" EXTENDED_LIMITS -327.6800 327.6700 /end CHARACTERISTIC
/begin CHARACTERISTIC FanCtl_dcycFan1Preset1_C "Vorgabewert von Dutycycle für Fan1 wenn Kühltemperatur den maximalen Wert überschreitet" VALUE 0x1D51A8 Kw_Ws16 100.0000 DtyCyc 0.00 100.0000 FORMAT "%8.4" EXTENDED_LIMITS -327.6800 327.6700 /end CHARACTERISTIC
/begin CHARACTERISTIC FanCtl_dcycFan1Preset2_C "Vorgabewert von Dutycycle für Fan1 wenn Motor sich in Start Zustand befindet" VALUE 0x1D51AA Kw_Ws16 100.0000 DtyCyc 0.00 100.0000 FORMAT "%8.4" EXTENDED_LIMITS -327.6800 327.6700 /end CHARACTERISTIC
/begin CHARACTERISTIC FanCtl_dcycFan1Preset3_MAP "Berechnete dutycycle für fan1 wenn Fan Control sich im AFTERRUN Zustand befindet" MAP 0x1D51AC Kf_Xs16_Ys16_Ws16 100.0000 DtyCyc 0.00 100.0000 FORMAT "%8.4" EXTENDED_LIMITS -327.6800 327.6700
 /begin AXIS_DESCR STD_AXIS EATSCD_tAir Temp_Cels 5 -53.14000 176.8600 FORMAT "%8.4" EXTENDED_LIMITS -3549.940 3003.560 DEPOSIT ABSOLUTE /end AXIS_DESCR
 /begin AXIS_DESCR STD_AXIS CTSCD_tClnt Temp_Cels 5 -53.14000 176.8600 FORMAT "%8.4" EXTENDED_LIMITS -3549.940 3003.560 DEPOSIT ABSOLUTE /end AXIS_DESCR
/end CHARACTERISTIC
/begin CHARACTERISTIC FanCtl_dcycFan1Rgn_C "Ansteuerersatzwert des Lüfters 1 während Regeneration" VALUE 0x1D51F6 Kw_Ws16 100.0000 DtyCyc 0.00 100.0000 FORMAT "%8.4" EXTENDED_LIMITS -327.6800 327.6700 /end CHARACTERISTIC
/begin CHARACTERISTIC FanCtl_dcycFan1ShutOff_C "Ansteuererersatzwert der Lüfteransteuerung 1 nach dem Lüfternachlauf" VALUE 0x1D51F8 Kw_Ws16 100.0000 DtyCyc 0.00 100.0000 FORMAT "%8.4" EXTENDED_LIMITS -327.6800 327.6700 /end CHARACTERISTIC
/begin CHARACTERISTIC FanCtl_dcycFan1_Vector "Konfigurationsdatei für Bypass Schnittstelle." VALUE 0x1C0A88 Kw_Wu8 255.0 OneToOne 0.00 255.0 FORMAT "%5.1" /end CHARACTERISTIC
/begin CHARACTERISTIC FanCtl_dcycFan1_Channel "Konfigurationslabel für Bypass message" VALUE 0x1C0A89 Kw_Wu8 255.0 OneToOne 0.00 255.0 FORMAT "%5.1" /end CHARACTERISTIC
/begin CHARACTERISTIC FanCtl_dcycFan1_CUR "Kennlinie: Ermittlung des Ansteuerwertes für Lüfter 1" CURVE 0x1D51FA Kl_Xs16_Ws16 100.0000 DtyCyc 0.00 100.0000 FORMAT "%8.4" EXTENDED_LIMITS -327.6800 327.6700
 /begin AXIS_DESCR STD_AXIS FanCtl_nFan1 EngN 8 0.00 32700.00 FORMAT "%8.2" EXTENDED_LIMITS -32768.00 32767.00 DEPOSIT ABSOLUTE /end AXIS_DESCR
/end CHARACTERISTIC
/begin CHARACTERISTIC FanCtl_dcycFan2HiLimVar2_C "maximaler Ansteuerwert für Lüfter 2, Variante 2 (Funktionscodierung)" VALUE 0x1D521C Kw_Ws16 100.0000 DtyCyc 0.00 100.0000 FORMAT "%8.4" EXTENDED_LIMITS -327.6800 327.6700 /end CHARACTERISTIC
/begin CHARACTERISTIC FanCtl_dcycFan2HiLim_C "maximaler Ansteuerwert des Lüfters 2" VALUE 0x1D521E Kw_Ws16 100.0000 DtyCyc 0.00 100.0000 FORMAT "%8.4" EXTENDED_LIMITS -327.6800 327.6700 /end CHARACTERISTIC
/begin CHARACTERISTIC FanCtl_dcycFan2LoLim_C "minimaler Ansteuerwert des Lüfters 2" VALUE 0x1D5220 Kw_Ws16 100.0000 DtyCyc 0.00 100.0000 FORMAT "%8.4" EXTENDED_LIMITS -327.6800 327.6700 /end CHARACTERISTIC
/begin CHARACTERISTIC FanCtl_dcycFan2Preset1_C "Vorgabewert von Dutycycle für Fan2 wenn Kühltemperatur den maximalen Wert überschreitet" VALUE 0x1D5222 Kw_Ws16 100.0000 DtyCyc 0.00 100.0000 FORMAT "%8.4" EXTENDED_LIMITS -327.6800 327.6700 /end CHARACTERISTIC
/begin CHARACTERISTIC FanCtl_dcycFan2Preset2_C "Vorgabewert von Dutycycle für Fan2 wenn Motor sich in Start Zustand befinde" VALUE 0x1D5224 Kw_Ws16 100.0000 DtyCyc 0.00 100.0000 FORMAT "%8.4" EXTENDED_LIMITS -327.6800 327.6700 /end CHARACTERISTIC
/begin CHARACTERISTIC FanCtl_dcycFan2Preset3_MAP "Tastverhältnis für Ansteuerung des Lüfter 2 im Zustand AFTERRUN" MAP 0x1D5226 Kf_Xs16_Ys16_Ws16 100.0000 DtyCyc 0.00 100.0000 FORMAT "%8.4" EXTENDED_LIMITS -327.6800 327.6700
 /begin AXIS_DESCR STD_AXIS EATSCD_tAir Temp_Cels 5 -53.14000 176.8600 FORMAT "%8.4" EXTENDED_LIMITS -3549.940 3003.560 DEPOSIT ABSOLUTE /end AXIS_DESCR
 /begin AXIS_DESCR STD_AXIS CTSCD_tClnt Temp_Cels 5 -53.14000 176.8600 FORMAT "%8.4" EXTENDED_LIMITS -3549.940 3003.560 DEPOSIT ABSOLUTE /end AXIS_DESCR
/end CHARACTERISTIC
/begin CHARACTERISTIC FanCtl_dcycFan2Rgn_C "Ansteuerersatzwert des Lüfters 2 während Regeneration" VALUE 0x1D5270 Kw_Ws16 100.0000 DtyCyc 0.00 100.0000 FORMAT "%8.4" EXTENDED_LIMITS -327.6800 327.6700 /end CHARACTERISTIC
/begin CHARACTERISTIC FanCtl_dcycFan2ShutOff_C "Vorgabewert für die Lüfteransteuerung 2 nach Lüfternachlauf" VALUE 0x1D5272 Kw_Ws16 100.0000 DtyCyc 0.00 100.0000 FORMAT "%8.4" EXTENDED_LIMITS -327.6800 327.6700 /end CHARACTERISTIC
/begin CHARACTERISTIC FanCtl_dcycFan2_Vector "Konfigurationsdatei für Bypass Schnittstelle." VALUE 0x1C0A8A Kw_Wu8 255.0 OneToOne 0.00 255.0 FORMAT "%5.1" /end CHARACTERISTIC
/begin CHARACTERISTIC FanCtl_dcycFan2_Channel "Konfigurationsdatei für die Bypass Schnittstelle." VALUE 0x1C0A8B Kw_Wu8 255.0 OneToOne 0.00 255.0 FORMAT "%5.1" /end CHARACTERISTIC
/begin CHARACTERISTIC FanCtl_dcycFan2_CUR "Kennlinie zur Berechnung des Tastverhältnisses für Lüfter 2" CURVE 0x1D5274 Kl_Xs16_Ws16 100.0000 DtyCyc 0.00 100.0000 FORMAT "%8.4" EXTENDED_LIMITS -327.6800 327.6700
 /begin AXIS_DESCR STD_AXIS FanCtl_nFan2 EngN 8 0.00 32700.00 FORMAT "%8.2" EXTENDED_LIMITS -32768.00 32767.00 DEPOSIT ABSOLUTE /end AXIS_DESCR
/end CHARACTERISTIC
/begin CHARACTERISTIC FanCtl_dcycRampBSGUp_C "Raufschaltrampe (BSG Anforderung)" VALUE 0x1D5298 Kw_Wu32 100.000000000 RmpDtyCyc 0.00 100.000000000 FORMAT "%13.9" EXTENDED_LIMITS 0.00 655359.999847 /end CHARACTERISTIC
/begin CHARACTERISTIC FanCtl_dcycRampBSGDown_C "Runterschaltrampe (BSG Anforderung)" VALUE 0x1D529C Kw_Wu32 100.000000000 RmpDtyCyc 0.00 100.000000000 FORMAT "%13.9" EXTENDED_LIMITS 0.00 655359.999847 /end CHARACTERISTIC
/begin CHARACTERISTIC FanCtl_dtClntDesCorrDfl_C "Temperaturoffset-Wert" VALUE 0x1D52A0 Kw_Ws16 400.0000 TempDiff_Kelv -200.0000 200.0000 FORMAT "%8.4" EXTENDED_LIMITS -3276.800 3276.700 /end CHARACTERISTIC
/begin CHARACTERISTIC FanCtl_dtClntDesCorr_MAP "Kennfeld: Korrekturwert der Solltemperatur" MAP 0x1D52A2 Kf_Xs16_Ys16_Ws16 100.0000 Prc 0.00 100.0000 FORMAT "%8.4" EXTENDED_LIMITS -327.6800 327.6700
 /begin AXIS_DESCR STD_AXIS CtTCtl_dtClntDiff TempDiff_Kelv 5 -200.0000 200.0000 FORMAT "%8.4" EXTENDED_LIMITS -3276.800 3276.700 DEPOSIT ABSOLUTE /end AXIS_DESCR
 /begin AXIS_DESCR STD_AXIS FanCtl_dtClntDes_mp TempDiff_Kelv 5 -200.0000 200.0000 FORMAT "%8.4" EXTENDED_LIMITS -3276.800 3276.700 DEPOSIT ABSOLUTE /end AXIS_DESCR
/end CHARACTERISTIC
/begin CHARACTERISTIC FanCtl_dtClntDesDiff_MAP "Soll-Temperaturdifferenz des Kühlers" MAP 0x1D52EC Kf_Xs16_Ys16_Ws16 100.0000 Prc 0.00 100.0000 FORMAT "%8.4" EXTENDED_LIMITS -327.6800 327.6700
 /begin AXIS_DESCR STD_AXIS EATSCD_tAir Temp_Cels 8 -53.14000 176.8600 FORMAT "%8.4" EXTENDED_LIMITS -3549.940 3003.560 DEPOSIT ABSOLUTE /end AXIS_DESCR
 /begin AXIS_DESCR STD_AXIS CTSCD_tClntCan Temp_Cels 8 -53.14000 176.8600 FORMAT "%8.4" EXTENDED_LIMITS -3549.940 3003.560 DEPOSIT ABSOLUTE /end AXIS_DESCR
/end CHARACTERISTIC
/begin CHARACTERISTIC FanCtl_dtCtTClntDiffThres1_C "Schwellwert 1 der Temperaturabweichung zwischen Kühlmitteltemperatur am Zylinderkopfaustritt und aktueller" VALUE 0x1D5390 Kw_Ws16 400.0000 TempDiff_Kelv -200.0000 200.0000 FORMAT "%8.4" EXTENDED_LIMITS -3276.800 3276.700 /end CHARACTERISTIC
/begin CHARACTERISTIC FanCtl_dtCtTClntDiffThres2_C "Schwellwert 2 der Temperaturabweichung zwischen Soll-Kühlmitteltemperatur am Zylinderkopfaustritt und aktueller" VALUE 0x1D5392 Kw_Ws16 400.0000 TempDiff_Kelv -200.0000 200.0000 FORMAT "%8.4" EXTENDED_LIMITS -3276.800 3276.700 /end CHARACTERISTIC
/begin CHARACTERISTIC FanCtl_factACReqCorr_CUR "Kennlinie: Geschwindigkeitskorrektur der Klimalast" CURVE 0x1D5394 Kl_Xs16_Ws16 1.000000 Fact 0.00 1.000000 FORMAT "%8.6" EXTENDED_LIMITS -4.000000 3.999878
 /begin AXIS_DESCR STD_AXIS VSSCD_v Vel 6 0.00 300.0000 FORMAT "%8.4" EXTENDED_LIMITS -327.6800 327.6700 DEPOSIT ABSOLUTE /end AXIS_DESCR
/end CHARACTERISTIC
/begin CHARACTERISTIC FanCtl_factApReqCorr_CUR "Korrekturkennlinie der Atmosphärendruckleistungsanforderung" CURVE 0x1D53AE Kl_Xs16_Ws16 1.000000 Fact 0.00 1.000000 FORMAT "%8.6" EXTENDED_LIMITS -4.000000 3.999878
 /begin AXIS_DESCR STD_AXIS FanCtl_vCurr2_mp Vel 6 0.00 300.0000 FORMAT "%8.4" EXTENDED_LIMITS -327.6800 327.6700 DEPOSIT ABSOLUTE /end AXIS_DESCR
/end CHARACTERISTIC
/begin CHARACTERISTIC FanCtl_factApReq_MAP "Kühlleistung durch Anfahren in der Höhe" MAP 0x1D53C8 Kf_Xs16_Ys16_Ws16 1.000000 Fact 0.00 1.000000 FORMAT "%8.6" EXTENDED_LIMITS -4.000000 3.999878
 /begin AXIS_DESCR STD_AXIS IATSCD_tAir Temp_Cels 6 -53.14000 226.8600 FORMAT "%8.4" EXTENDED_LIMITS -3549.940 3003.560 DEPOSIT ABSOLUTE /end AXIS_DESCR
 /begin AXIS_DESCR STD_AXIS APSCD_pVal Pres_hPa 6 0.00 2000.000 FORMAT "%8.3" EXTENDED_LIMITS -32768.00 32767.00 DEPOSIT ABSOLUTE /end AXIS_DESCR
/end CHARACTERISTIC
/begin CHARACTERISTIC FanCtl_factARBaseCor_CUR "Korrekturkurve der Nachlaufzeit" CURVE 0x1D542C Kl_Xs16_Ws16 1.000000 Fact 0.00 1.000000 FORMAT "%8.6" EXTENDED_LIMITS -4.000000 3.999878
 /begin AXIS_DESCR STD_AXIS EATSCD_tAir Temp_Cels 4 -53.14000 99.86000 FORMAT "%8.5" EXTENDED_LIMITS -3549.940 3003.560 DEPOSIT ABSOLUTE /end AXIS_DESCR
/end CHARACTERISTIC
/begin CHARACTERISTIC FanCtl_factBattCorr1_CUR "Kennlinie für Batteriekorrektur Lüfter 1" CURVE 0x1D543E Kl_Xs16_Ws16 1.600098 Fact 0.1999512 1.800049 FORMAT "%8.6" EXTENDED_LIMITS -4.000000 3.999878
 /begin AXIS_DESCR STD_AXIS BattCD_u Volt_Batt 4 0.00 20010.04 FORMAT "%8.2" EXTENDED_LIMITS -665674.1 665653.8 DEPOSIT ABSOLUTE /end AXIS_DESCR
/end CHARACTERISTIC
/begin CHARACTERISTIC FanCtl_factBattCorr2_CUR "Kennlinie für Batteriekorrektur Lüfter 2" CURVE 0x1D5450 Kl_Xs16_Ws16 1.600098 Fact 0.1999512 1.800049 FORMAT "%8.6" EXTENDED_LIMITS -4.000000 3.999878
 /begin AXIS_DESCR STD_AXIS BattCD_u Volt_Batt 4 0.00 20010.04 FORMAT "%8.2" EXTENDED_LIMITS -665674.1 665653.8 DEPOSIT ABSOLUTE /end AXIS_DESCR
/end CHARACTERISTIC
/begin CHARACTERISTIC FanCtl_factCorr_CUR "Korrekturfaktor des Temperaturdifferenzsollwertes des Kühlers" CURVE 0x1D5462 Kl_Xs16_Ws16 3.250000 Fact 0.00 3.250000 FORMAT "%8.6" EXTENDED_LIMITS -4.000000 3.999878
 /begin AXIS_DESCR STD_AXIS Eng_nAvrg EngN 8 0.00 6500.000 FORMAT "%8.3" EXTENDED_LIMITS -32768.00 32767.00 DEPOSIT ABSOLUTE /end AXIS_DESCR
/end CHARACTERISTIC
/begin CHARACTERISTIC FanCtl_nFan1Base_MAP "Kennfeld: Ermittlung der Basisdrehzahl des Lüfters 1" MAP 0x1D5484 Kf_Xs16_Ys16_Ws16 32700.00 EngN 0.00 32700.00 FORMAT "%8.2" EXTENDED_LIMITS -32768.00 32767.00
 /begin AXIS_DESCR STD_AXIS Eng_nAvrg EngN 8 0.00 6500.000 FORMAT "%8.3" EXTENDED_LIMITS -32768.00 32767.00 DEPOSIT ABSOLUTE /end AXIS_DESCR
 /begin AXIS_DESCR STD_AXIS FanCtl_prcRampFan1_mp Prc 8 0.00 100.0000 FORMAT "%8.4" EXTENDED_LIMITS -327.6800 327.6700 DEPOSIT ABSOLUTE /end AXIS_DESCR
/end CHARACTERISTIC
/begin CHARACTERISTIC FanCtl_nFan1MinThres1Var2_C "obere Schwelle für 1. Drehzahlausblendbereich Lüfter 1, Variante 2" VALUE 0x1D5528 Kw_Ws16 32000.00 EngN 0.00 32000.00 FORMAT "%8.2" EXTENDED_LIMITS -32768.00 32767.00 /end CHARACTERISTIC
/begin CHARACTERISTIC FanCtl_nFan1MaxThres1Var2_C "obere Schwell des 1. Drehzahlausblendbereichs des Lüfters 1, Variante 2" VALUE 0x1D552A Kw_Ws16 32000.00 EngN 0.00 32000.00 FORMAT "%8.2" EXTENDED_LIMITS -32768.00 32767.00 /end CHARACTERISTIC
/begin CHARACTERISTIC FanCtl_nFan1MinThres2Var2_C "untere Schwelle für 2. Drehzahlausblendbereich für Lüfter 1, Variante 2" VALUE 0x1D552C Kw_Ws16 32000.00 EngN 0.00 32000.00 FORMAT "%8.2" EXTENDED_LIMITS -32768.00 32767.00 /end CHARACTERISTIC
/begin CHARACTERISTIC FanCtl_nFan1MaxThres2Var2_C "obere Schwell des 2. Drehzahlausblendbereichs des Lüfter 1, Variante 2" VALUE 0x1D552E Kw_Ws16 32000.00 EngN 0.00 32000.00 FORMAT "%8.2" EXTENDED_LIMITS -32768.00 32767.00 /end CHARACTERISTIC
/begin CHARACTERISTIC FanCtl_nFan1MinThres3Var2_C "untere Schwelle für 3. Drehzahlausblendbereich Lüfter 1, Variante 2" VALUE 0x1D5530 Kw_Ws16 32000.00 EngN 0.00 32000.00 FORMAT "%8.2" EXTENDED_LIMITS -32768.00 32767.00 /end CHARACTERISTIC
/begin CHARACTERISTIC FanCtl_nFan1MaxThres3Var2_C "obere Schwelle des 3. Drehzahlausblendbereiches für Lüfter 1, Variante 2" VALUE 0x1D5532 Kw_Ws16 32000.00 EngN 0.00 32000.00 FORMAT "%8.2" EXTENDED_LIMITS -32768.00 32767.00 /end CHARACTERISTIC
/begin CHARACTERISTIC FanCtl_nFan1MinThres4Var2_C "unetere Schwelle des 4. Drehzahlausblendbereichs Lüfter 1, Variante 2" VALUE 0x1D5534 Kw_Ws16 32000.00 EngN 0.00 32000.00 FORMAT "%8.2" EXTENDED_LIMITS -32768.00 32767.00 /end CHARACTERISTIC
/begin CHARACTERISTIC FanCtl_nFan1MaxThres4Var2_C "obere Schwelle für 4. Drehzahlausblendbereich, Variante 2" VALUE 0x1D5536 Kw_Ws16 32000.00 EngN 0.00 32000.00 FORMAT "%8.2" EXTENDED_LIMITS -32768.00 32767.00 /end CHARACTERISTIC
/begin CHARACTERISTIC FanCtl_nFan1MinThres5Var2_C "untere Schwelle des 5. Drehzahlausblendbereichs, Variante 2" VALUE 0x1D5538 Kw_Ws16 32000.00 EngN 0.00 32000.00 FORMAT "%8.2" EXTENDED_LIMITS -32768.00 32767.00 /end CHARACTERISTIC
/begin CHARACTERISTIC FanCtl_nFan1MaxThres5Var2_C "obere Schwelle für 5. Drehzahlausblendbereich für Lüfter 1, Variante 2" VALUE 0x1D553A Kw_Ws16 32000.00 EngN 0.00 32000.00 FORMAT "%8.2" EXTENDED_LIMITS -32768.00 32767.00 /end CHARACTERISTIC
/begin CHARACTERISTIC FanCtl_nFan1MinThres1_C "Untere Schwelle des 1. ausgeblendeten Drehzahlbereichs für Lüfter 1" VALUE 0x1D553C Kw_Ws16 32000.00 EngN 0.00 32000.00 FORMAT "%8.2" EXTENDED_LIMITS -32768.00 32767.00 /end CHARACTERISTIC
/begin CHARACTERISTIC FanCtl_nFan1MaxThres1_C "Obere Schwelle des 1. ausgeblendeten Drehzahlbereichs für Lüfter 1" VALUE 0x1D553E Kw_Ws16 32000.00 EngN 0.00 32000.00 FORMAT "%8.2" EXTENDED_LIMITS -32768.00 32767.00 /end CHARACTERISTIC
/begin CHARACTERISTIC FanCtl_nFan1MinThres2_C "Untere Schwelle des 2. ausgeblendeten Drehzahlbereichs für Lüfter 1" VALUE 0x1D5540 Kw_Ws16 32000.00 EngN 0.00 32000.00 FORMAT "%8.2" EXTENDED_LIMITS -32768.00 32767.00 /end CHARACTERISTIC
/begin CHARACTERISTIC FanCtl_nFan1MaxThres2_C "Obere Schwelle des 2. ausgeblendeten Drehzahlbereichs für Lüfter 1" VALUE 0x1D5542 Kw_Ws16 32000.00 EngN 0.00 32000.00 FORMAT "%8.2" EXTENDED_LIMITS -32768.00 32767.00 /end CHARACTERISTIC
/begin CHARACTERISTIC FanCtl_nFan1MinThres3_C "Untere Schwelle des 3. ausgeblendeten Drehzahlbereichs für Lüfter 1" VALUE 0x1D5544 Kw_Ws16 32000.00 EngN 0.00 32000.00 FORMAT "%8.2" EXTENDED_LIMITS -32768.00 32767.00 /end CHARACTERISTIC
/begin CHARACTERISTIC FanCtl_nFan1MaxThres3_C "Obere Schwelle des 3. ausgeblendeten Drehzahlbereichs für Lüfter 1" VALUE 0x1D5546 Kw_Ws16 32000.00 EngN 0.00 32000.00 FORMAT "%8.2" EXTENDED_LIMITS -32768.00 32767.00 /end CHARACTERISTIC
/begin CHARACTERISTIC FanCtl_nFan1MinThres4_C "Untere Schwelle des 4. ausgeblendeten Drehzahlbereichs für Lüfter 1" VALUE 0x1D5548 Kw_Ws16 32000.00 EngN 0.00 32000.00 FORMAT "%8.2" EXTENDED_LIMITS -32768.00 32767.00 /end CHARACTERISTIC
/begin CHARACTERISTIC FanCtl_nFan1MaxThres4_C "Obere Schwelle des 4. ausgeblendeten Drehzahlbereichs für Lüfter 1" VALUE 0x1D554A Kw_Ws16 32000.00 EngN 0.00 32000.00 FORMAT "%8.2" EXTENDED_LIMITS -32768.00 32767.00 /end CHARACTERISTIC
/begin CHARACTERISTIC FanCtl_nFan1MinThres5_C "Untere Schwelle des 5. ausgeblendeten Drehzahlbereichs für Lüfter 1" VALUE 0x1D554C Kw_Ws16 32000.00 EngN 0.00 32000.00 FORMAT "%8.2" EXTENDED_LIMITS -32768.00 32767.00 /end CHARACTERISTIC
/begin CHARACTERISTIC FanCtl_nFan1MaxThres5_C "Obere Schwelle des 5. ausgeblendeten Drehzahlbereichs für Lüfter 1" VALUE 0x1D554E Kw_Ws16 32000.00 EngN 0.00 32000.00 FORMAT "%8.2" EXTENDED_LIMITS -32768.00 32767.00 /end CHARACTERISTIC
/begin CHARACTERISTIC FanCtl_nFan1XLow_C "unterer Hysteresenwert für die Ausblendbedingungen des Lüfters 1" VALUE 0x1D5550 Kw_Ws16 6000.000 EngN 0.00 6000.000 FORMAT "%8.3" EXTENDED_LIMITS -32768.00 32767.00 /end CHARACTERISTIC
/begin CHARACTERISTIC FanCtl_nFan1XHigh_C "oberer Hysteresenwert für die Ausblendbedingungen des Lüfters 1" VALUE 0x1D5552 Kw_Ws16 6000.000 EngN 0.00 6000.000 FORMAT "%8.3" EXTENDED_LIMITS -32768.00 32767.00 /end CHARACTERISTIC
/begin CHARACTERISTIC FanCtl_stFan1YLow_C "Hysteresewert wenn der Hystereseingang für Lüfter 1 unter der unteren Schwelle ist" VALUE 0x1D5554 Kw_Ws16 0.00 OneToOne 0.00 0.00 FORMAT "%8.2" EXTENDED_LIMITS -32768.00 32767.00 READ_ONLY /end CHARACTERISTIC
/begin CHARACTERISTIC FanCtl_stFan1YHigh_C "Hysteresewert wenn der Hystereseingang für Lüfter 1 über der oberen Schwelle ist" VALUE 0x1D5556 Kw_Ws16 0.00 OneToOne 1.000000 1.000000 FORMAT "%8.6" EXTENDED_LIMITS -32768.00 32767.00 READ_ONLY /end CHARACTERISTIC
/begin CHARACTERISTIC FanCtl_nFan1Min_C "Minimaldrehzahlvorgabewert für die Ausblendbedingungen des Lüfters 1" VALUE 0x1D5558 Kw_Ws16 6000.000 EngN 0.00 6000.000 FORMAT "%8.3" EXTENDED_LIMITS -32768.00 32767.00 /end CHARACTERISTIC
/begin CHARACTERISTIC FanCtl_nFan2Base_MAP "Kennfeld: Ermittlung der Basisdrehzahl des Lüfters 2" MAP 0x1D555A Kf_Xs16_Ys16_Ws16 32700.00 EngN 0.00 32700.00 FORMAT "%8.2" EXTENDED_LIMITS -32768.00 32767.00
 /begin AXIS_DESCR STD_AXIS Eng_nAvrg EngN 8 0.00 6500.000 FORMAT "%8.3" EXTENDED_LIMITS -32768.00 32767.00 DEPOSIT ABSOLUTE /end AXIS_DESCR
 /begin AXIS_DESCR STD_AXIS FanCtl_prcRampFan2_mp Prc 8 0.00 100.0000 FORMAT "%8.4" EXTENDED_LIMITS -327.6800 327.6700 DEPOSIT ABSOLUTE /end AXIS_DESCR
/end CHARACTERISTIC
/begin CHARACTERISTIC FanCtl_nFan2MinThres1Var2_C "untere Schwelle des 1. Drehzahlausblendbereichs für Lüfter 2, Variante 2" VALUE 0x1D55FE Kw_Ws16 32000.00 EngN 0.00 32000.00 FORMAT "%8.2" EXTENDED_LIMITS -32768.00 32767.00 /end CHARACTERISTIC
/begin CHARACTERISTIC FanCtl_nFan2MaxThres1Var2_C "obere Schwelle der 1. Drehzahlausblendungsbereich Lüfter 2, Variante 2" VALUE 0x1D5600 Kw_Ws16 32000.00 EngN 0.00 32000.00 FORMAT "%8.2" EXTENDED_LIMITS -32768.00 32767.00 /end CHARACTERISTIC
/begin CHARACTERISTIC FanCtl_nFan2MinThres2Var2_C "untere Schwelle des 2. Drehzahlausblendbereichs für Lüfter 2, Variante 2" VALUE 0x1D5602 Kw_Ws16 32000.00 EngN 0.00 32000.00 FORMAT "%8.2" EXTENDED_LIMITS -32768.00 32767.00 /end CHARACTERISTIC
/begin CHARACTERISTIC FanCtl_nFan2MaxThres2Var2_C "obere Schwelle des 2. Drehzahlausblendbereichs Lüfter 2, Variante 2" VALUE 0x1D5604 Kw_Ws16 32000.00 EngN 0.00 32000.00 FORMAT "%8.2" EXTENDED_LIMITS -32768.00 32767.00 /end CHARACTERISTIC
/begin CHARACTERISTIC FanCtl_nFan2MinThres3Var2_C "untere Schwelle des 3. Drehzahlausblendbereichs für 2. Lüfter, variant 2" VALUE 0x1D5606 Kw_Ws16 32000.00 EngN 0.00 32000.00 FORMAT "%8.2" EXTENDED_LIMITS -32768.00 32767.00 /end CHARACTERISTIC
/begin CHARACTERISTIC FanCtl_nFan2MaxThres3Var2_C "obere Schwelle des 3. Drehzahlausblendbereichs für Lüfter 2, Variante 2" VALUE 0x1D5608 Kw_Ws16 32000.00 EngN 0.00 32000.00 FORMAT "%8.2" EXTENDED_LIMITS -32768.00 32767.00 /end CHARACTERISTIC
/begin CHARACTERISTIC FanCtl_nFan2MinThres4Var2_C "untere Schwelle des 4. Drehzahlausblendbereichs für Lüfter 2, Variante 2" VALUE 0x1D560A Kw_Ws16 32000.00 EngN 0.00 32000.00 FORMAT "%8.2" EXTENDED_LIMITS -32768.00 32767.00 /end CHARACTERISTIC
/begin CHARACTERISTIC FanCtl_nFan2MaxThres4Var2_C "obere Schwelle des 4. Drehzahlausblendbereichs für Lüfter 2, Variante 2" VALUE 0x1D560C Kw_Ws16 32000.00 EngN 0.00 32000.00 FORMAT "%8.2" EXTENDED_LIMITS -32768.00 32767.00 /end CHARACTERISTIC
/begin CHARACTERISTIC FanCtl_nFan2MinThres5Var2_C "untere Schwelle des 5. Drehzahlausblendbereichs für Lüfter 2, Variante 2" VALUE 0x1D560E Kw_Ws16 32000.00 EngN 0.00 32000.00 FORMAT "%8.2" EXTENDED_LIMITS -32768.00 32767.00 /end CHARACTERISTIC
/begin CHARACTERISTIC FanCtl_nFan2MaxThres5Var2_C "obere Schwelle des 5. Drehzahlausblendbereichs für Lüfter 2, Variante 2" VALUE 0x1D5610 Kw_Ws16 32000.00 EngN 0.00 32000.00 FORMAT "%8.2" EXTENDED_LIMITS -32768.00 32767.00 /end CHARACTERISTIC
/begin CHARACTERISTIC FanCtl_nFan2MinThres1Var3_C "untere Schwell des 1. Drehzahlausblendbereichs für Lüfter 2, Variante 3" VALUE 0x1D5612 Kw_Ws16 32000.00 EngN 0.00 32000.00 FORMAT "%8.2" EXTENDED_LIMITS -32768.00 32767.00 /end CHARACTERISTIC
/begin CHARACTERISTIC FanCtl_nFan2MaxThres1Var3_C "obere Schwelle des 1. Drehzahlausblendbereichs Lüfter 2, Variante 3" VALUE 0x1D5614 Kw_Ws16 32000.00 EngN 0.00 32000.00 FORMAT "%8.2" EXTENDED_LIMITS -32768.00 32767.00 /end CHARACTERISTIC
/begin CHARACTERISTIC FanCtl_nFan2MinThres2Var3_C "untere Schwelle des 2. Drehzahlausblendbereichs für Lüfter 2, Variante 3" VALUE 0x1D5616 Kw_Ws16 32000.00 EngN 0.00 32000.00 FORMAT "%8.2" EXTENDED_LIMITS -32768.00 32767.00 /end CHARACTERISTIC
/begin CHARACTERISTIC FanCtl_nFan2MaxThres2Var3_C "obere Schwelle des 2. Drehzahlausblendbereichs Lüfter 2, Variante 3" VALUE 0x1D5618 Kw_Ws16 32000.00 EngN 0.00 32000.00 FORMAT "%8.2" EXTENDED_LIMITS -32768.00 32767.00 /end CHARACTERISTIC
/begin CHARACTERISTIC FanCtl_nFan2MinThres3Var3_C "untere Schwelle des 3. Drehzahlausblendbereichs für Lüfter 2, Variante 3" VALUE 0x1D561A Kw_Ws16 32000.00 EngN 0.00 32000.00 FORMAT "%8.2" EXTENDED_LIMITS -32768.00 32767.00 /end CHARACTERISTIC
/begin CHARACTERISTIC FanCtl_nFan2MaxThres3Var3_C "obere Schwelle für 3. Drehzahlausblendbereich für Lüfter 2, Variante 3" VALUE 0x1D561C Kw_Ws16 32000.00 EngN 0.00 32000.00 FORMAT "%8.2" EXTENDED_LIMITS -32768.00 32767.00 /end CHARACTERISTIC
/begin CHARACTERISTIC FanCtl_nFan2MinThres4Var3_C "untere Schwelle des 4. Drehzahlausblendbereichs für Lüfter 2, Variante 3" VALUE 0x1D561E Kw_Ws16 32000.00 EngN 0.00 32000.00 FORMAT "%8.2" EXTENDED_LIMITS -32768.00 32767.00 /end CHARACTERISTIC
/begin CHARACTERISTIC FanCtl_nFan2MaxThres4Var3_C "obere Schwelle des 4. Drehzahlausblendbereichs für Lüfter 2, Variante 3" VALUE 0x1D5620 Kw_Ws16 32000.00 EngN 0.00 32000.00 FORMAT "%8.2" EXTENDED_LIMITS -32768.00 32767.00 /end CHARACTERISTIC
/begin CHARACTERISTIC FanCtl_nFan2MinThres5Var3_C "untere Schwelle des 5. Drehzahlausblendbereichs für Lüfter 2, Varianate 3" VALUE 0x1D5622 Kw_Ws16 32000.00 EngN 0.00 32000.00 FORMAT "%8.2" EXTENDED_LIMITS -32768.00 32767.00 /end CHARACTERISTIC
/begin CHARACTERISTIC FanCtl_nFan2MaxThres5Var3_C "obere Drehzahlschwelle des 5. Ausblendbereichs für Lüfter 2, Variante 3" VALUE 0x1D5624 Kw_Ws16 32000.00 EngN 0.00 32000.00 FORMAT "%8.2" EXTENDED_LIMITS -32768.00 32767.00 /end CHARACTERISTIC
/begin CHARACTERISTIC FanCtl_nFan2MinThres1_C "Untere Schwelle des 1. ausgeblendeten Drehzahlbereichs für Lüfter 2" VALUE 0x1D5626 Kw_Ws16 32000.00 EngN 0.00 32000.00 FORMAT "%8.2" EXTENDED_LIMITS -32768.00 32767.00 /end CHARACTERISTIC
/begin CHARACTERISTIC FanCtl_nFan2MaxThres1_C "Obere Schwelle des 1. ausgeblendeten Drehzahlbereichs für Lüfter 2" VALUE 0x1D5628 Kw_Ws16 32000.00 EngN 0.00 32000.00 FORMAT "%8.2" EXTENDED_LIMITS -32768.00 32767.00 /end CHARACTERISTIC
/begin CHARACTERISTIC FanCtl_nFan2MinThres2_C "Untere Schwelle des 2. ausgeblendeten Drehzahlbereichs für Lüfter 2" VALUE 0x1D562A Kw_Ws16 32000.00 EngN 0.00 32000.00 FORMAT "%8.2" EXTENDED_LIMITS -32768.00 32767.00 /end CHARACTERISTIC
/begin CHARACTERISTIC FanCtl_nFan2MaxThres2_C "Obere Schwelle des 2. ausgeblendeten Drehzahlbereichs für Lüfter 2" VALUE 0x1D562C Kw_Ws16 32000.00 EngN 0.00 32000.00 FORMAT "%8.2" EXTENDED_LIMITS -32768.00 32767.00 /end CHARACTERISTIC
/begin CHARACTERISTIC FanCtl_nFan2MinThres3_C "Untere Schwelle des 3. ausgeblendeten Drehzahlbereichs für Lüfter 2" VALUE 0x1D562E Kw_Ws16 32000.00 EngN 0.00 32000.00 FORMAT "%8.2" EXTENDED_LIMITS -32768.00 32767.00 /end CHARACTERISTIC
/begin CHARACTERISTIC FanCtl_nFan2MaxThres3_C "Obere Schwelle des 3. ausgeblendeten Drehzahlbereichs für Lüfter 2" VALUE 0x1D5630 Kw_Ws16 32000.00 EngN 0.00 32000.00 FORMAT "%8.2" EXTENDED_LIMITS -32768.00 32767.00 /end CHARACTERISTIC
/begin CHARACTERISTIC FanCtl_nFan2MinThres4_C "Untere Schwelle des 4. ausgeblendeten Drehzahlbereichs für Lüfter 2" VALUE 0x1D5632 Kw_Ws16 32000.00 EngN 0.00 32000.00 FORMAT "%8.2" EXTENDED_LIMITS -32768.00 32767.00 /end CHARACTERISTIC
/begin CHARACTERISTIC FanCtl_nFan2MaxThres4_C "Obere Schwelle des 4. ausgeblendeten Drehzahlbereichs für Lüfter 2" VALUE 0x1D5634 Kw_Ws16 32000.00 EngN 0.00 32000.00 FORMAT "%8.2" EXTENDED_LIMITS -32768.00 32767.00 /end CHARACTERISTIC
/begin CHARACTERISTIC FanCtl_nFan2MinThres5_C "Untere Schwelle des 5. ausgeblendeten Drehzahlbereichs für Lüfter 2" VALUE 0x1D5636 Kw_Ws16 32000.00 EngN 0.00 32000.00 FORMAT "%8.2" EXTENDED_LIMITS -32768.00 32767.00 /end CHARACTERISTIC
/begin CHARACTERISTIC FanCtl_nFan2MaxThres5_C "Obere Schwelle des 5. ausgeblendeten Drehzahlbereichs für Lüfter 2" VALUE 0x1D5638 Kw_Ws16 32000.00 EngN 0.00 32000.00 FORMAT "%8.2" EXTENDED_LIMITS -32768.00 32767.00 /end CHARACTERISTIC
/begin CHARACTERISTIC FanCtl_nFan2XLow_C "unterer Hysteresenwert für die Ausblendbedingungen des Lüfters 2" VALUE 0x1D563A Kw_Ws16 6000.000 EngN 0.00 6000.000 FORMAT "%8.3" EXTENDED_LIMITS -32768.00 32767.00 /end CHARACTERISTIC
/begin CHARACTERISTIC FanCtl_nFan2XHigh_C "oberer Hysteresenwert für die Ausblendbedingungen des Lüfters 2" VALUE 0x1D563C Kw_Ws16 6000.000 EngN 0.00 6000.000 FORMAT "%8.3" EXTENDED_LIMITS -32768.00 32767.00 /end CHARACTERISTIC
/begin CHARACTERISTIC FanCtl_stFan2YLow_C "Hysteresewert wenn der Hystereseingang Lüfter 1unter der unteren Schwelle ist" VALUE 0x1D563E Kw_Ws16 0.00 OneToOne 0.00 0.00 FORMAT "%8.2" EXTENDED_LIMITS -32768.00 32767.00 READ_ONLY /end CHARACTERISTIC
/begin CHARACTERISTIC FanCtl_stFan2YHigh_C "Hysteresewert wenn der Hystereseingang für Lüfter 2 über der oberen Schwelle ist" VALUE 0x1D5640 Kw_Ws16 0.00 OneToOne 1.000000 1.000000 FORMAT "%8.6" EXTENDED_LIMITS -32768.00 32767.00 READ_ONLY /end CHARACTERISTIC
/begin CHARACTERISTIC FanCtl_nFan2Min_C "Minimaldrehzahlvorgabewert für die Ausblendbedingungen des Lüfters 2" VALUE 0x1D5642 Kw_Ws16 6000.000 EngN 0.00 6000.000 FORMAT "%8.3" EXTENDED_LIMITS -32768.00 32767.00 /end CHARACTERISTIC
/begin CHARACTERISTIC FanCtl_pACCDDfl_C "Vorgabewert Klimakompressordruck bei defektem Sensor" VALUE 0x1D5644 Kw_Ws16 60000.00 PresAC_hPa 0.00 60000.00 FORMAT "%8.2" EXTENDED_LIMITS -65536.00 65534.00 /end CHARACTERISTIC
/begin CHARACTERISTIC FanCtl_pAcHigh_C "oberer Schwellwert des Klimadruckes" VALUE 0x1D5646 Kw_Ws16 60000.00 PresAC_hPa 0.00 60000.00 FORMAT "%8.2" EXTENDED_LIMITS -65536.00 65534.00 /end CHARACTERISTIC
/begin CHARACTERISTIC FanCtl_pAcLow_C "unterer Schwellwert des Klimadruckes" VALUE 0x1D5648 Kw_Ws16 60000.00 PresAC_hPa 0.00 60000.00 FORMAT "%8.2" EXTENDED_LIMITS -65536.00 65534.00 /end CHARACTERISTIC
/begin CHARACTERISTIC FanCtl_RglIKi_C "Ki für Eingangssignale innerhalb des Fensters" VALUE 0x1D564C Kw_Wu32 1.99999194592 Ki_Temp2Prc 0.00 1.99999194592 FORMAT "%13.11" EXTENDED_LIMITS 0.00 99999.9999767 /end CHARACTERISTIC
/begin CHARACTERISTIC FanCtl_RglIKiPos_C "Ki für Eingangssignaländerungen über die positive Fenstergrenze" VALUE 0x1D5650 Kw_Wu32 1.99999194592 Ki_Temp2Prc 0.00 1.99999194592 FORMAT "%13.11" EXTENDED_LIMITS 0.00 99999.9999767 /end CHARACTERISTIC
/begin CHARACTERISTIC FanCtl_RglIKiNeg_C "Ki für Eingangssignaländerungen über die negative Fenstergrenze" VALUE 0x1D5654 Kw_Wu32 1.99999194592 Ki_Temp2Prc 0.00 1.99999194592 FORMAT "%13.11" EXTENDED_LIMITS 0.00 99999.9999767 /end CHARACTERISTIC
/begin CHARACTERISTIC FanCtl_RglIWinPos_C "Positive Fenstergrenze des I-Gliedes" VALUE 0x1D5658 Kw_Ws16 400.0000 TempDiff_Kelv -200.0000 200.0000 FORMAT "%8.4" EXTENDED_LIMITS -3276.800 3276.700 /end CHARACTERISTIC
/begin CHARACTERISTIC FanCtl_RglIWinNeg_C "Negative Fenstergrenze des I-Gliedes" VALUE 0x1D565A Kw_Ws16 400.0000 TempDiff_Kelv -200.0000 200.0000 FORMAT "%8.4" EXTENDED_LIMITS -3276.800 3276.700 /end CHARACTERISTIC
/begin CHARACTERISTIC FanCtl_tiPT1Neg_C "Zeitkonstante für negative Eingangswertänderung" VALUE 0x1D565C Kw_Wu32 4294.9673 TimeDelay_s 0.0000010000000 4294.9673 FORMAT "%9.4" /end CHARACTERISTIC
/begin CHARACTERISTIC FanCtl_tiPT1Pos_C "Zeitkonstante für positive Eingangswertänderung" VALUE 0x1D5660 Kw_Wu32 4294.9673 TimeDelay_s 0.0000010000000 4294.9673 FORMAT "%9.4" /end CHARACTERISTIC
/begin CHARACTERISTIC FanCtl_dprcRampFan1Up_C "positive Rampensteigung der Kühlleistung des Lüfters 1" VALUE 0x1D5664 Kw_Wu32 5000.00000000 RmpPrc 0.00 5000.00000000 FORMAT "%13.8" EXTENDED_LIMITS 0.00 655359.999847 /end CHARACTERISTIC
/begin CHARACTERISTIC FanCtl_dprcRampFan1Down_C "negative Rampensteigung der Kühlleistung des Lüfters 1" VALUE 0x1D5668 Kw_Wu32 5000.00000000 RmpPrc 0.00 5000.00000000 FORMAT "%13.8" EXTENDED_LIMITS 0.00 655359.999847 /end CHARACTERISTIC
/begin CHARACTERISTIC FanCtl_dprcRampFan2Up_C "positive Rampensteigung der Kühlleistung des Lüfters 2" VALUE 0x1D566C Kw_Wu32 5000.00000000 RmpPrc 0.00 5000.00000000 FORMAT "%13.8" EXTENDED_LIMITS 0.00 655359.999847 /end CHARACTERISTIC
/begin CHARACTERISTIC FanCtl_dprcRampFan2Down_C "negative Rampensteigung der Kühlleistung des Lüfters 2" VALUE 0x1D5670 Kw_Wu32 5000.00000000 RmpPrc 0.00 5000.00000000 FORMAT "%13.8" EXTENDED_LIMITS 0.00 655359.999847 /end CHARACTERISTIC
/begin CHARACTERISTIC FanCtl_prcARTime_C "Zeitpunkt der 2. Nachlaufzeitberechnung in Prozent der 1. Nachlaufzeit" VALUE 0x1D5674 Kw_Ws16 100.0000 Prc 0.00 100.0000 FORMAT "%8.4" EXTENDED_LIMITS -327.6800 327.6700 /end CHARACTERISTIC
/begin CHARACTERISTIC FanCtl_prcCanReq_CUR "Kennlinie zur Ermittlung des Ansteursignals aus der CAN-Anforderung" CURVE 0x1D5676 Kl_Xs16_Ws16 100.0000 Prc 0.00 100.0000 FORMAT "%8.4" EXTENDED_LIMITS -327.6800 327.6700
 /begin AXIS_DESCR STD_AXIS FanCtl_prcFan_mp Prc 5 0.00 100.0000 FORMAT "%8.4" EXTENDED_LIMITS -327.6800 327.6700 DEPOSIT ABSOLUTE /end AXIS_DESCR
/end CHARACTERISTIC
/begin CHARACTERISTIC FanCtl_prcClntInc_CUR "Zusatzkühlung für Angeforderte Motortemperatur von CAN" CURVE 0x1D568C Kl_Xs16_Ws16 100.0000 Prc 0.00 100.0000 FORMAT "%8.4" EXTENDED_LIMITS -327.6800 327.6700
 /begin AXIS_DESCR STD_AXIS FrmMng_stClgGearbx OneToOne 4 0.00 3.000 FORMAT "%5.3" EXTENDED_LIMITS 0.00 255.0 DEPOSIT ABSOLUTE /end AXIS_DESCR
/end CHARACTERISTIC
/begin CHARACTERISTIC FanCtl_prcCnvVar2_MAP "Kennfeld zur Umwandlung in relative Kühlleistung, Variante 2" MAP 0x1D569E Kf_Xs16_Ys16_Ws16 100.0000 Prc 0.00 100.0000 FORMAT "%8.4" EXTENDED_LIMITS -327.6800 327.6700
 /begin AXIS_DESCR STD_AXIS FanCtl_dcycFan2 DtyCyc 6 0.00 100.0000 FORMAT "%8.4" EXTENDED_LIMITS -327.6800 327.6700 DEPOSIT ABSOLUTE /end AXIS_DESCR
 /begin AXIS_DESCR STD_AXIS FanCtl_dcycFan1 DtyCyc 6 0.00 100.0000 FORMAT "%8.4" EXTENDED_LIMITS -327.6800 327.6700 DEPOSIT ABSOLUTE /end AXIS_DESCR
/end CHARACTERISTIC
/begin CHARACTERISTIC FanCtl_prcCnv_MAP "Umwandlung in Prozent relative Kühlleistung für das Lüfter-SG" MAP 0x1D5702 Kf_Xs16_Ys16_Ws16 100.0000 Prc 0.00 100.0000 FORMAT "%8.4" EXTENDED_LIMITS -327.6800 327.6700
 /begin AXIS_DESCR STD_AXIS FanCtl_dcycFan2 DtyCyc 6 0.00 100.0000 FORMAT "%8.4" EXTENDED_LIMITS -327.6800 327.6700 DEPOSIT ABSOLUTE /end AXIS_DESCR
 /begin AXIS_DESCR STD_AXIS FanCtl_dcycFan1 DtyCyc 6 0.00 100.0000 FORMAT "%8.4" EXTENDED_LIMITS -327.6800 327.6700 DEPOSIT ABSOLUTE /end AXIS_DESCR
/end CHARACTERISTIC
/begin CHARACTERISTIC FanCtl_prcCtl_MAP "Kennfeld: Ermittlung des Steuerwertes des zusätzlichen Kühlbedarfs" MAP 0x1D5766 Kf_Xs16_Ys16_Ws16 100.0000 Prc 0.00 100.0000 FORMAT "%8.4" EXTENDED_LIMITS -327.6800 327.6700
 /begin AXIS_DESCR STD_AXIS FanCtl_vCurr_mp Vel 8 0.00 300.0000 FORMAT "%8.4" EXTENDED_LIMITS -327.6800 327.6700 DEPOSIT ABSOLUTE /end AXIS_DESCR
 /begin AXIS_DESCR STD_AXIS FanCtl_prcRelClntDes2_mp Prc 8 0.00 100.0000 FORMAT "%8.4" EXTENDED_LIMITS -327.6800 327.6700 DEPOSIT ABSOLUTE /end AXIS_DESCR
/end CHARACTERISTIC
/begin CHARACTERISTIC FanCtl_prcFanDfl_C "Ersatzwert fuer FrmMng_prcFan" VALUE 0x1D580A Kw_Ws16 100.0000 Prc 0.00 100.0000 FORMAT "%8.4" EXTENDED_LIMITS -327.6800 327.6700 /end CHARACTERISTIC
/begin CHARACTERISTIC FanCtl_prcHiLimI_C "Maximumbegrenzung des I-Reglers für die Ermittlung des zusätzlichen Kühlbedarfs" VALUE 0x1D580C Kw_Ws16 20000.00 Prc -10000.00 10000.00 FORMAT "%8.2" EXTENDED_LIMITS -327.6800 327.6700 /end CHARACTERISTIC
/begin CHARACTERISTIC FanCtl_prcLoLimI_C "Minimumbegrenzung des I-Reglers für die Ermittlung des zusätzlichen Kühlbedarfs" VALUE 0x1D580E Kw_Ws16 20000.00 Prc -10000.00 10000.00 FORMAT "%8.2" EXTENDED_LIMITS -327.6800 327.6700 /end CHARACTERISTIC
/begin CHARACTERISTIC FanCtl_prcHiLim_C "Obere Begrenzung des zusätzlichen Kühlbedarfs" VALUE 0x1D5810 Kw_Ws16 100.0000 Prc 0.00 100.0000 FORMAT "%8.4" EXTENDED_LIMITS -327.6800 327.6700 /end CHARACTERISTIC
/begin CHARACTERISTIC FanCtl_prcLoLim_C "Untere Begrenzung des zusätzlichen Kühlbedarfs" VALUE 0x1D5812 Kw_Ws16 100.0000 Prc 0.00 100.0000 FORMAT "%8.4" EXTENDED_LIMITS -327.6800 327.6700 /end CHARACTERISTIC
/begin CHARACTERISTIC FanCtl_prcQKakt_MAP "Kennfeld: Ermittlung der Klimalast bei aktivem Kompressor" MAP 0x1D5814 Kf_Xs16_Ys16_Ws16 100.0000 Prc 0.00 100.0000 FORMAT "%8.4" EXTENDED_LIMITS -327.6800 327.6700
 /begin AXIS_DESCR STD_AXIS FanCtl_pAc_mp PresAC_hPa 5 0.00 60000.00 FORMAT "%8.2" EXTENDED_LIMITS -65536.00 65534.00 DEPOSIT ABSOLUTE /end AXIS_DESCR
 /begin AXIS_DESCR STD_AXIS EATSCD_tAir Temp_Cels 4 -53.14000 176.8600 FORMAT "%8.4" EXTENDED_LIMITS -3549.940 3003.560 DEPOSIT ABSOLUTE /end AXIS_DESCR
/end CHARACTERISTIC
/begin CHARACTERISTIC FanCtl_prcQKdeakt_CUR "Kennlinie: Ermittlung der Klimalast bei inaktivem Kompressor" CURVE 0x1D5852 Kl_Xs16_Ws16 100.0000 Prc 0.00 100.0000 FORMAT "%8.4" EXTENDED_LIMITS -327.6800 327.6700
 /begin AXIS_DESCR STD_AXIS FanCtl_pAc_mp PresAC_hPa 6 0.00 60000.00 FORMAT "%8.2" EXTENDED_LIMITS -65536.00 65534.00 DEPOSIT ABSOLUTE /end AXIS_DESCR
/end CHARACTERISTIC
/begin CHARACTERISTIC FanCtl_prcRelClntDesPreset_C "Vorgabewert für den relativen dynamischen Kühlbedarf" VALUE 0x1D586C Kw_Ws16 100.0000 Prc 0.00 100.0000 FORMAT "%8.4" EXTENDED_LIMITS -327.6800 327.6700 /end CHARACTERISTIC
/begin CHARACTERISTIC FanCtl_stFanVar2_C "bitcodierter Schalter für Lüfervariante (Variante 2)" VALUE 0x1D586E Kw_Wu8 7.000 OneToOne 0.00 7.000 FORMAT "%5.3" EXTENDED_LIMITS 0.00 255.0 /end CHARACTERISTIC
/begin CHARACTERISTIC FanCtl_stFanVar3_C "bitcodierter Schalter für Lüfervariante (Variante 3)" VALUE 0x1D586F Kw_Wu8 7.000 OneToOne 0.00 7.000 FORMAT "%5.3" EXTENDED_LIMITS 0.00 255.0 /end CHARACTERISTIC
/begin CHARACTERISTIC FanCtl_stFanVar4_C "bitcodierter Schalter für Lüftervariante (Variante 4)" VALUE 0x1D5870 Kw_Wu8 7.000 OneToOne 0.00 7.000 FORMAT "%5.3" EXTENDED_LIMITS 0.00 255.0 /end CHARACTERISTIC
/begin CHARACTERISTIC FanCtl_stFanVar5_C "bitcodierter Schalter für Lüftervariante (Variante 5)" VALUE 0x1D5871 Kw_Wu8 7.000 OneToOne 0.00 7.000 FORMAT "%5.3" EXTENDED_LIMITS 0.00 255.0 /end CHARACTERISTIC
/begin CHARACTERISTIC FanCtl_stFanVar_C "bitcodierter Schalter für Lüftervariante" VALUE 0x1D5872 Kw_Wu8 7.000 OneToOne 0.00 7.000 FORMAT "%5.3" EXTENDED_LIMITS 0.00 255.0 /end CHARACTERISTIC
/begin CHARACTERISTIC FanCtl_stRgnMsk_C "Kennlinie für Lüfterleistung beim Nachlauf" VALUE 0x1D5874 Kw_Wu32 4294967295.00 OneToOne 0.00 4294967295.00 FORMAT "%13.2" /end CHARACTERISTIC
/begin CHARACTERISTIC FanCtl_swtClgModVarVal_C "Schalterzustand des Kühlleistungsvariantenschalters" VALUE 0x1D5878 Kw_Wu8 1.000 OneToOne 0.00 1.000 FORMAT "%5.3" EXTENDED_LIMITS 0.00 255.0 READ_ONLY /end CHARACTERISTIC
/begin CHARACTERISTIC FanCtl_swtClgModVarType_C "Schaltertype des Kühlleistungsvariantenschalters" VALUE 0x1D5879 Kw_Wu8 0.00 OneToOne 0.00 0.00 FORMAT "%5.2" EXTENDED_LIMITS 0.00 255.0 READ_ONLY /end CHARACTERISTIC
/begin CHARACTERISTIC FanCtl_swtFanShutOff_C "Schalter um entweder Lüfter1 oder Lüfter2 an Akustikgrenze warten zu lassen" VALUE 0x1D587A Kw_Wu8 1.000 OneToOne 0.00 1.000 FORMAT "%5.3" EXTENDED_LIMITS 0.00 255.0 /end CHARACTERISTIC
/begin CHARACTERISTIC FanCtl_tARThres_CUR "Abschalttemperaturschwelle während der 2. Nachlaufphase" CURVE 0x1D587C Kl_Xs16_Ws16 200.0000 Temp_Cels -50.14000 149.8600 FORMAT "%8.4" EXTENDED_LIMITS -3549.940 3003.560
 /begin AXIS_DESCR STD_AXIS CTSCD_tClnt Temp_Cels 4 -50.14000 149.8600 FORMAT "%8.4" EXTENDED_LIMITS -3549.940 3003.560 DEPOSIT ABSOLUTE /end AXIS_DESCR
/end CHARACTERISTIC
/begin CHARACTERISTIC FanCtl_tClntCrit_MAP "Berechnung der kitischen Kühlmitteltemperatur" MAP 0x1D588E Kf_Xs16_Ys16_Ws16 280.0000 Temp_Cels -53.14000 226.8600 FORMAT "%8.4" EXTENDED_LIMITS -3549.940 3003.560
 /begin AXIS_DESCR STD_AXIS CTSCD_tClntCan Temp_Cels 5 -53.14000 176.8600 FORMAT "%8.4" EXTENDED_LIMITS -3549.940 3003.560 DEPOSIT ABSOLUTE /end AXIS_DESCR
 /begin AXIS_DESCR STD_AXIS CoEng_dvolFlConsumFlt FlConsum_l_h 5 0.00 150.0000 FORMAT "%8.4" EXTENDED_LIMITS -327.6800 327.6700 DEPOSIT ABSOLUTE /end AXIS_DESCR
/end CHARACTERISTIC
/begin CHARACTERISTIC FanCtl_tClntDesPreset_C "Ersatzwert für Kühlmitteltemperatur" VALUE 0x1D58D8 Kw_Ws16 280.0000 Temp_Cels -53.14000 226.8600 FORMAT "%8.4" EXTENDED_LIMITS -3549.940 3003.560 /end CHARACTERISTIC
/begin CHARACTERISTIC FanCtl_tClntDesRaw_MAP "Drehzahl- und Einspritzmengeabhängen/Moment Berechnung des Kühlmitteltemperaturrohwertes" MAP 0x1D58DA Kf_Xs16_Ys16_Ws16 280.0000 Temp_Cels -53.14000 226.8600 FORMAT "%8.4" EXTENDED_LIMITS -3549.940 3003.560
 /begin AXIS_DESCR STD_AXIS Eng_nAvrg EngN 8 0.00 6000.000 FORMAT "%8.3" EXTENDED_LIMITS -32768.00 32767.00 DEPOSIT ABSOLUTE /end AXIS_DESCR
 /begin AXIS_DESCR STD_AXIS CoEng_trqInrSet Trq 8 0.00 600.0000 FORMAT "%8.4" EXTENDED_LIMITS -3276.800 3276.700 DEPOSIT ABSOLUTE /end AXIS_DESCR
/end CHARACTERISTIC
/begin CHARACTERISTIC FanCtl_tClntDes_MAP "Temperatursollwert am Kühleraustritt" MAP 0x1D597E Kf_Xs16_Ys16_Ws16 280.0000 Temp_Cels -53.14000 226.8600 FORMAT "%8.4" EXTENDED_LIMITS -3549.940 3003.560
 /begin AXIS_DESCR STD_AXIS FanCtl_tClntDesFlt_mp Temp_Cels 8 -53.14000 226.8600 FORMAT "%8.4" EXTENDED_LIMITS -3549.940 3003.560 DEPOSIT ABSOLUTE /end AXIS_DESCR
 /begin AXIS_DESCR STD_AXIS FanCtl_tCTSCurr_mp Temp_Cels 8 -53.14000 226.8600 FORMAT "%8.4" EXTENDED_LIMITS -3549.940 3003.560 DEPOSIT ABSOLUTE /end AXIS_DESCR
/end CHARACTERISTIC
/begin CHARACTERISTIC FanCtl_dtCOTSCritXLow_C "untere Temperaturdifferenzschwelle der Hysterese" VALUE 0x1D5A22 Kw_Ws16 400.0000 TempDiff_Kelv -200.0000 200.0000 FORMAT "%8.4" EXTENDED_LIMITS -3276.800 3276.700 /end CHARACTERISTIC
/begin CHARACTERISTIC FanCtl_dtCOTSCritXHi_C "Obere Temperaturdifferenzschwelle der Hysterese" VALUE 0x1D5A24 Kw_Ws16 400.0000 TempDiff_Kelv -200.0000 200.0000 FORMAT "%8.4" EXTENDED_LIMITS -3276.800 3276.700 /end CHARACTERISTIC
/begin CHARACTERISTIC FanCtl_stCOTSCritYLow_C "untere Schwelle der kritischen Temperatur" VALUE 0x1D5A26 Kw_Ws16 0.00 OneToOne 0.00 0.00 FORMAT "%8.2" EXTENDED_LIMITS -32768.00 32767.00 READ_ONLY /end CHARACTERISTIC
/begin CHARACTERISTIC FanCtl_stCOTSCritYHi_C "obere Schwelle der kritischen Temperatur" VALUE 0x1D5A28 Kw_Ws16 0.00 OneToOne 1.000000 1.000000 FORMAT "%8.6" EXTENDED_LIMITS -32768.00 32767.00 READ_ONLY /end CHARACTERISTIC
/begin CHARACTERISTIC FanCtl_tCOTSCrit_C "Offsetwert der kritischen Temperatur am Kühleraustritt" VALUE 0x1D5A2A Kw_Ws16 280.0000 Temp_Cels -53.14000 226.8600 FORMAT "%8.4" EXTENDED_LIMITS -3549.940 3003.560 /end CHARACTERISTIC
/begin CHARACTERISTIC FanCtl_tCOTSPreset_C "Vorgabewert der Kühlmitteltemperatur am Kühleraustritt bei Sensorfehlern" VALUE 0x1D5A2C Kw_Ws16 280.0000 Temp_Cels -53.14000 226.8600 FORMAT "%8.4" EXTENDED_LIMITS -3549.940 3003.560 /end CHARACTERISTIC
/begin CHARACTERISTIC FanCtl_tCTSCritXLow_C "untere Hystereseschwelle der kritischen Kühlmitteltemperatur" VALUE 0x1D5A2E Kw_Ws16 230.0000 Temp_Cels -53.14000 176.8600 FORMAT "%8.4" EXTENDED_LIMITS -3549.940 3003.560 /end CHARACTERISTIC
/begin CHARACTERISTIC FanCtl_tCTSCritXHi_C "obere Hystereseschwelle der kritischen Kühlmitteltemperatur" VALUE 0x1D5A30 Kw_Ws16 230.0000 Temp_Cels -53.14000 176.8600 FORMAT "%8.4" EXTENDED_LIMITS -3549.940 3003.560 /end CHARACTERISTIC
/begin CHARACTERISTIC FanCtl_stCTSCritYLow_C "unterer Ausgang der temperaturkritischen Hysterese" VALUE 0x1D5A32 Kw_Ws16 0.00 OneToOne 0.00 0.00 FORMAT "%8.2" EXTENDED_LIMITS -32768.00 32767.00 READ_ONLY /end CHARACTERISTIC
/begin CHARACTERISTIC FanCtl_stCTSCritYHi_C "oberer Ausgang der temperaturkritischen Hysterese" VALUE 0x1D5A34 Kw_Ws16 0.00 OneToOne 1.000000 1.000000 FORMAT "%8.6" EXTENDED_LIMITS -32768.00 32767.00 READ_ONLY /end CHARACTERISTIC
/begin CHARACTERISTIC FanCtl_tiAcouLim_C "Dauer die der Lüfter an der Akustikgrenze verweilt" VALUE 0x1D5A36 Kw_Wu16 655140.0 Time_ms 0.00 655140.0 FORMAT "%8.1" EXTENDED_LIMITS 0.00 655350.0 /end CHARACTERISTIC
/begin CHARACTERISTIC FanCtl_tiAfterrunFan1_C "Abschaltrampendauer des Lüfters 1" VALUE 0x1D5A38 Kw_Wu32 1000000.00000 Time_ms 0.00 1000000.00000 FORMAT "%13.5" EXTENDED_LIMITS 0.00 42949672950.0 /end CHARACTERISTIC
/begin CHARACTERISTIC FanCtl_tiAfterrunFan2_C "Abschaltrampendauer des Lüfters 2" VALUE 0x1D5A3C Kw_Wu32 1000000.00000 Time_ms 0.00 1000000.00000 FORMAT "%13.5" EXTENDED_LIMITS 0.00 42949672950.0 /end CHARACTERISTIC
/begin CHARACTERISTIC FanCtl_tiARBase_MAP "Lüfternachlaufdauer-Grundkennfeld" MAP 0x1D5A40 Kf_Xs16_Ys16_Ws16 3200.000 TimeRed 0.00 3200.000 FORMAT "%8.3" EXTENDED_LIMITS -5242.880 5242.720
 /begin AXIS_DESCR STD_AXIS CTSCD_tClnt Temp_Cels 14 -53.14000 176.8600 FORMAT "%8.4" EXTENDED_LIMITS -3549.940 3003.560 DEPOSIT ABSOLUTE /end AXIS_DESCR
 /begin AXIS_DESCR STD_AXIS FanCtl_dvolFlConsumFltHold_mp FlConsum_l_h 8 0.00 150.0000 FORMAT "%8.4" EXTENDED_LIMITS -327.6800 327.6700 DEPOSIT ABSOLUTE /end AXIS_DESCR
/end CHARACTERISTIC
/begin CHARACTERISTIC FanCtl_tiARCor1_MAP "2. Lüfternachlaufdauerkennfeld für die 1. Phase" MAP 0x1D5B50 Kf_Xs16_Ys16_Ws16 3200.000 TimeRed 0.00 3200.000 FORMAT "%8.3" EXTENDED_LIMITS -5242.880 5242.720
 /begin AXIS_DESCR STD_AXIS CTSCD_tClnt Temp_Cels 8 -53.14000 176.8600 FORMAT "%8.4" EXTENDED_LIMITS -3549.940 3003.560 DEPOSIT ABSOLUTE /end AXIS_DESCR
 /begin AXIS_DESCR STD_AXIS EATSCD_tAir Temp_Cels 8 -53.14000 99.86000 FORMAT "%8.5" EXTENDED_LIMITS -3549.940 3003.560 DEPOSIT ABSOLUTE /end AXIS_DESCR
/end CHARACTERISTIC
/begin CHARACTERISTIC FanCtl_tiARCor2_MAP "Lüfternachlaufdauer-Kennfeld für 2. Phase" MAP 0x1D5BF4 Kf_Xs16_Ys16_Ws16 3200.000 TimeRed 0.00 3200.000 FORMAT "%8.3" EXTENDED_LIMITS -5242.880 5242.720
 /begin AXIS_DESCR STD_AXIS CTSCD_tClnt Temp_Cels 8 -53.14000 226.8600 FORMAT "%8.4" EXTENDED_LIMITS -3549.940 3003.560 DEPOSIT ABSOLUTE /end AXIS_DESCR
 /begin AXIS_DESCR STD_AXIS EATSCD_tAir Temp_Cels 8 -53.14000 99.86000 FORMAT "%8.5" EXTENDED_LIMITS -3549.940 3003.560 DEPOSIT ABSOLUTE /end AXIS_DESCR
/end CHARACTERISTIC
/begin CHARACTERISTIC FanCtl_tiARmax_C "maximale Lüfternachlaufdauer" VALUE 0x1D5C98 Kw_Wu32 1000000.00000 Time_ms 0.00 1000000.00000 FORMAT "%13.5" EXTENDED_LIMITS 0.00 42949672950.0 /end CHARACTERISTIC
/begin CHARACTERISTIC FanCtl_tiARmin_C "minimale Lüfternachlaufdauer" VALUE 0x1D5C9C Kw_Wu32 1000000.00000 Time_ms 0.00 1000000.00000 FORMAT "%13.5" EXTENDED_LIMITS 0.00 42949672950.0 /end CHARACTERISTIC
/begin CHARACTERISTIC FanCtl_tiAROilCorDfl_C "Ersatzwert wenn keine Serviceintervallberechnung aktiviert ist" VALUE 0x1D5CA0 Kw_Ws16 3200.000 TimeRed 0.00 3200.000 FORMAT "%8.3" EXTENDED_LIMITS -5242.880 5242.720 /end CHARACTERISTIC
/begin CHARACTERISTIC FanCtl_tiAROilCor_CUR "3. Lüfternachlaufzeit der 1. Phase" CURVE 0x1D5CA2 Kl_Xs16_Ws16 3200.000 TimeRed 0.00 3200.000 FORMAT "%8.3" EXTENDED_LIMITS -5242.880 5242.720
 /begin AXIS_DESCR STD_AXIS OTSCD_tEngOil Temp_Cels 8 -53.14000 226.8600 FORMAT "%8.4" EXTENDED_LIMITS -3549.940 3003.560 DEPOSIT ABSOLUTE /end AXIS_DESCR
/end CHARACTERISTIC
/begin CHARACTERISTIC FanCtl_tiARShutOffFan1_C "Abschaltrampendauer des Lüfters 1" VALUE 0x1D5CC4 Kw_Wu32 1000000.00000 Time_ms 0.00 1000000.00000 FORMAT "%13.5" EXTENDED_LIMITS 0.00 42949672950.0 /end CHARACTERISTIC
/begin CHARACTERISTIC FanCtl_tiARShutOffFan2_C "Abschaltrampendauer des Lüfters 2" VALUE 0x1D5CC8 Kw_Wu32 1000000.00000 Time_ms 0.00 1000000.00000 FORMAT "%13.5" EXTENDED_LIMITS 0.00 42949672950.0 /end CHARACTERISTIC
/begin CHARACTERISTIC FanCtl_tiClntDesCorrDly1_C "Verzögerung für zusätzliche Korrektur der Kühlmittelsolltemperatur" VALUE 0x1D5CCC Kw_Wu16 655140.0 Time_ms 0.00 655140.0 FORMAT "%8.1" EXTENDED_LIMITS 0.00 655350.0 /end CHARACTERISTIC
/begin CHARACTERISTIC FanCtl_tiClntDesCorrDly2_C "Verzögerung der Korrekturrücknahme der Kühlmittelsolltemperatur" VALUE 0x1D5CCE Kw_Wu16 655140.0 Time_ms 0.00 655140.0 FORMAT "%8.1" EXTENDED_LIMITS 0.00 655350.0 /end CHARACTERISTIC
/begin CHARACTERISTIC FanCtl_tiStartDly_C "Dauer der Lüfterabschaltung während des Startvorganges" VALUE 0x1D5CD0 Kw_Wu32 1000000.00000 Time_ms 0.00 1000000.00000 FORMAT "%13.5" EXTENDED_LIMITS 0.00 42949672950.0 /end CHARACTERISTIC
/begin CHARACTERISTIC FanCtl_vPreset2_C "zweiter Ersatzwert im Fehlerfall von VSS" VALUE 0x1D5CD4 Kw_Ws16 300.0000 Vel 0.00 300.0000 FORMAT "%8.4" EXTENDED_LIMITS -327.6800 327.6700 /end CHARACTERISTIC
/begin CHARACTERISTIC FanCtl_vPreset_C "Ersatzwert im Fehlerfall von VSS" VALUE 0x1D5CD6 Kw_Ws16 300.0000 Vel 0.00 300.0000 FORMAT "%8.4" EXTENDED_LIMITS -327.6800 327.6700 /end CHARACTERISTIC
/begin CHARACTERISTIC FBC_AACoeff_C "Antialiasingfilterkoeffizienten" VAL_BLK 0x1D5EA0 Kwb_Wr32 2.00000000 OneToOne -1.00000000 1.00000000 FORMAT "%10.8" EXTENDED_LIMITS -1.00000000E+37 1.00000000E+37 NUMBER 9 /end CHARACTERISTIC
/begin CHARACTERISTIC FBC_AAOrd_C "Filterordnung des Antialiasingfilter" VALUE 0x1D5EC4 Kw_Wu8 8.000 OneToOne 0.00 8.000 FORMAT "%5.3" EXTENDED_LIMITS 0.00 255.0 /end CHARACTERISTIC
/begin CHARACTERISTIC FBC_Act_C "=0: Geberradadaption inaktiv; =1 aktiv; =2 lösche Adaptionsergebnisspeicher (EEPROM)" VALUE 0x1D5EC5 Kw_Wu8 2.000 OneToOne 0.00 2.000 FORMAT "%5.3" EXTENDED_LIMITS 0.00 255.0 /end CHARACTERISTIC
/begin CHARACTERISTIC FBC_BPFac1NumG_CUR "drehmomentübersetzungsabhänige Nockenwellenbandpassverstärkung" CURVE 0x1D5CD8 Kl_Xs16_Ws16 40.00000 FBC_BPfac -20.00000 20.00000 FORMAT "%8.5" EXTENDED_LIMITS -20.00061 20.00000
 /begin AXIS_DESCR STD_AXIS DrvTrn_rTransDT TransR 6 0.00 100.0000 FORMAT "%8.4" EXTENDED_LIMITS -327.6800 327.6700 DEPOSIT ABSOLUTE /end AXIS_DESCR
/end CHARACTERISTIC
/begin CHARACTERISTIC FBC_dBPFacNumLo_CA "Bandpass array: Zählerkoeffizienten für unteren Drehzahlbereich" VAL_BLK 0x1D5CF4 Kwb_Wr32 30.0000000 OneToOne -15.0000000 15.0000000 FORMAT "%10.7" EXTENDED_LIMITS -1.00000000E+37 1.00000000E+37 NUMBER 2 /end CHARACTERISTIC
/begin CHARACTERISTIC FBC_dBPFacNumHi_CA "Bandpass array: Zählerkoeffizienten für den oberen Drehzahlbereich" VAL_BLK 0x1D5CFC Kwb_Wr32 30.0000000 OneToOne -15.0000000 15.0000000 FORMAT "%10.7" EXTENDED_LIMITS -1.00000000E+37 1.00000000E+37 NUMBER 2 /end CHARACTERISTIC
/begin CHARACTERISTIC FBC_dBPFacNumZFC_CA "Bandpassverstärkungen für Schubbetrieb" VAL_BLK 0x1D5D04 Kwb_Wr32 30.0000000 OneToOne -15.0000000 15.0000000 FORMAT "%10.7" EXTENDED_LIMITS -1.00000000E+37 1.00000000E+37 NUMBER 2 /end CHARACTERISTIC
/begin CHARACTERISTIC FBC_dBPFacDen1_CA "Bandpass Array: Nenner 1" VAL_BLK 0x1D5D0C Kwb_Wr32 20.0000000 OneToOne -10.0000000 10.0000000 FORMAT "%10.7" EXTENDED_LIMITS -1.00000000E+37 1.00000000E+37 NUMBER 2 /end CHARACTERISTIC
/begin CHARACTERISTIC FBC_dBPFacDen2_CA "Bandpass Array: Nenner 2" VAL_BLK 0x1D5D14 Kwb_Wr32 20.0000000 OneToOne -10.0000000 10.0000000 FORMAT "%10.7" EXTENDED_LIMITS -1.00000000E+37 1.00000000E+37 NUMBER 2 /end CHARACTERISTIC
/begin CHARACTERISTIC FBC_ctSegOffset_C "Abstand zwischen FBC-Berechnung und entsprechendem OT" VALUE 0x1D5D1C Kw_Ws8 0.00 OneToOne 2.000 2.000 FORMAT "%5.3" EXTENDED_LIMITS -128.0 127.0 /end CHARACTERISTIC
/begin CHARACTERISTIC FBC_dPreCtlBPSumMax_MAP "Applikationsfeld für die maximale Bandpass-Summe" MAP 0x1D5DE0 Kf_Xs16_Ys16_Ws16 32767.00 OneToOne 0.00 32767.00 FORMAT "%8.2" EXTENDED_LIMITS -32768.00 32767.00
 /begin AXIS_DESCR STD_AXIS Eng_nAvrg EngN 2 0.00 6000.000 FORMAT "%8.3" EXTENDED_LIMITS -32768.00 32767.00 DEPOSIT ABSOLUTE /end AXIS_DESCR
 /begin AXIS_DESCR STD_AXIS InjCtl_qSetUnBal InjMass 4 0.00 327.6700 FORMAT "%8.4" EXTENDED_LIMITS -327.6800 327.6700 DEPOSIT ABSOLUTE /end AXIS_DESCR
/end CHARACTERISTIC
/begin CHARACTERISTIC FBC_dqThresSurge_C "Schwelle um eine impulsförmige Mengenänderung zu erkennen" VALUE 0x1D5D1E Kw_Ws16 100.0000 InjMass 0.00 100.0000 FORMAT "%8.4" EXTENDED_LIMITS -327.6800 327.6700 /end CHARACTERISTIC
/begin CHARACTERISTIC FBC_dSegNhiCaS_C "Segmentwert für Eng_nAvrg > FBC_nThresFbc_C" VAL_BLK 0x1D5D20 Kwb_Wu16 255.9961 Per_Ratio 0.00 255.9961 FORMAT "%8.4" NUMBER 2 /end CHARACTERISTIC
/begin CHARACTERISTIC FBC_dSegNloCaS_C "Segmentwert für Eng_nAvrg < FBC_nThresFbc_C" VAL_BLK 0x1D5D24 Kwb_Wu16 255.9961 Per_Ratio 0.00 255.9961 FORMAT "%8.4" NUMBER 2 /end CHARACTERISTIC
/begin CHARACTERISTIC FBC_dSegZFCCaS_C "Segmentwahl für Schubbetrieb" VAL_BLK 0x1D5D28 Kwb_Wu16 255.9961 Per_Ratio 0.00 255.9961 FORMAT "%8.4" NUMBER 2 /end CHARACTERISTIC
/begin CHARACTERISTIC FBC_dSyn_C "Abstand OT Zyl.1 zu Segmentzählerstand 0 (bezogen auf CrSCD_numSeg)" VALUE 0x1D5D2C Kw_Ws8 16.00 OneToOne -8.000 8.000 FORMAT "%5.3" EXTENDED_LIMITS -128.0 127.0 /end CHARACTERISTIC
/begin CHARACTERISTIC FBC_DXadptl_C "Untere Schwelle der Adaptionsgüte" VALUE 0x1D5EC8 Kw_Wr32 1.00000000 Prc_float 0.00 1.00000000 FORMAT "%10.8" EXTENDED_LIMITS -1.00000000E+39 1.00000000E+39 /end CHARACTERISTIC
/begin CHARACTERISTIC FBC_DXadptu_C "Obere Schwelle der Adaptionsgüte" VALUE 0x1D5ECC Kw_Wr32 1.00000000 Prc_float 0.00 1.00000000 FORMAT "%10.8" EXTENDED_LIMITS -1.00000000E+39 1.00000000E+39 /end CHARACTERISTIC
/begin CHARACTERISTIC FBC_DXalf0_C "Startwerte für FBC_DXSfn, FBC_DXSfp" VALUE 0x1D5ED0 Kw_Wr32 3.00000000 Prc_float 0.00 3.00000000 FORMAT "%10.8" EXTENDED_LIMITS -1.00000000E+39 1.00000000E+39 READ_ONLY /end CHARACTERISTIC
/begin CHARACTERISTIC FBC_facBPRedNum_C "Faktor um den die BP-Verstärkungen bei impulsförmige Mengenänderungen reduziert werden" VALUE 0x1D5D30 Kw_Wr32 1.00000000 OneToOne 0.00 1.00000000 FORMAT "%10.8" EXTENDED_LIMITS -1.00000000E+37 1.00000000E+37 /end CHARACTERISTIC
/begin CHARACTERISTIC FBC_facPreCtlBPSumMaxFst_C "Faktor für die maximale Bandpass-Summe beim Schnelllernen" VALUE 0x1D5E00 Kw_Wu16 3.899902 FBCPreCtlfacBPSum 0.00 3.899902 FORMAT "%8.6" EXTENDED_LIMITS 0.00 31.99951 /end CHARACTERISTIC
/begin CHARACTERISTIC FBC_facPreCtlBPSumMaxTemp_CUR "Temperaturkurve der maximalen Bandpass-Summen" CURVE 0x1D5E02 Kl_Xs16_Ws16 3.899902 FBCPreCtlfacBPSum 0.00 3.899902 FORMAT "%8.6" EXTENDED_LIMITS -16.00000 15.99951
 /begin AXIS_DESCR STD_AXIS FBC_idxPreCtlLrnTemp_mp OneToOne 2 0.00 1.000000 FORMAT "%8.6" EXTENDED_LIMITS -32768.00 32767.00 DEPOSIT ABSOLUTE /end AXIS_DESCR
/end CHARACTERISTIC
/begin CHARACTERISTIC FBC_facPreCtlLrnFltFst_C "Übernahmefaktor der Integratorwerte (Schnelllernen)" VALUE 0x1D5E0C Kw_Wu16 2.000000 FBCPreCtlfacLrnFlt 0.00 2.000000 FORMAT "%8.6" EXTENDED_LIMITS 0.00 1.999969 /end CHARACTERISTIC
/begin CHARACTERISTIC FBC_facPreCtlLrnFlt_C "Übernahmefaktor der Integrator" VALUE 0x1D5E0E Kw_Wu16 2.000000 FBCPreCtlfacLrnFlt 0.00 2.000000 FORMAT "%8.6" EXTENDED_LIMITS 0.00 1.999969 /end CHARACTERISTIC
/begin CHARACTERISTIC FBC_fSurge_CUR "drehmomentübersetzungsabhängige Ruckelfrequenzen" CURVE 0x1D5D34 Kl_Xs16_Ws16 20.00000 Surge_Frq 0.00 20.00000 FORMAT "%8.5" EXTENDED_LIMITS -273.0667 273.0583
 /begin AXIS_DESCR STD_AXIS DrvTrn_rTransDT TransR 6 0.00 100.0000 FORMAT "%8.4" EXTENDED_LIMITS -327.6800 327.6700 DEPOSIT ABSOLUTE /end AXIS_DESCR
/end CHARACTERISTIC
/begin CHARACTERISTIC FBC_GvrnIKi_C "Regler: Integrationskonstante" VALUE 0x1D5D50 Kw_Wr32 1.00000000 FBC_GvrnIKi_float 0.00 1.00000000 FORMAT "%10.8" EXTENDED_LIMITS -1.00000000E+37 1.00000000E+37 /end CHARACTERISTIC
/begin CHARACTERISTIC FBC_GvrnIKiPos_C "Regler: Integrationskonstante" VALUE 0x1D5D54 Kw_Wr32 1.00000000 FBC_GvrnIKi_float 0.00 1.00000000 FORMAT "%10.8" EXTENDED_LIMITS -1.00000000E+37 1.00000000E+37 /end CHARACTERISTIC
/begin CHARACTERISTIC FBC_GvrnIKiNeg_C "Regler: Integrationskonstante" VALUE 0x1D5D58 Kw_Wr32 1.00000000 FBC_GvrnIKi_float 0.00 1.00000000 FORMAT "%10.8" EXTENDED_LIMITS -1.00000000E+37 1.00000000E+37 /end CHARACTERISTIC
/begin CHARACTERISTIC FBC_GvrnIWinPos_C "Regler: I-Parameter" VALUE 0x1D5D5C Kw_Wr32 12200.0000 EngN_float -6100.00000 6100.00000 FORMAT "%10.5" EXTENDED_LIMITS -1.00000000E+37 1.00000000E+37 /end CHARACTERISTIC
/begin CHARACTERISTIC FBC_GvrnIWinNeg_C "Regler: I-Parameter" VALUE 0x1D5D60 Kw_Wr32 12200.0000 EngN_float -6100.00000 6100.00000 FORMAT "%10.5" EXTENDED_LIMITS -1.00000000E+37 1.00000000E+37 /end CHARACTERISTIC
/begin CHARACTERISTIC FBC_GvrnPKp_C "Regler: Proportionaltitätskonstante" VALUE 0x1D5D64 Kw_Wr32 1.00000000 FBC_GvrnPKp_float 0.00 1.00000000 FORMAT "%10.8" EXTENDED_LIMITS -1.00000000E+37 1.00000000E+37 /end CHARACTERISTIC
/begin CHARACTERISTIC FBC_GvrnPKpPos_C "Regler: Proportionaltitätskonstante" VALUE 0x1D5D68 Kw_Wr32 1.00000000 FBC_GvrnPKp_float 0.00 1.00000000 FORMAT "%10.8" EXTENDED_LIMITS -1.00000000E+37 1.00000000E+37 READ_ONLY /end CHARACTERISTIC
/begin CHARACTERISTIC FBC_GvrnPKpNeg_C "Regler: Proportionaltitätskonstante" VALUE 0x1D5D6C Kw_Wr32 1.00000000 FBC_GvrnPKp_float 0.00 1.00000000 FORMAT "%10.8" EXTENDED_LIMITS -1.00000000E+37 1.00000000E+37 READ_ONLY /end CHARACTERISTIC
/begin CHARACTERISTIC FBC_GvrnPWinPos_C "Regler: P-Parameter" VALUE 0x1D5D70 Kw_Wr32 12200.0000 EngN_float -6100.00000 6100.00000 FORMAT "%10.5" EXTENDED_LIMITS -1.00000000E+37 1.00000000E+37 READ_ONLY /end CHARACTERISTIC
/begin CHARACTERISTIC FBC_GvrnPWinNeg_C "Regler: P-Parameter" VALUE 0x1D5D74 Kw_Wr32 12200.0000 EngN_float -6100.00000 6100.00000 FORMAT "%10.5" EXTENDED_LIMITS -1.00000000E+37 1.00000000E+37 READ_ONLY /end CHARACTERISTIC
/begin CHARACTERISTIC FBC_idxPreCtlLrnSetQnt_C "Mengenindex zum Setzen der Lernwerte" VALUE 0x1D5E10 Kw_Wu8 3.000 OneToOne 0.00 3.000 FORMAT "%5.3" EXTENDED_LIMITS 0.00 255.0 /end CHARACTERISTIC
/begin CHARACTERISTIC FBC_idxPreCtlLrnSetSpd_C "Drehzahlindex zum Setzen der Lernwerte" VALUE 0x1D5E11 Kw_Wu8 1.000 OneToOne 0.00 1.000 FORMAT "%5.3" EXTENDED_LIMITS 0.00 255.0 /end CHARACTERISTIC
/begin CHARACTERISTIC FBC_idxPreCtlLrnSetTemp_C "Temperaturindex zum Setzen der Lernwerte" VALUE 0x1D5E12 Kw_Wu8 1.000 OneToOne 0.00 1.000 FORMAT "%5.3" EXTENDED_LIMITS 0.00 255.0 /end CHARACTERISTIC
/begin CHARACTERISTIC FBC_idxPreCtlTFld_C "Auswahl der Temperaturquelle" VALUE 0x1D5E13 Kw_Wu8 4.00000000000 EngTempFldSel 0.00 4.00000000000 FORMAT "%13.11" /end CHARACTERISTIC
/begin CHARACTERISTIC FBC_nCtlOfsMinRgn_C "Offset der unteren drehzahlabhängigen Steuerschwelle zur aktuellen Leerlaufdrehzahl im Falle einer Regeneration" VALUE 0x1D5D78 Kw_Ws16 65535.00 EngN -32768.00 32767.00 FORMAT "%8.2" /end CHARACTERISTIC
/begin CHARACTERISTIC FBC_nCtlOfsMin_C "Offset der unteren drehzahlabhängigen Steuerschwelle zur aktuellen Leerlaufdrehzahl" VALUE 0x1D5D7A Kw_Ws16 65535.00 EngN -32768.00 32767.00 FORMAT "%8.2" /end CHARACTERISTIC
/begin CHARACTERISTIC FBC_nCtlThresMaxRgn_C "obere Drehzahlsteuerschwelle im Falle einer Regeneration" VALUE 0x1D5D7C Kw_Ws16 65535.00 EngN -32768.00 32767.00 FORMAT "%8.2" /end CHARACTERISTIC
/begin CHARACTERISTIC FBC_nCtlThresMax_C "obere Drehzahlsteuerschwelle" VALUE 0x1D5D7E Kw_Ws16 65535.00 EngN -32768.00 32767.00 FORMAT "%8.2" /end CHARACTERISTIC
/begin CHARACTERISTIC FBC_nGvrnOfsMinRgn_C "Offset der unteren drehzahlabhängigen Regelschwelle zur aktuellen Leerlaufdrehzahl im Falle einer Regeneration" VALUE 0x1D5D80 Kw_Ws16 65535.00 EngN -32768.00 32767.00 FORMAT "%8.2" /end CHARACTERISTIC
/begin CHARACTERISTIC FBC_nGvrnOfsMin_C "Offset der unteren drehzahlabhängigen Regelschwelle zur aktuellen Leerlaufdrehzahl" VALUE 0x1D5D82 Kw_Ws16 65535.00 EngN -32768.00 32767.00 FORMAT "%8.2" /end CHARACTERISTIC
/begin CHARACTERISTIC FBC_nGvrnThresMaxRgn_C "obere Drehzahlregelschwelle im Falle einer Regeneration" VALUE 0x1D5D84 Kw_Ws16 6000.000 EngN 0.00 6000.000 FORMAT "%8.3" EXTENDED_LIMITS -32768.00 32767.00 /end CHARACTERISTIC
/begin CHARACTERISTIC FBC_nGvrnThresMax_C "obere Drehzahlregelschwelle" VALUE 0x1D5D86 Kw_Ws16 6000.000 EngN 0.00 6000.000 FORMAT "%8.3" EXTENDED_LIMITS -32768.00 32767.00 /end CHARACTERISTIC
/begin CHARACTERISTIC FBC_nHyst_C "Drehzahlhysterese" VALUE 0x1D5D88 Kw_Ws16 100.0000 EngN 0.00 100.0000 FORMAT "%8.4" EXTENDED_LIMITS -32768.00 32767.00 /end CHARACTERISTIC
/begin CHARACTERISTIC FBC_nLrnThres_C "Drehzahlschwellen der Lernbereiche der Geberradadaption" VAL_BLK 0x1D5ED4 Kwb_Ws16 6000.000 EngN 0.00 6000.000 FORMAT "%8.3" EXTENDED_LIMITS -32768.00 32767.00 NUMBER 3 /end CHARACTERISTIC
/begin CHARACTERISTIC FBC_nPreCtlHys_C "Hysterese für Vorsteuerungs-Index (Drehzahl)" VALUE 0x1D5E14 Kw_Ws16 6000.000 EngN 0.00 6000.000 FORMAT "%8.3" EXTENDED_LIMITS -32768.00 32767.00 /end CHARACTERISTIC
/begin CHARACTERISTIC FBC_nPreCtl_CUR "Drehzahlbereichs-Applikationsfeld" CURVE 0x1D5E16 Kl_Xs16_Ws16 6000.000 EngN 0.00 6000.000 FORMAT "%8.3" EXTENDED_LIMITS -32768.00 32767.00
 /begin AXIS_DESCR STD_AXIS FBC_idxPreCtlLrnSpd_mp OneToOne 2 0.00 1.000000 FORMAT "%8.6" EXTENDED_LIMITS -32768.00 32767.00 DEPOSIT ABSOLUTE /end AXIS_DESCR
/end CHARACTERISTIC
/begin CHARACTERISTIC FBC_nSurgeOffset_C "pos. Offset zur kritischen Drehzahl, bei der fNW=fRuck gilt." VALUE 0x1D5D8A Kw_Ws16 1000.000 EngN 0.00 1000.000 FORMAT "%8.3" EXTENDED_LIMITS -32768.00 32767.00 /end CHARACTERISTIC
/begin CHARACTERISTIC FBC_nThresFbc_C "Komfortdrehzahlbereich für Segmentwerte" VALUE 0x1D5EDA Kw_Ws16 65535.00 EngN -32768.00 32767.00 FORMAT "%8.2" /end CHARACTERISTIC
/begin CHARACTERISTIC FBC_numPreCtlApplyWcySettled_C "Maximale Anzahl an eingeschwungenen Arbeitszyklen um Vorsteuerung noch zu erlauben" VALUE 0x1D5E20 Kw_Wu16 65535.00 OneToOne 0.00 65535.00 FORMAT "%8.2" /end CHARACTERISTIC
/begin CHARACTERISTIC FBC_numPreCtlIniStrt_C "Anzahl der Arbeitspiele der Initialisierung nach Motorstart" VALUE 0x1D5E22 Kw_Wu16 65535.00 OneToOne 0.00 65535.00 FORMAT "%8.2" /end CHARACTERISTIC
/begin CHARACTERISTIC FBC_numPreCtlIni_C "Anzahl der Arbeitsspiele der Bandpass-Initialisierung" VALUE 0x1D5E24 Kw_Wu16 65535.00 OneToOne 0.00 65535.00 FORMAT "%8.2" /end CHARACTERISTIC
/begin CHARACTERISTIC FBC_numPreCtlLrnActvStrt_CUR "Anzahl der Arbeitszyklen die Lernen nach dem Motorstart aktiviert ist" CURVE 0x1D5E26 Kl_Xs16_Ws16 65535.00 OneToOne 0.00 65535.00 FORMAT "%8.2" EXTENDED_LIMITS -32768.00 32767.00
 /begin AXIS_DESCR STD_AXIS FBC_idxPreCtlLrnTemp_mp OneToOne 2 0.00 1.000000 FORMAT "%8.6" EXTENDED_LIMITS -32768.00 32767.00 DEPOSIT ABSOLUTE /end AXIS_DESCR
/end CHARACTERISTIC
/begin CHARACTERISTIC FBC_numPreCtlLrnDeActvStrt_CUR "Anzahl der Arbeitsspiele die Lernen nach dem Motorstart deaktiviert ist" CURVE 0x1D5E30 Kl_Xs16_Ws16 65535.00 OneToOne 0.00 65535.00 FORMAT "%8.2" EXTENDED_LIMITS -32768.00 32767.00
 /begin AXIS_DESCR STD_AXIS FBC_idxPreCtlLrnTemp_mp OneToOne 2 0.00 1.000000 FORMAT "%8.6" EXTENDED_LIMITS -32768.00 32767.00 DEPOSIT ABSOLUTE /end AXIS_DESCR
/end CHARACTERISTIC
/begin CHARACTERISTIC FBC_numPreCtlLrnWcyMinFst_C "Anzahl der eingeregelten Arbeitsspiele für Schnelllernen" VALUE 0x1D5E3A Kw_Wu16 65535.00 OneToOne 0.00 65535.00 FORMAT "%8.2" /end CHARACTERISTIC
/begin CHARACTERISTIC FBC_numPreCtlLrnWcyMin_C "Anzahl der eingeregelte Arbeitsspiele zum Lernen" VALUE 0x1D5E3C Kw_Wu16 65535.00 OneToOne 0.00 65535.00 FORMAT "%8.2" /end CHARACTERISTIC
/begin CHARACTERISTIC FBC_nZFCThresMax_C "obere Drehzahlschwelle für ZFC Unterstützung im Schubbetrieb" VALUE 0x1D5D8C Kw_Ws16 6000.000 EngN 0.00 6000.000 FORMAT "%8.3" EXTENDED_LIMITS -32768.00 32767.00 /end CHARACTERISTIC
/begin CHARACTERISTIC FBC_qCtlOfsMaxRgn_C "Offset für obere mengenabhängige Steuerschwelle im Falle einer Regeneration" VALUE 0x1D5D8E Kw_Ws16 655.3500 InjMass -327.6800 327.6700 FORMAT "%8.4" /end CHARACTERISTIC
/begin CHARACTERISTIC FBC_qCtlOfsMax_C "Offset für obere mengenabhängige Steuerschwelle" VALUE 0x1D5D90 Kw_Ws16 655.3500 InjMass -327.6800 327.6700 FORMAT "%8.4" /end CHARACTERISTIC
/begin CHARACTERISTIC FBC_qCtlThresMinRgn_C "untere Mengensteuerschwelle im Falle einer Regeneration" VALUE 0x1D5D92 Kw_Ws16 655.3500 InjMass -327.6800 327.6700 FORMAT "%8.4" /end CHARACTERISTIC
/begin CHARACTERISTIC FBC_qCtlThresMin_C "untere Mengensteuerschwelle" VALUE 0x1D5D94 Kw_Ws16 655.3500 InjMass -327.6800 327.6700 FORMAT "%8.4" /end CHARACTERISTIC
/begin CHARACTERISTIC FBC_qGvrnMaxRgn_CUR "obere mengenabhängige Regelschwelle im Falle einer Regernation" CURVE 0x1D5D96 Kl_Xs16_Ws16 327.6700 InjMass 0.00 327.6700 FORMAT "%8.4" EXTENDED_LIMITS -327.6800 327.6700
 /begin AXIS_DESCR STD_AXIS Eng_nAvrg EngN 4 0.00 6000.000 FORMAT "%8.3" EXTENDED_LIMITS -32768.00 32767.00 DEPOSIT ABSOLUTE /end AXIS_DESCR
/end CHARACTERISTIC
/begin CHARACTERISTIC FBC_qGvrnThresMax_CUR "obere mengenabhängige Regelschwelle" CURVE 0x1D5DA8 Kl_Xs16_Ws16 327.6700 InjMass 0.00 327.6700 FORMAT "%8.4" EXTENDED_LIMITS -327.6800 327.6700
 /begin AXIS_DESCR STD_AXIS Eng_nAvrg EngN 4 0.00 6000.000 FORMAT "%8.3" EXTENDED_LIMITS -32768.00 32767.00 DEPOSIT ABSOLUTE /end AXIS_DESCR
/end CHARACTERISTIC
/begin CHARACTERISTIC FBC_qGvrnThresMinRgn_C "untere Mengenregelschwelle im Falle einer Regeneration" VALUE 0x1D5DBA Kw_Ws16 655.3500 InjMass -327.6800 327.6700 FORMAT "%8.4" /end CHARACTERISTIC
/begin CHARACTERISTIC FBC_qGvrnThresMin_C "untere Mengenregelschwelle" VALUE 0x1D5DBC Kw_Ws16 655.3500 InjMass -327.6800 327.6700 FORMAT "%8.4" /end CHARACTERISTIC
/begin CHARACTERISTIC FBC_qLim_CUR "mengenabhängige Korrekturmengenbegrenzung" CURVE 0x1D5DBE Kl_Xs16_Ws16 327.6700 InjMass 0.00 327.6700 FORMAT "%8.4" EXTENDED_LIMITS -327.6800 327.6700
 /begin AXIS_DESCR STD_AXIS InjCtl_qSetUnBal InjMass 4 0.00 327.6700 FORMAT "%8.4" EXTENDED_LIMITS -327.6800 327.6700 DEPOSIT ABSOLUTE /end AXIS_DESCR
/end CHARACTERISTIC
/begin CHARACTERISTIC FBC_qPreCtlHys_C "Hysterese für Vorsteuerungs-index (Einpritzmenge)" VALUE 0x1D5E3E Kw_Ws16 327.6700 InjMass 0.00 327.6700 FORMAT "%8.4" EXTENDED_LIMITS -327.6800 327.6700 /end CHARACTERISTIC
/begin CHARACTERISTIC FBC_qPreCtlLim_CUR "Limit für die Vorsteuerung" CURVE 0x1D5E40 Kl_Xs16_Ws16 327.6700 InjMass 0.00 327.6700 FORMAT "%8.4" EXTENDED_LIMITS -327.6800 327.6700
 /begin AXIS_DESCR STD_AXIS InjCtl_qSetUnBal InjMass 4 0.00 327.6700 FORMAT "%8.4" EXTENDED_LIMITS -327.6800 327.6700 DEPOSIT ABSOLUTE /end AXIS_DESCR
/end CHARACTERISTIC
/begin CHARACTERISTIC FBC_qPreCtl_CUR "Einspritzmengenbereichs-Applikationsfeld" CURVE 0x1D5E52 Kl_Xs16_Ws16 327.6700 InjMass 0.00 327.6700 FORMAT "%8.4" EXTENDED_LIMITS -327.6800 327.6700
 /begin AXIS_DESCR STD_AXIS FBC_idxPreCtlLrnQnt_mp OneToOne 4 0.00 3.000000 FORMAT "%8.6" EXTENDED_LIMITS -32768.00 32767.00 DEPOSIT ABSOLUTE /end AXIS_DESCR
/end CHARACTERISTIC
/begin CHARACTERISTIC FBC_qRC_CA "zylinderindividuellen additiven Korrekturmengen zur Aufprägung einen Mengenmusters am Ausgang der FBC" VAL_BLK 0x1D5E64 Kwb_Ws16 655.3500 InjMass -327.6800 327.6700 FORMAT "%8.4" NUMBER 3 /end CHARACTERISTIC
/begin CHARACTERISTIC FBC_stEgtMsk_C "Maske für Regenerationsstatus (NOx-Kat)  zur Auswahl des Arbeitsbereiches" VALUE 0x1D5DD0 Kw_Ws32 4294967295.00 OneToOne -2147483648.00 2147483647.00 FORMAT "%13.2" /end CHARACTERISTIC
/begin CHARACTERISTIC FBC_stInitI_C "Initialisierung des I-Anteils im Zustand ""inaktiv"": '0' einfrieren, '1' mit 0 initialisieren." VALUE 0x1D5DD4 Kw_Ws8 1.000 OneToOne 0.00 1.000 FORMAT "%5.3" EXTENDED_LIMITS -128.0 127.0 /end CHARACTERISTIC
/begin CHARACTERISTIC FBC_stMskRgn_C "Maske für Regenerationsstatus (NOx-Kat)" VALUE 0x1D5DD8 Kw_Ws32 4294967295.00 OneToOne -2147483648.00 2147483647.00 FORMAT "%13.2" /end CHARACTERISTIC
/begin CHARACTERISTIC FBC_stPreCtlApplyOpModeInhib_C "EGT - Modus Auswahlmaske" VALUE 0x1D5E6C Kw_Wu32 4294967295.00 OneToOne 0.00 4294967295.00 FORMAT "%13.2" /end CHARACTERISTIC
/begin CHARACTERISTIC FBC_stPreCtlEEP_MAP "Kennfeld für die Applikation der im EEPROM zu speichernden Kennraumpunkte" MAP 0x1D5E70 Kf_Xu8_Yu8_Wu8 255.0 OneToOne 0.00 255.0 FORMAT "%5.1"
 /begin AXIS_DESCR STD_AXIS FBC_idxPreCtlLrnSpd_mp OneToOne 2 0.00 2.000000 FORMAT "%8.6" EXTENDED_LIMITS -32768.00 32767.00 DEPOSIT ABSOLUTE /end AXIS_DESCR
 /begin AXIS_DESCR STD_AXIS FBC_idxPreCtlLrnQnt_mp OneToOne 4 0.00 4.000000 FORMAT "%8.6" EXTENDED_LIMITS -32768.00 32767.00 DEPOSIT ABSOLUTE /end AXIS_DESCR
/end CHARACTERISTIC
/begin CHARACTERISTIC FBC_stPreCtlLrnOpModeInhib_C "EGT Modus Auswahlmaske" VALUE 0x1D5E80 Kw_Wu32 4294967295.00 OneToOne 0.00 4294967295.00 FORMAT "%13.2" /end CHARACTERISTIC
/begin CHARACTERISTIC FBC_swtInjMass_C "Schalter, zu ausgeweahlter Einspritzmenge, 0: InjCtl_qSetUnBal 1: InjCrv_qMI1Des" VALUE 0x1D5DDC Kw_Wu8 1.000 OneToOne 0.00 1.000 FORMAT "%5.3" EXTENDED_LIMITS 0.00 255.0 /end CHARACTERISTIC
/begin CHARACTERISTIC FBC_swtPoI2HCFBC_C "Schalter zum Aktivieren der massage InjCrv_stPoI2HCOff und somit der zusätzlichen Einfrierbedingung" VALUE 0x1D5DDD Kw_Wu8 1.000 OneToOne 0.00 1.000 FORMAT "%5.3" EXTENDED_LIMITS 0.00 255.0 /end CHARACTERISTIC
/begin CHARACTERISTIC FBC_swtPreCtlApply_C "Globaler Schalter zur Aktiverung der Vorsteuerung (nicht für Warmstart)" VALUE 0x1D5E84 Kw_Wu8 1.000 OneToOne 0.00 1.000 FORMAT "%5.3" EXTENDED_LIMITS 0.00 255.0 /end CHARACTERISTIC
/begin CHARACTERISTIC FBC_swtPreCtlEEPIni_C "Schalter zur Initialisierung der gelernten Werte in EEPROM und RAM" VALUE 0x1D5E85 Kw_Wu8 1.000 OneToOne 0.00 1.000 FORMAT "%5.3" EXTENDED_LIMITS 0.00 255.0 /end CHARACTERISTIC
/begin CHARACTERISTIC FBC_swtPreCtlLrnOut_C "Starten des Ausgabemechanismus des gesamten Kennraumes" VALUE 0x1D5E86 Kw_Wu8 1.000 OneToOne 0.00 1.000 FORMAT "%5.3" EXTENDED_LIMITS 0.00 255.0 /end CHARACTERISTIC
/begin CHARACTERISTIC FBC_swtPreCtlLrnSet_C "Applizieren der Lernwerte im Kennraum" VALUE 0x1D5E87 Kw_Wu8 1.000 OneToOne 0.00 1.000 FORMAT "%5.3" EXTENDED_LIMITS 0.00 255.0 /end CHARACTERISTIC
/begin CHARACTERISTIC FBC_swtPreCtlLrn_C "Globaler Schalter zum Aktivieren des Einlernens von Kennräumen" VALUE 0x1D5E88 Kw_Wu8 1.000 OneToOne 0.00 1.000 FORMAT "%5.3" EXTENDED_LIMITS 0.00 255.0 /end CHARACTERISTIC
/begin CHARACTERISTIC FBC_swtPreCtlRngChngRst_C "zurücksetzen des Zählers für eingeregelte Arbeitszyklen bei Arbeitspunktänderung" VALUE 0x1D5E89 Kw_Wu8 1.000 OneToOne 0.00 1.000 FORMAT "%5.3" EXTENDED_LIMITS 0.00 255.0 /end CHARACTERISTIC
/begin CHARACTERISTIC FBC_swtPreCtlStartInitWrm_C "Vorsteuerung aktivieren mit Warmstart-Werten" VALUE 0x1D5E8A Kw_Wu8 1.000 OneToOne 0.00 1.000 FORMAT "%5.3" EXTENDED_LIMITS 0.00 255.0 /end CHARACTERISTIC
/begin CHARACTERISTIC FBC_TFlrn_C "Filterkoeffizient des Bewertungsfilters" VALUE 0x1D5EDC Kw_Wr32 1.00000000 OneToOne 0.00 1.00000000 FORMAT "%10.8" EXTENDED_LIMITS -1.00000000E+37 1.00000000E+37 /end CHARACTERISTIC
/begin CHARACTERISTIC FBC_TF_C "Filterkoeffizient des Adaptionsfilters" VALUE 0x1D5EE0 Kw_Wr32 1.00000000 OneToOne 0.00 1.00000000 FORMAT "%10.8" EXTENDED_LIMITS -1.00000000E+37 1.00000000E+37 /end CHARACTERISTIC
/begin CHARACTERISTIC FBC_ThresDyn_C "Drehzahldynamikgrenzwert um die Adaption zu deaktivieren" VALUE 0x1D5EE4 Kw_Wr32 1.00000000 OneToOne 0.00 1.00000000 FORMAT "%10.8" EXTENDED_LIMITS -1.00000000E+37 1.00000000E+37 /end CHARACTERISTIC
/begin CHARACTERISTIC FBC_tPreCtlApplyMax_C "Oberes Temperaturlimit zum Vorsteuern" VALUE 0x1D5E8C Kw_Ws16 250.0000 Temp_Cels -50.04000 199.9600 FORMAT "%8.4" EXTENDED_LIMITS -3549.940 3003.560 /end CHARACTERISTIC
/begin CHARACTERISTIC FBC_tPreCtlApplyMin_C "Unteres Temperaturlimit zum Vorsteuern" VALUE 0x1D5E8E Kw_Ws16 250.0000 Temp_Cels -50.04000 199.9600 FORMAT "%8.4" EXTENDED_LIMITS -3549.940 3003.560 /end CHARACTERISTIC
/begin CHARACTERISTIC FBC_tPreCtlLrnMax_C "Oberes Temperaturlimit zum Lernen" VALUE 0x1D5E90 Kw_Ws16 250.0000 Temp_Cels -50.04000 199.9600 FORMAT "%8.4" EXTENDED_LIMITS -3549.940 3003.560 /end CHARACTERISTIC
/begin CHARACTERISTIC FBC_tPreCtlLrnMin_C "Unteres Temperaturlimit zum Lernen" VALUE 0x1D5E92 Kw_Ws16 250.0000 Temp_Cels -50.04000 199.9600 FORMAT "%8.4" EXTENDED_LIMITS -3549.940 3003.560 /end CHARACTERISTIC
/begin CHARACTERISTIC FBC_tPreCtl_CUR "Temperaturbereichs-Applikationsfeld" CURVE 0x1D5E94 Kl_Xs16_Ws16 250.0000 Temp_Cels -50.04000 199.9600 FORMAT "%8.4" EXTENDED_LIMITS -3549.940 3003.560
 /begin AXIS_DESCR STD_AXIS FBC_idxPreCtlLrnTemp_mp OneToOne 2 0.00 1.000000 FORMAT "%8.6" EXTENDED_LIMITS -32768.00 32767.00 DEPOSIT ABSOLUTE /end AXIS_DESCR
/end CHARACTERISTIC
/begin CHARACTERISTIC FBC_TSm_C "Koeffizienten für Mittelwertfilter" VAL_BLK 0x1D5EE8 Kwb_Wr32 9.00000000 OneToOne -4.00000000 5.00000000 FORMAT "%10.8" EXTENDED_LIMITS -1.00000000E+37 1.00000000E+37 NUMBER 2 /end CHARACTERISTIC
/begin CHARACTERISTIC FlMng_dRmpSlpLimSmkL_C "Rampensteigung für Rampe in der Rauchbegrenzung über Lambda" VALUE 0x1D5F0C Kw_Wu32 100000.000000 Rmp 0.00 100000.000000 FORMAT "%13.6" EXTENDED_LIMITS 0.00 65535999.9847 /end CHARACTERISTIC
/begin CHARACTERISTIC FlMng_dSmokeMapNr_CUR "Auswahl Kennfeld zur Rauchbegrenzung aus Motortemperatur" CURVE 0x1D5F10 Kl_Xs16_Ws16 2.000000 Map_Select 0.00 2.000000 FORMAT "%8.6" EXTENDED_LIMITS -128.0000 127.9961
 /begin AXIS_DESCR STD_AXIS Eng_tEng Temp_Cels 2 -50.14000 199.8600 FORMAT "%8.4" EXTENDED_LIMITS -3549.940 3003.560 DEPOSIT ABSOLUTE /end AXIS_DESCR
/end CHARACTERISTIC
/begin CHARACTERISTIC FlMng_facCorAirTemp_CUR "Lufttemperaturkorrektur für PWG abhängige Rauchbegrenzung" CURVE 0x1D5F1A Kl_Xs16_Ws16 1.000000 Fact 0.00 1.000000 FORMAT "%8.6" EXTENDED_LIMITS -4.000000 3.999878
 /begin AXIS_DESCR STD_AXIS FlMng_AirTemp_mp Temp_Cels 12 -50.14000 199.8600 FORMAT "%8.4" EXTENDED_LIMITS -3549.940 3003.560 DEPOSIT ABSOLUTE /end AXIS_DESCR
/end CHARACTERISTIC
/begin CHARACTERISTIC FlMng_facCorAP_CUR "Atmosphärendruckkorrektur für PWG abhängige Rauchbegrenzung" CURVE 0x1D5F4C Kl_Xs16_Ws16 1.000000 Fact 0.00 1.000000 FORMAT "%8.6" EXTENDED_LIMITS -4.000000 3.999878
 /begin AXIS_DESCR STD_AXIS APSCD_pVal Pres_hPa 12 0.00 3500.000 FORMAT "%8.3" EXTENDED_LIMITS -32768.00 32767.00 DEPOSIT ABSOLUTE /end AXIS_DESCR
/end CHARACTERISTIC
/begin CHARACTERISTIC FlMng_facCorEngTemp_CUR "Motortemperaturkorrektur für PWG abhängige Rauchbegrenzung" CURVE 0x1D5F7E Kl_Xs16_Ws16 1.000000 Fact 0.00 1.000000 FORMAT "%8.6" EXTENDED_LIMITS -4.000000 3.999878
 /begin AXIS_DESCR STD_AXIS Eng_tEng Temp_Cels 12 -50.14000 199.8600 FORMAT "%8.4" EXTENDED_LIMITS -3549.940 3003.560 DEPOSIT ABSOLUTE /end AXIS_DESCR
/end CHARACTERISTIC
/begin CHARACTERISTIC FlMng_facDynSmkAP_CUR "Kennlinie für Korrektur der dynamischen Rauchmengenerhöhung in Abhängigkeit vom Umgebungsdruck" CURVE 0x1D5FB0 Kl_Xs16_Ws16 1.000000 Fact 0.00 1.000000 FORMAT "%8.6" EXTENDED_LIMITS -4.000000 3.999878
 /begin AXIS_DESCR STD_AXIS APSCD_pVal Pres_hPa 5 -32768.00 32767.00 FORMAT "%8.2" DEPOSIT ABSOLUTE /end AXIS_DESCR
/end CHARACTERISTIC
/begin CHARACTERISTIC FlMng_facDynSmkTemp_CUR "Kennlinie für temperaturabhängige Korrektur der dynamischen Rauchmengenerhöhung" CURVE 0x1D5FC6 Kl_Xs16_Ws16 1.000000 Fact 0.00 1.000000 FORMAT "%8.6" EXTENDED_LIMITS -4.000000 3.999878
 /begin AXIS_DESCR STD_AXIS IATSCD_tAir Temp_Cels 5 -3549.940 3003.560 FORMAT "%8.3" DEPOSIT ABSOLUTE /end AXIS_DESCR
/end CHARACTERISTIC
/begin CHARACTERISTIC FlMng_facDynSmoke_CUR "Kennlinie für geschwindigkeitsabhängige Korrektur der dynamischen Rauchmengenerhöhung" CURVE 0x1D5FDC Kl_Xs16_Ws16 1.000000 Fact 0.00 1.000000 FORMAT "%8.6" EXTENDED_LIMITS -4.000000 3.999878
 /begin AXIS_DESCR STD_AXIS VSSCD_v Vel 8 -327.6800 327.6700 FORMAT "%8.4" DEPOSIT ABSOLUTE /end AXIS_DESCR
/end CHARACTERISTIC
/begin CHARACTERISTIC FlMng_facLmbdSmkSOE_CUR "Korrekturfaktor aufgrund Saugrohrdruck" CURVE 0x1D5FFE Kl_Xs16_Ws16 6.000000 Fact -3.000000 3.000000 FORMAT "%8.6" EXTENDED_LIMITS -4.000000 3.999878
 /begin AXIS_DESCR STD_AXIS FlMng_pValSel_mp Pres_hPa 6 0.00 3500.000 FORMAT "%8.3" EXTENDED_LIMITS -32768.00 32767.00 DEPOSIT ABSOLUTE /end AXIS_DESCR
/end CHARACTERISTIC
/begin CHARACTERISTIC FlMng_FullLdRglIKi_CUR "Drehzahlabhängige Ki-Parameter der Vollastregelung" CURVE 0x1D6018 Kl_Xs16_Ws16 762.9162 Ki_LmbdRec2InjMass 0.00 762.9162 FORMAT "%8.4" EXTENDED_LIMITS -762.9395 762.9162
 /begin AXIS_DESCR STD_AXIS Eng_nAvrg EngN 7 0.00 6000.000 FORMAT "%8.3" EXTENDED_LIMITS -32768.00 32767.00 DEPOSIT ABSOLUTE /end AXIS_DESCR
/end CHARACTERISTIC
/begin CHARACTERISTIC FlMng_qFullLdRglMax_C "Maximale Stellgröße für Vollastregler" VALUE 0x1D6036 Kw_Ws16 327.6700 InjMass 0.00 327.6700 FORMAT "%8.4" EXTENDED_LIMITS -327.6800 327.6700 /end CHARACTERISTIC
/begin CHARACTERISTIC FlMng_qFullLdRglMin_C "Minimale Stellgröße für Volllastregler" VALUE 0x1D6038 Kw_Ws16 327.6800 InjMass -327.6800 0.00 FORMAT "%8.4" EXTENDED_LIMITS -327.6800 327.6700 /end CHARACTERISTIC
/begin CHARACTERISTIC FlMng_FullLdRglPKp_CUR "Drehzahlabhängige P-Parameter der Vollastregelung" CURVE 0x1D603A Kl_Xs16_Ws16 399.9878 Kp_LmbdRec2InjMass_1 0.00 399.9878 FORMAT "%8.4" EXTENDED_LIMITS -400.0000 399.9878
 /begin AXIS_DESCR STD_AXIS Eng_nAvrg EngN 7 0.00 6000.000 FORMAT "%8.3" EXTENDED_LIMITS -32768.00 32767.00 DEPOSIT ABSOLUTE /end AXIS_DESCR
/end CHARACTERISTIC
/begin CHARACTERISTIC FlMng_mAirPerCylMin_C "untere Begrenzung der Luftmasse" VALUE 0x1D6058 Kw_Ws16 6553.500 AirMassPerCyl -3276.800 3276.700 FORMAT "%8.3" /end CHARACTERISTIC
/begin CHARACTERISTIC FlMng_pIATCorr_MAP "Kennfeld zur Korrektur Druck f. Rauchbegrenzung" MAP 0x1D605A Kf_Xs16_Ys16_Ws16 3500.000 Pres_hPa 0.00 3500.000 FORMAT "%8.3" EXTENDED_LIMITS -32768.00 32767.00
 /begin AXIS_DESCR STD_AXIS FlMng_pBPAPCorr_mp Pres_hPa 16 0.00 3500.000 FORMAT "%8.3" EXTENDED_LIMITS -32768.00 32767.00 DEPOSIT ABSOLUTE /end AXIS_DESCR
 /begin AXIS_DESCR STD_AXIS IATSCD_tAir Temp_Cels 10 -50.14000 199.8600 FORMAT "%8.4" EXTENDED_LIMITS -3549.940 3003.560 DEPOSIT ABSOLUTE /end AXIS_DESCR
/end CHARACTERISTIC
/begin CHARACTERISTIC FlMng_qAFSCDSmoke_MAP "Rauchkennfeld" MAP 0x1D61D2 Kf_Xs16_Ys16_Ws16 327.6700 InjMass 0.00 327.6700 FORMAT "%8.4" EXTENDED_LIMITS -327.6800 327.6700
 /begin AXIS_DESCR STD_AXIS Eng_nAvrg EngN 16 0.00 6000.000 FORMAT "%8.3" EXTENDED_LIMITS -32768.00 32767.00 DEPOSIT ABSOLUTE /end AXIS_DESCR
 /begin AXIS_DESCR STD_AXIS FlMng_mAirPerCyl_mp AirMassPerCyl 13 0.00 2000.000 FORMAT "%8.3" EXTENDED_LIMITS -3276.800 3276.700 DEPOSIT ABSOLUTE /end AXIS_DESCR
/end CHARACTERISTIC
/begin CHARACTERISTIC FlMng_qAFSCDtEngSmoke0_MAP "Kennfeld 0 aus Rauchkennraum" MAP 0x1D63B0 Kf_Xs16_Ys16_Ws16 327.6700 InjMass 0.00 327.6700 FORMAT "%8.4" EXTENDED_LIMITS -327.6800 327.6700
 /begin AXIS_DESCR STD_AXIS Eng_nAvrg EngN 2 0.00 6000.000 FORMAT "%8.3" EXTENDED_LIMITS -32768.00 32767.00 DEPOSIT ABSOLUTE /end AXIS_DESCR
 /begin AXIS_DESCR STD_AXIS FlMng_mAirPerCyl_mp AirMassPerCyl 2 0.00 2000.000 FORMAT "%8.3" EXTENDED_LIMITS -3276.800 3276.700 DEPOSIT ABSOLUTE /end AXIS_DESCR
/end CHARACTERISTIC
/begin CHARACTERISTIC FlMng_qAFSCDtEngSmoke1_MAP "Kennfeld 1 aus Rauchkennraum" MAP 0x1D63C4 Kf_Xs16_Ys16_Ws16 327.6700 InjMass 0.00 327.6700 FORMAT "%8.4" EXTENDED_LIMITS -327.6800 327.6700
 /begin AXIS_DESCR STD_AXIS Eng_nAvrg EngN 2 0.00 6000.000 FORMAT "%8.3" EXTENDED_LIMITS -32768.00 32767.00 DEPOSIT ABSOLUTE /end AXIS_DESCR
 /begin AXIS_DESCR STD_AXIS FlMng_mAirPerCyl_mp AirMassPerCyl 2 0.00 2000.000 FORMAT "%8.3" EXTENDED_LIMITS -3276.800 3276.700 DEPOSIT ABSOLUTE /end AXIS_DESCR
/end CHARACTERISTIC
/begin CHARACTERISTIC FlMng_qAFSCDtEngSmoke2_MAP "Kennfeld 2 aus Rauchkennraum" MAP 0x1D63D8 Kf_Xs16_Ys16_Ws16 327.6700 InjMass 0.00 327.6700 FORMAT "%8.4" EXTENDED_LIMITS -327.6800 327.6700
 /begin AXIS_DESCR STD_AXIS Eng_nAvrg EngN 2 0.00 6000.000 FORMAT "%8.3" EXTENDED_LIMITS -32768.00 32767.00 DEPOSIT ABSOLUTE /end AXIS_DESCR
 /begin AXIS_DESCR STD_AXIS FlMng_mAirPerCyl_mp AirMassPerCyl 2 0.00 2000.000 FORMAT "%8.3" EXTENDED_LIMITS -3276.800 3276.700 DEPOSIT ABSOLUTE /end AXIS_DESCR
/end CHARACTERISTIC
/begin CHARACTERISTIC FlMng_qDynSmoke_MAP "Kennfeld für dynamische Rauchmengenerhöhung" MAP 0x1D63EC Kf_Xs16_Ys16_Ws16 327.6700 InjMass 0.00 327.6700 FORMAT "%8.4" EXTENDED_LIMITS -327.6800 327.6700
 /begin AXIS_DESCR STD_AXIS Eng_nAvrg EngN 8 0.00 6000.000 FORMAT "%8.3" EXTENDED_LIMITS -32768.00 32767.00 DEPOSIT ABSOLUTE /end AXIS_DESCR
 /begin AXIS_DESCR STD_AXIS PCR_pBGDev Pres_hPa 8 -32768.00 32767.00 FORMAT "%8.2" DEPOSIT ABSOLUTE /end AXIS_DESCR
/end CHARACTERISTIC
/begin CHARACTERISTIC FlMng_qPresSmoke_MAP "Kennfeld für Rauchmenge aus Druck" MAP 0x1D6490 Kf_Xs16_Ys16_Ws16 327.6700 InjMass 0.00 327.6700 FORMAT "%8.4" EXTENDED_LIMITS -327.6800 327.6700
 /begin AXIS_DESCR STD_AXIS Eng_nAvrg EngN 16 0.00 6000.000 FORMAT "%8.3" EXTENDED_LIMITS -32768.00 32767.00 DEPOSIT ABSOLUTE /end AXIS_DESCR
 /begin AXIS_DESCR STD_AXIS FlMng_pIATCorr_mp Pres_hPa 13 0.00 3500.000 FORMAT "%8.3" EXTENDED_LIMITS -32768.00 32767.00 DEPOSIT ABSOLUTE /end AXIS_DESCR
/end CHARACTERISTIC
/begin CHARACTERISTIC FlMng_qTempFuel_MAP "Kennfeld für motortemperaturabhängige Vollastkorrektur" MAP 0x1D666E Kf_Xs16_Ys16_Ws16 655.0000 dQnt_dT1 0.00 655.0000 FORMAT "%8.4" EXTENDED_LIMITS -655.3600 655.3400
 /begin AXIS_DESCR STD_AXIS Eng_nAvrg EngN 10 0.00 6000.000 FORMAT "%8.3" EXTENDED_LIMITS -32768.00 32767.00 DEPOSIT ABSOLUTE /end AXIS_DESCR
 /begin AXIS_DESCR STD_AXIS InjCtl_qAct InjMass 10 0.00 327.6700 FORMAT "%8.4" EXTENDED_LIMITS -327.6800 327.6700 DEPOSIT ABSOLUTE /end AXIS_DESCR
/end CHARACTERISTIC
/begin CHARACTERISTIC FlMng_rLmbdPartLd_CUR "Kennlinie für PWG abhängige Rauchbegrenzung" CURVE 0x1D6762 Kl_Xs16_Ws16 32.00000 lambda 0.00 32.00000 FORMAT "%8.5" EXTENDED_LIMITS -32.76800 32.76700
 /begin AXIS_DESCR STD_AXIS AccPed_rChkdVal Prc 12 -327.6800 327.6700 FORMAT "%8.4" DEPOSIT ABSOLUTE /end AXIS_DESCR
/end CHARACTERISTIC
/begin CHARACTERISTIC FlMng_rLmbdRecDvtMax_C "Maximale reziproke Lamda-Regelabweichung der Volllastregelung" VALUE 0x1D6794 Kw_Ws16 1.330000 lambdaRec 0.00 1.330000 FORMAT "%8.6" EXTENDED_LIMITS -3.276800 3.276700 /end CHARACTERISTIC
/begin CHARACTERISTIC FlMng_rLmbdRecDvtMin_C "Minimale reziproke Lambda-Regelabweichung der Vollastregelung" VALUE 0x1D6796 Kw_Ws16 1.330000 lambdaRec -1.330000 0.00 FORMAT "%8.6" EXTENDED_LIMITS -3.276800 3.276700 /end CHARACTERISTIC
/begin CHARACTERISTIC FlMng_rLmbdSmkEGT_MAP "Kennfeld zur Ermittlung des Lambda-Werts der Rauchbegrenzung während der Partikelfilterregeneration" MAP 0x1D6798 Kf_Xs16_Ys16_Ws16 32.00000 lambda 0.00 32.00000 FORMAT "%8.5" EXTENDED_LIMITS -32.76800 32.76700
 /begin AXIS_DESCR STD_AXIS Eng_nAvrg EngN 16 0.00 6000.000 FORMAT "%8.3" EXTENDED_LIMITS -32768.00 32767.00 DEPOSIT ABSOLUTE /end AXIS_DESCR
 /begin AXIS_DESCR STD_AXIS FlMng_mAirPerCyl_mp AirMassPerCyl 13 0.00 2500.000 FORMAT "%8.3" EXTENDED_LIMITS -3276.800 3276.700 DEPOSIT ABSOLUTE /end AXIS_DESCR
/end CHARACTERISTIC
/begin CHARACTERISTIC FlMng_rLmbdSmkLim0_MAP "Kennfeld 0 aus Kennraum zur Ermittlung des Lambda-Werts der Rauchbegrenzung" MAP 0x1D6976 Kf_Xs16_Ys16_Ws16 32.00000 lambda 0.00 32.00000 FORMAT "%8.5" EXTENDED_LIMITS -32.76800 32.76700
 /begin AXIS_DESCR STD_AXIS Eng_nAvrg EngN 16 0.00 6000.000 FORMAT "%8.3" EXTENDED_LIMITS -32768.00 32767.00 DEPOSIT ABSOLUTE /end AXIS_DESCR
 /begin AXIS_DESCR STD_AXIS FlMng_mAirPerCyl_mp AirMassPerCyl 13 0.00 2500.000 FORMAT "%8.3" EXTENDED_LIMITS -3276.800 3276.700 DEPOSIT ABSOLUTE /end AXIS_DESCR
/end CHARACTERISTIC
/begin CHARACTERISTIC FlMng_rLmbdSmkLim1_MAP "Kennfeld 1 aus Kennraum zur Ermittlung des Lambda-Werts der Rauchbegrenzung" MAP 0x1D6B54 Kf_Xs16_Ys16_Ws16 32.00000 lambda 0.00 32.00000 FORMAT "%8.5" EXTENDED_LIMITS -32.76800 32.76700
 /begin AXIS_DESCR STD_AXIS Eng_nAvrg EngN 16 0.00 6000.000 FORMAT "%8.3" EXTENDED_LIMITS -32768.00 32767.00 DEPOSIT ABSOLUTE /end AXIS_DESCR
 /begin AXIS_DESCR STD_AXIS FlMng_mAirPerCyl_mp AirMassPerCyl 13 0.00 2500.000 FORMAT "%8.3" EXTENDED_LIMITS -3276.800 3276.700 DEPOSIT ABSOLUTE /end AXIS_DESCR
/end CHARACTERISTIC
/begin CHARACTERISTIC FlMng_rLmbdSmkLim2_MAP "Kennfeld 2 aus Kennraum zur Ermittlung des Lambda-Werts der Rauchbegrenzung" MAP 0x1D6D32 Kf_Xs16_Ys16_Ws16 32.00000 lambda 0.00 32.00000 FORMAT "%8.5" EXTENDED_LIMITS -32.76800 32.76700
 /begin AXIS_DESCR STD_AXIS Eng_nAvrg EngN 16 0.00 6000.000 FORMAT "%8.3" EXTENDED_LIMITS -32768.00 32767.00 DEPOSIT ABSOLUTE /end AXIS_DESCR
 /begin AXIS_DESCR STD_AXIS FlMng_mAirPerCyl_mp AirMassPerCyl 13 0.00 2500.000 FORMAT "%8.3" EXTENDED_LIMITS -3276.800 3276.700 DEPOSIT ABSOLUTE /end AXIS_DESCR
/end CHARACTERISTIC
/begin CHARACTERISTIC FlMng_rLmbdSmkSOE_MAP "Lambdakorrekturwert durch Ansteuerbeginn - Frühverstellung" MAP 0x1D6F10 Kf_Xs16_Ys16_Ws16 60.00000 lambda -30.00000 30.00000 FORMAT "%8.5" EXTENDED_LIMITS -32.76800 32.76700
 /begin AXIS_DESCR STD_AXIS Eng_nAvrg EngN 16 0.00 6000.000 FORMAT "%8.3" EXTENDED_LIMITS -32768.00 32767.00 DEPOSIT ABSOLUTE /end AXIS_DESCR
 /begin AXIS_DESCR STD_AXIS InjCrv_phiMIPCRCor AngleCrS 6 -90.00000 90.00000 FORMAT "%8.5" EXTENDED_LIMITS -768.0000 767.9766 DEPOSIT ABSOLUTE /end AXIS_DESCR
/end CHARACTERISTIC
/begin CHARACTERISTIC FlMng_dqSlpPos_C "Positive Steigung der Abklingrampe der Vollastregelung" VALUE 0x1D7000 Kw_Wu32 655359.499817 RmpInjMass 0.500030517578 655359.999847 FORMAT "%13.6" EXTENDED_LIMITS 0.00 655359.999847 /end CHARACTERISTIC
/begin CHARACTERISTIC FlMng_dqSlpNeg_C "Negative Steigung der Abklingrampe der Vollastregelung" VALUE 0x1D7004 Kw_Wu32 655359.499817 RmpInjMass 0.500030517578 655359.999847 FORMAT "%13.6" EXTENDED_LIMITS 0.00 655359.999847 /end CHARACTERISTIC
/begin CHARACTERISTIC FlMng_stEGTRglOff_C "Maske zur Abschaltung des Reglers bei Regenerationsbetrieb bei Abgasnachbehandlung" VALUE 0x1D7008 Kw_Ws32 4294967295.00 OneToOne -2147483648.00 2147483647.00 FORMAT "%13.2" /end CHARACTERISTIC
/begin CHARACTERISTIC FlMng_stRgnMsk_C "Maske zur Umschaltung der Rauchbegrenzung bei Regenerationsbetrieb des Parikelfilters" VALUE 0x1D700C Kw_Wu32 4294967295.00 OneToOne 0.00 4294967295.00 FORMAT "%13.2" /end CHARACTERISTIC
/begin CHARACTERISTIC FlMng_swtAirTemp_C "Temperaturauswahlschalter für PWG abhängige Rauchbegrenzung" VALUE 0x1D7010 Kw_Wu8 1.000 OneToOne 0.00 1.000 FORMAT "%5.3" EXTENDED_LIMITS 0.00 255.0 /end CHARACTERISTIC
/begin CHARACTERISTIC FlMng_swtBPAP_C "Schalter für Eingangsdruck Rauchbegrenzung" VALUE 0x1D7011 Kw_Wu8 1.000 OneToOne 0.00 1.000 FORMAT "%5.3" EXTENDED_LIMITS 0.00 255.0 /end CHARACTERISTIC
/begin CHARACTERISTIC FlMng_swtFullLdRglVal_C "Schalter um Volllastregelung zu (de)aktivieren (1: aktiev, 0: inaktiev)" VALUE 0x1D7012 Kw_Wu8 0.00 OneToOne 0.00 0.00 FORMAT "%5.2" EXTENDED_LIMITS 0.00 255.0 /end CHARACTERISTIC
/begin CHARACTERISTIC FlMng_swtFullLdRglType_C "Typ des Schalters um Volllastregelung zu (de)aktivieren" VALUE 0x1D7013 Kw_Wu8 1.000 OneToOne 1.000 2.000 FORMAT "%5.3" EXTENDED_LIMITS 0.00 255.0 /end CHARACTERISTIC
/begin CHARACTERISTIC FlMng_swtMIAPSSrcSel_C "Auswahlschalter für Druck für Korrektur durch Ansteuerbeginn - Frühverstellung" VALUE 0x1D7014 Kw_Wu8 1.000 OneToOne 0.00 1.000 FORMAT "%5.3" EXTENDED_LIMITS 0.00 255.0 /end CHARACTERISTIC
/begin CHARACTERISTIC FlMng_swtqLimSmkQ_C "Auswahl Rauchbegrenzung über Lambda (0) oder Menge (1)" VALUE 0x1D7015 Kw_Wu8 1.000 OneToOne 0.00 1.000 FORMAT "%5.3" EXTENDED_LIMITS 0.00 255.0 /end CHARACTERISTIC
/begin CHARACTERISTIC FlMng_swtSmokeSpace_C "Auswahl Rauchbegrenzung über Kennfeld (0) oder Kennraum (1)" VALUE 0x1D7016 Kw_Wu8 1.000 OneToOne 0.00 1.000 FORMAT "%5.3" EXTENDED_LIMITS 0.00 255.0 /end CHARACTERISTIC
/begin CHARACTERISTIC FlMng_swtSmokeVariant_C "Schalter Rauchbegrenzung zwischen Luftmasse oder Luftdruck" VALUE 0x1D7017 Kw_Wu8 1.000 OneToOne 0.00 1.000 FORMAT "%5.3" EXTENDED_LIMITS 0.00 255.0 /end CHARACTERISTIC
/begin CHARACTERISTIC FlMng_tFueRef_C "Referenztemperatur Treibstoff für Rauchbegrenzung" VALUE 0x1D7018 Kw_Ws16 200.0000 Temp_Cels -50.14000 149.8600 FORMAT "%8.4" EXTENDED_LIMITS -3549.940 3003.560 /end CHARACTERISTIC
/begin CHARACTERISTIC FlMng_tiFullLdRglDel_CUR "Drehzahlabhängige Einschaltverzögerung der Vollastregelung" CURVE 0x1D701A Kl_Xs16_Ws16 327670.0 Time_ms 0.00 327670.0 FORMAT "%8.1" EXTENDED_LIMITS -327680.0 327670.0
 /begin AXIS_DESCR STD_AXIS Eng_nAvrg EngN 10 0.00 6000.000 FORMAT "%8.3" EXTENDED_LIMITS -32768.00 32767.00 DEPOSIT ABSOLUTE /end AXIS_DESCR
/end CHARACTERISTIC
/begin CHARACTERISTIC FlMng_trqEpsLim_C "halbe Intervallbreite für Abfrage der Abschaltbedingung" VALUE 0x1D7044 Kw_Ws16 3276.700 Trq 0.00 3276.700 FORMAT "%8.3" EXTENDED_LIMITS -3276.800 3276.700 /end CHARACTERISTIC
/begin CHARACTERISTIC FlMng_trqEps_C "Hysterese für Momentenschwellwert der Vollastregelung" VALUE 0x1D7046 Kw_Ws16 3276.700 Trq 0.00 3276.700 FORMAT "%8.3" EXTENDED_LIMITS -3276.800 3276.700 /end CHARACTERISTIC
/begin CHARACTERISTIC FlPpCD_ctPwrStgOnMax_C "maximale Anzahl von Endstufen-Einschaltungen pro Fahrzyklus bei SCB oder Übertemperatur" VALUE 0x1D7048 Kw_Wu16 65535.00 OneToOne 0.00 65535.00 FORMAT "%8.2" /end CHARACTERISTIC
/begin CHARACTERISTIC FlPpCD_DebExcTempDef_C "Defekterkennungszeit Übertemperatur für FlPpCD Endstufe" VALUE 0x1D704A Kw_Wu16 655350.0 Time_ms 0.00 655350.0 FORMAT "%8.1" /end CHARACTERISTIC
/begin CHARACTERISTIC FlPpCD_DebExcTempOk_C "Heilzeit Übertemperatur für FlPpCD Endstufe" VALUE 0x1D704C Kw_Wu16 655350.0 Time_ms 0.00 655350.0 FORMAT "%8.1" /end CHARACTERISTIC
/begin CHARACTERISTIC FlPpCD_DebNoLoadDef_C "Defekterkennungszeit Leerlauf für FlPpCD Endstufe" VALUE 0x1D704E Kw_Wu16 655350.0 Time_ms 0.00 655350.0 FORMAT "%8.1" /end CHARACTERISTIC
/begin CHARACTERISTIC FlPpCD_DebNoLoadOk_C "Heilzeit Leerlauf für FlPpCD Endstufe" VALUE 0x1D7050 Kw_Wu16 655350.0 Time_ms 0.00 655350.0 FORMAT "%8.1" /end CHARACTERISTIC
/begin CHARACTERISTIC FlPpCD_DebShortCircBatDef_C "Defekterkennungszeit Kurzschluß Batterie für FlPpCD Endstufe" VALUE 0x1D7052 Kw_Wu16 655350.0 Time_ms 0.00 655350.0 FORMAT "%8.1" /end CHARACTERISTIC
/begin CHARACTERISTIC FlPpCD_DebShortCircBatOk_C "Heilzeit Kurzschluß Batterie für FlPpCD Endstufe" VALUE 0x1D7054 Kw_Wu16 655350.0 Time_ms 0.00 655350.0 FORMAT "%8.1" /end CHARACTERISTIC
/begin CHARACTERISTIC FlPpCD_DebShortCircGndDef_C "Defekterkennungszeit Kurzschluß Masse für FlPpCD Endstufe" VALUE 0x1D7056 Kw_Wu16 655350.0 Time_ms 0.00 655350.0 FORMAT "%8.1" /end CHARACTERISTIC
/begin CHARACTERISTIC FlPpCD_DebShortCircGndOk_C "Heilzeit Kurzschluß Masse für FlPpCD Endstufe" VALUE 0x1D7058 Kw_Wu16 655350.0 Time_ms 0.00 655350.0 FORMAT "%8.1" /end CHARACTERISTIC
/begin CHARACTERISTIC FlPpCD_stInvOut_C "Invertierung des Ausgangssignales" VALUE 0x1D705A Kw_Wu8 1.000 OneToOne 0.00 1.000 FORMAT "%5.3" EXTENDED_LIMITS 0.00 255.0 /end CHARACTERISTIC
/begin CHARACTERISTIC FlPpCD_stSPICtl_C "Parameter zur Anzeige der verwendeten Endstufenart ( 1 = SPI kontrollierbare Endstufe, 0 = nicht SPI-Endstufe )" VALUE 0x1D705B Kw_Wu8 1.000 OneToOne 0.00 1.000 FORMAT "%5.3" EXTENDED_LIMITS 0.00 255.0 /end CHARACTERISTIC
/begin CHARACTERISTIC FlPpCD_swtFlPpAct_C "Kraftstoffumwälzpumpe AKTIV/INAKTIV" VALUE 0x1D5F08 Kw_Wu8 1.000 OneToOne 0.00 1.000 FORMAT "%5.3" EXTENDED_LIMITS 0.00 255.0 /end CHARACTERISTIC
/begin CHARACTERISTIC FlPpCD_swtFlPpActVal_C "Wert des EEPROM Schalters fuer die Kraftstoffumwaelzpumpe" VALUE 0x1D5F09 Kw_Wu8 1.000 OneToOne 0.00 1.000 FORMAT "%5.3" EXTENDED_LIMITS 0.00 255.0 /end CHARACTERISTIC
/begin CHARACTERISTIC FlPpCD_swtFlPpActType_C "Type des Schalters fuer die Kraftstoffumwaelzpumpe" VALUE 0x1D5F0A Kw_Wu8 0.00 OneToOne 1.000 1.000 FORMAT "%5.3" EXTENDED_LIMITS 0.00 255.0 /end CHARACTERISTIC
/begin CHARACTERISTIC FlPpCD_tiBtwTst_C "Zeitabstand, in dem im Fehlerfall die Endstufe getestet wird" VALUE 0x1D705C Kw_Wu16 29900.00 Time_ms 100.0000 30000.00 FORMAT "%8.2" EXTENDED_LIMITS 0.00 655350.0 /end CHARACTERISTIC
/begin CHARACTERISTIC FlPpCD_tiPwrStgOn_C "Zeit für welche die Endstufe im Fehlerfall eingeschalten wird (nur nicht SPI kontrolliert)" VALUE 0x1D705E Kw_Wu16 500.0000 Time_ms 0.00 500.0000 FORMAT "%8.4" EXTENDED_LIMITS 0.00 655350.0 /end CHARACTERISTIC
/begin CHARACTERISTIC FlSCD_uSRCMin_C "Untere Schwelle für den SRC-Min" VALUE 0x1D7060 Kw_Ws16 5200.391 Volt 0.00 5200.391 FORMAT "%8.3" EXTENDED_LIMITS -160156.4 160151.5 /end CHARACTERISTIC
/begin CHARACTERISTIC FlSCD_uSRCMax_C "Obere Schwelle für SRC-Max" VALUE 0x1D7062 Kw_Ws16 5200.391 Volt 0.00 5200.391 FORMAT "%8.3" EXTENDED_LIMITS -160156.4 160151.5 /end CHARACTERISTIC
/begin CHARACTERISTIC FlSCD_volTotalLin_CUR "Kennlinie um Pegelmesswert in Kraftstoffvolumen umzuwandeln" CURVE 0x1D7064 Kl_Xs16_Ws16 300.0000 Fl_Half_L 0.00 300.0000 FORMAT "%8.4" EXTENDED_LIMITS -16384.00 16383.50
 /begin AXIS_DESCR STD_AXIS FlSCD_uLvlRawT1 Volt 25 0.00 5200.391 FORMAT "%8.3" EXTENDED_LIMITS -160156.4 160151.5 DEPOSIT ABSOLUTE /end AXIS_DESCR
/end CHARACTERISTIC
/begin CHARACTERISTIC FlSCD_DebSigDef_C "Defektentprellung fuer CAN-Fehler" VALUE 0x1D70CA Kw_Wu16 655350.0 Time_ms 0.00 655350.0 FORMAT "%8.1" /end CHARACTERISTIC
/begin CHARACTERISTIC FlSCD_DebSigOK_C "Heilungsentprellung fuer CAN-Fehler" VALUE 0x1D70CC Kw_Wu16 655350.0 Time_ms 0.00 655350.0 FORMAT "%8.1" /end CHARACTERISTIC
/begin CHARACTERISTIC FlSCD_DebSRCMaxDef_C "Defektentprellung fuer SCR-High Fehler" VALUE 0x1D70CE Kw_Wu16 655350.0 Time_ms 0.00 655350.0 FORMAT "%8.1" /end CHARACTERISTIC
/begin CHARACTERISTIC FlSCD_DebSRCMaxOk_C "Heilungsentprellung fuer SRC-High Fehler" VALUE 0x1D70D0 Kw_Wu16 655350.0 Time_ms 0.00 655350.0 FORMAT "%8.1" /end CHARACTERISTIC
/begin CHARACTERISTIC FlSCD_DebSRCMinDef_C "Defektentprellung fuer SRC-Low Fehler" VALUE 0x1D70D2 Kw_Wu16 655350.0 Time_ms 0.00 655350.0 FORMAT "%8.1" /end CHARACTERISTIC
/begin CHARACTERISTIC FlSCD_DebSRCMinOk_C "Heilungsentprellung fuer SRC-Low Fehler" VALUE 0x1D70D4 Kw_Wu16 655350.0 Time_ms 0.00 655350.0 FORMAT "%8.1" /end CHARACTERISTIC
/begin CHARACTERISTIC FlSCD_dvolRmpSlpUp_C "Rampensteigung aufwärts bei Heilung/Vorgabewert" VALUE 0x1D70D8 Kw_Wu32 32767999.9924 RmpFuel 0.00 32767999.9924 FORMAT "%13.4" /end CHARACTERISTIC
/begin CHARACTERISTIC FlSCD_dvolRmpSlpDwn_C "Rampensteigung abwärts für Heilung/Vorgabewert" VALUE 0x1D70DC Kw_Wu32 32767999.9924 RmpFuel 0.00 32767999.9924 FORMAT "%13.4" /end CHARACTERISTIC
/begin CHARACTERISTIC FlSCD_swtFuelSens_C "Schalter für Konstantwert Kraftstoffvolumen" VALUE 0x1D70E0 Kw_Wu8 1.000 OneToOne 0.00 1.000 FORMAT "%5.3" EXTENDED_LIMITS 0.00 255.0 /end CHARACTERISTIC
/begin CHARACTERISTIC FlSCD_swtSig_C "Schalter für Eingangssignal ADC oder CAN für Tankstandssensor" VALUE 0x1D70E1 Kw_Wu8 1.000 OneToOne 0.00 1.000 FORMAT "%5.3" EXTENDED_LIMITS 0.00 255.0 /end CHARACTERISTIC
/begin CHARACTERISTIC FlSCD_stSensIDWord_C "Geberkennwort FlSCD" VALUE 0x1D70E2 Kw_Wu16 7.000000 OneToOne 0.00 7.000000 FORMAT "%8.6" EXTENDED_LIMITS 0.00 65535.00 /end CHARACTERISTIC
/begin CHARACTERISTIC FlSCD_volTotalDflVal_C "Vorgabewert bei SRC Fehler" VALUE 0x1D70E4 Kw_Ws16 300.0000 Fl_Half_L 0.00 300.0000 FORMAT "%8.4" EXTENDED_LIMITS -16384.00 16383.50 /end CHARACTERISTIC
/begin CHARACTERISTIC FlSCD_volTotal_C "Konstantwert für Kraftstoffvolumen am Prüfstand" VALUE 0x1D70E6 Kw_Ws16 300.0000 Fl_Half_L 0.00 300.0000 FORMAT "%8.4" EXTENDED_LIMITS -16384.00 16383.50 /end CHARACTERISTIC
/begin CHARACTERISTIC FlSys_rhoFl_C "Kraftstoffdichte bei Normtemperatur" VALUE 0x1D70E8 Kw_Ws16 999.9000 RhoFuel 0.1000000 1000.000 FORMAT "%8.3" EXTENDED_LIMITS -3276.800 3276.700 /end CHARACTERISTIC
/begin CHARACTERISTIC FlSys_rhoFl_CUR "temperaturabhängige Kraftstoffdichte" CURVE 0x1D70EA Kl_Xs16_Ws16 999.9000 RhoFuel 0.1000000 1000.000 FORMAT "%8.3" EXTENDED_LIMITS -3276.800 3276.700
 /begin AXIS_DESCR STD_AXIS FTSCD_tFuel Temp_Cels 2 -50.14000 149.8600 FORMAT "%8.4" EXTENDED_LIMITS -3549.940 3003.560 DEPOSIT ABSOLUTE /end AXIS_DESCR
/end CHARACTERISTIC
/begin CHARACTERISTIC FMA_dfacSwtOffMax_C "Maximal zulässige Änderungsgeschwindigkeit der temperaturabhängigen Abschaltfaktoren" VALUE 0x1D71EC Kw_Wu32 49.9940011650 Rmp_Fact 0.00599958002567 50.0000007451 FORMAT "%13.10" EXTENDED_LIMITS 0.00 7999.99999814 /end CHARACTERISTIC
/begin CHARACTERISTIC FMA_dqThrs_C "Schwelle für Erkennung starker Einspritzmengenänderungen der FMA" VALUE 0x1D71F0 Kw_Ws16 200.0000 InjMassSec 0.00 200.0000 FORMAT "%8.4" EXTENDED_LIMITS -327.6800 327.6700 /end CHARACTERISTIC
/begin CHARACTERISTIC FMA_drLmbdThrs_C "Schwelle für Erkennung starker Lambdaänderung der FMA" VALUE 0x1D71F2 Kw_Ws16 10.20000 lambdaSec -0.2000000 10.00000 FORMAT "%8.5" EXTENDED_LIMITS -32.76800 32.76700 /end CHARACTERISTIC
/begin CHARACTERISTIC FMA_facAirSwtOff_CUR "Kennlinie des ansauglufttemperaturabhängigen Abschaltfaktors der FMA" CURVE 0x1D71F4 Kl_Xs16_Ws16 1.000000 Fact 0.00 1.000000 FORMAT "%8.6" EXTENDED_LIMITS -4.000000 3.999878
 /begin AXIS_DESCR STD_AXIS IATSCD_tAir Temp_Cels 8 -50.14000 199.8600 FORMAT "%8.4" EXTENDED_LIMITS -3549.940 3003.560 DEPOSIT ABSOLUTE /end AXIS_DESCR
/end CHARACTERISTIC
/begin CHARACTERISTIC FMA_facEngSwtOff_CUR "Kennlinie des motortemperaturabhängigen Abschaltfaktors der FMA" CURVE 0x1D7216 Kl_Xs16_Ws16 1.000000 Fact 0.00 1.000000 FORMAT "%8.6" EXTENDED_LIMITS -4.000000 3.999878
 /begin AXIS_DESCR STD_AXIS Eng_tEng Temp_Cels 8 -50.14000 149.8600 FORMAT "%8.4" EXTENDED_LIMITS -3549.940 3003.560 DEPOSIT ABSOLUTE /end AXIS_DESCR
/end CHARACTERISTIC
/begin CHARACTERISTIC FMA_facFlSwtOff_CUR "Kennlinie des kraftstofftemperaturabhängigen Abschaltfaktors der FMA" CURVE 0x1D7238 Kl_Xs16_Ws16 1.000000 Fact 0.00 1.000000 FORMAT "%8.6" EXTENDED_LIMITS -4.000000 3.999878
 /begin AXIS_DESCR STD_AXIS FTSCD_tFuel Temp_Cels 8 -50.14000 149.8600 FORMAT "%8.4" EXTENDED_LIMITS -3549.940 3003.560 DEPOSIT ABSOLUTE /end AXIS_DESCR
/end CHARACTERISTIC
/begin CHARACTERISTIC FMA_IKi_C "Integriererverstärkung der FMA bei Kleinsignalen" VALUE 0x1D711C Kw_Wu32 4.00003045797 Ki 0.00 4.00003045797 FORMAT "%13.11" EXTENDED_LIMITS 0.00 999999.999767 /end CHARACTERISTIC
/begin CHARACTERISTIC FMA_IKiPos_C "Integriererverstärkung der FMA bei positiven Großsignalen" VALUE 0x1D7120 Kw_Wu32 4.00003045797 Ki 0.00 4.00003045797 FORMAT "%13.11" EXTENDED_LIMITS 0.00 999999.999767 /end CHARACTERISTIC
/begin CHARACTERISTIC FMA_IKiNeg_C "Integriererverstärkung der FMA bei negativen Großsignalen" VALUE 0x1D7124 Kw_Wu32 4.00003045797 Ki 0.00 4.00003045797 FORMAT "%13.11" EXTENDED_LIMITS 0.00 999999.999767 /end CHARACTERISTIC
/begin CHARACTERISTIC FMA_qIWinPos_C "Obere Kleinsignalgrenze für Integratoren der FMA" VALUE 0x1D7128 Kw_Ws16 20.00000 InjMass 0.00 20.00000 FORMAT "%8.5" EXTENDED_LIMITS -327.6800 327.6700 /end CHARACTERISTIC
/begin CHARACTERISTIC FMA_qIWinNeg_C "Untere Kleinsignalgrenze für Integratoren der FMA" VALUE 0x1D712A Kw_Ws16 20.00000 InjMass -20.00000 0.00 FORMAT "%8.5" EXTENDED_LIMITS -327.6800 327.6700 /end CHARACTERISTIC
/begin CHARACTERISTIC FMA_nHysMap_C "Hysteresebreite für Lernpunktbestimmung des adaptiven Kennfelds in Drehzahlrichtung" VALUE 0x1D712C Kw_Ws16 8000.000 EngN 0.00 8000.000 FORMAT "%8.3" EXTENDED_LIMITS -32768.00 32767.00 /end CHARACTERISTIC
/begin CHARACTERISTIC FMA_nThrs_C "Drehzahlschwelle für Schuberkennung der FMA" VALUE 0x1D725A Kw_Ws16 5960.000 EngN 40.00000 6000.000 FORMAT "%8.3" EXTENDED_LIMITS -32768.00 32767.00 /end CHARACTERISTIC
/begin CHARACTERISTIC FMA_numMaxLim_C "maximale Anzahl der Kennfeldpunkte, die an den erlaubten Grenzwerten liegen dürfen (für Dfp)" VALUE 0x1D712E Kw_Wu16 65535.00 OneToOne 0.00 65535.00 FORMAT "%8.2" /end CHARACTERISTIC
/begin CHARACTERISTIC FMA_tiPT1_C "Zeitkonstante der PT1-Filter zur Filterung des aktuellen Mengenfehlers" VALUE 0x1D7130 Kw_Wu32 4294.9663 TimeDelay_s 0.0010000001 4294.9673 FORMAT "%9.4" EXTENDED_LIMITS 0.0000010000000 4294.9673 /end CHARACTERISTIC
/begin CHARACTERISTIC FMA_qDiffMaxLim_C "obere Grenze für die Adaptionskennfeldüberwachung" VALUE 0x1D7134 Kw_Ws16 65.53400 InjMassCorr -32.76700 32.76700 FORMAT "%8.5" EXTENDED_LIMITS -32.76800 32.76700 /end CHARACTERISTIC
/begin CHARACTERISTIC FMA_qDiffMax_C "Maximal positiv zulässiger Offset für adaptierten Mengenfehler in den Lernpunkten" VALUE 0x1D7136 Kw_Ws16 80.00000 InjMass -40.00000 40.00000 FORMAT "%8.5" EXTENDED_LIMITS -327.6800 327.6700 /end CHARACTERISTIC
/begin CHARACTERISTIC FMA_qDiffMinLim_C "untere Grenze für die  Adaptionskennfeldüberwachung" VALUE 0x1D7138 Kw_Ws16 65.53400 InjMassCorr -32.76700 32.76700 FORMAT "%8.5" EXTENDED_LIMITS -32.76800 32.76700 /end CHARACTERISTIC
/begin CHARACTERISTIC FMA_qDiffMin_C "Maximal negativ zulässiger Offset für adaptierten Mengenfehler in den Lernpunkten" VALUE 0x1D713A Kw_Ws16 80.00000 InjMass -40.00000 40.00000 FORMAT "%8.5" EXTENDED_LIMITS -327.6800 327.6700 /end CHARACTERISTIC
/begin CHARACTERISTIC FMA_qHysMap_C "Hysteresebreite für Lernpunktbestimmung des adaptiven Kennfelds in Mengenrichtung" VALUE 0x1D713C Kw_Ws16 80.00000 InjMass -40.00000 40.00000 FORMAT "%8.5" EXTENDED_LIMITS -327.6800 327.6700 /end CHARACTERISTIC
/begin CHARACTERISTIC FMA_qIncMap_C "Betrag der Veränderung der Kennfeldwerte bei der Glättung des adaptiven Kennfelds" VALUE 0x1D713E Kw_Ws16 0.1000000 InjMassCorr 0.00 0.1000000 FORMAT "%9.7" EXTENDED_LIMITS -32.76800 32.76700 /end CHARACTERISTIC
/begin CHARACTERISTIC FMA_qRst_MAP "Initialisierungskennfeld der FMA" MAP 0x1D7140 Kf_Xs16_Ys16_Ws16 65.53400 InjMassCorr -32.76700 32.76700 FORMAT "%8.5" EXTENDED_LIMITS -32.76800 32.76700
 /begin AXIS_DESCR STD_AXIS InjCrv_qLmbdCtl InjMass 8 0.00 327.6700 FORMAT "%8.4" EXTENDED_LIMITS -327.6800 327.6700 DEPOSIT ABSOLUTE /end AXIS_DESCR
 /begin AXIS_DESCR STD_AXIS Eng_nAvrg EngN 8 0.00 6000.000 FORMAT "%8.3" EXTENDED_LIMITS -32768.00 32767.00 DEPOSIT ABSOLUTE /end AXIS_DESCR
/end CHARACTERISTIC
/begin CHARACTERISTIC FMA_qSlpNMax_C "Betragsmäßig zulässige Steigung in Drehzahlrichtung für Glättung des adaptiven Kennfelds" VALUE 0x1D71E4 Kw_Ws16 6.000000 InjMassNSlp -3.000000 3.000000 FORMAT "%8.6" EXTENDED_LIMITS -3.276800 3.276700 /end CHARACTERISTIC
/begin CHARACTERISTIC FMA_qSlpQMax_C "Betragsmäßig zulässige Steigung in Mengenrichtung für Glättung des adaptiven Kennfelds" VALUE 0x1D71E6 Kw_Ws16 80.00000 InjMassQSlp -40.00000 40.00000 FORMAT "%8.5" EXTENDED_LIMITS -327.6800 327.6700 /end CHARACTERISTIC
/begin CHARACTERISTIC FMA_qThrs_C "Einspritzmengenschwelle für Schuberkennung der FMA" VALUE 0x1D725C Kw_Ws16 40.00000 InjMass 0.00 40.00000 FORMAT "%8.5" EXTENDED_LIMITS -327.6800 327.6700 /end CHARACTERISTIC
/begin CHARACTERISTIC FMA_rLmbdThrsMax_C "Obere Grenze des für FMA zulässigen Lambdabereichs" VALUE 0x1D725E Kw_Ws16 10.20000 lambda -0.2000000 10.00000 FORMAT "%8.5" EXTENDED_LIMITS -32.76800 32.76700 /end CHARACTERISTIC
/begin CHARACTERISTIC FMA_rLmbdThrsMin_C "Untere Grenze des für FMA zulässigen Lambdabereichs" VALUE 0x1D7260 Kw_Ws16 10.20000 lambda -0.2000000 10.00000 FORMAT "%8.5" EXTENDED_LIMITS -32.76800 32.76700 /end CHARACTERISTIC
/begin CHARACTERISTIC FMA_stRgnMsk_C "Bitmaske zur Abschaltung der FMA bei bestimmten Regenerationszuständen EGT_st" VALUE 0x1D7264 Kw_Wu32 4294967295.00 OneToOne 0.00 4294967295.00 FORMAT "%13.2" /end CHARACTERISTIC
/begin CHARACTERISTIC FMA_swtIC_C "Schalter für Betriebsartauswahl der FMA (1: Indirect Control, 0: Direct Control)" VALUE 0x1D711A Kw_Wu8 1.000 OneToOne 0.00 1.000 FORMAT "%5.3" EXTENDED_LIMITS 0.00 255.0 READ_ONLY /end CHARACTERISTIC
/begin CHARACTERISTIC FMA_swtOnFMA_C "Schalter zum Ein-/Ausschalten der gesamten FMA (1...ein, 0...aus)" VALUE 0x1D7268 Kw_Wu8 1.000 OneToOne 0.00 1.000 FORMAT "%5.3" EXTENDED_LIMITS 0.00 255.0 /end CHARACTERISTIC
/begin CHARACTERISTIC FMA_swtResetMap_C "Schalter für reinitialisierung des adaptiven Kennfelds der FMA (1- Reset)" VALUE 0x1D71E8 Kw_Wu8 1.000 OneToOne 0.00 1.000 FORMAT "%5.3" EXTENDED_LIMITS 0.00 255.0 /end CHARACTERISTIC
/begin CHARACTERISTIC FMA_tiDLmbdThrs_C "Wartezeit bis der FMA- Lambdaänderungsstatus nach Ende der Lambdaänderung zurückgesetzt wird" VALUE 0x1D726A Kw_Wu16 20.00000 Time_s 0.00 20.00000 FORMAT "%8.5" EXTENDED_LIMITS 0.00 655.3500 /end CHARACTERISTIC
/begin CHARACTERISTIC FMA_tiDynThrs_C "Wartezeit bis der FMA-Einspritzmengendynamikstatus nach Ende der Einspritzmengenänderung zurückgesetzt wird" VALUE 0x1D726C Kw_Wu16 20.00000 Time_s 0.00 20.00000 FORMAT "%8.5" EXTENDED_LIMITS 0.00 655.3500 /end CHARACTERISTIC
/begin CHARACTERISTIC FMA_tiFaultRmp_C "Dauer des rampenförmigen Abschaltens der FMA bei schweren Systemfehlern" VALUE 0x1D7270 Kw_Wu32 40.0000000000 Time_s 0.00 40.0000000000 FORMAT "%13.10" EXTENDED_LIMITS 0.00 42949672.9500 /end CHARACTERISTIC
/begin CHARACTERISTIC FMA_tiLmbdDT1_C "Verzögerungszeitkonstante der Differentiation von Lambda in der FMA" VALUE 0x1D7274 Kw_Wu32 3.9980385 TimeDelay_s 0.0010000001 3.9990385 FORMAT "%9.7" EXTENDED_LIMITS 0.0000010000000 4294.9673 /end CHARACTERISTIC
/begin CHARACTERISTIC FMA_tiLmbdThrs_C "Wartezeit bis der FMA- Lambdabereichstatus nach Bereichs-verletzung zurückgesetzt wird" VALUE 0x1D7278 Kw_Wu16 20.00000 Time_s 0.00 20.00000 FORMAT "%8.5" EXTENDED_LIMITS 0.00 655.3500 /end CHARACTERISTIC
/begin CHARACTERISTIC FMA_tiOvrRun_C "Wartezeit bis der FMA-Schbstatus nach Schubende zurückgesetzt wird" VALUE 0x1D727A Kw_Wu16 20.00000 Time_s 0.00 20.00000 FORMAT "%8.5" EXTENDED_LIMITS 0.00 655.3500 /end CHARACTERISTIC
/begin CHARACTERISTIC FMA_tiQDT1_C "Vezögerungszeitkonstante der Differentiation der Einspritzmenge für Erkennung starker Mengenänderungen der FMA" VALUE 0x1D727C Kw_Wu32 3.9980385 TimeDelay_s 0.0010000001 3.9990385 FORMAT "%9.7" EXTENDED_LIMITS 0.0000010000000 4294.9673 /end CHARACTERISTIC
/begin CHARACTERISTIC FMA_tiQLmbd_C "Verzögerungszeit nach einer Resetierung um die Adaption zuzulassen" VALUE 0x1D7280 Kw_Wu16 20.00000 Time_s 0.00 20.00000 FORMAT "%8.5" EXTENDED_LIMITS 0.00 655.3500 /end CHARACTERISTIC
/begin CHARACTERISTIC FMTC_eta0_C "fester Wirkungsgradfaktor zur Umrechnung Startmoment in Startmenge" VALUE 0x1D7284 Kw_Ws16 100.0000 Eta 0.00 100.0000 FORMAT "%8.4" EXTENDED_LIMITS -256.0000 255.9922 /end CHARACTERISTIC
/begin CHARACTERISTIC FMTC_qStrt_Vector "Konfigurationslabel für Bypass Freischnitt" VALUE 0x1C0A96 Kw_Wu8 255.0 OneToOne 0.00 255.0 FORMAT "%5.1" /end CHARACTERISTIC
/begin CHARACTERISTIC FMTC_qStrt_Channel "Konfigurationslabel für Bypass Freischnitt" VALUE 0x1C0A97 Kw_Wu8 255.0 OneToOne 0.00 255.0 FORMAT "%5.1" /end CHARACTERISTIC
/begin CHARACTERISTIC FMTC_stRgnMsk1_C "applizierbare Bitmaske für Regenerationsstatus 1" VALUE 0x1D7288 Kw_Wu32 4294967295.00 OneToOne 0.00 4294967295.00 FORMAT "%13.2" /end CHARACTERISTIC
/begin CHARACTERISTIC FMTC_stRgnMsk2_C "applizierbare Bitmaske für Regenerationsstatus 2" VALUE 0x1D728C Kw_Wu32 4294967295.00 OneToOne 0.00 4294967295.00 FORMAT "%13.2" /end CHARACTERISTIC
/begin CHARACTERISTIC FMTC_stRgnMsk3_C "applizierbare Bitmaske für Regenerationsstatus 3" VALUE 0x1D7290 Kw_Wu32 4294967295.00 OneToOne 0.00 4294967295.00 FORMAT "%13.2" /end CHARACTERISTIC
/begin CHARACTERISTIC FMTC_stRgnMsk4_C "applizierbare Bitmaske für Regenerationsstatus 4" VALUE 0x1D7294 Kw_Wu32 4294967295.00 OneToOne 0.00 4294967295.00 FORMAT "%13.2" /end CHARACTERISTIC
/begin CHARACTERISTIC FMTC_tiRmpSlp_C "Rampenlaufzeit für Mehrfachschalter" VALUE 0x1D7298 Kw_Wu32 31.775030303030302 TimeEGTRmp 0.99296969696969695 32.768000000000001 FORMAT "%19.16" EXTENDED_LIMITS 0.000000015258789066052715 65.536000000000001 /end CHARACTERISTIC
/begin CHARACTERISTIC FMTC_trq2qBas_MAP "Grundkennfeld für Moment/Menge Umrechnung als Funktion des Arbeitspunktes" MAP 0x1D729C Kf_Xs16_Ys16_Ws16 327.6700 InjMassCyc 0.00 327.6700 FORMAT "%8.4" EXTENDED_LIMITS -327.6800 327.6700
 /begin AXIS_DESCR STD_AXIS Eng_nAvrg EngN 16 0.00 6000.000 FORMAT "%8.3" EXTENDED_LIMITS -32768.00 32767.00 DEPOSIT ABSOLUTE /end AXIS_DESCR
 /begin AXIS_DESCR STD_AXIS CoEng_trqInrSet Trq 18 -500.0000 1000.000 FORMAT "%8.3" EXTENDED_LIMITS -3276.800 3276.700 DEPOSIT ABSOLUTE /end AXIS_DESCR
/end CHARACTERISTIC
/begin CHARACTERISTIC FMTC_trq2qRgn1_MAP "Grundkennfeld für Moment-/Mengenumrechnung unter Regenerationsanforderung 1 der Abgasnachbehandlung" MAP 0x1D7524 Kf_Xs16_Ys16_Ws16 327.6700 InjMassCyc 0.00 327.6700 FORMAT "%8.4" EXTENDED_LIMITS -327.6800 327.6700
 /begin AXIS_DESCR STD_AXIS Eng_nAvrg EngN 2 0.00 6000.000 FORMAT "%8.3" EXTENDED_LIMITS -32768.00 32767.00 DEPOSIT ABSOLUTE /end AXIS_DESCR
 /begin AXIS_DESCR STD_AXIS CoEng_trqInrSet Trq 2 -500.0000 1000.000 FORMAT "%8.3" EXTENDED_LIMITS -3276.800 3276.700 DEPOSIT ABSOLUTE /end AXIS_DESCR
/end CHARACTERISTIC
/begin CHARACTERISTIC FMTC_trq2qRgn2_MAP "Grundkennfeld für Moment-/Mengenumrechnung unter Regenerationsanforderung 2 der Abgasnachbehandlung" MAP 0x1D7538 Kf_Xs16_Ys16_Ws16 327.6700 InjMassCyc 0.00 327.6700 FORMAT "%8.4" EXTENDED_LIMITS -327.6800 327.6700
 /begin AXIS_DESCR STD_AXIS Eng_nAvrg EngN 2 0.00 6000.000 FORMAT "%8.3" EXTENDED_LIMITS -32768.00 32767.00 DEPOSIT ABSOLUTE /end AXIS_DESCR
 /begin AXIS_DESCR STD_AXIS CoEng_trqInrSet Trq 2 -500.0000 1000.000 FORMAT "%8.3" EXTENDED_LIMITS -3276.800 3276.700 DEPOSIT ABSOLUTE /end AXIS_DESCR
/end CHARACTERISTIC
/begin CHARACTERISTIC FMTC_trq2qRgn3_MAP "Grundkennfeld für Moment-/Mengenumrechnung unter Regenerationsanforderung 3 der Abgasnachbehandlung" MAP 0x1D754C Kf_Xs16_Ys16_Ws16 327.6700 InjMassCyc 0.00 327.6700 FORMAT "%8.4" EXTENDED_LIMITS -327.6800 327.6700
 /begin AXIS_DESCR STD_AXIS Eng_nAvrg EngN 2 0.00 6000.000 FORMAT "%8.3" EXTENDED_LIMITS -32768.00 32767.00 DEPOSIT ABSOLUTE /end AXIS_DESCR
 /begin AXIS_DESCR STD_AXIS CoEng_trqInrSet Trq 2 -500.0000 1000.000 FORMAT "%8.3" EXTENDED_LIMITS -3276.800 3276.700 DEPOSIT ABSOLUTE /end AXIS_DESCR
/end CHARACTERISTIC
/begin CHARACTERISTIC FMTC_trq2qRgn4_MAP "Grundkennfeld für Moment-/Mengenumrechnung unter Regenerationsanforderung 4 der Abgasnachbehandlung" MAP 0x1D7560 Kf_Xs16_Ys16_Ws16 327.6700 InjMassCyc 0.00 327.6700 FORMAT "%8.4" EXTENDED_LIMITS -327.6800 327.6700
 /begin AXIS_DESCR STD_AXIS Eng_nAvrg EngN 2 0.00 6000.000 FORMAT "%8.3" EXTENDED_LIMITS -32768.00 32767.00 DEPOSIT ABSOLUTE /end AXIS_DESCR
 /begin AXIS_DESCR STD_AXIS CoEng_trqInrSet Trq 2 -500.0000 1000.000 FORMAT "%8.3" EXTENDED_LIMITS -3276.800 3276.700 DEPOSIT ABSOLUTE /end AXIS_DESCR
/end CHARACTERISTIC
/begin CHARACTERISTIC FMTC_trqInrLimSmk_Vector "Konfigurationslabel für Bypass" VALUE 0x1C0A98 Kw_Wu8 255.0 OneToOne 0.00 255.0 FORMAT "%5.1" /end CHARACTERISTIC
/begin CHARACTERISTIC FMTC_trqInrLimSmk_Channel "Konfigurationslabels für Bypass" VALUE 0x1C0A99 Kw_Wu8 255.0 OneToOne 0.00 255.0 FORMAT "%5.1" /end CHARACTERISTIC
/begin CHARACTERISTIC FQlSCD_uSRCMin_C "SRC Low Schwelle" VALUE 0x1D7574 Kw_Ws16 5200.391 Volt 0.00 5200.391 FORMAT "%8.3" EXTENDED_LIMITS -160156.4 160151.5 /end CHARACTERISTIC
/begin CHARACTERISTIC FQlSCD_uSRCMax_C "SRC High Schwelle" VALUE 0x1D7576 Kw_Ws16 5200.391 Volt 0.00 5200.391 FORMAT "%8.3" EXTENDED_LIMITS -160156.4 160151.5 /end CHARACTERISTIC
/begin CHARACTERISTIC FQlSCD_rLin_CUR "Linearisierungskennlinie für RME" CURVE 0x1D7578 Kl_Xs16_Ws16 100.0000 Prc 0.00 100.0000 FORMAT "%8.4" EXTENDED_LIMITS -327.6800 327.6700
 /begin AXIS_DESCR STD_AXIS FQlSCD_uRaw Volt 20 0.00 5200.391 FORMAT "%8.3" EXTENDED_LIMITS -160156.4 160151.5 DEPOSIT ABSOLUTE /end AXIS_DESCR
/end CHARACTERISTIC
/begin CHARACTERISTIC FQlSCD_DebSigDef_C "Fehlerentprellzeit für CAN Fehler" VALUE 0x1D75CA Kw_Wu16 655350.0 Time_ms 0.00 655350.0 FORMAT "%8.1" /end CHARACTERISTIC
/begin CHARACTERISTIC FQlSCD_DebSigOk_C "Heilungsentprellzeit für CAN Fehler" VALUE 0x1D75CC Kw_Wu16 655350.0 Time_ms 0.00 655350.0 FORMAT "%8.1" /end CHARACTERISTIC
/begin CHARACTERISTIC FQlSCD_DebSRCHighDef_C "Fehlerentprellzeit für SRC Fehler High" VALUE 0x1D75CE Kw_Wu16 655350.0 Time_ms 0.00 655350.0 FORMAT "%8.1" /end CHARACTERISTIC
/begin CHARACTERISTIC FQlSCD_DebSRCHighOk_C "Heilungsentprellzeit für SRC Fehler High" VALUE 0x1D75D0 Kw_Wu16 655350.0 Time_ms 0.00 655350.0 FORMAT "%8.1" /end CHARACTERISTIC
/begin CHARACTERISTIC FQlSCD_DebSRCLowDef_C "Fehlerentprellzeit für SRC Fehler Low" VALUE 0x1D75D2 Kw_Wu16 655350.0 Time_ms 0.00 655350.0 FORMAT "%8.1" /end CHARACTERISTIC
/begin CHARACTERISTIC FQlSCD_DebSRCLowOk_C "Heilungsentprellzeit für SRC Fehler Low" VALUE 0x1D75D4 Kw_Wu16 655350.0 Time_ms 0.00 655350.0 FORMAT "%8.1" /end CHARACTERISTIC
/begin CHARACTERISTIC FQlSCD_numSSp_C "Wahlschalter für Sensorversorgungsschaltermonitor für RME-Sensor" VALUE 0x1D75D6 Kw_Wu8 2.000 OneToOne 1.000 3.000 FORMAT "%5.3" EXTENDED_LIMITS 0.00 255.0 /end CHARACTERISTIC
/begin CHARACTERISTIC FQlSCD_dtRmpSlpUp_C "Rampe für Analogeingang Struktur" VALUE 0x1D75D8 Kw_Wu32 655358.999786 RmpPrc 1.00006103516 655359.999847 FORMAT "%13.6" EXTENDED_LIMITS 0.00 655359.999847 /end CHARACTERISTIC
/begin CHARACTERISTIC FQlSCD_dtRmpSlpDwn_C "Rampe für Analogeingang Struktur" VALUE 0x1D75DC Kw_Wu32 655358.999786 RmpPrc 1.00006103516 655359.999847 FORMAT "%13.6" EXTENDED_LIMITS 0.00 655359.999847 /end CHARACTERISTIC
/begin CHARACTERISTIC FQlSCD_rRpOilHi_C "Obere Hystereseschwelle für Erkennung Kraftstoffart" VALUE 0x1D75E0 Kw_Ws16 100.0000 Prc 0.00 100.0000 FORMAT "%8.4" EXTENDED_LIMITS -327.6800 327.6700 /end CHARACTERISTIC
/begin CHARACTERISTIC FQlSCD_rRpOilLo_C "Untere Hystereschwelle für Erkennung Kraftstoffart" VALUE 0x1D75E2 Kw_Ws16 100.0000 Prc 0.00 100.0000 FORMAT "%8.4" EXTENDED_LIMITS -327.6800 327.6700 /end CHARACTERISTIC
/begin CHARACTERISTIC FQlSCD_swtSig_C "Auswahlschalter RME über ADC oder CAN" VALUE 0x1D75E4 Kw_Wu8 1.000 OneToOne 0.00 1.000 FORMAT "%5.3" EXTENDED_LIMITS 0.00 255.0 /end CHARACTERISTIC
/begin CHARACTERISTIC FQlSCD_stSensIDWord_C "Status ID für Statemaschine" VALUE 0x1D75E6 Kw_Wu16 65535.00 OneToOne 0.00 65535.00 FORMAT "%8.2" /end CHARACTERISTIC
/begin CHARACTERISTIC FQlSCD_rDfl_C "Ersatzwert bei Fehler" VALUE 0x1D75E8 Kw_Ws16 100.0000 Prc 0.00 100.0000 FORMAT "%8.4" EXTENDED_LIMITS -327.6800 327.6700 /end CHARACTERISTIC
/begin CHARACTERISTIC FQTSCD_DebNplDef_C "Zählerwert zur Fehlerentprellung der Frequenz-Plausibilisierung" VALUE 0x1D75EC Kw_Wu16 65535.00 OneToOne 0.00 65535.00 FORMAT "%8.2" /end CHARACTERISTIC
/begin CHARACTERISTIC FQTSCD_DebNplOk_C "Zählerwert zur Heilungsentprellung der Frequenz-Plausibilisierung" VALUE 0x1D75EE Kw_Wu16 65535.00 OneToOne 0.00 65535.00 FORMAT "%8.2" /end CHARACTERISTIC
/begin CHARACTERISTIC FQTSCD_DebSRCHighDef_C "Zählerwert zur Fehlerentprellung von SRC-High" VALUE 0x1D75F0 Kw_Wu16 65535.00 OneToOne 0.00 65535.00 FORMAT "%8.2" /end CHARACTERISTIC
/begin CHARACTERISTIC FQTSCD_DebSRCHighOk_C "Zählerwert zur Heilungsentprellung von SRC-High" VALUE 0x1D75F2 Kw_Wu16 65535.00 OneToOne 0.00 65535.00 FORMAT "%8.2" /end CHARACTERISTIC
/begin CHARACTERISTIC FQTSCD_DebSRCLowDef_C "Zählerwert zur Fehlerentprellung von SRC-Low" VALUE 0x1D75F4 Kw_Wu16 65535.00 OneToOne 0.00 65535.00 FORMAT "%8.2" /end CHARACTERISTIC
/begin CHARACTERISTIC FQTSCD_DebSRCLowOk_C "Zählerwert zur Heilungsentprellung von SRC-Low" VALUE 0x1D75F6 Kw_Wu16 65535.00 OneToOne 0.00 65535.00 FORMAT "%8.2" /end CHARACTERISTIC
/begin CHARACTERISTIC FQTSCD_drRmpSlpUp_C "Steigende Rampensteigung des Kraftstoffqualitätssignals" VALUE 0x1D75F8 Kw_Wu32 655358.999786 RmpPrc 1.00006103516 655359.999847 FORMAT "%13.6" EXTENDED_LIMITS 0.00 655359.999847 /end CHARACTERISTIC
/begin CHARACTERISTIC FQTSCD_drRmpSlpDwn_C "Fallende Rampensteigung des Kraftstoffqualitätssignals" VALUE 0x1D75FC Kw_Wu32 655358.999786 RmpPrc 1.00006103516 655359.999847 FORMAT "%13.6" EXTENDED_LIMITS 0.00 655359.999847 /end CHARACTERISTIC
/begin CHARACTERISTIC FQTSCD_stFlQlSensIDWord_C "Sensor-ID-Datenwort für Kraftstoffqualität" VALUE 0x1D7600 Kw_Wu16 65535.00 OneToOne 0.00 65535.00 FORMAT "%8.2" /end CHARACTERISTIC
/begin CHARACTERISTIC FQTSCD_rDfl_C "Vorgabewert der Kraftstoffqualität im Fehlerfall" VALUE 0x1D7602 Kw_Ws16 100.0000 Prc 0.00 100.0000 FORMAT "%8.4" EXTENDED_LIMITS -327.6800 327.6700 /end CHARACTERISTIC
/begin CHARACTERISTIC FQTSCD_uFlTempSRCMin_C "SRC low der Krafstofftemperatur (nur intern in der SW notwendig, keine Auswirkung auf Fehlererkennung)" VALUE 0x1D7604 Kw_Ws16 5200.391 Volt 0.00 5200.391 FORMAT "%8.3" EXTENDED_LIMITS -160156.4 160151.5 /end CHARACTERISTIC
/begin CHARACTERISTIC FQTSCD_uFlTempSRCMax_C "Maximaler SRC-Wert für Kraftstofftemperatur" VALUE 0x1D7606 Kw_Ws16 5200.391 Volt 0.00 5200.391 FORMAT "%8.3" EXTENDED_LIMITS -160156.4 160151.5 /end CHARACTERISTIC
/begin CHARACTERISTIC FQTSCD_tLin_CUR "Parameter der Linearisierungs-Kennlinie zum Kraftstofftemperatursignal" CURVE 0x1D7608 Kl_Xs16_Ws16 250.0000 Temp_Cels -50.04000 199.9600 FORMAT "%8.4" EXTENDED_LIMITS -3549.940 3003.560
 /begin AXIS_DESCR STD_AXIS FQTSCD_uFlTempRaw Volt 25 0.00 5200.391 FORMAT "%8.3" EXTENDED_LIMITS -160156.4 160151.5 DEPOSIT ABSOLUTE /end AXIS_DESCR
/end CHARACTERISTIC
/begin CHARACTERISTIC FQTSCD_dtRmpSlpUp_C "Steigende Rampensteigung des Kraftstofftemperatursignals" VALUE 0x1D7670 Kw_Wu32 6553599.99847 RmpTemp 0.00 6553599.99847 FORMAT "%13.5" /end CHARACTERISTIC
/begin CHARACTERISTIC FQTSCD_dtRmpSlpDwn_C "Fallende Rampensteigung des Kraftstofftemperatursignals" VALUE 0x1D7674 Kw_Wu32 6553599.99847 RmpTemp 0.00 6553599.99847 FORMAT "%13.5" /end CHARACTERISTIC
/begin CHARACTERISTIC FQTSCD_stFlTempSensIDWord_C "Sensor-ID-Datenwort für Kraftstofftemperatur" VALUE 0x1D7678 Kw_Wu16 65535.00 OneToOne 0.00 65535.00 FORMAT "%8.2" /end CHARACTERISTIC
/begin CHARACTERISTIC FQTSCD_tDfl_C "Vorgabewert der Kraftstofftemperatur im Fehlerfall" VALUE 0x1D767A Kw_Ws16 250.0000 Temp_Cels -50.04000 199.9600 FORMAT "%8.4" EXTENDED_LIMITS -3549.940 3003.560 /end CHARACTERISTIC
/begin CHARACTERISTIC FQTSCD_numAdc_C "Parameter zur Auswahl des Analog-HW-Pins für Kombi-Sensor" VALUE 0x1D7814 Kw_Wu8 23.0000000000 NumPinAdc 2.00000000000 25.0000000000 FORMAT "%13.10" /end CHARACTERISTIC
/begin CHARACTERISTIC FQTSCD_numSSp_C "Nummer der Sensorversorgungsgruppe, an welche der Sensor angeschlossen ist." VALUE 0x1D767C Kw_Wu8 2.000 OneToOne 1.000 3.000 FORMAT "%5.3" EXTENDED_LIMITS 0.00 255.0 /end CHARACTERISTIC
/begin CHARACTERISTIC FQTSCD_tiPT1_C "Zeitkonstante des PT1-Filters für Kraftstofftemperaturssignal." VALUE 0x1D7680 Kw_Wu32 4294.9673 TimeDelay_s 0.0000010000000 4294.9673 FORMAT "%9.4" /end CHARACTERISTIC
/begin CHARACTERISTIC FQTSCD_rLin_MAP "Parameter der Linearisierung und Temperaturkompensations-Kennfeld für Kraftstoffqualitätssignal." MAP 0x1D7684 Kf_Xs16_Ys16_Ws16 100.0000 Prc 0.00 100.0000 FORMAT "%8.4" EXTENDED_LIMITS -327.6800 327.6700
 /begin AXIS_DESCR STD_AXIS FQTSCD_uFlQlRaw Volt 20 0.00 5200.391 FORMAT "%8.3" EXTENDED_LIMITS -160156.4 160151.5 DEPOSIT ABSOLUTE /end AXIS_DESCR
 /begin AXIS_DESCR STD_AXIS FQTSCD_tFuel Temp_Cels 8 -50.04000 199.9600 FORMAT "%8.4" EXTENDED_LIMITS -3549.940 3003.560 DEPOSIT ABSOLUTE /end AXIS_DESCR
/end CHARACTERISTIC
/begin CHARACTERISTIC FQTSCD_rRpOilHi_C "Schwellenwert, über welchem der Kraftstoff als RME eingestuft wird" VALUE 0x1D7800 Kw_Ws16 100.0000 Prc 0.00 100.0000 FORMAT "%8.4" EXTENDED_LIMITS -327.6800 327.6700 /end CHARACTERISTIC
/begin CHARACTERISTIC FQTSCD_rRpOilLo_C "Schwellenwert, unter welchem der Kraftstoff als Diesel eingestuft wird" VALUE 0x1D7802 Kw_Ws16 100.0000 Prc 0.00 100.0000 FORMAT "%8.4" EXTENDED_LIMITS -327.6800 327.6700 /end CHARACTERISTIC
/begin CHARACTERISTIC FQTSCD_swtEnaVal_C "Aktivierung über Funktionscodierung oder Softwareschalter" VALUE 0x1D7815 Kw_Wu8 1.000 OneToOne 0.00 1.000 FORMAT "%5.3" EXTENDED_LIMITS 0.00 255.0 /end CHARACTERISTIC
/begin CHARACTERISTIC FQTSCD_swtEnaType_C "Aktivierung des Kombisensors über Funktionscodierung oder Softwareschalter" VALUE 0x1D7816 Kw_Wu8 0.00 OneToOne 2.000 2.000 FORMAT "%5.3" EXTENDED_LIMITS 0.00 255.0 /end CHARACTERISTIC
/begin CHARACTERISTIC FQTSCD_tiSmplPerMax_C "Maximale Dauer, vor welcher ein Signalübergang erfolgen soll" VALUE 0x1D7804 Kw_Wu16 655350.0 Time_ms 0.00 655350.0 FORMAT "%8.1" /end CHARACTERISTIC
/begin CHARACTERISTIC FQTSCD_tiSmplPerMin_C "Minimale Dauer, vor welcher ein Signalübergang nicht erfolgen darf" VALUE 0x1D7806 Kw_Wu16 655350.0 Time_ms 0.00 655350.0 FORMAT "%8.1" /end CHARACTERISTIC
/begin CHARACTERISTIC FQTSCD_tiSyncMax_C "Maximale Dauer, vor welcher die Synchronisierung erreicht werden soll" VALUE 0x1D7808 Kw_Wu16 655350.0 Time_ms 0.00 655350.0 FORMAT "%8.1" /end CHARACTERISTIC
/begin CHARACTERISTIC FQTSCD_tiSyncMin_C "Minimale Dauer, vor welcher die Synchronisierung nicht erfolgen darf" VALUE 0x1D780A Kw_Wu16 655350.0 Time_ms 0.00 655350.0 FORMAT "%8.1" /end CHARACTERISTIC
/begin CHARACTERISTIC FQTSCD_tiTrnstStlg_C "Maximale Dauer, innerhalb welcher alle Transiente infolge des Signalübergangs ausklingen (Transientenberuhigungszeit)" VALUE 0x1D780C Kw_Wu16 655350.0 Time_ms 0.00 655350.0 FORMAT "%8.1" /end CHARACTERISTIC
/begin CHARACTERISTIC FQTSCD_uFlQlSRCMin_C "Minimaler SRC-Wert für Kraftstoffqualität" VALUE 0x1D780E Kw_Ws16 5200.391 Volt 0.00 5200.391 FORMAT "%8.3" EXTENDED_LIMITS -160156.4 160151.5 /end CHARACTERISTIC
/begin CHARACTERISTIC FQTSCD_uFlQlUpLim_C "Maximaler Grenzwert für Kraftstoffqualität, über welchem ein Übergang auf die Kraftstofftemperatur erfolgt" VALUE 0x1D7810 Kw_Ws16 5200.391 Volt 0.00 5200.391 FORMAT "%8.3" EXTENDED_LIMITS -160156.4 160151.5 /end CHARACTERISTIC
/begin CHARACTERISTIC FQTSCD_uFlTempLoLim_C "Minimaler Grenzwert für Kraftstofftemperatur, unter welchem ein Übergang auf die Kraftstoffqualität erfolgt" VALUE 0x1D7812 Kw_Ws16 5200.391 Volt 0.00 5200.391 FORMAT "%8.3" EXTENDED_LIMITS -160156.4 160151.5 /end CHARACTERISTIC
/begin CHARACTERISTIC FTSCD_uSRCMin_C "SRC Minimum (Kraftstoffstemperatur)" VALUE 0x1D8084 Kw_Ws16 5200.391 Volt 0.00 5200.391 FORMAT "%8.3" EXTENDED_LIMITS -160156.4 160151.5 /end CHARACTERISTIC
/begin CHARACTERISTIC FTSCD_uSRCMax_C "SRC Maximum (Kraftstoffstemperatur)" VALUE 0x1D8086 Kw_Ws16 5200.391 Volt 0.00 5200.391 FORMAT "%8.3" EXTENDED_LIMITS -160156.4 160151.5 /end CHARACTERISTIC
/begin CHARACTERISTIC FTSCD_tLin_CUR "Linearisierungskennlinie der Kraftstoffstemperatur" CURVE 0x1D8088 Kl_Xs16_Ws16 250.0000 Temp_Cels -50.04000 199.9600 FORMAT "%8.4" EXTENDED_LIMITS -3549.940 3003.560
 /begin AXIS_DESCR STD_AXIS FTSCD_uRaw Volt 25 0.00 5200.391 FORMAT "%8.3" EXTENDED_LIMITS -160156.4 160151.5 DEPOSIT ABSOLUTE /end AXIS_DESCR
/end CHARACTERISTIC
/begin CHARACTERISTIC FTSCD_DebNplDef_C "Defektentprellzeit für  Npl" VALUE 0x1D80EE Kw_Wu16 655350.0 Time_ms 0.00 655350.0 FORMAT "%8.1" /end CHARACTERISTIC
/begin CHARACTERISTIC FTSCD_DebNplOk_C "Heilentprellzeit Npl" VALUE 0x1D80F0 Kw_Wu16 655350.0 Time_ms 0.00 655350.0 FORMAT "%8.1" /end CHARACTERISTIC
/begin CHARACTERISTIC FTSCD_DebSRCHighDef_C "FTS Fehlerentprellungszeit fuer SRC-High" VALUE 0x1D80F6 Kw_Wu16 655350.0 Time_ms 0.00 655350.0 FORMAT "%8.1" /end CHARACTERISTIC
/begin CHARACTERISTIC FTSCD_DebSRCHighOk_C "FTS Heilungsentprellzeit fuer SRC-High" VALUE 0x1D80F8 Kw_Wu16 655350.0 Time_ms 0.00 655350.0 FORMAT "%8.1" /end CHARACTERISTIC
/begin CHARACTERISTIC FTSCD_DebSRCLowDef_C "FTS Fehlerentprellungszeit fuer SRC-Low" VALUE 0x1D80FA Kw_Wu16 655350.0 Time_ms 0.00 655350.0 FORMAT "%8.1" /end CHARACTERISTIC
/begin CHARACTERISTIC FTSCD_DebSRCLowOk_C "FTS Heilungsentprellzeit fuer SRC-Low" VALUE 0x1D80FC Kw_Wu16 655350.0 Time_ms 0.00 655350.0 FORMAT "%8.1" /end CHARACTERISTIC
/begin CHARACTERISTIC FTSCD_dtRmpSlpUp_C "Aufwärts-Schritt für Rampe" VALUE 0x1D8100 Kw_Wu32 6553599.99847 RmpTemp 0.00 6553599.99847 FORMAT "%13.5" /end CHARACTERISTIC
/begin CHARACTERISTIC FTSCD_dtRmpSlpDwn_C "Abwärts-Schritt für Rampe" VALUE 0x1D8104 Kw_Wu32 6553599.99847 RmpTemp 0.00 6553599.99847 FORMAT "%13.5" /end CHARACTERISTIC
/begin CHARACTERISTIC FTSCD_tDiff_C "Absolute Kraftstofftemperaturdifferenzschwelle" VALUE 0x1D8108 Kw_Ws16 149.9000 TempDiff_Kelv 0.00 149.9000 FORMAT "%8.4" EXTENDED_LIMITS -3276.800 3276.700 /end CHARACTERISTIC
/begin CHARACTERISTIC FTSCD_tImn_C "minimale Kraftstofftemperaturdifferenz" VALUE 0x1D810A Kw_Ws16 149.9000 TempDiff_Kelv 0.00 149.9000 FORMAT "%8.4" EXTENDED_LIMITS -3276.800 3276.700 /end CHARACTERISTIC
/begin CHARACTERISTIC FTSCD_tInt_C "Kraftstofftemperaturdifferenz Integral Schwelle" VALUE 0x1D810C Kw_Ws16 149.9000 TempDiff_Kelv 0.00 149.9000 FORMAT "%8.4" EXTENDED_LIMITS -3276.800 3276.700 /end CHARACTERISTIC
/begin CHARACTERISTIC FTSCD_tiTmn_C "minimale Kraftstofftemperatur DTI Testdauer" VALUE 0x1D8110 Kw_Wu32 100.000000000 TimeEngOn 0.00 100.000000000 FORMAT "%13.9" EXTENDED_LIMITS 0.00 4294967295.00 /end CHARACTERISTIC
/begin CHARACTERISTIC FTSCD_tiT_C "Kraftstofftemperatur DTI Testdauer" VALUE 0x1D8114 Kw_Wu32 500.000000000 TimeEngOn 0.00 500.000000000 FORMAT "%13.9" EXTENDED_LIMITS 0.00 4294967295.00 /end CHARACTERISTIC
/begin CHARACTERISTIC FTSCD_stSensIDWord_C "Geberkennwort Kraftstoffstemperatur" VALUE 0x1D8118 Kw_Wu16 65535.00 OneToOne 0.00 65535.00 FORMAT "%8.2" /end CHARACTERISTIC
/begin CHARACTERISTIC FTSCD_tDfl_C "Vorgabewert Kraftstoffstemperatur" VALUE 0x1D811A Kw_Ws16 250.0000 Temp_Cels -50.04000 199.9600 FORMAT "%8.4" EXTENDED_LIMITS -3549.940 3003.560 /end CHARACTERISTIC
/begin CHARACTERISTIC SigTst_Fan1En_C "Tester Anforderung Überwachung Enable maske für Fan1" VALUE 0x1F04A4 Kw_Wu8 7.000 OneToOne 0.00 7.000 FORMAT "%5.3" EXTENDED_LIMITS 0.00 255.0 /end CHARACTERISTIC
/begin CHARACTERISTIC SigTst_Fan2En_C "Tester Anforderung Überwachung Enable maske für Fan1" VALUE 0x1F04A5 Kw_Wu8 7.000 OneToOne 0.00 7.000 FORMAT "%5.3" EXTENDED_LIMITS 0.00 255.0 /end CHARACTERISTIC
/begin CHARACTERISTIC SigTst_FlPpCDEn_C "Stellertestüberwachung Freigabemaske für Kraftstoffumwälzpumpe" VALUE 0x1F04A7 Kw_Wu8 7.000 OneToOne 0.00 7.000 FORMAT "%5.3" EXTENDED_LIMITS 0.00 255.0 /end CHARACTERISTIC
/begin CHARACTERISTIC SigTst_MILLAMPEn_C "Stellertestüberwachung Freigabemaske für MIL (OBD-Lampe)" VALUE 0x1F04AC Kw_Wu8 7.000 OneToOne 0.00 7.000 FORMAT "%5.3" EXTENDED_LIMITS 0.00 255.0 /end CHARACTERISTIC
/begin CHARACTERISTIC SigTst_SYSLAMPEn_C "Stellertestüberwachung Freigabemaske für Systemlampe" VALUE 0x1F04B0 Kw_Wu8 7.000 OneToOne 0.00 7.000 FORMAT "%5.3" EXTENDED_LIMITS 0.00 255.0 /end CHARACTERISTIC
/begin COMPU_METHOD Acc "Fahrzeugbeschleunigung" RAT_FUNC "%6.5" "[m/s^2]" COEFFS 0 1000 0 0 0 1 /end COMPU_METHOD
/begin COMPU_METHOD AirMassPerCyl "Luftmasse pro Zylinder" RAT_FUNC "%6.3" "[mg/Hub Luft]" COEFFS 0 10 0 0 0 1 /end COMPU_METHOD
/begin COMPU_METHOD AngleCrS "Winkel Kurbelwelle" RAT_FUNC "%6.4" "[deg CrS]" COEFFS 0 42.6666666666667 0 0 0 1 /end COMPU_METHOD
/begin COMPU_METHOD dQnt_dT1 "Einspritzmengenabweichung per 100 Kelvin" RAT_FUNC "%6.4" "[(mg/hub)/100C]" COEFFS 0 50 0 0 0 1 /end COMPU_METHOD
/begin COMPU_METHOD DtyCyc "Tastverhaeltnis" RAT_FUNC "%6.4" "[%]" COEFFS 0 100 0 0 0 1 /end COMPU_METHOD
/begin COMPU_METHOD EngN "Motordrehzahl" RAT_FUNC "%6.2" "[rpm]" COEFFS 0 1 0 0 0 1 /end COMPU_METHOD
/begin COMPU_METHOD EngN_float "Formel fuer die Drehzahl (Fließkomma)" RAT_FUNC "%6.2" "[rpm]" COEFFS 0 1 0 0 0 1 /end COMPU_METHOD
/begin COMPU_METHOD EngTempFldSel "Verbale Umrechnung für Auswahl aus dem Motortemperatur-Feld Eng_tFld" TAB_VERB "%6.3" "" COMPU_TAB_REF EngTempFldSel /end COMPU_METHOD
/begin COMPU_VTAB EngTempFldSel "Verbale Umrechnung für Auswahl aus dem Motortemperatur-Feld Eng_tFld" TAB_VERB 5 0 "Coolant_Temperature" 1 "Oil_Temperature" 2 "Engine_Temperature" 3 "Fuel_Temperature" 4 "Coolant_Temperature_CAN" /end COMPU_VTAB
/begin COMPU_METHOD Eta "Umrechnugsformel für Wirkungsgradfaktor eta" RAT_FUNC "%6.4" "Nm/(mg/cyc)" COEFFS 0 128 0 0 0 1 /end COMPU_METHOD
/begin COMPU_METHOD Fact "Faktor mit Auflösung 1 / 8192, hauptsächlich für einen Faktorenbereich 0...1 verwendet" RAT_FUNC "%6.5" "[-]" COEFFS 0 8192 0 0 0 1 /end COMPU_METHOD
/begin COMPU_METHOD FBCPreCtlfacBPSum "Umrechnungsfaktor Bandpass-Summe" RAT_FUNC "%6.5" "[-]" COEFFS 0 2048 0 0 0 1 /end COMPU_METHOD
/begin COMPU_METHOD FBCPreCtlfacLrnFlt "Filterfaktor für das Einlernen der FBC-Werte" RAT_FUNC "%7.6" "[-]" COEFFS 0 32768 0 0 0 1 /end COMPU_METHOD
/begin COMPU_METHOD FBC_BPfac "Umrechnungsformel für drehmomentübersetzungsabhängige Bandpassverstärkung" RAT_FUNC "%6.5" "-" COEFFS 0 1638.35 0 0 0 1 /end COMPU_METHOD
/begin COMPU_METHOD FBC_GvrnIKi_float "Integrationskonstante für FBC" RAT_FUNC "%6.2" "[mg/((1/min^2)*s)]" COEFFS 0 1 0 0 0 1 /end COMPU_METHOD
/begin COMPU_METHOD FBC_GvrnPKp_float "Proportinalitäts-Faktor für FBC" RAT_FUNC "%6.2" "[mg/(1/min^2)]" COEFFS 0 1 0 0 0 1 /end COMPU_METHOD
/begin COMPU_METHOD FlConsum_l_h "Kraftstoffverbrauch" RAT_FUNC "%6.4" "[l/h]" COEFFS 0 100 0 0 0 1 /end COMPU_METHOD
/begin COMPU_METHOD Fl_Half_L "Kraftstoffverbrauchsintegral" RAT_FUNC "%6.3" "[l]" COEFFS 0 2 0 0 0 1 /end COMPU_METHOD
/begin COMPU_METHOD InjMass "Einspritzmenge" RAT_FUNC "%6.4" "[mg/hub]" COEFFS 0 100 0 0 0 1 /end COMPU_METHOD
/begin COMPU_METHOD InjMassCorr "Korrektureinspritzmenge" RAT_FUNC "%6.5" "[mg/hub]" COEFFS 0 1000 0 0 0 1 /end COMPU_METHOD
/begin COMPU_METHOD InjMassCyc "Einspritzmenge pro Zyklus (mg/Zyklus)" RAT_FUNC "%6.4" "[mg/cyc]" COEFFS 0 100 0 0 0 1 /end COMPU_METHOD
/begin COMPU_METHOD InjMassNSlp "Steigung der Korrektureinspritzmenge aufgrund der Drehzahlrichtung" RAT_FUNC "%7.6" "[(mg/hub)/rpm]" COEFFS 0 10000 0 0 0 1 /end COMPU_METHOD
/begin COMPU_METHOD InjMassQSlp "Steigung der Korrektureinspritzmenge aufgrund der Mengenrichtung" RAT_FUNC "%6.4" "[-]" COEFFS 0 100 0 0 0 1 /end COMPU_METHOD
/begin COMPU_METHOD InjMassSec "Einspritzmenge pro Sekunde" RAT_FUNC "%6.4" "[mg/hub/s]" COEFFS 0 100 0 0 0 1 /end COMPU_METHOD
/begin COMPU_METHOD Ki "Integrale Verstärkung Ki (gleiche Einheit/Umrechnungsregel an Ein- und Ausgang)" RAT_FUNC "%6.5" "[1/s]" COEFFS 0 4294.967296 0 0 0 1 /end COMPU_METHOD
/begin COMPU_METHOD Ki_LmbdRec2InjMass "Integrationsverstärkung (reziprokes Lambda zu Einspritzmenge)" RAT_FUNC "%6.4" "[mg/stroke/s]" COEFFS 0 42.94967296 0 0 0 1 /end COMPU_METHOD
/begin COMPU_METHOD Ki_Temp2Prc "Integralzunahme (Temperatur zu Prozent)" RAT_FUNC "%7.6" "[%/(s deg C)]" COEFFS 0 42949.67296 0 0 0 1 /end COMPU_METHOD
/begin COMPU_METHOD Kp_LmbdRec2InjMass_1 "Proportionale Verstärkung Kp (reziprokes Lambda zu Einspritzmenge)" RAT_FUNC "%6.4" "[mg/stroke]" COEFFS 0 81.92 0 0 0 1 /end COMPU_METHOD
/begin COMPU_METHOD lambda "Lambda" RAT_FUNC "%6.5" "[-]" COEFFS 0 1000 0 0 0 1 /end COMPU_METHOD
/begin COMPU_METHOD lambdaRec "Kehrwert von Lambda" RAT_FUNC "%7.6" "[-]" COEFFS 0 10000 0 0 0 1 /end COMPU_METHOD
/begin COMPU_METHOD lambdaSec "Lambda Aenderungsrate" RAT_FUNC "%6.5" "[-/s]" COEFFS 0 1000 0 0 0 1 /end COMPU_METHOD
/begin COMPU_METHOD Map_Select "Umsetzungsfaktor von Kennfeldern fuer vierdimensionale Raeume" RAT_FUNC "%6.4" "[-]" COEFFS 0 256 0 0 0 1 /end COMPU_METHOD
/begin COMPU_METHOD NumPinAdc "verbale Umrechnung für ADC Signale" TAB_VERB "%6.3" "" COMPU_TAB_REF NumPinAdc /end COMPU_METHOD
/begin COMPU_VTAB NumPinAdc "verbale Umrechnung für ADC Signale" TAB_VERB 5 2 "Exhaust_Gas_Recirculation_Sensor" 14 "Throttle_Valve_Position_Sensor" 17 "Fuel_Temperature_Sensor" 24 "1st_APP_Sensor" 25 "2nd_APP_Sensor" /end COMPU_VTAB
/begin COMPU_METHOD OneToOne "eins zu eins (physikalischer Wert ist gleich dem internen Wert)" RAT_FUNC "%6.2" "[-]" COEFFS 0 1 0 0 0 1 /end COMPU_METHOD
/begin COMPU_METHOD Period "Periodendauer" RAT_FUNC "%6.3" "[ms]" COEFFS 0 10 0 0 0 1 /end COMPU_METHOD
/begin COMPU_METHOD Per_Ratio "Umwandlung fuer Bereichsgewichtung" RAT_FUNC "%6.4" "[-]" COEFFS 0 256 0 0 0 1 /end COMPU_METHOD
/begin COMPU_METHOD Prc "Prozent, gleiche interne Auflösung wie Fact, aber Darstellung in Prozent (0...100%)" RAT_FUNC "%6.4" "[%]" COEFFS 0 100 0 0 0 1 /end COMPU_METHOD
/begin COMPU_METHOD Prc_float "Prozent Umrechnung für float" RAT_FUNC "%6.0" "%" COEFFS 0 0.01 0 0 0 1 /end COMPU_METHOD
/begin COMPU_METHOD PresAC_hPa "Druck (Klimatisierung) angezeigt in [hPa]" RAT_FUNC "%6.2" "[hPa]" COEFFS 0 0.5 0 0 0 1 /end COMPU_METHOD
/begin COMPU_METHOD Pres_hPa "Druck (angezeigt in [hPa])" RAT_FUNC "%6.2" "[hPa]" COEFFS 0 1 0 0 0 1 /end COMPU_METHOD
/begin COMPU_METHOD RhoFuel "Kraftstoffdichte" RAT_FUNC "%6.3" "[kg/m^3]" COEFFS 0 10 0 0 0 1 /end COMPU_METHOD
/begin COMPU_METHOD Rmp "einheitenloser Rampengradient (für Library Ramp, etc.)" RAT_FUNC "%6.4" "[1/s]" COEFFS 0 65.536 0 0 0 1 /end COMPU_METHOD
/begin COMPU_METHOD RmpDtyCyc "Rampengradient für Tastverhältnis" RAT_FUNC "%6.5" "[%/s]" COEFFS 0 6553.6 0 0 0 1 /end COMPU_METHOD
/begin COMPU_METHOD RmpFuel "fuel consumption ramp gradient" RAT_FUNC "%6.4" "[l/s]" COEFFS 0 131.072 0 0 0 1 /end COMPU_METHOD
/begin COMPU_METHOD RmpInjMass "Rampengradient für Einspritzmenge" RAT_FUNC "%6.5" "[(mg/stroke)/s]" COEFFS 0 6553.6 0 0 0 1 /end COMPU_METHOD
/begin COMPU_METHOD RmpPrc "Prozent Rampengradient" RAT_FUNC "%6.5" "[%/s]" COEFFS 0 6553.6 0 0 0 1 /end COMPU_METHOD
/begin COMPU_METHOD RmpTemp "Rampengradient für Temperatur" RAT_FUNC "%6.4" "[deg C/s]" COEFFS 0 655.36 0 0 0 1 /end COMPU_METHOD
/begin COMPU_METHOD RmpTrq "Rampengradient für Motormoment" RAT_FUNC "%6.4" "[Nm/s]" COEFFS 0 655.36 0 0 0 1 /end COMPU_METHOD
/begin COMPU_METHOD Rmp_Fact "Rampenfaktorgradient" RAT_FUNC "%8.7" "[1/s]" COEFFS 0 536870.912 0 0 0 1 /end COMPU_METHOD
/begin COMPU_METHOD Surge_Frq "Umrechung der Ruckelfrequenz in kritische Drehzahl für fNW=fRuck" RAT_FUNC "%6.4" "[Hz]" COEFFS 0 120 0 0 0 1 /end COMPU_METHOD
/begin COMPU_METHOD TempDiff_Kelv "Offsettemperatur dargestellt in [K]" RAT_FUNC "%6.3" "[ deg C ]" COEFFS 0 10 0 0 0 1 /end COMPU_METHOD
/begin COMPU_METHOD Temp_Cels "Temperatur dargestellt in °C (gleiche interne Darstellung wie Temp_Kelv)" RAT_FUNC "%6.1" "[deg C]" COEFFS 0 10 2731.4 0 0 1 /end COMPU_METHOD
/begin COMPU_METHOD TimeDelay_s "Zeitkonstante T1 (in s) für PT1, DT1, etc." RAT_FUNC "%9.3" "[s]" COEFFS 0 0 1 0 0.00023283064365387 0 /end COMPU_METHOD
/begin COMPU_METHOD TimeEGTRmp "Umrechnung  Zeit in Rampensteigung,  Verwendet in EGT-Bibliothek" RAT_FUNC "%6.3" "[s]" COEFFS 0 0 1 0 0.0152587890625 0 /end COMPU_METHOD
/begin COMPU_METHOD TimeEngOn "Motorbetriebszeit in Sekunden" RAT_FUNC "%6.2" "[s]" COEFFS 0 1 0 0 0 1 /end COMPU_METHOD
/begin COMPU_METHOD TimeRed "Zeit in Sekunden mit reduzierter Auflösung für Ein/Ausgänge von KL/KF (sint16)" RAT_FUNC "%6.3" "[s]" COEFFS 0 6.25 0 0 0 1 /end COMPU_METHOD
/begin COMPU_METHOD Time_ms "Zeit in ms für Fehlerentprellung (DSM) und SW-Timer" RAT_FUNC "%6.1" "[ms]" COEFFS 0 0.1 0 0 0 1 /end COMPU_METHOD
/begin COMPU_METHOD Time_s "Zeit in s für Fehlerentprellung (DSM) und SW-Timer" RAT_FUNC "%6.4" "[s]" COEFFS 0 100 0 0 0 1 /end COMPU_METHOD
/begin COMPU_METHOD TransR "Übersetzungsverhältnis (Getriebe etc.)" RAT_FUNC "%6.4" "[-]" COEFFS 0 100 0 0 0 1 /end COMPU_METHOD
/begin COMPU_METHOD Trq "Motormoment" RAT_FUNC "%6.3" "[Nm]" COEFFS 0 10 0 0 0 1 /end COMPU_METHOD
/begin COMPU_METHOD Vel "Fahrzeuggeschwindigkeit, gleiche interne Auflösung wie Vel_SI" RAT_FUNC "%6.4" "[km/h]" COEFFS 0 100 0 0 0 1 /end COMPU_METHOD
/begin COMPU_METHOD VelToN "Verhältnis Fahrzeuggeschwindigkeit zu Motordrehzahl v/n" RAT_FUNC "%8.7" "[(km/h)/rpm]" COEFFS 0 100000 0 0 0 1 /end COMPU_METHOD
/begin COMPU_METHOD Volt "Spannung in V (von ADC)" RAT_FUNC "%6.2" "[mV]" COEFFS 0 0.2046 0 0 0 1 /end COMPU_METHOD
/begin COMPU_METHOD Volt_Batt "Batteriespannung" RAT_FUNC "%6.1" "[mV]" COEFFS 0 0.0492252911173131 0 0 0 1 /end COMPU_METHOD
/begin RECORD_LAYOUT Kf_Xs16_Ys16_Ws16 NO_AXIS_PTS_X 1 SWORD NO_AXIS_PTS_Y 2 SWORD AXIS_PTS_X 3 SWORD INDEX_INCR DIRECT AXIS_PTS_Y 4 SWORD INDEX_INCR DIRECT FNC_VALUES 5 SWORD COLUMN_DIR DIRECT /end RECORD_LAYOUT
/begin RECORD_LAYOUT Kf_Xu8_Yu8_Wu8 NO_AXIS_PTS_X 1 UBYTE NO_AXIS_PTS_Y 2 UBYTE AXIS_PTS_X 3 UBYTE INDEX_INCR DIRECT AXIS_PTS_Y 4 UBYTE INDEX_INCR DIRECT FNC_VALUES 5 UBYTE COLUMN_DIR DIRECT /end RECORD_LAYOUT
/begin RECORD_LAYOUT Kl_Xs16_Ws16 NO_AXIS_PTS_X 1 SWORD AXIS_PTS_X 2 SWORD INDEX_INCR DIRECT FNC_VALUES 3 SWORD COLUMN_DIR DIRECT /end RECORD_LAYOUT
/begin RECORD_LAYOUT Kwb_Wr32 FNC_VALUES 1 FLOAT32_IEEE COLUMN_DIR DIRECT /end RECORD_LAYOUT
/begin RECORD_LAYOUT Kwb_Ws16 FNC_VALUES 1 SWORD COLUMN_DIR DIRECT /end RECORD_LAYOUT
/begin RECORD_LAYOUT Kwb_Wu16 FNC_VALUES 1 UWORD COLUMN_DIR DIRECT /end RECORD_LAYOUT
/begin RECORD_LAYOUT Kw_Wr32 FNC_VALUES 1 FLOAT32_IEEE COLUMN_DIR DIRECT /end RECORD_LAYOUT
/begin RECORD_LAYOUT Kw_Ws16 FNC_VALUES 1 SWORD COLUMN_DIR DIRECT /end RECORD_LAYOUT
/begin RECORD_LAYOUT Kw_Ws32 FNC_VALUES 1 SLONG COLUMN_DIR DIRECT /end RECORD_LAYOUT
/begin RECORD_LAYOUT Kw_Ws8 FNC_VALUES 1 SBYTE COLUMN_DIR DIRECT /end RECORD_LAYOUT
/begin RECORD_LAYOUT Kw_Wu16 FNC_VALUES 1 UWORD COLUMN_DIR DIRECT /end RECORD_LAYOUT
/begin RECORD_LAYOUT Kw_Wu32 FNC_VALUES 1 ULONG COLUMN_DIR DIRECT /end RECORD_LAYOUT
/begin RECORD_LAYOUT Kw_Wu8 FNC_VALUES 1 UBYTE COLUMN_DIR DIRECT /end RECORD_LAYOUT
/begin FUNCTION EngPrt_PrtLim "Motormechanikschutz"
 /begin DEF_CHARACTERISTIC EngPrt_dfacBoostNeg_C EngPrt_dfacBoostPos_C EngPrt_dfacCTOvhtDwn_C EngPrt_dfacCTOvhtUp_C EngPrt_dfacChgrDwn_C EngPrt_dfacChgrUp_C EngPrt_dtrqDwnNLim_C EngPrt_dtrqUpNLim_C EngPrt_facAPCorr_MAP EngPrt_facAirOvhtPrv_MAP EngPrt_facBPAPIncLoadCorr_MAP EngPrt_facBoost1_MAP EngPrt_facBoost2_MAP EngPrt_facCTOvhtPrv_MAP EngPrt_facChgrPrt_CUR EngPrt_facFlClgDSPHysXHigh_C EngPrt_facFlClgDSPHysXLow_C EngPrt_facFlTempLim_MAP EngPrt_facOilOvhtPrv_MAP EngPrt_facTempBoostPreTrbn_MAP EngPrt_facTempPreTrbn_MAP EngPrt_nIncLoadHigh_C EngPrt_nIncLoadLow_C EngPrt_nOvhtThresHigh_C EngPrt_nOvhtThresLow_C EngPrt_qLimPBoost_MAP EngPrt_qLimP_MAP EngPrt_rDvtChgrMax_C EngPrt_stFlClgDSPHysYHigh_C EngPrt_stFlClgDSPHysYLow_C EngPrt_swtAPBP_C EngPrt_swtEGSys2_C EngPrt_swtFlTempVirtEna_C EngPrt_swtLimPMap_C EngPrt_swtOilOvhtPrevType_C EngPrt_swtOilOvhtPrevVal_C EngPrt_swtTempPreTrbnType_C EngPrt_swtTempPreTrbnVal_C EngPrt_tAirHysShiftHigh_C EngPrt_tAirHysShiftLow_C EngPrt_tClntHysShiftHigh_C EngPrt_tClntHysShiftLow_C EngPrt_tEngOilHysShiftHigh_C EngPrt_tEngOilHysShiftLow_C EngPrt_tFuelVirt_MAP EngPrt_tiBoostLock_C EngPrt_tiBoostMax_C EngPrt_tiChgr_C EngPrt_tiPreTrbnPT1_C EngPrt_trqIncLoad_MAP EngPrt_trqLimPBoost_MAP EngPrt_trqLimP_MAP EngPrt_trqLimrVnNoPI_MAP EngPrt_trqNLimShTrp_CUR EngPrt_trqNLimSpr_CUR EngPrt_trqNLim_CUR /end DEF_CHARACTERISTIC
/end FUNCTION
/begin FUNCTION Eng_Spd "Motordrehzahl" /begin DEF_CHARACTERISTIC Eng_ctEngSpdDiffCalc_C /end DEF_CHARACTERISTIC /end FUNCTION
/begin FUNCTION Eng_TrqSpdCrv "Motorkennlinie" /begin DEF_CHARACTERISTIC Eng_trqSpd_CUR /end DEF_CHARACTERISTIC /end FUNCTION
/begin FUNCTION Eng_tEngCalc "Motortemperatur-Berechnung"
 /begin DEF_CHARACTERISTIC Eng_dtEng_MAP Eng_swtTempSub_C Eng_tThresAirtEngCor_C Eng_tThresClnttEngCor_C Eng_tThresFueltEngCor_C /end DEF_CHARACTERISTIC
/end FUNCTION
/begin FUNCTION Engine "Motor"
 /begin SUB_FUNCTION CaS CmbChb_Misfire CoEng_Mon CoEng_ShOff CoEng_TrqCalc CoEng_TrqLimCalc EngM_EngDat EngM_EngMntCtl EngM_trqFrcCalc Eng_Spd Eng_TrqSpdCrv Eng_tEngCalc FBC FMTC GlwCD_Actr GlwCD_DigIn GlwCtl StSys StrtCD /end SUB_FUNCTION
/end FUNCTION
/begin FUNCTION EnvDa "Umweltgrößen" /begin SUB_FUNCTION APSCD EATSCD /end SUB_FUNCTION /end FUNCTION
/begin FUNCTION ErLpCD "Fehlerlampe Komponententreiber" /begin SUB_FUNCTION ErLpCD_Co /end SUB_FUNCTION /end FUNCTION
/begin FUNCTION ErLpCD_Co "Fehlerlampe Komponententreiber Koordination"
 /begin DEF_CHARACTERISTIC ErLpCD_ctMilPwrStgOnMax_C ErLpCD_ctSysLmpPwrStgOnMax_C ErLpCD_stMilInvOut_C ErLpCD_stMilSPICtl_C ErLpCD_stPwrStgLampActv_C ErLpCD_stPwrStgLampDia_C ErLpCD_stPwrStgMilActv_C ErLpCD_stPwrStgMilDia_C ErLpCD_stSysLampInvOut_C ErLpCD_stSysLmpSPICtl_C ErLpCD_swtMILType_C ErLpCD_swtMILVal_C ErLpCD_swtSYSType_C ErLpCD_swtSYSVal_C ErLpCD_tiBtwTstMil_C ErLpCD_tiBtwTstSysLmp_C ErLpCD_tiMilPwrStgOn_C ErLpCD_tiSysLampBlkDia_C ErLpCD_tiSysLmpPwrStgOn_C ErLp_MilEngN_C ErLp_SysLampEngN_C ErLp_swtMilEn_C ErLp_swtSysEqGlwLamp_C ErLp_swtSysLampEn_C ErLp_tiMilBlk_C ErLp_tiMilDefectTime_C ErLp_tiMilDel_C ErLp_tiMilMax_C ErLp_tiMilOkTime_C ErLp_tiMilTst_C ErLp_tiSysLampBlk_C ErLp_tiSysLampDefectTime_C ErLp_tiSysLampDel_C ErLp_tiSysLampMax_C ErLp_tiSysLampOkTime_C ErLp_tiSysLampTst_C SigTst_MILLAMPEn_C SigTst_SYSLAMPEn_C /end DEF_CHARACTERISTIC
/end FUNCTION
/begin FUNCTION Exhaust_Gas_Recirculation "Abgasrückführung (ARF)"
 /begin SUB_FUNCTION AirCtl_CtlValCalc AirCtl_DesValCalc AirCtl_Governor AirCtl_Monitor EGRCD_Co TVACD_Co /end SUB_FUNCTION
/end FUNCTION
/begin FUNCTION FBC "Mengenausgleichsregelung" /begin SUB_FUNCTION FBC_equal FBC_wheellrn /end SUB_FUNCTION /end FUNCTION
/begin FUNCTION FBC_equal "Laufruheregler"
 /begin DEF_CHARACTERISTIC FBC_BPFac1NumG_CUR FBC_GvrnIKiNeg_C FBC_GvrnIKiPos_C FBC_GvrnIKi_C FBC_GvrnIWinNeg_C FBC_GvrnIWinPos_C FBC_GvrnPKpNeg_C FBC_GvrnPKpPos_C FBC_GvrnPKp_C FBC_GvrnPWinNeg_C FBC_GvrnPWinPos_C FBC_ctSegOffset_C FBC_dBPFacDen1_CA FBC_dBPFacDen2_CA FBC_dBPFacNumHi_CA FBC_dBPFacNumLo_CA FBC_dBPFacNumZFC_CA FBC_dPreCtlBPSumMax_MAP FBC_dSegNhiCaS_C FBC_dSegNloCaS_C FBC_dSegZFCCaS_C FBC_dSyn_C FBC_dqThresSurge_C FBC_fSurge_CUR FBC_facBPRedNum_C FBC_facPreCtlBPSumMaxFst_C FBC_facPreCtlBPSumMaxTemp_CUR FBC_facPreCtlLrnFltFst_C FBC_facPreCtlLrnFlt_C FBC_idxPreCtlLrnSetQnt_C FBC_idxPreCtlLrnSetSpd_C FBC_idxPreCtlLrnSetTemp_C FBC_idxPreCtlTFld_C FBC_nCtlOfsMinRgn_C FBC_nCtlOfsMin_C FBC_nCtlThresMaxRgn_C FBC_nCtlThresMax_C FBC_nGvrnOfsMinRgn_C FBC_nGvrnOfsMin_C FBC_nGvrnThresMaxRgn_C FBC_nGvrnThresMax_C FBC_nPreCtlHys_C FBC_nPreCtl_CUR FBC_nSurgeOffset_C FBC_nZFCThresMax_C FBC_numPreCtlApplyWcySettled_C FBC_numPreCtlIniStrt_C FBC_numPreCtlIni_C FBC_numPreCtlLrnActvStrt_CUR FBC_numPreCtlLrnDeActvStrt_CUR FBC_numPreCtlLrnWcyMinFst_C FBC_numPreCtlLrnWcyMin_C FBC_qCtlOfsMaxRgn_C FBC_qCtlOfsMax_C FBC_qCtlThresMinRgn_C FBC_qCtlThresMin_C FBC_qGvrnMaxRgn_CUR FBC_qGvrnThresMax_CUR FBC_qGvrnThresMinRgn_C FBC_qGvrnThresMin_C FBC_qLim_CUR FBC_qPreCtlHys_C FBC_qPreCtlLim_CUR FBC_qPreCtl_CUR FBC_qRC_CA FBC_stEgtMsk_C FBC_stInitI_C FBC_stMskRgn_C FBC_stPreCtlApplyOpModeInhib_C FBC_stPreCtlEEP_MAP FBC_stPreCtlLrnOpModeInhib_C FBC_swtInjMass_C FBC_swtPoI2HCFBC_C FBC_swtPreCtlApply_C FBC_swtPreCtlEEPIni_C FBC_swtPreCtlLrnOut_C FBC_swtPreCtlLrnSet_C FBC_swtPreCtlLrn_C FBC_swtPreCtlRngChngRst_C FBC_swtPreCtlStartInitWrm_C FBC_tPreCtlApplyMax_C FBC_tPreCtlApplyMin_C FBC_tPreCtlLrnMax_C FBC_tPreCtlLrnMin_C FBC_tPreCtl_CUR /end DEF_CHARACTERISTIC
/end FUNCTION
/begin FUNCTION FBC_wheellrn "Antialiasingfilter und Geberradadaption"
 /begin DEF_CHARACTERISTIC FBC_AACoeff_C FBC_AAOrd_C FBC_Act_C FBC_DXadptl_C FBC_DXadptu_C FBC_DXalf0_C FBC_TF_C FBC_TFlrn_C FBC_TSm_C FBC_ThresDyn_C FBC_nHyst_C FBC_nLrnThres_C FBC_nThresFbc_C /end DEF_CHARACTERISTIC
/end FUNCTION
/begin FUNCTION FMA_CtlCalc "Mengenmittelwertadaption - Berechnung des Einspritzmengenfehlers mittels adaptiver Steuerung" /begin DEF_CHARACTERISTIC FMA_swtIC_C FMA_tiPT1_C /end DEF_CHARACTERISTIC /end FUNCTION
/begin FUNCTION FMA_ErrMod "Mengenmittelwertadaption - Algoithmen für Adaption und Auswertung des Fehlermodells für FMA_Adapt und FMA_CtlCalc"
 /begin DEF_CHARACTERISTIC FMA_IKiNeg_C FMA_IKiPos_C FMA_IKi_C FMA_nHysMap_C FMA_numMaxLim_C FMA_qDiffMaxLim_C FMA_qDiffMax_C FMA_qDiffMinLim_C FMA_qDiffMin_C FMA_qHysMap_C FMA_qIWinNeg_C FMA_qIWinPos_C FMA_qIncMap_C FMA_qRst_MAP FMA_qSlpNMax_C FMA_qSlpQMax_C FMA_swtResetMap_C /end DEF_CHARACTERISTIC
/end FUNCTION
/begin FUNCTION FMA_Monitor "Mengenmittelwertadaption - Überwachung und Abschaltung"
 /begin DEF_CHARACTERISTIC FMA_dfacSwtOffMax_C FMA_dqThrs_C FMA_drLmbdThrs_C FMA_facAirSwtOff_CUR FMA_facEngSwtOff_CUR FMA_facFlSwtOff_CUR FMA_nThrs_C FMA_qThrs_C FMA_rLmbdThrsMax_C FMA_rLmbdThrsMin_C FMA_stRgnMsk_C FMA_swtOnFMA_C FMA_tiDLmbdThrs_C FMA_tiDynThrs_C FMA_tiFaultRmp_C FMA_tiLmbdDT1_C FMA_tiLmbdThrs_C FMA_tiOvrRun_C FMA_tiQDT1_C FMA_tiQLmbd_C /end DEF_CHARACTERISTIC
/end FUNCTION
/begin FUNCTION FMTC "Masse/Momenten-Wandler" /begin SUB_FUNCTION FMTC_etaCalc FMTC_q2trq FMTC_trq2q /end SUB_FUNCTION /end FUNCTION
/begin FUNCTION FMTC_etaCalc "Effektivitätsfaktorberechung mit Funktionalitäten für die Abgasnachbehandlung (EGR)" /begin DEF_CHARACTERISTIC FMTC_stRgnMsk1_C FMTC_stRgnMsk2_C FMTC_tiRmpSlp_C /end DEF_CHARACTERISTIC /end FUNCTION
/begin FUNCTION FMTC_q2trq "Umrechnung Menge in Moment" /begin DEF_CHARACTERISTIC FMTC_trq2qBas_MAP /end DEF_CHARACTERISTIC /end FUNCTION
/begin FUNCTION FMTC_q2trqLimSmk "Umrechnung Begrenzungsmenge in ein Momentwert" /begin DEF_CHARACTERISTIC FMTC_trqInrLimSmk_Channel FMTC_trqInrLimSmk_Vector /end DEF_CHARACTERISTIC /end FUNCTION
/begin FUNCTION FMTC_trq2q "Umrechnung Moment in Menge"
 /begin DEF_CHARACTERISTIC FMTC_eta0_C FMTC_qStrt_Channel FMTC_qStrt_Vector FMTC_stRgnMsk3_C FMTC_stRgnMsk4_C FMTC_trq2qRgn1_MAP FMTC_trq2qRgn2_MAP FMTC_trq2qRgn3_MAP FMTC_trq2qRgn4_MAP /end DEF_CHARACTERISTIC
/end FUNCTION
/begin FUNCTION FQSVCD "Kraftstoffmenge Magnetventil Komponententreiber" /begin SUB_FUNCTION FQSVCD_Co /end SUB_FUNCTION /end FUNCTION
/begin FUNCTION FQSVCD_Co "Kraftstoffmenge Magnetventil Komponententreiber" /begin DEF_CHARACTERISTIC FQlSCD_DebSRCHighDef_C FQlSCD_DebSigOk_C /end DEF_CHARACTERISTIC /end FUNCTION
/begin FUNCTION FQTSCD_Co "Fuel Quality/Temperature sensor component driver"
 /begin DEF_CHARACTERISTIC FQTSCD_DebNplDef_C FQTSCD_DebNplOk_C FQTSCD_DebSRCHighDef_C FQTSCD_DebSRCHighOk_C FQTSCD_DebSRCLowDef_C FQTSCD_DebSRCLowOk_C FQTSCD_drRmpSlpDwn_C FQTSCD_drRmpSlpUp_C FQTSCD_dtRmpSlpDwn_C FQTSCD_dtRmpSlpUp_C FQTSCD_numAdc_C FQTSCD_numSSp_C FQTSCD_rDfl_C FQTSCD_rLin_MAP FQTSCD_rRpOilHi_C FQTSCD_rRpOilLo_C FQTSCD_stFlQlSensIDWord_C FQTSCD_stFlTempSensIDWord_C FQTSCD_swtEnaType_C FQTSCD_swtEnaVal_C FQTSCD_tDfl_C FQTSCD_tLin_CUR FQTSCD_tiPT1_C FQTSCD_tiSmplPerMax_C FQTSCD_tiSmplPerMin_C FQTSCD_tiSyncMax_C FQTSCD_tiSyncMin_C FQTSCD_tiTrnstStlg_C FQTSCD_uFlQlSRCMin_C FQTSCD_uFlQlUpLim_C FQTSCD_uFlTempLoLim_C FQTSCD_uFlTempSRCMax_C FQTSCD_uFlTempSRCMin_C /end DEF_CHARACTERISTIC
/end FUNCTION
/begin FUNCTION FTSCD_TempEval "Kraftstofftemperatur Erfassung"
 /begin DEF_CHARACTERISTIC FTSCD_DebNplDef_C FTSCD_DebNplOk_C FTSCD_DebSRCHighDef_C FTSCD_DebSRCHighOk_C FTSCD_DebSRCLowDef_C FTSCD_DebSRCLowOk_C FTSCD_dtRmpSlpDwn_C FTSCD_dtRmpSlpUp_C FTSCD_stSensIDWord_C FTSCD_tDfl_C FTSCD_tDiff_C FTSCD_tImn_C FTSCD_tInt_C FTSCD_tLin_CUR FTSCD_tiT_C FTSCD_tiTmn_C FTSCD_uSRCMax_C FTSCD_uSRCMin_C /end DEF_CHARACTERISTIC
/end FUNCTION
/begin FUNCTION Fan "Lüfter" /begin SUB_FUNCTION FanCD FanCtl /end SUB_FUNCTION /end FUNCTION
/begin FUNCTION FanCD "Komponententreiber Lüfter" /begin SUB_FUNCTION FanCD_Co /end SUB_FUNCTION /end FUNCTION
/begin FUNCTION FanCD_Co "Komponententreiber Lüfter Koordination"
 /begin DEF_CHARACTERISTIC FanCD_Fan1DebExcTempDef_C FanCD_Fan1DebExcTempOk_C FanCD_Fan1DebNoLoadDef_C FanCD_Fan1DebNoLoadOk_C FanCD_Fan1DebShortCircBatDef_C FanCD_Fan1DebShortCircBatOk_C FanCD_Fan1DebShortCircGndDef_C FanCD_Fan1DebShortCircGndOk_C FanCD_Fan2DebExcTempDefVar2_C FanCD_Fan2DebExcTempDef_C FanCD_Fan2DebExcTempOkVar2_C FanCD_Fan2DebExcTempOk_C FanCD_Fan2DebNoLoadDefVar2_C FanCD_Fan2DebNoLoadDef_C FanCD_Fan2DebNoLoadOkVar2_C FanCD_Fan2DebNoLoadOk_C FanCD_Fan2DebShortBatDefVar2_C FanCD_Fan2DebShortBatOkVar2_C FanCD_Fan2DebShortCircBatDef_C FanCD_Fan2DebShortCircBatOk_C FanCD_Fan2DebShortCircGndDef_C FanCD_Fan2DebShortCircGndOk_C FanCD_Fan2DebShortGndDefVar2_C FanCD_Fan2DebShortGndOkVar2_C FanCD_ctShutOffPeriods_C FanCD_numErrThres_C FanCD_rFan1Tst_C FanCD_rFan2Tst_C FanCD_rShutOff_CA FanCD_stFanCtlr1DfpEna_C FanCD_stFanCtlr2DfpEna_C FanCD_stStage1InvOut_C FanCD_stStage2InvOut_C FanCD_swtFanShutOffType_C FanCD_swtFanShutOffVal_C FanCD_tiDebFan1Ctlr1Def_C FanCD_tiDebFan1Ctlr1Ok_C FanCD_tiDebFan1Ctlr2Def_C FanCD_tiDebFan1Ctlr2Ok_C FanCD_tiDebFan2Ctlr1Def_C FanCD_tiDebFan2Ctlr1Ok_C FanCD_tiDebFan2Ctlr2Def_C FanCD_tiDebFan2Ctlr2Ok_C FanCD_tiDebFanCtlr1Def_C FanCD_tiDebFanCtlr1Ok_C FanCD_tiDebFanCtlr2Def_C FanCD_tiDebFanCtlr2Ok_C FanCD_tiFANcheckDfpTmr_C FanCD_tiFan1BtwTst_C FanCD_tiFan2BtwTst_C FanCD_tiFanCtlr1Max_C FanCD_tiFanCtlr1Min_C FanCD_tiFanCtlr2Max_C FanCD_tiFanCtlr2Min_C FanCD_tiFanCtlr3Max_C FanCD_tiFanCtlr3Min_C FanCD_tiFanCtlr4Max_C FanCD_tiFanCtlr4Min_C FanCD_tiFanCtlr5Max_C FanCD_tiFanCtlr5Min_C FanCD_tiFanCtlr6Max_C FanCD_tiFanCtlr6Min_C FanCD_tiFanCtlrErrIdlMax_C FanCD_tiFanCtlrErrIdlMin_C FanCD_tiFanOFFTmr_C FanCD_tiShutOffBreak_C FanCD_tiShutOffPeriod_C FanCD_tiStage1Per_C FanCD_tiStage2Per_C SigTst_Fan1En_C SigTst_Fan2En_C /end DEF_CHARACTERISTIC
/end FUNCTION
/begin FUNCTION FanCtl "Lüftersteuerung" /begin SUB_FUNCTION FanCtl_AR FanCtl_Co /end SUB_FUNCTION /end FUNCTION
/begin FUNCTION FanCtl_AR "Nachlaufzeitberechnung fuer Kuelerlueftersteuerung"
 /begin DEF_CHARACTERISTIC FanCtl_factARBaseCor_CUR FanCtl_prcARTime_C FanCtl_tARThres_CUR FanCtl_tiARBase_MAP FanCtl_tiARCor1_MAP FanCtl_tiARCor2_MAP FanCtl_tiAROilCorDfl_C FanCtl_tiAROilCor_CUR FanCtl_tiARmax_C FanCtl_tiARmin_C /end DEF_CHARACTERISTIC
/end FUNCTION
/begin FUNCTION FanCtl_Co "Lüftersteuerung Koordination"
 /begin DEF_CHARACTERISTIC Clg_stCtl_C FanCtl_RglIKiNeg_C FanCtl_RglIKiPos_C FanCtl_RglIKi_C FanCtl_RglIWinNeg_C FanCtl_RglIWinPos_C FanCtl_dcycAcouLim_C FanCtl_dcycBSGmax_C FanCtl_dcycCtTThres1_C FanCtl_dcycCtTThres2_C FanCtl_dcycFan1HiLim_C FanCtl_dcycFan1LoLim_C FanCtl_dcycFan1Preset1_C FanCtl_dcycFan1Preset2_C FanCtl_dcycFan1Preset3_MAP FanCtl_dcycFan1Rgn_C FanCtl_dcycFan1ShutOff_C FanCtl_dcycFan1_CUR FanCtl_dcycFan1_Channel FanCtl_dcycFan1_Vector FanCtl_dcycFan2HiLimVar2_C FanCtl_dcycFan2HiLim_C FanCtl_dcycFan2LoLim_C FanCtl_dcycFan2Preset1_C FanCtl_dcycFan2Preset2_C FanCtl_dcycFan2Preset3_MAP FanCtl_dcycFan2Rgn_C FanCtl_dcycFan2ShutOff_C FanCtl_dcycFan2_CUR FanCtl_dcycFan2_Channel FanCtl_dcycFan2_Vector FanCtl_dcycRampBSGDown_C FanCtl_dcycRampBSGUp_C FanCtl_dprcRampFan1Down_C FanCtl_dprcRampFan1Up_C FanCtl_dprcRampFan2Down_C FanCtl_dprcRampFan2Up_C FanCtl_dtCOTSCritXHi_C FanCtl_dtCOTSCritXLow_C FanCtl_dtClntDesCorrDfl_C FanCtl_dtClntDesCorr_MAP FanCtl_dtClntDesDiff_MAP FanCtl_dtCtTClntDiffThres1_C FanCtl_dtCtTClntDiffThres2_C FanCtl_factACReqCorr_CUR FanCtl_factApReqCorr_CUR FanCtl_factApReq_MAP FanCtl_factBattCorr1_CUR FanCtl_factBattCorr2_CUR FanCtl_factCorr_CUR FanCtl_nFan1Base_MAP FanCtl_nFan1MaxThres1Var2_C FanCtl_nFan1MaxThres1_C FanCtl_nFan1MaxThres2Var2_C FanCtl_nFan1MaxThres2_C FanCtl_nFan1MaxThres3Var2_C FanCtl_nFan1MaxThres3_C FanCtl_nFan1MaxThres4Var2_C FanCtl_nFan1MaxThres4_C FanCtl_nFan1MaxThres5Var2_C FanCtl_nFan1MaxThres5_C FanCtl_nFan1MinThres1Var2_C FanCtl_nFan1MinThres1_C FanCtl_nFan1MinThres2Var2_C FanCtl_nFan1MinThres2_C FanCtl_nFan1MinThres3Var2_C FanCtl_nFan1MinThres3_C FanCtl_nFan1MinThres4Var2_C FanCtl_nFan1MinThres4_C FanCtl_nFan1MinThres5Var2_C FanCtl_nFan1MinThres5_C FanCtl_nFan1Min_C FanCtl_nFan1XHigh_C FanCtl_nFan1XLow_C FanCtl_nFan2Base_MAP FanCtl_nFan2MaxThres1Var2_C FanCtl_nFan2MaxThres1Var3_C FanCtl_nFan2MaxThres1_C FanCtl_nFan2MaxThres2Var2_C FanCtl_nFan2MaxThres2Var3_C FanCtl_nFan2MaxThres2_C FanCtl_nFan2MaxThres3Var2_C FanCtl_nFan2MaxThres3Var3_C FanCtl_nFan2MaxThres3_C FanCtl_nFan2MaxThres4Var2_C FanCtl_nFan2MaxThres4Var3_C FanCtl_nFan2MaxThres4_C FanCtl_nFan2MaxThres5Var2_C FanCtl_nFan2MaxThres5Var3_C FanCtl_nFan2MaxThres5_C FanCtl_nFan2MinThres1Var2_C FanCtl_nFan2MinThres1Var3_C FanCtl_nFan2MinThres1_C FanCtl_nFan2MinThres2Var2_C FanCtl_nFan2MinThres2Var3_C FanCtl_nFan2MinThres2_C FanCtl_nFan2MinThres3Var2_C FanCtl_nFan2MinThres3Var3_C FanCtl_nFan2MinThres3_C FanCtl_nFan2MinThres4Var2_C FanCtl_nFan2MinThres4Var3_C FanCtl_nFan2MinThres4_C FanCtl_nFan2MinThres5Var2_C FanCtl_nFan2MinThres5Var3_C FanCtl_nFan2MinThres5_C FanCtl_nFan2Min_C FanCtl_nFan2XHigh_C FanCtl_nFan2XLow_C FanCtl_pACCDDfl_C FanCtl_pAcHigh_C FanCtl_pAcLow_C FanCtl_prcCanReq_CUR FanCtl_prcClntInc_CUR FanCtl_prcCnvVar2_MAP FanCtl_prcCnv_MAP FanCtl_prcCtl_MAP FanCtl_prcFanDfl_C FanCtl_prcHiLimI_C FanCtl_prcHiLim_C FanCtl_prcLoLimI_C FanCtl_prcLoLim_C FanCtl_prcQKakt_MAP FanCtl_prcQKdeakt_CUR FanCtl_prcRelClntDesPreset_C FanCtl_stCOTSCritYHi_C FanCtl_stCOTSCritYLow_C FanCtl_stCTSCritYHi_C FanCtl_stCTSCritYLow_C FanCtl_stFan1YHigh_C FanCtl_stFan1YLow_C FanCtl_stFan2YHigh_C FanCtl_stFan2YLow_C FanCtl_stFanVar2_C FanCtl_stFanVar3_C FanCtl_stFanVar4_C FanCtl_stFanVar5_C FanCtl_stFanVar_C FanCtl_stRgnMsk_C FanCtl_swtClgModVarType_C FanCtl_swtClgModVarVal_C FanCtl_swtFanShutOff_C FanCtl_tCOTSCrit_C FanCtl_tCOTSPreset_C FanCtl_tCTSCritXHi_C FanCtl_tCTSCritXLow_C FanCtl_tClntCrit_MAP FanCtl_tClntDesPreset_C FanCtl_tClntDesRaw_MAP FanCtl_tClntDes_MAP FanCtl_tiARShutOffFan1_C FanCtl_tiARShutOffFan2_C FanCtl_tiAcouLim_C FanCtl_tiAfterrunFan1_C FanCtl_tiAfterrunFan2_C FanCtl_tiClntDesCorrDly1_C FanCtl_tiClntDesCorrDly2_C FanCtl_tiPT1Neg_C FanCtl_tiPT1Pos_C FanCtl_tiStartDly_C FanCtl_vPreset2_C FanCtl_vPreset_C /end DEF_CHARACTERISTIC
/end FUNCTION
/begin FUNCTION FlMng_FullLdRgl "Volllastreglung"
 /begin DEF_CHARACTERISTIC FlMng_FullLdRglIKi_CUR FlMng_FullLdRglPKp_CUR FlMng_dqSlpNeg_C FlMng_dqSlpPos_C FlMng_qFullLdRglMax_C FlMng_qFullLdRglMin_C FlMng_rLmbdRecDvtMax_C FlMng_rLmbdRecDvtMin_C FlMng_stEGTRglOff_C FlMng_swtFullLdRglType_C FlMng_swtFullLdRglVal_C FlMng_tiFullLdRglDel_CUR FlMng_trqEpsLim_C FlMng_trqEps_C /end DEF_CHARACTERISTIC
/end FUNCTION
/begin FUNCTION FlMng_InjMassLim "Rauchbegrenzungsmenge"
 /begin DEF_CHARACTERISTIC FlMng_dRmpSlpLimSmkL_C FlMng_dSmokeMapNr_CUR FlMng_facCorAP_CUR FlMng_facCorAirTemp_CUR FlMng_facCorEngTemp_CUR FlMng_facDynSmkAP_CUR FlMng_facDynSmkTemp_CUR FlMng_facDynSmoke_CUR FlMng_facLmbdSmkSOE_CUR FlMng_mAirPerCylMin_C FlMng_pIATCorr_MAP FlMng_qAFSCDSmoke_MAP FlMng_qAFSCDtEngSmoke0_MAP FlMng_qAFSCDtEngSmoke1_MAP FlMng_qAFSCDtEngSmoke2_MAP FlMng_qDynSmoke_MAP FlMng_qPresSmoke_MAP FlMng_qTempFuel_MAP FlMng_rLmbdPartLd_CUR FlMng_rLmbdSmkEGT_MAP FlMng_rLmbdSmkLim0_MAP FlMng_rLmbdSmkLim1_MAP FlMng_rLmbdSmkLim2_MAP FlMng_rLmbdSmkSOE_MAP FlMng_stRgnMsk_C FlMng_swtAirTemp_C FlMng_swtBPAP_C FlMng_swtMIAPSSrcSel_C FlMng_swtSmokeSpace_C FlMng_swtSmokeVariant_C FlMng_swtqLimSmkQ_C FlMng_tFueRef_C /end DEF_CHARACTERISTIC
/end FUNCTION
/begin FUNCTION FlPpCD_Co "Komponententreiber Kraftstoffumwälzpumpe Koordination"
 /begin DEF_CHARACTERISTIC FlPpCD_DebExcTempDef_C FlPpCD_DebExcTempOk_C FlPpCD_DebNoLoadDef_C FlPpCD_DebNoLoadOk_C FlPpCD_DebShortCircBatDef_C FlPpCD_DebShortCircBatOk_C FlPpCD_DebShortCircGndDef_C FlPpCD_DebShortCircGndOk_C FlPpCD_ctPwrStgOnMax_C FlPpCD_stInvOut_C FlPpCD_stSPICtl_C FlPpCD_swtFlPpActType_C FlPpCD_swtFlPpActVal_C FlPpCD_swtFlPpAct_C FlPpCD_tiBtwTst_C FlPpCD_tiPwrStgOn_C SigTst_FlPpCDEn_C /end DEF_CHARACTERISTIC
/end FUNCTION
/begin FUNCTION FlSCD_Co "Kraftstoffsensor Komponententreiber Koordination"
 /begin DEF_CHARACTERISTIC FQlSCD_DebSRCHighOk_C FQlSCD_DebSRCLowDef_C FQlSCD_DebSRCLowOk_C FQlSCD_DebSigDef_C FQlSCD_dtRmpSlpDwn_C FQlSCD_dtRmpSlpUp_C FQlSCD_numSSp_C FQlSCD_rDfl_C FQlSCD_rLin_CUR FQlSCD_rRpOilHi_C FQlSCD_rRpOilLo_C FQlSCD_stSensIDWord_C FQlSCD_swtSig_C FQlSCD_uSRCMax_C FQlSCD_uSRCMin_C FlSCD_DebSRCMaxDef_C FlSCD_DebSRCMaxOk_C FlSCD_DebSRCMinDef_C FlSCD_DebSRCMinOk_C FlSCD_DebSigDef_C FlSCD_DebSigOK_C FlSCD_dvolRmpSlpDwn_C FlSCD_dvolRmpSlpUp_C FlSCD_stSensIDWord_C FlSCD_swtFuelSens_C FlSCD_swtSig_C FlSCD_uSRCMax_C FlSCD_uSRCMin_C FlSCD_volTotalDflVal_C FlSCD_volTotalLin_CUR FlSCD_volTotal_C /end DEF_CHARACTERISTIC
/end FUNCTION
/begin FUNCTION FlSys_CalcCnvFac "Berechnung Umwandlungsfaktor von Einspritzmenge nach Einspritzvolumen" /begin DEF_CHARACTERISTIC FlSys_rhoFl_C FlSys_rhoFl_CUR /end DEF_CHARACTERISTIC /end FUNCTION
/end MODULE
/end PROJECT
