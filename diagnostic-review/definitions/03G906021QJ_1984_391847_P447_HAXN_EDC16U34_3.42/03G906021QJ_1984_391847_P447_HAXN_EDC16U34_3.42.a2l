ASAP2_VERSION 1 3
/begin PROJECT X447 "EDC16U34"
/begin HEADER "" VERSION "VAA1" PROJECT_NO X447 /end HEADER
/begin MODULE DIM ""
/begin MOD_COMMON "" BYTE_ORDER MSB_FIRST ALIGNMENT_BYTE 1 ALIGNMENT_WORD 2 ALIGNMENT_LONG 4 ALIGNMENT_FLOAT32_IEEE 4 /end MOD_COMMON
/begin MEASUREMENT Dfp_HWEMonRcySuppressed_mp "Messpunkt fuer Fehlerpfad  Dfp_HWEMonRcySuppressed" UWORD OneToOne 1 100 0.00 65535.00 FORMAT "%8.2" ECU_ADDRESS 0x9FED8C /end MEASUREMENT
/begin MEASUREMENT Dfp_HWEMonRcyVisible_mp "Messpunkt fuer Fehlerpfad  Dfp_HWEMonRcyVisible" UWORD OneToOne 1 100 0.00 65535.00 FORMAT "%8.2" ECU_ADDRESS 0x9FED8E /end MEASUREMENT
/begin MEASUREMENT Dfp_HWEMonUMaxSupply_Low "LowByte von Dfp_HWEMonUMaxSupply_mp" UBYTE OneToOne 1 100 0.00 255.0 FORMAT "%5.1" ECU_ADDRESS 0x7F938C /end MEASUREMENT
/begin MEASUREMENT Dfp_HWEMonUMaxSupply_mp "Messpunkt fuer Fehlerpfad  Dfp_HWEMonUMaxSupply" UWORD OneToOne 1 100 0.00 65535.00 FORMAT "%8.2" ECU_ADDRESS 0x9FED90 /end MEASUREMENT
/begin MEASUREMENT Dfp_HWEMonUMinSupply_Low "LowByte von HWEMonUMinSupply_mp" UBYTE OneToOne 1 100 0.00 255.0 FORMAT "%5.1" ECU_ADDRESS 0x7F938D /end MEASUREMENT
/begin MEASUREMENT Dfp_HWEMonUMinSupply_mp "Messpunkt fuer Fehlerpfad  Dfp_HWEMonUMinSupply" UWORD OneToOne 1 100 0.00 65535.00 FORMAT "%8.2" ECU_ADDRESS 0x9FED92 /end MEASUREMENT
/begin MEASUREMENT Dfp_IATSCD_mp "Messpunkt fuer Fehlerpfad  Dfp_IATSCD" UWORD OneToOne 1 100 0.00 65535.00 FORMAT "%8.2" ECU_ADDRESS 0x9FED94 /end MEASUREMENT
/begin MEASUREMENT Dfp_IFCD_mp "Fehlerpfadmesspunkt der Endstufenüberwachnung des Ladeluftkühler-Lüfter Komponententreibers" UWORD OneToOne 1 100 0.00 65535.00 FORMAT "%8.2" ECU_ADDRESS 0x9FED96 /end MEASUREMENT
/begin MEASUREMENT Dfp_ImmCtl_mp "Messpunkt fuer Fehlerpfad  Dfp_ImmCtl" UWORD OneToOne 1 100 0.00 65535.00 FORMAT "%8.2" ECU_ADDRESS 0x9FED98 /end MEASUREMENT
/begin MEASUREMENT Dfp_IndSysMonIntMnf_mp "Fehlerpfad zur Ladedruckschlauchabfallerkennung" UWORD OneToOne 1 100 0.00 65535.00 FORMAT "%8.2" ECU_ADDRESS 0x9FED9A /end MEASUREMENT
/begin MEASUREMENT Dfp_InjCrvT3DiaMax_mp "Max-Fehlerpfad der T3-Diagnose; t EGP dauerhaft über max. Schlauchgrenze" UWORD OneToOne 1 100 0.00 65535.00 FORMAT "%8.2" ECU_ADDRESS 0x9FED9C /end MEASUREMENT
/begin MEASUREMENT Dfp_InjCrvT3DiaMin_mp "Min-Fehlerpfad der T3-Diagnose; t EGP dauerhaft unter min. Schlauchgrenze" UWORD OneToOne 1 100 0.00 65535.00 FORMAT "%8.2" ECU_ADDRESS 0x9FED9E /end MEASUREMENT
/begin MEASUREMENT Dfp_InjVlvBnk1A_mp "Magnetventilfehler an allen Magentventilen der Bank 1A" UWORD OneToOne 1 100 0.00 65535.00 FORMAT "%8.2" ECU_ADDRESS 0x9FEDA0 /end MEASUREMENT
/begin MEASUREMENT Dfp_InjVlvBnk2A_mp "Magnetventilfehler an allen Magentventilen der Bank 2A" UWORD OneToOne 1 100 0.00 65535.00 FORMAT "%8.2" ECU_ADDRESS 0x9FEDA2 /end MEASUREMENT
/begin MEASUREMENT Dfp_InjVlvCyl10A_mp "Einspritzventilfehler A für Zylinder 10" UWORD OneToOne 1 100 0.00 65535.00 FORMAT "%8.2" ECU_ADDRESS 0x9FEDA4 /end MEASUREMENT
/begin MEASUREMENT Dfp_InjVlvCyl11A_mp "Einspritzventilfehler A für Zylinder 11" UWORD OneToOne 1 100 0.00 65535.00 FORMAT "%8.2" ECU_ADDRESS 0x9FEDA6 /end MEASUREMENT
/begin MEASUREMENT Dfp_InjVlvCyl12A_mp "Einspritzventilfehler A für Zylinder 12" UWORD OneToOne 1 100 0.00 65535.00 FORMAT "%8.2" ECU_ADDRESS 0x9FEDA8 /end MEASUREMENT
/begin MEASUREMENT Dfp_InjVlvCyl1A_mp "Einspritzventilfehler A für Zylinder 1" UWORD OneToOne 1 100 0.00 65535.00 FORMAT "%8.2" ECU_ADDRESS 0x9FEDAA /end MEASUREMENT
/begin MEASUREMENT Dfp_InjVlvCyl2A_mp "Einspritzventilfehler A für Zylinder 2" UWORD OneToOne 1 100 0.00 65535.00 FORMAT "%8.2" ECU_ADDRESS 0x9FEDAC /end MEASUREMENT
/begin MEASUREMENT Dfp_InjVlvCyl3A_mp "Einspritzventilfehler A für Zylinder 3" UWORD OneToOne 1 100 0.00 65535.00 FORMAT "%8.2" ECU_ADDRESS 0x9FEDAE /end MEASUREMENT
/begin MEASUREMENT Dfp_InjVlvCyl4A_mp "Einspritzventilfehler A für Zylinder 4" UWORD OneToOne 1 100 0.00 65535.00 FORMAT "%8.2" ECU_ADDRESS 0x9FEDB0 /end MEASUREMENT
/begin MEASUREMENT Dfp_InjVlvCyl5A_mp "Einspritzventilfehler A für Zylinder 5" UWORD OneToOne 1 100 0.00 65535.00 FORMAT "%8.2" ECU_ADDRESS 0x9FEDB2 /end MEASUREMENT
/begin MEASUREMENT Dfp_InjVlvCyl6A_mp "Einspritzventilfehler A für Zylinder 6" UWORD OneToOne 1 100 0.00 65535.00 FORMAT "%8.2" ECU_ADDRESS 0x9FEDB4 /end MEASUREMENT
/begin MEASUREMENT Dfp_InjVlvCyl7A_mp "Einspritzventilfehler A für Zylinder 7" UWORD OneToOne 1 100 0.00 65535.00 FORMAT "%8.2" ECU_ADDRESS 0x9FEDB6 /end MEASUREMENT
/begin MEASUREMENT Dfp_InjVlvCyl8A_mp "Einspritzventilfehler A für Zylinder 8" UWORD OneToOne 1 100 0.00 65535.00 FORMAT "%8.2" ECU_ADDRESS 0x9FEDB8 /end MEASUREMENT
/begin MEASUREMENT Dfp_InjVlvCyl9A_mp "Einspritzventilfehler A für Zylinder 9" UWORD OneToOne 1 100 0.00 65535.00 FORMAT "%8.2" ECU_ADDRESS 0x9FEDBA /end MEASUREMENT
/begin MEASUREMENT Dfp_LASCD_mp "Meßgröße für Fehlerpfad des Längsbeschleunigungssensors" UWORD OneToOne 1 100 0.00 65535.00 FORMAT "%8.2" ECU_ADDRESS 0x9FEDBC /end MEASUREMENT
/begin MEASUREMENT Dfp_LSUCDCircNernst0_Low "LowByte von Dfp_LSUCDCircNernst0_mp" UBYTE OneToOne 1 100 0.00 255.0 FORMAT "%5.1" ECU_ADDRESS 0x7F938E /end MEASUREMENT
/begin MEASUREMENT Dfp_LSUCDCircNernst0_mp "Messpunkt fuer Fehlerpfad  Dfp_LSUCDCircNernst0" UWORD OneToOne 1 100 0.00 65535.00 FORMAT "%8.2" ECU_ADDRESS 0x9FEDBE /end MEASUREMENT
/begin MEASUREMENT Dfp_LSUCDCircPumpCur0_Low "LowByte von Dfp_LSUCDCircPumpCur0_mp" UBYTE OneToOne 1 100 0.00 255.0 FORMAT "%5.1" ECU_ADDRESS 0x7F938F /end MEASUREMENT
/begin MEASUREMENT Dfp_LSUCDCircPumpCur0_mp "Messpunkt fuer Fehlerpfad  Dfp_LSUCDCircPumpCur0" UWORD OneToOne 1 100 0.00 65535.00 FORMAT "%8.2" ECU_ADDRESS 0x9FEDC0 /end MEASUREMENT
/begin MEASUREMENT Dfp_LSUCDCircVirtGnd0_Low "LowByte von Dfp_LSUCDCircVirtGnd0_mp" UBYTE OneToOne 1 100 0.00 255.0 FORMAT "%5.1" ECU_ADDRESS 0x7F9390 /end MEASUREMENT
/begin MEASUREMENT Dfp_LSUCDCircVirtGnd0_mp "Messpunkt fuer Fehlerpfad  Dfp_LSUCDCircVirtGnd0" UWORD OneToOne 1 100 0.00 65535.00 FORMAT "%8.2" ECU_ADDRESS 0x9FEDC2 /end MEASUREMENT
/begin MEASUREMENT Dfp_LSUCDHeater0_Low "LowByte von Dfp_LSUCDHeater0_mp" UBYTE OneToOne 1 100 0.00 255.0 FORMAT "%5.1" ECU_ADDRESS 0x7F9391 /end MEASUREMENT
/begin MEASUREMENT Dfp_LSUCDHeater0_mp "Messpunkt fuer Fehlerpfad  Dfp_LSUCDHeater0" UWORD OneToOne 1 100 0.00 65535.00 FORMAT "%8.2" ECU_ADDRESS 0x9FEDC4 /end MEASUREMENT
/begin MEASUREMENT Dfp_LSUCDHtCoup0_Low "LowByte von Dfp_LSUCDHtCoup0_mp" UBYTE OneToOne 1 100 0.00 255.0 FORMAT "%5.1" ECU_ADDRESS 0x7F9392 /end MEASUREMENT
/begin MEASUREMENT Dfp_LSUCDHtCoup0_mp "Messpunkt fuer Fehlerpfad  Dfp_LSUCDHtCoup0" UWORD OneToOne 1 100 0.00 65535.00 FORMAT "%8.2" ECU_ADDRESS 0x9FEDC6 /end MEASUREMENT
/begin MEASUREMENT Dfp_LSUCDO20_Low "LowByte von Dfp_LSUCDO20_mp" UBYTE OneToOne 1 100 0.00 255.0 FORMAT "%5.1" ECU_ADDRESS 0x7F9393 /end MEASUREMENT
/begin MEASUREMENT Dfp_LSUCDO20_mp "Messpunkt fuer Fehlerpfad  Dfp_LSUCDO20" UWORD OneToOne 1 100 0.00 65535.00 FORMAT "%8.2" ECU_ADDRESS 0x9FEDC8 /end MEASUREMENT
/begin MEASUREMENT Dfp_LSUCDO2Clb0_Low "LowByte von Dfp_LSUCDO2Clb0_mp" UBYTE OneToOne 1 100 0.00 255.0 FORMAT "%5.1" ECU_ADDRESS 0x7F9394 /end MEASUREMENT
/begin MEASUREMENT Dfp_LSUCDO2Clb0_mp "Messpunkt fuer Fehlerpfad  Dfp_LSUCDO2Clb0" UWORD OneToOne 1 100 0.00 65535.00 FORMAT "%8.2" ECU_ADDRESS 0x9FEDCA /end MEASUREMENT
/begin MEASUREMENT Dfp_LSUCDRiClb0_Low "LowByte von Dfp_LSUCDRiClb0_mp" UBYTE OneToOne 1 100 0.00 255.0 FORMAT "%5.1" ECU_ADDRESS 0x7F9395 /end MEASUREMENT
/begin MEASUREMENT Dfp_LSUCDRiClb0_mp "Messpunkt fuer Fehlerpfad  Dfp_LSUCDRiClb0" UWORD OneToOne 1 100 0.00 65535.00 FORMAT "%8.2" ECU_ADDRESS 0x9FEDCC /end MEASUREMENT
/begin MEASUREMENT Dfp_LSUCDSPI0_Low "LowByte von Dfp_LSUCDSPI0_mp" UBYTE OneToOne 1 100 0.00 255.0 FORMAT "%5.1" ECU_ADDRESS 0x7F9396 /end MEASUREMENT
/begin MEASUREMENT Dfp_LSUCDSPI0_mp "Messpunkt fuer Fehlerpfad  Dfp_LSUCDSPI0" UWORD OneToOne 1 100 0.00 65535.00 FORMAT "%8.2" ECU_ADDRESS 0x9FEDCE /end MEASUREMENT
/begin MEASUREMENT Dfp_LSUCDSPIBattLow0_mp "Fehlerpfad für niedrige Batteriespannung" UWORD OneToOne 1 100 0.00 65535.00 FORMAT "%8.2" ECU_ADDRESS 0x9FEDD0 /end MEASUREMENT
/begin MEASUREMENT Dfp_LSUCDWireIP0_Low "LowByte von Dfp_LSUCDWireIP0_mp" UBYTE OneToOne 1 100 0.00 255.0 FORMAT "%5.1" ECU_ADDRESS 0x7F9397 /end MEASUREMENT
/begin MEASUREMENT Dfp_LSUCDWireIP0_mp "Messpunkt fuer Fehlerpfad  Dfp_LSUCDWireIP0" UWORD OneToOne 1 100 0.00 65535.00 FORMAT "%8.2" ECU_ADDRESS 0x9FEDD2 /end MEASUREMENT
/begin MEASUREMENT Dfp_LSUCtlRiExc0_Low "LowByte von Dfp_LSUCtlRiExc0_mp" UBYTE OneToOne 1 100 0.00 255.0 FORMAT "%5.1" ECU_ADDRESS 0x7F9398 /end MEASUREMENT
/begin MEASUREMENT Dfp_LSUCtlRiExc0_mp "Messpunkt fuer Fehlerpfad  Dfp_LSUCtlRiExc0" UWORD OneToOne 1 100 0.00 65535.00 FORMAT "%8.2" ECU_ADDRESS 0x9FEDD4 /end MEASUREMENT
/begin MEASUREMENT Dfp_LSUMonDyn0_mp "Messpunkt fuer Fehlerpfad  Dfp_LSUMonDyn0" UWORD OneToOne 1 100 0.00 65535.00 FORMAT "%8.2" ECU_ADDRESS 0x9FEDD6 /end MEASUREMENT
/begin MEASUREMENT Dfp_LSUMonDyn_Low "Low Byte von  Dfp_LSUMonDyn0_mp" UBYTE OneToOne 1 100 0.00 255.0 FORMAT "%5.1" ECU_ADDRESS 0x7F9399 /end MEASUREMENT
/begin MEASUREMENT Dfp_LSUMonFullLd0_mp "Messpunkt fuer Fehlerpfad  Dfp_LSUMonFullLd0" UWORD OneToOne 1 100 0.00 65535.00 FORMAT "%8.2" ECU_ADDRESS 0x9FEDD8 /end MEASUREMENT
/begin MEASUREMENT Dfp_LSUMonFullLd_Low "Low Byte von  Dfp_LSUMonFullLd0_mp" UBYTE OneToOne 1 100 0.00 255.0 FORMAT "%5.1" ECU_ADDRESS 0x7F939A /end MEASUREMENT
/begin MEASUREMENT Dfp_LSUMonOvrRun0_mp "Messpunkt fuer Fehlerpfad  Dfp_LSUMonOvrRun0" UWORD OneToOne 1 100 0.00 65535.00 FORMAT "%8.2" ECU_ADDRESS 0x9FEDDA /end MEASUREMENT
/begin MEASUREMENT Dfp_LSUMonOvrRun_Low "Low Byte von  Dfp_LSUMonOvrRun0_mp" UBYTE OneToOne 1 100 0.00 255.0 FORMAT "%5.1" ECU_ADDRESS 0x7F939B /end MEASUREMENT
/begin MEASUREMENT Dfp_LSUMonPartLd0_mp "Messpunkt fuer Fehlerpfad  Dfp_LSUMonPartLd0" UWORD OneToOne 1 100 0.00 65535.00 FORMAT "%8.2" ECU_ADDRESS 0x9FEDDC /end MEASUREMENT
/begin MEASUREMENT Dfp_LSUMonPartLd_Low "Low Byte von Dfp_LSUMonPartLd0_mp" UBYTE OneToOne 1 100 0.00 255.0 FORMAT "%5.1" ECU_ADDRESS 0x7F939C /end MEASUREMENT
/begin MEASUREMENT Dfp_MIL_mp "Messpunkt fuer Fehlerpfad  Dfp_MIL" UWORD OneToOne 1 100 0.00 65535.00 FORMAT "%8.2" ECU_ADDRESS 0x9FEDDE /end MEASUREMENT
/begin MEASUREMENT Dfp_Montr_mp "Messpunkt fuer Fehlerpfad  Dfp_Montr" UWORD OneToOne 1 100 0.00 65535.00 FORMAT "%8.2" ECU_ADDRESS 0x9FEDE0 /end MEASUREMENT
/begin MEASUREMENT Dfp_MRlyCD_mp "Messpunkt fuer Fehlerpfad  Dfp_MRlyCD" UWORD OneToOne 1 100 0.00 65535.00 FORMAT "%8.2" ECU_ADDRESS 0x9FEDE2 /end MEASUREMENT
/begin MEASUREMENT Dfp_OTSCDCanInac_mp "Messpunkt fuer Fehlerpfad  Dfp_OTSCDCanInac" UWORD OneToOne 1 100 0.00 65535.00 FORMAT "%8.2" ECU_ADDRESS 0x9FEDE4 /end MEASUREMENT
/begin MEASUREMENT Dfp_OTSCDCanSig_mp "Messpunkt fuer Fehlerpfad  Dfp_OTSCDCanSig" UWORD OneToOne 1 100 0.00 65535.00 FORMAT "%8.2" ECU_ADDRESS 0x9FEDE6 /end MEASUREMENT
/begin MEASUREMENT Dfp_OTSCD_DynTst_mp "Fehlerpfad dynamischen Plausibilitätstest" UWORD OneToOne 1 100 0.00 65535.00 FORMAT "%8.2" ECU_ADDRESS 0x9FEDE8 /end MEASUREMENT
/begin MEASUREMENT Dfp_OTSCD_mp "Fehlerpfad Öltemperaturwert" UWORD OneToOne 1 100 0.00 65535.00 FORMAT "%8.2" ECU_ADDRESS 0x9FEDEA /end MEASUREMENT
/begin MEASUREMENT Dfp_OvRMonCrCtlP_mp "Fehlerpfad für die Cruise Control Plus: Allgemeine Überwachung, Überreiten und Verzögerungsbegrenzung" UWORD OneToOne 1 100 0.00 65535.00 FORMAT "%8.2" ECU_ADDRESS 0x9FEDEC /end MEASUREMENT
/begin MEASUREMENT Dfp_OvRMonSigA_mp "Fehlerpfad für Drehzahlplausibilisierung in der Schubüberwachung" UWORD OneToOne 1 100 0.00 65535.00 FORMAT "%8.2" ECU_ADDRESS 0x9FEDEE /end MEASUREMENT
/begin MEASUREMENT Dfp_OvRMon_mp "Messpunkt fuer Fehlerpfad  Dfp_OvRMon" UWORD OneToOne 1 100 0.00 65535.00 FORMAT "%8.2" ECU_ADDRESS 0x9FEDF0 /end MEASUREMENT
/begin MEASUREMENT Dfp_OxiCCDTPre1_mp "Fehlerpfad für Abgastemperatur vor Abgasturbolader [-]" UWORD OneToOne 1 100 0.00 65535.00 FORMAT "%8.2" ECU_ADDRESS 0x9FEDF2 /end MEASUREMENT
/begin MEASUREMENT Dfp_OxiCCDTPre_mp "Messpunkt fuer Fehlerpfad  Dfp_OxiCCDTPre" UWORD OneToOne 1 100 0.00 65535.00 FORMAT "%8.2" ECU_ADDRESS 0x9FEDF4 /end MEASUREMENT
/begin MEASUREMENT Dfp_PCR_BalGovDev_mp "Messpunkt fuer Fehlerpfad Dfp_PCR_BalGovDev" UWORD OneToOne 1 100 0.00 65535.00 FORMAT "%8.2" ECU_ADDRESS 0x9FEDF6 /end MEASUREMENT
/begin MEASUREMENT Dfp_PCR_GovDev_mp "Messpunkt fuer Fehlerpfad  Dfp_PCR_GovDev" UWORD OneToOne 1 100 0.00 65535.00 FORMAT "%8.2" ECU_ADDRESS 0x9FEDF8 /end MEASUREMENT
/begin MEASUREMENT Dfp_PFltAPSens_mp "Fehlerfad für Atmosphärendrucksensor" UWORD OneToOne 1 100 0.00 65535.00 FORMAT "%8.2" ECU_ADDRESS 0x9FEDFA /end MEASUREMENT
/begin MEASUREMENT Dfp_PFltCDHtg1_mp "Messpunkt fuer Fehlerpfad  Dfp_PFltCDHtg1" UWORD OneToOne 1 100 0.00 65535.00 FORMAT "%8.2" ECU_ADDRESS 0x9FEDFC /end MEASUREMENT
/begin MEASUREMENT Dfp_PFltCDHtg_mp "Messpunkt fuer Fehlerpfad  Dfp_PFltCDHtg" UWORD OneToOne 1 100 0.00 65535.00 FORMAT "%8.2" ECU_ADDRESS 0x9FEDFE /end MEASUREMENT
/begin MEASUREMENT Dfp_PFltCDPDiff_mp "Messpunkt fuer Fehlerpfad  Dfp_PFltCDPDiff" UWORD OneToOne 1 100 0.00 65535.00 FORMAT "%8.2" ECU_ADDRESS 0x9FEE00 /end MEASUREMENT
/begin MEASUREMENT Dfp_PFltCDTempPre1_mp "Fehlerpfad der Abgastemperatur vor dem Partikelfilter" UWORD OneToOne 1 100 0.00 65535.00 FORMAT "%8.2" ECU_ADDRESS 0x9FEE02 /end MEASUREMENT
/begin MEASUREMENT Dfp_PFltCDTempPre_mp "Fehlerpfad der Abgastemperatur vor dem Partikelfilter [-]" UWORD OneToOne 1 100 0.00 65535.00 FORMAT "%8.2" ECU_ADDRESS 0x9FEE04 /end MEASUREMENT
/begin MEASUREMENT Dfp_PFltCDTempPst_mp "Messpunkt fuer Fehlerpfad  Dfp_PFltCDTempPst" UWORD OneToOne 1 100 0.00 65535.00 FORMAT "%8.2" ECU_ADDRESS 0x9FEE06 /end MEASUREMENT
/begin MEASUREMENT Dfp_PFltChar_mp "Digitaler Fehlerpfad für Fliesswiderstand Partikelfilter" UWORD OneToOne 1 100 0.00 65535.00 FORMAT "%8.2" ECU_ADDRESS 0x9FEE08 /end MEASUREMENT
/begin MEASUREMENT Dfp_PFltEngPrt_mp "Messpunkt fuer Fehlerpfad  Dfp_PFltEngPrt" UWORD OneToOne 1 100 0.00 65535.00 FORMAT "%8.2" ECU_ADDRESS 0x9FEE0A /end MEASUREMENT
/begin MEASUREMENT Dfp_PFltPresDynPlaus_mp "Messpunkt fuer Fehlerpfad  Dfp_PFltPresDynPlaus" UWORD OneToOne 1 100 0.00 65535.00 FORMAT "%8.2" ECU_ADDRESS 0x9FEE0C /end MEASUREMENT
/begin MEASUREMENT Dfp_PFltPresHsChng_mp "Messpunkt fuer Fehlerpfad Dfp_PFltPresHsChng" UWORD OneToOne 1 100 0.00 65535.00 FORMAT "%8.2" ECU_ADDRESS 0x9FEE0E /end MEASUREMENT
/begin MEASUREMENT Dfp_PFltPresSensFrz_mp "Messpunkt fuer Fehlerpfad  Dfp_PFltPresSensFrz" UWORD OneToOne 1 100 0.00 65535.00 FORMAT "%8.2" ECU_ADDRESS 0x9FEE10 /end MEASUREMENT
/begin MEASUREMENT Dfp_PFltPresSensHsLn_mp "Messpunkt fuer Fehlerpfad  Dfp_PFltPresSensHsLn" UWORD OneToOne 1 100 0.00 65535.00 FORMAT "%8.2" ECU_ADDRESS 0x9FEE12 /end MEASUREMENT
/begin MEASUREMENT Dfp_PFltPresSensSot_mp "Messpunkt fuer Fehlerpfad  Dfp_PFltPresSensSot" UWORD OneToOne 1 100 0.00 65535.00 FORMAT "%8.2" ECU_ADDRESS 0x9FEE14 /end MEASUREMENT
/begin MEASUREMENT Dfp_PFltPresSens_mp "Messpunkt fuer Fehlerpfad  Dfp_PFltPresSens" UWORD OneToOne 1 100 0.00 65535.00 FORMAT "%8.2" ECU_ADDRESS 0x9FEE16 /end MEASUREMENT
/begin MEASUREMENT Dfp_PFltRgnLckPermTstr_mp "Fehlerpfad Regenerationsstrategie endgültig gescheitert (durch VAG-Testereingriff deaktivierbar)" UWORD OneToOne 1 100 0.00 65535.00 FORMAT "%8.2" ECU_ADDRESS 0x9FEE18 /end MEASUREMENT
/begin MEASUREMENT Dfp_PFltRgnLckPerm_mp "Fehlerpfad Regenerationsstrategie endgültig gescheitert" UWORD OneToOne 1 100 0.00 65535.00 FORMAT "%8.2" ECU_ADDRESS 0x9FEE1A /end MEASUREMENT
/begin MEASUREMENT Dfp_PFltRgnPerm_mp "Messpunkt fuer Fehlerpfad  Dfp_PFltRgnPerm" UWORD OneToOne 1 100 0.00 65535.00 FORMAT "%8.2" ECU_ADDRESS 0x9FEE1C /end MEASUREMENT
/begin MEASUREMENT Dfp_PFltSotSimPresPerm_mp "Partikelfilter-Fehlerpfad wegen Umgebungsbedingungen." UWORD OneToOne 1 100 0.00 65535.00 FORMAT "%8.2" ECU_ADDRESS 0x9FEE1E /end MEASUREMENT
/begin MEASUREMENT Dfp_PFltTempDwnStrmMax_mp "Max. Fehlerpfad Downstream Abgastemperatur" UWORD OneToOne 1 100 0.00 65535.00 FORMAT "%8.2" ECU_ADDRESS 0x9FEE20 /end MEASUREMENT
/begin MEASUREMENT Dfp_PFltTempDwnStrmMin_mp "Min. Fehlerpfad Downstream Abgastemperatur" UWORD OneToOne 1 100 0.00 65535.00 FORMAT "%8.2" ECU_ADDRESS 0x9FEE22 /end MEASUREMENT
/begin MEASUREMENT Dfp_PFltTempDwnStrm_mp "Digitaler Fehlerpfad für zweiten Abgastemperatursensor" UWORD OneToOne 1 100 0.00 65535.00 FORMAT "%8.2" ECU_ADDRESS 0x9FEE24 /end MEASUREMENT
/begin MEASUREMENT Dfp_PFltTempPreOxiC_mp "Messpunkt fuer Fehlerpfad  Dfp_PFltTempPreOxiC" UWORD OneToOne 1 100 0.00 65535.00 FORMAT "%8.2" ECU_ADDRESS 0x9FEE26 /end MEASUREMENT
/begin MEASUREMENT Dfp_PFltTempPrePFlt_mp "Messpunkt fuer Fehlerpfad  Dfp_PFltTempPrePFlt" UWORD OneToOne 1 100 0.00 65535.00 FORMAT "%8.2" ECU_ADDRESS 0x9FEE28 /end MEASUREMENT
/begin MEASUREMENT Dfp_PFltTempPreTrbn_mp "Messpunkt fuer Fehlerpfad  Dfp_PFltTempPreTrbn" UWORD OneToOne 1 100 0.00 65535.00 FORMAT "%8.2" ECU_ADDRESS 0x9FEE2A /end MEASUREMENT
/begin MEASUREMENT Dfp_PFltTempPstPFlt_mp "Fehlerpfad für die Temperatur nach Partikelfilter" UWORD OneToOne 1 100 0.00 65535.00 FORMAT "%8.2" ECU_ADDRESS 0x9FEE2C /end MEASUREMENT
/begin MEASUREMENT Dfp_PFltTempPst_mp "Fehlerpfad für die Temperatur nach Partikelfilter" UWORD OneToOne 1 100 0.00 65535.00 FORMAT "%8.2" ECU_ADDRESS 0x9FEE2E /end MEASUREMENT
/begin MEASUREMENT Dfp_PFltTempSens2_mp "Messpunkt fuer Fehlerpfad  Dfp_PFltTempSens2" UWORD OneToOne 1 100 0.00 65535.00 FORMAT "%8.2" ECU_ADDRESS 0x9FEE30 /end MEASUREMENT
/begin MEASUREMENT Dfp_PFltTempSens_mp "Messpunkt fuer Fehlerpfad  Dfp_PFltTempSens" UWORD OneToOne 1 100 0.00 65535.00 FORMAT "%8.2" ECU_ADDRESS 0x9FEE32 /end MEASUREMENT
/begin MEASUREMENT Dfp_PFltTempUpStrmMax_mp "Max. Fehlerpfad Upstream Abgastemperatur Sensor" UWORD OneToOne 1 100 0.00 65535.00 FORMAT "%8.2" ECU_ADDRESS 0x9FEE34 /end MEASUREMENT
/begin MEASUREMENT Dfp_PFltTempUpStrmMin_mp "Min. Fehlerpfad Upstream Abgastemperatur Sensor" UWORD OneToOne 1 100 0.00 65535.00 FORMAT "%8.2" ECU_ADDRESS 0x9FEE36 /end MEASUREMENT
/begin MEASUREMENT Dfp_PFltTempUpStrm_mp "Digitaler Fehlerpfad für ersten Abgastemperatursensor" UWORD OneToOne 1 100 0.00 65535.00 FORMAT "%8.2" ECU_ADDRESS 0x9FEE38 /end MEASUREMENT
/begin MEASUREMENT Dfp_PrpCtlvLimErrPat_mp "Fehlerpfad für physikalisches Fehlermuster bei der Geschwindigkeitsbegrenzung" UWORD OneToOne 1 100 0.00 65535.00 FORMAT "%8.2" ECU_ADDRESS 0x9FEE3A /end MEASUREMENT
/begin MEASUREMENT Dfp_PSPCD_Actr_mp "Messpunkt fuer Fehlerpfad  Dfp_PSPCD_Actr" UWORD OneToOne 1 100 0.00 65535.00 FORMAT "%8.2" ECU_ADDRESS 0x9FEE3C /end MEASUREMENT
/begin MEASUREMENT Dfp_Shtrp_EGRBA_mp "Fehlerpfad der ShortTrip diagnose für EGR Grundeinstellung" UWORD OneToOne 1 100 0.00 65535.00 FORMAT "%8.2" ECU_ADDRESS 0x9FEE3E /end MEASUREMENT
/begin MEASUREMENT Dfp_Shtrp_PCRBA_mp "Fehlerpfad für Short Trip Diagnose der PCR Grundeinstellung" UWORD OneToOne 1 100 0.00 65535.00 FORMAT "%8.2" ECU_ADDRESS 0x9FEE40 /end MEASUREMENT
/begin MEASUREMENT Dfp_SOPTst_Low "LowByte von Dfp_SOPTst_mp" UBYTE OneToOne 1 100 0.00 255.0 FORMAT "%5.1" ECU_ADDRESS 0x7F939D /end MEASUREMENT
/begin MEASUREMENT Dfp_SOPTst_mp "Messpunkt fuer Fehlerpfad  Dfp_SOPTst" UWORD OneToOne 1 100 0.00 65535.00 FORMAT "%8.2" ECU_ADDRESS 0x9FEE42 /end MEASUREMENT
/begin MEASUREMENT Dfp_SrvPmpStSAEcu_mp "Messpunkt fuer Fehlerpfad  Dfp_SrvPmpStSAEcu" UWORD OneToOne 1 100 0.00 65535.00 FORMAT "%8.2" ECU_ADDRESS 0x9FEE44 /end MEASUREMENT
/begin MEASUREMENT Dfp_SSpMon1_mp "Meßpunkt des Fehlerpfades für Sensorversorgungsspannung 1" UWORD OneToOne 1 100 0.00 65535.00 FORMAT "%8.2" ECU_ADDRESS 0x9FEE46 /end MEASUREMENT
/begin MEASUREMENT Dfp_SSpMon2_mp "Meßpunkt des Fehlerpfades für Sensorversorgungsspannung 2" UWORD OneToOne 1 100 0.00 65535.00 FORMAT "%8.2" ECU_ADDRESS 0x9FEE48 /end MEASUREMENT
/begin MEASUREMENT Dfp_SSpMon3_mp "Meßpunkt des Fehlerpfades für Sensorversorgungsspannung 3" UWORD OneToOne 1 100 0.00 65535.00 FORMAT "%8.2" ECU_ADDRESS 0x9FEE4A /end MEASUREMENT
/begin MEASUREMENT Dfp_StrtCDOffRly_mp "Meßpunkt für Fehlerpfad Dfp_StrtCDOffRly" UWORD OneToOne 1 100 0.00 65535.00 FORMAT "%8.2" ECU_ADDRESS 0x9FEE4C /end MEASUREMENT
/begin MEASUREMENT Dfp_StrtCDOnRly_mp "Meßpunkt des Fehlerpfads Dfp_StrtCDOnRly" UWORD OneToOne 1 100 0.00 65535.00 FORMAT "%8.2" ECU_ADDRESS 0x9FEE4E /end MEASUREMENT
/begin MEASUREMENT Dfp_StrtCtlIlsNotPlaus_mp "Messpunkt für Fehlerpfad Dfp_StrtCtlIlsNotPlaus" UWORD OneToOne 1 100 0.00 65535.00 FORMAT "%8.2" ECU_ADDRESS 0x9FEE50 /end MEASUREMENT
/begin MEASUREMENT Dfp_StrtCtlT50ROneRly1_mp "Messpunkt fuer Fehlerpfad  Dfp_StrtCtlT50ROneRly1" UWORD OneToOne 1 100 0.00 65535.00 FORMAT "%8.2" ECU_ADDRESS 0x9FEE52 /end MEASUREMENT
/begin MEASUREMENT Dfp_StrtCtlT50ROneRly2_mp "Messpunkt fuer Fehlerpfad  Dfp_StrtCtlT50ROneRly2" UWORD OneToOne 1 100 0.00 65535.00 FORMAT "%8.2" ECU_ADDRESS 0x9FEE54 /end MEASUREMENT
/begin MEASUREMENT Dfp_StrtCtlT50RZero_mp "Messpunkt fuer Fehlerpfad  Dfp_StrtCtlT50RZero" UWORD OneToOne 1 100 0.00 65535.00 FORMAT "%8.2" ECU_ADDRESS 0x9FEE56 /end MEASUREMENT
/begin MEASUREMENT Dfp_StSysCtlShCirBatt_mp "Interlockschalter Kurzschluß gegen Ubatt[-]" UWORD OneToOne 1 100 0.00 65535.00 FORMAT "%8.2" ECU_ADDRESS 0x9FEE58 /end MEASUREMENT
/begin MEASUREMENT Dfp_SysLamp_mp "Messpunkt fuer Fehlerpfad  Dfp_SysLamp" UWORD OneToOne 1 100 0.00 65535.00 FORMAT "%8.2" ECU_ADDRESS 0x9FEE5A /end MEASUREMENT
/begin MEASUREMENT Dfp_T15CD_mp "Messpunkt fuer Fehlerpfad  Dfp_T15CD" UWORD OneToOne 1 100 0.00 65535.00 FORMAT "%8.2" ECU_ADDRESS 0x9FEE5C /end MEASUREMENT
/begin MEASUREMENT Dfp_T50CD_mp "Messpunt fur Fehlerpfad Dfp_T50CD_mp" UWORD OneToOne 1 100 0.00 65535.00 FORMAT "%8.2" ECU_ADDRESS 0x9FEE5E /end MEASUREMENT
/begin MEASUREMENT Dfp_ThrVlvGvnrDvt_mp "Messpunkt fuer Fehlerpfad  Dfp_ThrVlvGvnrDvt" UWORD OneToOne 1 100 0.00 65535.00 FORMAT "%8.2" ECU_ADDRESS 0x9FEE60 /end MEASUREMENT
/begin MEASUREMENT Dfp_ThrVlvJamVlv_mp "Messpunkt fuer Fehlerpfad  Dfp_ThrVlvJamVlv" UWORD OneToOne 1 100 0.00 65535.00 FORMAT "%8.2" ECU_ADDRESS 0x9FEE62 /end MEASUREMENT
/begin MEASUREMENT Dfp_TPUMon_mp "Messpunkt fuer Fehlerpfad  Dfp_TPUMon" UWORD OneToOne 1 100 0.00 65535.00 FORMAT "%8.2" ECU_ADDRESS 0x9FEE64 /end MEASUREMENT
/begin MEASUREMENT Dfp_TVACD_Max_mp "Fehlerpfad für Kurzschluss nach Batteriespannung des Drosselklappenstellers" UWORD OneToOne 1 100 0.00 65535.00 FORMAT "%8.2" ECU_ADDRESS 0x9FEE66 /end MEASUREMENT
/begin MEASUREMENT Dfp_TVACD_Min_mp "Fehlerpfad für Kurzschluss nach Masse des Drosselklappenstellers" UWORD OneToOne 1 100 0.00 65535.00 FORMAT "%8.2" ECU_ADDRESS 0x9FEE68 /end MEASUREMENT
/begin MEASUREMENT Dfp_TVACD_SigNpl_mp "Fehlerpfad für Lastabfall und Übertemperatur des Drosselklappenstellers" UWORD OneToOne 1 100 0.00 65535.00 FORMAT "%8.2" ECU_ADDRESS 0x9FEE6A /end MEASUREMENT
/begin MEASUREMENT Dfp_TVACD_Sig_mp "Fehlerpfad für Kurzschluss nach Masse, Kurzschluss nach Batteriespannung oder Übertemperatur des Drosselklappenstellers" UWORD OneToOne 1 100 0.00 65535.00 FORMAT "%8.2" ECU_ADDRESS 0x9FEE6C /end MEASUREMENT
/begin MEASUREMENT Dfp_TVACD_stLineDef_mp "Messpunkt fuer Fehlerpfad  Dfp_TVACD_stLineDef" UWORD OneToOne 1 100 0.00 65535.00 FORMAT "%8.2" ECU_ADDRESS 0x9FEE6E /end MEASUREMENT
/begin MEASUREMENT Dfp_TVASCD_Drft_mp "Fehlerpfad für Drifterkennung des Lagesensors" UWORD OneToOne 1 100 0.00 65535.00 FORMAT "%8.2" ECU_ADDRESS 0x9FEE70 /end MEASUREMENT
/begin MEASUREMENT Dfp_TVASCD_mp "Messpunkt fuer Fehlerpfad  Dfp_TVASCD" UWORD OneToOne 1 100 0.00 65535.00 FORMAT "%8.2" ECU_ADDRESS 0x9FEE72 /end MEASUREMENT
/begin MEASUREMENT Dfp_UAcc_CodeBitErr_mp "Messpunkt fuer Fehlerpfad  Dfp_UAcc_CodeBitErr" UWORD OneToOne 1 100 0.00 65535.00 FORMAT "%8.2" ECU_ADDRESS 0x9FEE74 /end MEASUREMENT
/begin MEASUREMENT Dfp_USAp_DataVariant_mp "Messpunkt fuer Fehlerpfad  Dfp_USAp_DataVariant" UWORD OneToOne 1 100 0.00 65535.00 FORMAT "%8.2" ECU_ADDRESS 0x9FEE76 /end MEASUREMENT
/begin MEASUREMENT Dfp_USAp_FuncCodeRead_mp "Funktionkodierung gültig" UWORD OneToOne 1 100 0.00 65535.00 FORMAT "%8.2" ECU_ADDRESS 0x9FEE78 /end MEASUREMENT
/begin MEASUREMENT Dfp_VSACD_Max_mp "Fehlerpfad für Kurzschluss nach Batteriespannung des Drallniveaustellers" UWORD OneToOne 1 100 0.00 65535.00 FORMAT "%8.2" ECU_ADDRESS 0x9FEE7A /end MEASUREMENT
/begin MEASUREMENT Dfp_VSACD_Min_mp "Fehlerpfad für Kurzschluss nach Masse des Drallniveaustellers" UWORD OneToOne 1 100 0.00 65535.00 FORMAT "%8.2" ECU_ADDRESS 0x9FEE7C /end MEASUREMENT
/begin MEASUREMENT Dfp_VSACD_SigNpl_mp "Fehlerpfad für Lastabfall und Übertemperatur des Drallniveaustellers" UWORD OneToOne 1 100 0.00 65535.00 FORMAT "%8.2" ECU_ADDRESS 0x9FEE7E /end MEASUREMENT
/begin MEASUREMENT Dfp_VSSCD1_mp "Messpunkt fuer Fehlerpfad  Dfp_VSSCD1" UWORD OneToOne 1 100 0.00 65535.00 FORMAT "%8.2" ECU_ADDRESS 0x9FEE80 /end MEASUREMENT
/begin MEASUREMENT Dfp_VSSCD2_mp "Messpunkt fuer Fehlerpfad  Dfp_VSSCD2" UWORD OneToOne 1 100 0.00 65535.00 FORMAT "%8.2" ECU_ADDRESS 0x9FEE82 /end MEASUREMENT
/begin MEASUREMENT Dfp_VSSCD4_mp "Messpunkt fuer Fehlerpfad Dfp_VSSCD4" UWORD OneToOne 1 100 0.00 65535.00 FORMAT "%8.2" ECU_ADDRESS 0x9FEE84 /end MEASUREMENT
/begin MEASUREMENT Dfp_VSSCDBrkLowVltg_mp "Fehlerpfad für Gschwindigkeitssensorunterspannung in BRK1" UWORD OneToOne 1 100 0.00 65535.00 FORMAT "%8.2" ECU_ADDRESS 0x9FEE86 /end MEASUREMENT
/begin MEASUREMENT Dfp_VSSCDCAN_mp "Messpunt für Fehlerpfad Dfp_VSSCDCAN (wenn Geschwindigkeit über CAN: wird gesetzt wenn CAN-spez. Fehler auftritt)" UWORD OneToOne 1 100 0.00 65535.00 FORMAT "%8.2" ECU_ADDRESS 0x9FEE88 /end MEASUREMENT
/begin MEASUREMENT Dfp_VSSCDNpl_mp "Messpunkt fuer Fehlerpfad  Dfp_VSSCDNpl" UWORD OneToOne 1 100 0.00 65535.00 FORMAT "%8.2" ECU_ADDRESS 0x9FEE8A /end MEASUREMENT
/begin MEASUREMENT Dfp_VSSCD_mp "Messpunkt fuer Fehlerpfad  Dfp_VSSCD" UWORD OneToOne 1 100 0.00 65535.00 FORMAT "%8.2" ECU_ADDRESS 0x9FEE8C /end MEASUREMENT
/begin MEASUREMENT Dfp_WDALCD_mp "Fehlerpfad zur Erkennung von Endstufenfehler des Winterfahrprogramms" UWORD OneToOne 1 100 0.00 65535.00 FORMAT "%8.2" ECU_ADDRESS 0x9FEE8E /end MEASUREMENT
/begin MEASUREMENT Dfp_WdCom_mp "Messpunkt fuer Fehlerpfad  Dfp_WdCom" UWORD OneToOne 1 100 0.00 65535.00 FORMAT "%8.2" ECU_ADDRESS 0x9FEE90 /end MEASUREMENT
/begin MEASUREMENT Diff_trqEngMax "Begrenzungsmoment für das Differenzial in innerem Moment" SWORD Trq 1 100 -3276.800 3276.700 FORMAT "%8.3" ECU_ADDRESS 0x7F983E /end MEASUREMENT
/begin MEASUREMENT Diff_trqMax "Begrenzungsmoment durch Allradsteuergerät" SLONG TrqPrpHigh 1 100 -214748364.800 214748364.700 FORMAT "%13.3" ECU_ADDRESS 0x7F9DE8 /end MEASUREMENT
/begin MEASUREMENT DIUMPR_ctCtlRatio_mp "Index für die einzelnen Verhältnisse" UWORD OneToOne 1 100 0.00 65535.00 FORMAT "%8.2" ECU_ADDRESS 0x9FEAE6 /end MEASUREMENT
/begin MEASUREMENT DIUMPR_ctDenom_mp "Denominator" UWORD OneToOne 1 100 0.00 65535.00 FORMAT "%8.2" ARRAY_SIZE 40 ECU_ADDRESS 0x9FEAE8 /end MEASUREMENT
/begin MEASUREMENT DIUMPR_ctGenDenom_mp "General Denominator" UWORD OneToOne 1 100 0.00 65535.00 FORMAT "%8.2" ECU_ADDRESS 0x7FDDE2 /end MEASUREMENT
/begin MEASUREMENT DIUMPR_ctIgn_mp "Ignition cycle counter" UWORD OneToOne 1 100 0.00 65535.00 FORMAT "%8.2" ECU_ADDRESS 0x7FDDE4 /end MEASUREMENT
/begin MEASUREMENT DIUMPR_ctNum_mp "Numerator" UWORD OneToOne 1 100 0.00 65535.00 FORMAT "%8.2" ARRAY_SIZE 40 ECU_ADDRESS 0x9FEB38 /end MEASUREMENT
/begin MEASUREMENT DIUMPR_numIndGrp "Index des kleinsten Verhältnisses (für jede Gruppe)" UBYTE OneToOne 1 100 0.00 255.0 FORMAT "%5.1" ARRAY_SIZE 9 ECU_ADDRESS 0x7F9F34 /end MEASUREMENT
/begin MEASUREMENT DIUMPR_r "Die DIUMPR Ratios" UWORD Fact 1 100 0.00 7.999878 FORMAT "%8.6" ARRAY_SIZE 40 ECU_ADDRESS 0x7FB578 /end MEASUREMENT
/begin MEASUREMENT DIUMPR_rMBGrp "Message array das Ratios zusammenfasst welche in Messwerteblöcke ausgegeben werden sollen" UWORD Fact 1 100 0.00 7.999878 FORMAT "%8.6" ARRAY_SIZE 15 ECU_ADDRESS 0x7FB5C8 /end MEASUREMENT
/begin MEASUREMENT DIUMPR_rValRatMin "Wert des kleinsten Verhältnisses (für jede Gruppe)" UWORD Fact 1 100 0.00 7.999878 FORMAT "%8.6" ARRAY_SIZE 9 ECU_ADDRESS 0x7FA010 /end MEASUREMENT
/begin MEASUREMENT DIUMPR_st "Statusinformation für die zähler" UBYTE OneToOne 1 100 0.00 255.0 FORMAT "%5.1" ARRAY_SIZE 40 ECU_ADDRESS 0x7FA056 /end MEASUREMENT
/begin MEASUREMENT DIUMPR_stEnaDen_mp "Status für die einzelnen Zähler" UBYTE OneToOne 1 100 0.00 255.0 FORMAT "%5.1" ECU_ADDRESS 0x9FFA54 /end MEASUREMENT
/begin MEASUREMENT DIUMPR_tiEngNorSpdCum_mp "DIUMPR Motor Laufzeit unter Berücksichtigung der üblichen Bedingungen" UWORD DIUMPR_Time_ms_100ms 1 100 0.00 6553500. FORMAT "%8.0" ECU_ADDRESS 0x9FEB88 /end MEASUREMENT
/begin MEASUREMENT DIUMPR_tiIdl_mp "Zeit seit erreichen von Leerlauf" UWORD DIUMPR_Time_ms_100ms 1 100 0.00 6553500. FORMAT "%8.0" ECU_ADDRESS 0x9FEB8A /end MEASUREMENT
/begin MEASUREMENT DIUMPR_tiIgnMin_mp "Zeit seit Zündung an" UWORD DIUMPR_Time_ms_100ms 1 100 0.00 6553500. FORMAT "%8.0" ECU_ADDRESS 0x9FEB8C /end MEASUREMENT
/begin MEASUREMENT DIUMPR_tiSigActv "Timerwert für die Zeit Tester aktiv (für jeden Steller)" UWORD DIUMPR_Time_ms_100ms 1 100 0.00 6553500. FORMAT "%8.0" ARRAY_SIZE 10 ECU_ADDRESS 0x7FA022 /end MEASUREMENT
/begin MEASUREMENT DIUMPR_tiVehSpdCum_mp "Kumulierte Zeit, für welche die Fahrzeuggeschwindigkeit oberhalb einer Schwelle ist" UWORD DIUMPR_Time_ms_100ms 1 100 0.00 6553500. FORMAT "%8.0" ECU_ADDRESS 0x9FEB8E /end MEASUREMENT
/begin MEASUREMENT DIUMPR_valSignal_mp "Temporärer Wert eines Signals" SLONG OneToOne 1 100 -2147483648.00 2147483647.00 FORMAT "%13.2" ECU_ADDRESS 0x9FE4E0 /end MEASUREMENT
/begin MEASUREMENT DrvTrn_rTransDT "Triebstrang-Übersetzung (Radmoment pro Motormoment)" SWORD TransR 1 100 -327.6800 327.6700 FORMAT "%8.4" ECU_ADDRESS 0x7F9840 /end MEASUREMENT
/begin MEASUREMENT DrvTrn_rTrans_mp "Messpunkt der Triebstrang-Übersetzung" SWORD TransR 1 100 -327.6800 327.6700 FORMAT "%8.4" ECU_ADDRESS 0x9FEB90 /end MEASUREMENT
/begin MEASUREMENT DrvTrn_swtSig "Signalquelle für Triebstrangübersetzung bei stehendem Fahrzeug" UBYTE OneToOne 1 100 0.00 255.0 FORMAT "%5.1" ECU_ADDRESS 0x7F939E /end MEASUREMENT
/begin MEASUREMENT DSCHED_numDefDfpArray_mp "Array von defekten DFPs welche einen ausgewählten FID verriegeln" UWORD DfpName 1 100 0.00 384.000000000 FORMAT "%13.9" ARRAY_SIZE 10 ECU_ADDRESS 0x9FEF58 /end MEASUREMENT
/begin MEASUREMENT DSCHED_numOkDfpArray_mp "Array von nicht defekten DFPs welche einen ausgewählten FID verriegeln" UWORD DfpName 1 100 0.00 384.000000000 FORMAT "%13.9" ARRAY_SIZE 20 ECU_ADDRESS 0x9FEF6C /end MEASUREMENT
/begin MEASUREMENT DSC_stTstTrigger_mp "Zustand Testeranforderung an DSM Scheduler" UBYTE OneToOne 1 100 0.00 255.0 FORMAT "%5.1" ECU_ADDRESS 0x9FFA55 /end MEASUREMENT
/begin MEASUREMENT DSMDur_ctDfctDur1 "Wert Fehlerdauerzähler" UWORD OneToOne 1 100 0.00 65535.00 FORMAT "%8.2" ECU_ADDRESS 0x7F9832 /end MEASUREMENT
/begin MEASUREMENT DSMDur_ctDfctDur2 "Wert Fehlerdauerzähler 2" UWORD OneToOne 1 100 0.00 65535.00 FORMAT "%8.2" ECU_ADDRESS 0x7F9834 /end MEASUREMENT
/begin MEASUREMENT DSMDur_stGlobalDefCnt_mp "Aktivierungs und Resetzustand der beiden globalen Fehlerdauerzähler" UBYTE OneToOne 1 100 0.00 255.0 FORMAT "%5.1" ECU_ADDRESS 0x9FFDFE /end MEASUREMENT
/begin MEASUREMENT DSM_ctDfctPath "Anzahl der momentan defekten Fehlerpfade" UWORD OneToOne 1 100 0.00 65535.00 FORMAT "%8.2" ECU_ADDRESS 0x7F9836 /end MEASUREMENT
/begin MEASUREMENT DSM_ctFcmEntry "Anzahl der belegten Fehlerspeichereinträge" UBYTE OneToOne 1 100 0.00 255.0 FORMAT "%5.1" ECU_ADDRESS 0x7F9380 /end MEASUREMENT
/begin MEASUREMENT DSM_ctFCMEntrySize_mp "Größe eines Fehlerspeichereintrages in Bytes (Inklusive Füllbyte falls vorhanden)" UBYTE OneToOne 1 100 0.00 255.0 FORMAT "%5.1" ECU_ADDRESS 0x9FFDF3 /end MEASUREMENT
/begin MEASUREMENT DSM_ctOBDPath "Anzahl der momentanen OBD-fehler im Fehlerspeicher" UBYTE OneToOne 1 100 0.00 255.0 FORMAT "%5.1" ECU_ADDRESS 0x7F9381 /end MEASUREMENT
/begin MEASUREMENT DSM_ctOBDValidPath "Anzahl bestätigter OBD relevanter Fehlerspeicher Einträge." UBYTE OneToOne 1 100 0.00 255.0 FORMAT "%5.1" ECU_ADDRESS 0x7F9382 /end MEASUREMENT
/begin MEASUREMENT DSM_ctPath_mp "Anzahl der existierenden Fehlerpfade" UWORD OneToOne 1 100 0.00 65535.00 FORMAT "%8.2" ECU_ADDRESS 0x9FEF94 /end MEASUREMENT
/begin MEASUREMENT DSM_ctRdyActCyc_mp "Status für jedes Readinessbit aus dem aktuellen driving cycle" UBYTE OneToOne 1 100 0.00 255.0 FORMAT "%5.1" ECU_ADDRESS 0x7FDDE6 /end MEASUREMENT
/begin MEASUREMENT DSM_ctRdyCycCat_mp "Anzahl der für Readiness Bit Catalyst erreichten Zyklen." UWORD OneToOne 1 100 0.00 65535.00 FORMAT "%8.2" ECU_ADDRESS 0x9FEE92 /end MEASUREMENT
/begin MEASUREMENT DSM_ctRdyCycCompr_mp "Anzahl der für Readiness Bit Comprehensive Components erreichten Zyklen." UWORD OneToOne 1 100 0.00 65535.00 FORMAT "%8.2" ECU_ADDRESS 0x9FEE94 /end MEASUREMENT
/begin MEASUREMENT DSM_ctRdyCycEGR_mp "Anzahl der für Readiness Bit EGR erreichten Zyklen." UWORD OneToOne 1 100 0.00 65535.00 FORMAT "%8.2" ECU_ADDRESS 0x9FEE96 /end MEASUREMENT
/begin MEASUREMENT DSM_ctRdyCycFuel_mp "Anzahl der für Readiness Bit Fuel System erreichten Zyklen." UWORD OneToOne 1 100 0.00 65535.00 FORMAT "%8.2" ECU_ADDRESS 0x9FEE98 /end MEASUREMENT
/begin MEASUREMENT DSM_ctRdyCycMisf_mp "Anzahl der für Readiness Bit Misfire erreichten Zyklen." UWORD OneToOne 1 100 0.00 65535.00 FORMAT "%8.2" ECU_ADDRESS 0x9FEE9A /end MEASUREMENT
/begin MEASUREMENT DSM_ctRdyCycOxSenHt_mp "Anzahl erreichter Zyklen für Readiness Bit Oxygen Sensor Heater" UWORD OneToOne 1 100 0.00 65535.00 FORMAT "%8.2" ECU_ADDRESS 0x9FEE9C /end MEASUREMENT
/begin MEASUREMENT DSM_ctRdyCycOxSen_mp "Anzahl der erreichten Zyklen für Readiness Bit Oxygen Sensor" UWORD OneToOne 1 100 0.00 65535.00 FORMAT "%8.2" ECU_ADDRESS 0x9FEE9E /end MEASUREMENT
/begin MEASUREMENT DSM_ctRdyPathsCat_mp "Anzahl von Fehlerpfaden die zum Readiness Bit Catalyst gehören." UWORD OneToOne 1 100 0.00 65535.00 FORMAT "%8.2" ECU_ADDRESS 0x9FEEA0 /end MEASUREMENT
/begin MEASUREMENT DSM_ctRdyPathsCompr_mp "Anzahl von Fehlerpfaden die zum Readiness Bit Comprehensive Components gehören." UWORD OneToOne 1 100 0.00 65535.00 FORMAT "%8.2" ECU_ADDRESS 0x9FEEA2 /end MEASUREMENT
/begin MEASUREMENT DSM_ctRdyPathsEGR_mp "Anzahl von Fehlerpfaden die zum Readiness Bit EGR gehören." UWORD OneToOne 1 100 0.00 65535.00 FORMAT "%8.2" ECU_ADDRESS 0x9FEEA4 /end MEASUREMENT
/begin MEASUREMENT DSM_ctRdyPathsFuel_mp "Anzahl von Fehlerpfaden die zum Readiness Bit Fuel System gehören." UWORD OneToOne 1 100 0.00 65535.00 FORMAT "%8.2" ECU_ADDRESS 0x9FEEA6 /end MEASUREMENT
/begin MEASUREMENT DSM_ctRdyPathsMisf_mp "Anzahl von Fehlerpfaden die zum Readiness Bit Misfire gehören." UWORD OneToOne 1 100 0.00 65535.00 FORMAT "%8.2" ECU_ADDRESS 0x9FEEA8 /end MEASUREMENT
/begin MEASUREMENT DSM_ctRdyPathsOxSenHt_mp "Anzahl von Fehlerpfaden, die zum Readiness Bit Oxygen Sensor Heater gehören" UWORD OneToOne 1 100 0.00 65535.00 FORMAT "%8.2" ECU_ADDRESS 0x9FEEAA /end MEASUREMENT
/begin MEASUREMENT DSM_ctRdyPathsOxSen_mp "Anzahl der Fehlerpfade die zum Readiness Bit Oxygen Sensor gehören" UWORD OneToOne 1 100 0.00 65535.00 FORMAT "%8.2" ECU_ADDRESS 0x9FEEAC /end MEASUREMENT
/begin MEASUREMENT DSM_ctRdyTstCat_mp "Anzahl von in diesem Zyklus getesteten Fehlerpfaden die zum Readiness Bit Catalyst gehören." UWORD OneToOne 1 100 0.00 65535.00 FORMAT "%8.2" ECU_ADDRESS 0x9FEEAE /end MEASUREMENT
/begin MEASUREMENT DSM_ctRdyTstCompr_mp "Anzahl von in diesem Zyklus getesteten Fehlerpfaden die zum Readiness Bit Comprehensive Components  gehören." UWORD OneToOne 1 100 0.00 65535.00 FORMAT "%8.2" ECU_ADDRESS 0x9FEEB0 /end MEASUREMENT
/begin MEASUREMENT DSM_ctRdyTstEGR_mp "Anzahl von in diesem Zyklus getesteten Fehlerpfaden die zum Readiness Bit EGR gehören." UWORD OneToOne 1 100 0.00 65535.00 FORMAT "%8.2" ECU_ADDRESS 0x9FEEB2 /end MEASUREMENT
/begin MEASUREMENT DSM_ctRdyTstFuel_mp "Anzahl von in diesem Zyklus getesteten Fehlerpfaden die zum Readiness Bit Fuel System gehören." UWORD OneToOne 1 100 0.00 65535.00 FORMAT "%8.2" ECU_ADDRESS 0x9FEEB4 /end MEASUREMENT
/begin MEASUREMENT DSM_ctRdyTstMisf_mp "Anzahl von in diesem Zyklus getesteten Fehlerpfaden die zum Readiness Bit Misfire  gehören." UWORD OneToOne 1 100 0.00 65535.00 FORMAT "%8.2" ECU_ADDRESS 0x9FEEB6 /end MEASUREMENT
/begin MEASUREMENT DSM_ctRdyTstOxSenHt_mp "Anzahl von in diesem Zyklus getesteten Fehlerpfaden die zum Readiness Bit Oxygen Sensor Heater gehören." UWORD OneToOne 1 100 0.00 65535.00 FORMAT "%8.2" ECU_ADDRESS 0x9FEEB8 /end MEASUREMENT
/begin MEASUREMENT DSM_ctRdyTstOxSen_mp "Anzahl von in diesem Zyklus getesteten Fehlerpfaden die zum Readiness Bit Oxygen Sensor Heater gehören." UWORD OneToOne 1 100 0.00 65535.00 FORMAT "%8.2" ECU_ADDRESS 0x9FEEBA /end MEASUREMENT
/begin MEASUREMENT DSM_ctTstPath "Anzahl der getesteten Fehlerpfade" UWORD OneToOne 1 100 0.00 65535.00 FORMAT "%8.2" ECU_ADDRESS 0x7F9838 /end MEASUREMENT
/begin MEASUREMENT DSM_ctWUC "Anzahl der Warm Up Cycle seit dem letzten Fehlerspeicherlöschen  (PID $30)" UBYTE OneToOne 1 100 0.00 255.0 FORMAT "%5.1" ECU_ADDRESS 0x7FE908 /end MEASUREMENT
/begin MEASUREMENT DSM_DTR_valLoLim_mp "Messpunkt für unterer DTR Wert, der von den Überwachungsfunktionen an den DSM gemeldet wird" UWORD OneToOne 1 100 0.00 65535.00 FORMAT "%8.2" ARRAY_SIZE 18 ECU_ADDRESS 0x9FEF96 /end MEASUREMENT
/begin MEASUREMENT DSM_DTR_valTst_mp "Messpunkt für DTR-Werte, die von den Überwachungsfunktionen gemeldet werden" UWORD OneToOne 1 100 0.00 65535.00 FORMAT "%8.2" ARRAY_SIZE 18 ECU_ADDRESS 0x9FEFBA /end MEASUREMENT
/begin MEASUREMENT DSM_DTR_valUpLim_mp "Messpunkt für oberer DTR Wert, der von den Überwachungsfunktionen an den DSM gemeldet wird" UWORD OneToOne 1 100 0.00 65535.00 FORMAT "%8.2" ARRAY_SIZE 18 ECU_ADDRESS 0x9FEFDE /end MEASUREMENT
/begin MEASUREMENT DSM_FCM_mp "Fehlerspeicher" UBYTE OneToOne 1 100 0.00 255.0 FORMAT "%5.1" ARRAY_SIZE 464 ECU_ADDRESS 0x9FFA56 /end MEASUREMENT
/begin MEASUREMENT DSM_idxClr "" UBYTE OneToOne 1 100 0.00 255.0 FORMAT "%5.1" ECU_ADDRESS 0x7F9383 /end MEASUREMENT
/begin MEASUREMENT DSM_lDist "Anzahl der gefahrenen Strecke seitdem letzten Fehlerspeicherlöschen (PID $31)" UWORD OneToOne 1 100 0.00 65535.00 FORMAT "%8.2" ECU_ADDRESS 0x7FE90A /end MEASUREMENT
/begin MEASUREMENT DSM_stCycles "Status der DSM Trigger Zyklen (WUC, DC, ...)" UBYTE OneToOne 1 100 0.00 255.0 FORMAT "%5.1" ECU_ADDRESS 0x7F9384 /end MEASUREMENT
/begin MEASUREMENT DSM_stDfpBak_mp "Meßpunkt für Backup Flags" UBYTE OneToOne 1 100 0.00 255.0 FORMAT "%5.1" ECU_ADDRESS 0x9FFDF4 /end MEASUREMENT
/begin MEASUREMENT DSM_stDfpDA_mp "Meßpunkt für debounce active flag" UBYTE OneToOne 1 100 0.00 255.0 FORMAT "%5.1" ECU_ADDRESS 0x9FFDF5 /end MEASUREMENT
/begin MEASUREMENT DSM_stDfpErr_mp "Meßpunkt für Error Flags" UBYTE OneToOne 1 100 0.00 255.0 FORMAT "%5.1" ECU_ADDRESS 0x9FFDF6 /end MEASUREMENT
/begin MEASUREMENT DSM_stDfpMax_mp "Meßpunkt für Max-Error Flags" UBYTE OneToOne 1 100 0.00 255.0 FORMAT "%5.1" ECU_ADDRESS 0x9FFDF7 /end MEASUREMENT
/begin MEASUREMENT DSM_stDfpMem_mp "Meßpunkt für Memory Flags" UBYTE OneToOne 1 100 0.00 255.0 FORMAT "%5.1" ECU_ADDRESS 0x9FFDF8 /end MEASUREMENT
/begin MEASUREMENT DSM_stDfpMin_mp "Meßpunkt für Minimum Fehler Flags" UBYTE OneToOne 1 100 0.00 255.0 FORMAT "%5.1" ECU_ADDRESS 0x9FFDF9 /end MEASUREMENT
/begin MEASUREMENT DSM_stDfpNpl_mp "Meßpunkt für NPL Fehler Flags" UBYTE OneToOne 1 100 0.00 255.0 FORMAT "%5.1" ECU_ADDRESS 0x9FFDFA /end MEASUREMENT
/begin MEASUREMENT DSM_stDfpSig_mp "Meßpunkt für Signal Fehler Flag" UBYTE OneToOne 1 100 0.00 255.0 FORMAT "%5.1" ECU_ADDRESS 0x9FFDFB /end MEASUREMENT
/begin MEASUREMENT DSM_stDfpZpf_mp "Meßpunkt für ZPF-Flags" UBYTE OneToOne 1 100 0.00 255.0 FORMAT "%5.1" ECU_ADDRESS 0x9FFDFC /end MEASUREMENT
/begin MEASUREMENT DSM_stDfpZyf_mp "Meßpunkt für Zyklus Flags" UBYTE OneToOne 1 100 0.00 255.0 FORMAT "%5.1" ECU_ADDRESS 0x9FFDFD /end MEASUREMENT
/begin MEASUREMENT DSM_stECUMasterSlave "Statusinformation ob das Steuergerät ein Master- oder ein Slave-Steuergerät ist" UBYTE OneToOne 1 100 0.00 255.0 FORMAT "%5.1" ECU_ADDRESS 0x7F9385 /end MEASUREMENT
/begin MEASUREMENT DSM_stInhDelay "Status Fehlerverriegelungs Verzögerung (1 wenn mindestens 1 Verzögerung aktiv)" UBYTE OneToOne 1 100 0.00 255.0 FORMAT "%5.1" ECU_ADDRESS 0x7F9386 /end MEASUREMENT
/begin MEASUREMENT DSM_stMIL "DSM Mil Anforderungsstatus (1 = kontinuierlich, 2 blinkend)" UBYTE OneToOne 1 100 0.00 255.0 FORMAT "%5.1" ECU_ADDRESS 0x7F9387 /end MEASUREMENT
/begin MEASUREMENT DSM_stPID41 "Readiness Status für Diagnoseschnittstelle gemäß ISO/DIS 15031-6.5, PID41" ULONG OneToOne 1 100 0.00 4294967295.00 FORMAT "%13.2" ECU_ADDRESS 0x7F9DE0 /end MEASUREMENT
/begin MEASUREMENT DSM_stRdyAB "Readiness Status für Diagnoseschnittstelle gemäß SAE J1979 PID1 Byte A + B" UWORD OneToOne 1 100 0.00 65535.00 FORMAT "%8.2" ECU_ADDRESS 0x7F983A /end MEASUREMENT
/begin MEASUREMENT DSM_stRdyABCD "Werte der Readiness Bits, PID 01" ULONG OneToOne 1 100 0.00 4294967295.00 FORMAT "%13.2" ECU_ADDRESS 0x7F9DE4 /end MEASUREMENT
/begin MEASUREMENT DSM_stRdyCD "Readiness Status für Diagnoseschnittstelle gemäß SAE J1979 PID1 Byte C * D" UWORD OneToOne 1 100 0.00 65535.00 FORMAT "%8.2" ECU_ADDRESS 0x7F983C /end MEASUREMENT
/begin MEASUREMENT DSM_stRdyCheckEnable "veroderte ready-bits der dfps, die durch die Funktion DSM_SetDfpSleep ermittelt wurden" UBYTE OneToOne 1 100 0.00 255.0 FORMAT "%5.1" ECU_ADDRESS 0x7F9388 /end MEASUREMENT
/begin MEASUREMENT DSM_stSysLamp "DSM System Lampen Anforderungsstatus (1 = kontinuierlich)" UBYTE OneToOne 1 100 0.00 255.0 FORMAT "%5.1" ECU_ADDRESS 0x7F9389 /end MEASUREMENT
/begin MEASUREMENT DSM_tiDCDelay_mp "aktuelle Zeit für Driving cycle Verzögerungszeit" UWORD OneToOne 1 100 0.00 65535.00 FORMAT "%8.2" ECU_ADDRESS 0x9FF002 /end MEASUREMENT
/begin MEASUREMENT DSM_tiSinceFCMClr "Zeit seit Fehlerspeicher löschen (PID 0x4E)" UWORD OneToOne 1 100 0.00 65535.00 FORMAT "%8.2" ECU_ADDRESS 0x7FE90C /end MEASUREMENT
/begin MEASUREMENT EATSCD_swtSig "Signalquelle Umgebungstemperatur (ADC oder CAN)" UBYTE OneToOne 1 100 0.00 255.0 FORMAT "%5.1" ECU_ADDRESS 0x7F939F /end MEASUREMENT
/begin MEASUREMENT EATSCD_tAir "Umgebungstemperatur" SWORD Temp_Cels 1 100 -3549.940 3003.560 FORMAT "%8.3" ECU_ADDRESS 0x7F9842 /end MEASUREMENT
/begin MEASUREMENT EATSCD_tAirLin "linearisierter Wert der Umgebungstemperatur" SWORD Temp_Cels 1 100 -3549.940 3003.560 FORMAT "%8.3" ECU_ADDRESS 0x7F9844 /end MEASUREMENT
/begin MEASUREMENT EATSCD_uRaw "Spannungsrohwert der Umgebungstemperatur" SWORD Volt 1 100 0.00 5000.000 FORMAT "%8.3" ECU_ADDRESS 0x7F9846 /end MEASUREMENT
/begin MEASUREMENT EcoCD_stDebVal "Entprelltes Eingangssignal" UBYTE OneToOne 1 100 0.00 255.0 FORMAT "%5.1" ECU_ADDRESS 0x7F93B0 /end MEASUREMENT
/begin MEASUREMENT EcuInit_ExpEcu_u8 "Ein *( $2A) zeigt an ob es sich um ein Versuchssteuergerät handelt, ein Blank ' ' ($20) ist ein Serien SG" UBYTE OneToOne 1 100 0.00 255.0 FORMAT "%5.1" ECU_ADDRESS 0x7F93B1 /end MEASUREMENT
/begin MEASUREMENT EcuInit_HW_u8 "zeigt die Hardwareteilenummer an" UBYTE OneToOne 1 100 0.00 255.0 FORMAT "%5.1" ARRAY_SIZE 12 ECU_ADDRESS 0x7F9FF2 /end MEASUREMENT
/begin MEASUREMENT EcuInit_stProduction "Programmierstatus des SG" UBYTE OneToOne 1 100 0.00 255.0 FORMAT "%5.1" ECU_ADDRESS 0x7F93B2 /end MEASUREMENT
/begin MEASUREMENT EEPCD_stErrSet "Allgemeiner Fehlerzustand bei der Aktivierung einer Konfiguration" UBYTE OneToOne 1 100 0.00 255.0 FORMAT "%5.1" ECU_ADDRESS 0x7F93A0 /end MEASUREMENT
/begin MEASUREMENT EEPCD_stOptErrCodKwp "Fehlercode der Option, in der beim Download (KWP) ein Fehler auftrat" UBYTE OneToOne 1 100 0.00 255.0 FORMAT "%5.1" ECU_ADDRESS 0x7F93A1 /end MEASUREMENT
/begin MEASUREMENT EEPCD_stOptErrCodSet "Fehlercode der Option, in der während der Aktivierung der neuen Konfiguration ein Fehler auftrat" UBYTE OneToOne 1 100 0.00 255.0 FORMAT "%5.1" ECU_ADDRESS 0x7F93A2 /end MEASUREMENT
/begin MEASUREMENT EEPCD_stOptNumKwp "Nummer der Option, in der beim Download (KWP) ein Fehler auftrat" UBYTE OneToOne 1 100 0.00 255.0 FORMAT "%5.1" ECU_ADDRESS 0x7F93A3 /end MEASUREMENT
/begin MEASUREMENT EEPCD_stOptNumSet "Nummer der Option, in der während der Aktivierung der neuen Konfiguration ein Fehler auftrat" UBYTE OneToOne 1 100 0.00 255.0 FORMAT "%5.1" ECU_ADDRESS 0x7F93A4 /end MEASUREMENT
/begin MEASUREMENT EepDev_dBlockVal_mp "Mepßunkt der Anzeige eines gelesenen bzw. geschriebenen Blockinhaltes (max. 100 Byte)" ULONG OneToOne 1 100 0.00 4294967295.00 FORMAT "%13.2" ARRAY_SIZE 25 ECU_ADDRESS 0x7FB700 /end MEASUREMENT
/begin MEASUREMENT EepDev_stLastJob_mp "Status des letzten Lese- bzw. Schreibauftrages" UWORD OneToOne 1 100 0.00 65535.00 FORMAT "%8.2" ECU_ADDRESS 0x7FB7EC /end MEASUREMENT
/begin MEASUREMENT EepInit_stFrstInit "Markierung für ECU Erstinitialisierung" UBYTE OneToOne 1 100 0.00 255.0 FORMAT "%5.1" ECU_ADDRESS 0x7F93B3 /end MEASUREMENT
/begin MEASUREMENT EGPpCD_tLinPreTrbn "Linearisierter Wert der Abgastemperatur vor Abgasturbolader" SWORD Temp_Cels 1 100 -3549.940 3003.560 FORMAT "%8.3" ECU_ADDRESS 0x7F9848 /end MEASUREMENT
/begin MEASUREMENT EGPpCD_tPreTrbn "Abgastemperatur vor Abgasturbolader" SWORD Temp_Cels 1 100 -3549.940 3003.560 FORMAT "%8.3" ECU_ADDRESS 0x7F984A /end MEASUREMENT
/begin MEASUREMENT EGPpCD_tPreTrbn1 "Abgastemperatur vor Abgasturbolader 1" SWORD Temp_Cels 1 100 -3549.940 3003.560 FORMAT "%8.3" ECU_ADDRESS 0x7F984C /end MEASUREMENT
/begin MEASUREMENT EGPpCD_tPreTrbn2 "Abgastemperatur vor Turbolader 2" SWORD Temp_Cels 1 100 -3549.940 3003.560 FORMAT "%8.3" ECU_ADDRESS 0x7F984E /end MEASUREMENT
/begin MEASUREMENT EGPpCD_uRawTempPreTrbn "Spannungsrohwert der Abgastemperatur vor Abgasturbolader" SWORD Volt 1 100 0.00 5000.000 FORMAT "%8.3" ECU_ADDRESS 0x7F9850 /end MEASUREMENT
/begin MEASUREMENT EGPpCD_uRawTempPreTrbnFast "Abgastemperatur vor Turbolader Spannungsarray 20 ms" SWORD Volt 1 100 -160156.4 160151.5 FORMAT "%8.1" ARRAY_SIZE 5 ECU_ADDRESS 0x7F9FCA /end MEASUREMENT
/begin MEASUREMENT EGPpCD_uRawTempPreTrbnInt_mp "Messpunkt fuer gefilterte Spannung des 20 ms EGPpCD" SWORD Volt 1 100 -160156.4 160151.5 FORMAT "%8.1" ECU_ADDRESS 0x9FF054 /end MEASUREMENT
/begin MEASUREMENT EGPpCD_uRawTempPreTrbnSlow "Abgastemperatur vor Turbolader Spannungsarray 100 ms" SWORD Volt 1 100 -160156.4 160151.5 FORMAT "%8.1" ARRAY_SIZE 5 ECU_ADDRESS 0x7F9FD4 /end MEASUREMENT
/begin MEASUREMENT EGPpCD_uRawTempPreTrbnUnFlt_mp "Messpunkt fuer ungefilterte Sannung des 20 ms EGPpCD" SWORD Volt 1 100 -160156.4 160151.5 FORMAT "%8.1" ECU_ADDRESS 0x9FF056 /end MEASUREMENT
/begin MEASUREMENT EGPpCD_uRawTempPreTrbn_mp "Spannungsrohwert der Abgastemperatur vor Abgasturbolader[mv]" SWORD Volt 1 100 -160156.4 160151.5 FORMAT "%8.1" ECU_ADDRESS 0x9FF058 /end MEASUREMENT
/begin MEASUREMENT EGPp_dmEG_mp "Abgasmassenstrom" SWORD AirMassPerTime 1 100 -3276.800 3276.700 FORMAT "%8.3" ECU_ADDRESS 0x9FF046 /end MEASUREMENT
/begin MEASUREMENT EGPp_dvolSilBnk_mp "Abgasvolumenstrom nach Partikelfilter" SWORD CubMtrPerHr 1 100 -3276.800 3276.700 FORMAT "%8.3" ECU_ADDRESS 0x9FF048 /end MEASUREMENT
/begin MEASUREMENT EGPp_dvolSil_mp "Abgasvolumenstrom nach Partikelfilter" SWORD CubMtrPerHr 1 100 -3276.800 3276.700 FORMAT "%8.3" ECU_ADDRESS 0x9FF04A /end MEASUREMENT
/begin MEASUREMENT EGPp_pPstPFlt "Druckabfall des Abgassystems nach Partikelfilter" SWORD Pres_hPa 1 100 -32768.00 32767.00 FORMAT "%8.2" ECU_ADDRESS 0x7F9852 /end MEASUREMENT
/begin MEASUREMENT EGPp_pPstPFltMap_mp "Druckabfall nach Partikelfilter aus Kennfeldberechnung" SWORD Pres_hPa 1 100 -32768.00 32767.00 FORMAT "%8.2" ECU_ADDRESS 0x9FF04C /end MEASUREMENT
/begin MEASUREMENT EGPp_pPstPFltSim_mp "Druckabfall nach Partikelfilter aus Simulation" SWORD Pres_hPa 1 100 -32768.00 32767.00 FORMAT "%8.2" ECU_ADDRESS 0x9FF04E /end MEASUREMENT
/begin MEASUREMENT EGPp_tPstSimBnk_mp "Simulierte Temperatur nach Partikelfilter" SWORD Temp_Cels 1 100 -3549.940 3003.560 FORMAT "%8.3" ECU_ADDRESS 0x9FF050 /end MEASUREMENT
/begin MEASUREMENT EGPp_tSurf_mp "Oberflächen Temperatur vom Partikel Filter" SWORD Temp_Cels 1 100 -3549.940 3003.560 FORMAT "%8.3" ECU_ADDRESS 0x9FF052 /end MEASUREMENT
/begin MEASUREMENT EGRCD_facCorFlt_mp "PT1-gefilterter Batteriespannungskorrekturwert" SWORD Fact 1 100 -4.000000 3.999878 FORMAT "%8.6" ECU_ADDRESS 0x9FF05A /end MEASUREMENT
/begin MEASUREMENT EGRCD_rOut "Tastverhältnis zur Ansteuerung des AGR-Ventils" SWORD DtyCyc 1 100 -327.6800 327.6700 FORMAT "%8.4" ECU_ADDRESS 0x7F9854 /end MEASUREMENT
/begin MEASUREMENT EGRCD_rOutByp_mp "Meßpunkt für Bypass Freischnitt" SWORD DtyCyc 1 100 -327.6800 327.6700 FORMAT "%8.4" ECU_ADDRESS 0x9FF05C /end MEASUREMENT
/begin MEASUREMENT EGRCD_stCBVOutHWE_mp "Ausgabewert nach Fehlerbehandlung" SWORD OneToOne 1 100 -32768.00 32767.00 FORMAT "%8.2" ECU_ADDRESS 0x7FDDE8 /end MEASUREMENT
/begin MEASUREMENT EGRCD_stFlag_mp "Fehlerzustandsflag für das Signal der AGR-Endstufe" UBYTE OneToOne 1 100 0.00 255.0 FORMAT "%5.1" ECU_ADDRESS 0x9FFDFF /end MEASUREMENT
/begin MEASUREMENT EGRCD_stSignOut "Vorzeichen des ausgegebenen Tastverhältnisses" UBYTE OneToOne 1 100 0.00 255.0 FORMAT "%5.1" ECU_ADDRESS 0x7F93A5 /end MEASUREMENT
/begin MEASUREMENT EGRCD_swtPwrStgDfl_mp "Schalter zur Aktivierung des Vorgabewertes" UBYTE OneToOne 1 100 0.00 255.0 FORMAT "%5.1" ECU_ADDRESS 0x9FFE00 /end MEASUREMENT
/begin MEASUREMENT EGRCD_swtPwrStgOff_mp "Schalter zur Endstufenabschaltung" UBYTE OneToOne 1 100 0.00 255.0 FORMAT "%5.1" ECU_ADDRESS 0x9FFE01 /end MEASUREMENT
/begin MEASUREMENT EGRSCD_ctAdaptCls_mp "Anzahl der Zyklen von Offset-Lernen" UBYTE OneToOne 1 100 0.00 255.0 FORMAT "%5.1" ECU_ADDRESS 0x9FFE02 /end MEASUREMENT
/begin MEASUREMENT EGRSCD_rAdaptLrnMax_mp "Maximaler Wert von Offset-Learning" SWORD DtyCyc 1 100 -327.6800 327.6700 FORMAT "%8.4" ECU_ADDRESS 0x9FF05E /end MEASUREMENT
/begin MEASUREMENT EGRSCD_rAdaptLrnMin_mp "Minimaler Wert von Offset-Learning" SWORD DtyCyc 1 100 -327.6800 327.6700 FORMAT "%8.4" ECU_ADDRESS 0x9FF060 /end MEASUREMENT
/begin MEASUREMENT EGRSCD_rAdaptLrn_mp "Lernen des Anpassungswertes" SWORD DtyCyc 1 100 -327.6800 327.6700 FORMAT "%8.4" ECU_ADDRESS 0x9FF062 /end MEASUREMENT
/begin MEASUREMENT EGRSCD_rAdaptPos_mp "Stellung des Nullpunkts" SWORD DtyCyc 1 100 -327.6800 327.6700 FORMAT "%8.4" ECU_ADDRESS 0x9FF064 /end MEASUREMENT
/begin MEASUREMENT EGRSCD_rLin "Linearisierter Wert des AGR-Sensorsignals" SWORD DtyCyc 1 100 -327.6800 327.6700 FORMAT "%8.4" ECU_ADDRESS 0x7F9856 /end MEASUREMENT
/begin MEASUREMENT EGRSCD_rLinOfs_mp "Offset-korrigierter Ausgang" SWORD DtyCyc 1 100 -327.6800 327.6700 FORMAT "%8.4" ECU_ADDRESS 0x9FF066 /end MEASUREMENT
/begin MEASUREMENT EGRSCD_rOfsLrnFrst "Zuerst gelernter Offsetwert" SWORD DtyCyc 1 100 -327.6800 327.6700 FORMAT "%8.4" ECU_ADDRESS 0x7F9858 /end MEASUREMENT
/begin MEASUREMENT EGRSCD_rOfsLrnLst "Zuletzt gelernter Offsetwert" SWORD DtyCyc 1 100 -327.6800 327.6700 FORMAT "%8.4" ECU_ADDRESS 0x7F985A /end MEASUREMENT
/begin MEASUREMENT EGRSCD_rOfsLrnNew "Neuer Anpassungswert" SWORD DtyCyc 1 100 -327.6800 327.6700 FORMAT "%8.4" ECU_ADDRESS 0x7F985C /end MEASUREMENT
/begin MEASUREMENT EGRSCD_rOfsLrnVlv "Offset-Lernwert des EGR-Stellers" SWORD DtyCyc 1 100 -327.6800 327.6700 FORMAT "%8.4" ECU_ADDRESS 0x7F985E /end MEASUREMENT
/begin MEASUREMENT EGRSCD_rPlausLgTime_mp "Langzeitdrift-Plausibilitätswert" SWORD DtyCyc 1 100 -327.6800 327.6700 FORMAT "%8.4" ECU_ADDRESS 0x9FF068 /end MEASUREMENT
/begin MEASUREMENT EGRSCD_rPlausShTime_mp "Kurzzeitdrift-Plausibilitätswert" SWORD DtyCyc 1 100 -327.6800 327.6700 FORMAT "%8.4" ECU_ADDRESS 0x9FF06A /end MEASUREMENT
/begin MEASUREMENT EGRSCD_rPlausVal_mp "Plausibilitätswert" SWORD DtyCyc 1 100 -327.6800 327.6700 FORMAT "%8.4" ECU_ADDRESS 0x9FF06C /end MEASUREMENT
/begin MEASUREMENT EGRSCD_rPosRef_mp "Referenzstellung der Klappe" SWORD DtyCyc 1 100 -327.6800 327.6700 FORMAT "%8.4" ECU_ADDRESS 0x9FF06E /end MEASUREMENT
/begin MEASUREMENT EGRSCD_rPullDwnVal_mp "Integratorreaktion / Integratoransprechen" SWORD DtyCyc 1 100 -327.6800 327.6700 FORMAT "%8.4" ECU_ADDRESS 0x9FF070 /end MEASUREMENT
/begin MEASUREMENT EGRSCD_rRelPos "relative Offset-korrigierte Position des Abgasrückführventils" SWORD DtyCyc 1 100 -327.6800 327.6700 FORMAT "%8.4" ECU_ADDRESS 0x7F9860 /end MEASUREMENT
/begin MEASUREMENT EGRSCD_rRelPosNoErrHdl "EGR Ventil Position mit Offsetkorrektur aber ohne Fehlerbehandlung" SWORD DtyCyc 1 100 -327.6800 327.6700 FORMAT "%8.4" ECU_ADDRESS 0x7F9862 /end MEASUREMENT
/begin MEASUREMENT EGRSCD_rRelPosOfs_mp "Aktueller Offsetwert" SWORD DtyCyc 1 100 -327.6800 327.6700 FORMAT "%8.4" ECU_ADDRESS 0x9FF072 /end MEASUREMENT
/begin MEASUREMENT EGRSCD_rRelPosOld_mp "Referenzstellung der Klappe" SWORD DtyCyc 1 100 -327.6800 327.6700 FORMAT "%8.4" ECU_ADDRESS 0x9FF074 /end MEASUREMENT
/begin MEASUREMENT EGRSCD_rRelPos_mp "Flüchtiges Ansprechen / Transienter Antwort" SWORD DtyCyc 1 100 -327.6800 327.6700 FORMAT "%8.4" ECU_ADDRESS 0x9FF076 /end MEASUREMENT
/begin MEASUREMENT EGRSCD_rSum_mp "Aufsummierter Anpassungswert" SWORD DtyCyc 1 100 -327.6800 327.6700 FORMAT "%8.4" ECU_ADDRESS 0x9FF078 /end MEASUREMENT
/begin MEASUREMENT EGRSCD_rTmpOfs "Temporärer Offset des EEGR-Ventils" SWORD DtyCyc 1 100 -327.6800 327.6700 FORMAT "%8.4" ECU_ADDRESS 0x7F9864 /end MEASUREMENT
/begin MEASUREMENT EGRSCD_stAdapt "Status des Nullpunktslernens im Nachlauf" UWORD OneToOne 1 100 0.00 65535.00 FORMAT "%8.2" ECU_ADDRESS 0x7F9866 /end MEASUREMENT
/begin MEASUREMENT EGRSCD_stAdaptActv_mp "Anpassung aktiv" UBYTE OneToOne 1 100 0.00 255.0 FORMAT "%5.1" ECU_ADDRESS 0x9FFE03 /end MEASUREMENT
/begin MEASUREMENT EGRSCD_stAdaptVlv_mp "Geschlossener Zustand des Ventils" UBYTE OneToOne 1 100 0.00 255.0 FORMAT "%5.1" ECU_ADDRESS 0x9FFE04 /end MEASUREMENT
/begin MEASUREMENT EGRSCD_stEdgeOpn_mp "Geöffneter Zustand des Ventils nach dem ersten Öffnen" UBYTE OneToOne 1 100 0.00 255.0 FORMAT "%5.1" ECU_ADDRESS 0x9FFE05 /end MEASUREMENT
/begin MEASUREMENT EGRSCD_stFrstOpn_mp "Zustand des ersten Öffnens von dem Ventil" UBYTE OneToOne 1 100 0.00 255.0 FORMAT "%5.1" ECU_ADDRESS 0x9FFE06 /end MEASUREMENT
/begin MEASUREMENT EGRSCD_stInitOpnBnd_mp "Initialisierungszustand des Integrators zum Öffnen der Klappe" UBYTE OneToOne 1 100 0.00 255.0 FORMAT "%5.1" ECU_ADDRESS 0x9FFE07 /end MEASUREMENT
/begin MEASUREMENT EGRSCD_stMovFin_mp "Überschreiten von dem maximalen Wert durch den Anpassungszähler" UBYTE OneToOne 1 100 0.00 255.0 FORMAT "%5.1" ECU_ADDRESS 0x9FFE08 /end MEASUREMENT
/begin MEASUREMENT EGRSCD_stNewVlvTrg_mp "Ventiltrigger zum Offsetlernen" UBYTE OneToOne 1 100 0.00 255.0 FORMAT "%5.1" ECU_ADDRESS 0x9FFE09 /end MEASUREMENT
/begin MEASUREMENT EGRSCD_stOfsLrn "Stabiler Anpassungszustand" UBYTE OneToOne 1 100 0.00 255.0 FORMAT "%5.1" ECU_ADDRESS 0x7F93A6 /end MEASUREMENT
/begin MEASUREMENT EGRSCD_stOfsLrnStMch_mp "Zustand der geschlossenen Klappe" UBYTE OneToOne 1 100 0.00 255.0 FORMAT "%5.1" ECU_ADDRESS 0x9FFE0A /end MEASUREMENT
/begin MEASUREMENT EGRSCD_stOfsLrnStrt "Offset Anlern Start des Positionssensors vom Tester" UBYTE OneToOne 1 100 0.00 255.0 FORMAT "%5.1" ECU_ADDRESS 0x7F93A7 /end MEASUREMENT
/begin MEASUREMENT EGRSCD_stPullDwnBuf_mp "Untentprellter Zustand der Anpassung" UBYTE OneToOne 1 100 0.00 255.0 FORMAT "%5.1" ECU_ADDRESS 0x9FFE0B /end MEASUREMENT
/begin MEASUREMENT EGRSCD_stStrStMch_mp "Zustand der geschlossenen Klappe" UBYTE OneToOne 1 100 0.00 255.0 FORMAT "%5.1" ECU_ADDRESS 0x9FFE0C /end MEASUREMENT
/begin MEASUREMENT EGRSCD_stStr_mp "Zustand der Speicherung des Stellungswerts" UBYTE OneToOne 1 100 0.00 255.0 FORMAT "%5.1" ECU_ADDRESS 0x9FFE0D /end MEASUREMENT
/begin MEASUREMENT EGRSCD_stTimePullDwn_mp "Entprellter Zustand der Anpassung" UBYTE OneToOne 1 100 0.00 255.0 FORMAT "%5.1" ECU_ADDRESS 0x9FFE0E /end MEASUREMENT
/begin MEASUREMENT EGRSCD_stTrg_mp "Trigger-Zustand für Zustandsübergänge" UBYTE OneToOne 1 100 0.00 255.0 FORMAT "%5.1" ECU_ADDRESS 0x9FFE0F /end MEASUREMENT
/begin MEASUREMENT EGRSCD_stVlvClsBuf_mp "Geschlossener Zustand des Ventils" UBYTE OneToOne 1 100 0.00 255.0 FORMAT "%5.1" ECU_ADDRESS 0x9FFE10 /end MEASUREMENT
/begin MEASUREMENT EGRSCD_stVlvClsd_mp "Zustand der geschlossenen Klappe" UBYTE OneToOne 1 100 0.00 255.0 FORMAT "%5.1" ECU_ADDRESS 0x9FFE11 /end MEASUREMENT
/begin MEASUREMENT EGRSCD_stVlvDiff_mp "Zustand der Bewegung des Ventils" UBYTE OneToOne 1 100 0.00 255.0 FORMAT "%5.1" ECU_ADDRESS 0x9FFE12 /end MEASUREMENT
/begin MEASUREMENT EGRSCD_stVlvJamBuf_mp "Verklemmter Zustand der Klappe" UBYTE OneToOne 1 100 0.00 255.0 FORMAT "%5.1" ECU_ADDRESS 0x9FFE13 /end MEASUREMENT
/begin MEASUREMENT EGRSCD_stVlvOpnBuf_mp "Geöffnete Zustand der Klappe" UBYTE OneToOne 1 100 0.00 255.0 FORMAT "%5.1" ECU_ADDRESS 0x9FFE14 /end MEASUREMENT
/begin MEASUREMENT EGRSCD_stVlvStkCls_mp "Zustand des verklemmten Ventils bei geschlossenem Zustand" UBYTE OneToOne 1 100 0.00 255.0 FORMAT "%5.1" ECU_ADDRESS 0x9FFE15 /end MEASUREMENT
/begin MEASUREMENT EGRSCD_stVlvStk_mp "Status der verklemmten Klappe" UBYTE OneToOne 1 100 0.00 255.0 FORMAT "%5.1" ECU_ADDRESS 0x9FFE16 /end MEASUREMENT
/begin MEASUREMENT EGRSCD_stZrPntAdaptRls_mp "Reset-Zustand des Zustandsautomaten" UBYTE OneToOne 1 100 0.00 255.0 FORMAT "%5.1" ECU_ADDRESS 0x9FFE17 /end MEASUREMENT
/begin MEASUREMENT EGRSCD_uRaw "Rohwert der Batteriespannung zur Freigabe der Nullpunktadaption" SWORD Volt 1 100 -160156.4 160151.5 FORMAT "%8.1" ECU_ADDRESS 0x7F9868 /end MEASUREMENT
/begin MEASUREMENT EGRVlv_drRelPos_mp "Geschwindigkeit des ARF-Ventils" SWORD DtyCyc 1 100 -327.6800 327.6700 FORMAT "%8.4" ECU_ADDRESS 0x9FF07C /end MEASUREMENT
/begin MEASUREMENT EGRVlv_iEffFlt_mp "gemittelter Effektivstrom" SWORD Curr_A 1 100 -327.6800 327.6700 FORMAT "%8.4" ECU_ADDRESS 0x9FF07E /end MEASUREMENT
/begin MEASUREMENT EGRVlv_iEff_mp "modellierter Effektivstrom" SWORD Curr_A 1 100 -327.6800 327.6700 FORMAT "%8.4" ECU_ADDRESS 0x9FF080 /end MEASUREMENT
/begin MEASUREMENT EGRVlv_numLckdDet "Anzahl der Abtastungen seit konstanter Regelabweichung im mechanischen Anschlag" UBYTE OneToOne 1 100 0.00 255.0 FORMAT "%5.1" ECU_ADDRESS 0x7F93A8 /end MEASUREMENT
/begin MEASUREMENT EGRVlv_rAbsEGRCorr_mp "batteriekorrigierter Absolutwert des Ansteuertastverhältnisses des AGR Ventils" SWORD DtyCyc 1 100 -327.6800 327.6700 FORMAT "%8.4" ECU_ADDRESS 0x9FF082 /end MEASUREMENT
/begin MEASUREMENT EGRVlv_rDesVal "Lagesollwert des ARF-Ventils" SWORD DtyCyc 1 100 -327.6800 327.6700 FORMAT "%8.4" ECU_ADDRESS 0x7F986A /end MEASUREMENT
/begin MEASUREMENT EGRVlv_rEGR "Ansteuertastverhältnis für ARF-Ventil" SWORD DtyCyc 1 100 -327.6800 327.6700 FORMAT "%8.4" ECU_ADDRESS 0x7F986C /end MEASUREMENT
/begin MEASUREMENT EGRVlv_rEGRByp_mp "Bypass-Label, Kopie von EGRVlv_rEGR" SWORD Prc 1 100 -327.6800 327.6700 FORMAT "%8.4" ECU_ADDRESS 0x9FF084 /end MEASUREMENT
/begin MEASUREMENT EGRVlv_rGvnrDvt "Regelabweichung des Lagereglers" SWORD DtyCyc 1 100 -327.6800 327.6700 FORMAT "%8.4" ECU_ADDRESS 0x7F986E /end MEASUREMENT
/begin MEASUREMENT EGRVlv_rGvnrDvtRel "Relative EGR - Ventil Regelabweichung" SWORD Prc 1 100 -327.6800 327.6700 FORMAT "%8.4" ECU_ADDRESS 0x7F9870 /end MEASUREMENT
/begin MEASUREMENT EGRVlv_rGvnrEGR "Stellgröße des Lagereglers" SWORD DtyCyc 1 100 -327.6800 327.6700 FORMAT "%8.4" ECU_ADDRESS 0x7F9872 /end MEASUREMENT
/begin MEASUREMENT EGRVlv_rGvnrMax_mp "oberer Grenzwert des Sollwerts des Lagereglers" SWORD DtyCyc 1 100 -327.6800 327.6700 FORMAT "%8.4" ECU_ADDRESS 0x9FF086 /end MEASUREMENT
/begin MEASUREMENT EGRVlv_rGvnrMin_mp "unterer Grenzwert der Stellgröße des Lagereglers" SWORD DtyCyc 1 100 -327.6800 327.6700 FORMAT "%8.4" ECU_ADDRESS 0x9FF088 /end MEASUREMENT
/begin MEASUREMENT EGRVlv_rOutD_mp "Ausgang des D-Anteils des Reglers [%]" SWORD DtyCyc 1 100 -327.6800 327.6700 FORMAT "%8.4" ECU_ADDRESS 0x9FF08A /end MEASUREMENT
/begin MEASUREMENT EGRVlv_rOutI_mp "Ausgang des I-Anteils des Reglers [%]" SWORD DtyCyc 1 100 -327.6800 327.6700 FORMAT "%8.4" ECU_ADDRESS 0x9FF08C /end MEASUREMENT
/begin MEASUREMENT EGRVlv_rOutP_mp "Ausgang des P-Anteils des Reglers [%]" SWORD DtyCyc 1 100 -327.6800 327.6700 FORMAT "%8.4" ECU_ADDRESS 0x9FF08E /end MEASUREMENT
/begin MEASUREMENT EGRVlv_rPullDwnEGR "Ansteuertastverhältnis des Pull-Down-Integrators" SWORD DtyCyc 1 100 -327.6800 327.6700 FORMAT "%8.4" ECU_ADDRESS 0x7F9874 /end MEASUREMENT
/begin MEASUREMENT EGRVlv_rRlsEGR "Ansteuertastverhältnis der Losreißfunktion" SWORD DtyCyc 1 100 -327.6800 327.6700 FORMAT "%8.4" ECU_ADDRESS 0x7F9876 /end MEASUREMENT
/begin MEASUREMENT EGRVlv_stGvnrByp "Status der Umgehung des Lagereglers" UBYTE OneToOne 1 100 0.00 255.0 FORMAT "%5.1" ECU_ADDRESS 0x7F93A9 /end MEASUREMENT
/begin MEASUREMENT EGRVlv_stMon "Stauts der Systemüberwachung" UWORD OneToOne 1 100 0.00 65535.00 FORMAT "%8.2" ECU_ADDRESS 0x7F9878 /end MEASUREMENT
/begin MEASUREMENT EGRVlv_stSlwCls_mp "Status für aktivierte Parameter für langsames Schließen" UBYTE OneToOne 1 100 0.00 255.0 FORMAT "%5.1" ECU_ADDRESS 0x9FFE18 /end MEASUREMENT
/begin MEASUREMENT EGRVlv_tEngMon_mp "selektierte Motortemperatur fuer EGR-Ueberwachung" SWORD Temp_Cels 1 100 -3549.940 3003.560 FORMAT "%8.3" ECU_ADDRESS 0x9FF07A /end MEASUREMENT
/begin MEASUREMENT EGSys_AlpEGTube_mp "Wärmeübertragungskoeffizient zwischen Abgas und Abgasrohr" SWORD ThermalCoEff 1 100 -3276.800 3276.700 FORMAT "%8.3" ARRAY_SIZE 4 ECU_ADDRESS 0x9FF15C /end MEASUREMENT
/begin MEASUREMENT EGSys_AlpOxiCat_mp "Wärmeübertragungskoeffizient des OxiCat" SWORD ThermalCoEff 1 100 -3276.800 3276.700 FORMAT "%8.3" ECU_ADDRESS 0x9FF10E /end MEASUREMENT
/begin MEASUREMENT EGSys_AlpTubeEnv_mp "Wärmeübertragungskoeffizient zwischen Abgasrohr und Umgebung" SWORD ThermalCoEff 1 100 -3276.800 3276.700 FORMAT "%8.3" ARRAY_SIZE 4 ECU_ADDRESS 0x9FF164 /end MEASUREMENT
/begin MEASUREMENT EGSys_cndHtEGi_mp "Wärmeleitfähigkeit Abgas im Rohr" SWORD Fact 1 100 -4.000000 3.999878 FORMAT "%8.6" ARRAY_SIZE 4 ECU_ADDRESS 0x9FF16C /end MEASUREMENT
/begin MEASUREMENT EGSys_cndHtEGo_mp "Wärmeleitfähigkeit Luft ausserhalb des Rohres" SWORD Fact 1 100 -4.000000 3.999878 FORMAT "%8.6" ARRAY_SIZE 4 ECU_ADDRESS 0x9FF174 /end MEASUREMENT
/begin MEASUREMENT EGSys_cpEGLSU_mp "Spezifische Wärmekapazität des Abgases" SWORD SpecificHeat 1 100 -3.276800 3.276700 FORMAT "%8.6" ARRAY_SIZE 1 ECU_ADDRESS 0x9FF090 /end MEASUREMENT
/begin MEASUREMENT EGSys_cpEGNSC_mp "Spezifische Wärmekapazität Abgas im NSC" SWORD SpecificHeat 1 100 -3.276800 3.276700 FORMAT "%8.6" ECU_ADDRESS 0x9FF106 /end MEASUREMENT
/begin MEASUREMENT EGSys_cpEGOxiCatBrik "Spezifische Wärmekapazität Abgas im Oxidationskatalysator" SWORD SpecificHeat 1 100 -3.276800 3.276700 FORMAT "%8.6" ECU_ADDRESS 0x7F987A /end MEASUREMENT
/begin MEASUREMENT EGSys_cpEGOxiCatBrik_mp "Spezifische Wärmekapazität des OxiCat" SWORD SpecificHeat 1 100 -3.276800 3.276700 FORMAT "%8.6" ARRAY_SIZE 2 ECU_ADDRESS 0x9FF110 /end MEASUREMENT
/begin MEASUREMENT EGSys_cpEGOxiCat_mp "Spezifische Wärmekapazität Abgas im Oxidationskatalysator" SWORD SpecificHeat 1 100 -3.276800 3.276700 FORMAT "%8.6" ECU_ADDRESS 0x9FF124 /end MEASUREMENT
/begin MEASUREMENT EGSys_cpEGTrbn_mp "Spezifische Wärmekapazität Abgas in Turbine" SWORD SpecificHeat 1 100 -3.276800 3.276700 FORMAT "%8.6" ARRAY_SIZE 2 ECU_ADDRESS 0x9FF14A /end MEASUREMENT
/begin MEASUREMENT EGSys_cpEGTube_mp "Spezifsche Wärmekapazität Abgas im Abgasrohr" SWORD SpecificHeat 1 100 -3.276800 3.276700 FORMAT "%8.6" ARRAY_SIZE 4 ECU_ADDRESS 0x9FF17C /end MEASUREMENT
/begin MEASUREMENT EGSys_ctCldStrtLSU_mp "Zähler für wiederholte Kaltstarts" UBYTE OneToOne 1 100 0.00 255.0 FORMAT "%5.1" ARRAY_SIZE 1 ECU_ADDRESS 0x9FFE19 /end MEASUREMENT
/begin MEASUREMENT EGSys_ctPlsLSUSrvTst_mp "Anzeige Gasstosszähler im Servicetest-Modus" UBYTE OneToOne 1 100 0.00 255.0 FORMAT "%5.1" ARRAY_SIZE 1 ECU_ADDRESS 0x9FFE1A /end MEASUREMENT
/begin MEASUREMENT EGSys_dmEG "näherungsweiser Abgasmassenstrom" SWORD AirMassPerTime 1 100 -3276.800 3276.700 FORMAT "%8.3" ECU_ADDRESS 0x7F987C /end MEASUREMENT
/begin MEASUREMENT EGSys_dmExhGas2_mp "Abgasmassenstrom rechtes System" SWORD AirMassPerTime 1 100 -3276.800 3276.700 FORMAT "%8.3" ECU_ADDRESS 0x9FF0A0 /end MEASUREMENT
/begin MEASUREMENT EGSys_dmExhGas_mp "Abgasmassenstrom linkes System" SWORD AirMassPerTime 1 100 -3276.800 3276.700 FORMAT "%8.3" ECU_ADDRESS 0x9FF0A6 /end MEASUREMENT
/begin MEASUREMENT EGSys_dmHCCldStrt_mp "HC Massenstrom bei Kaltstart" SWORD InjMassPerTimeHigh 1 100 -32.76800 32.76700 FORMAT "%8.5" ECU_ADDRESS 0x9FF0E0 /end MEASUREMENT
/begin MEASUREMENT EGSys_dmHCCor_mp "HC-Massenkorrektur wegen Nacheinspritzung 2 im Schub" SWORD InjMassPerTimeHigh 1 100 -32.76800 32.76700 FORMAT "%8.5" ECU_ADDRESS 0x9FF0E2 /end MEASUREMENT
/begin MEASUREMENT EGSys_dmHCCtlOxiCat_mp "HC Massenstrom bei OxiCat während HCI" SWORD InjMassPerTimeHigh 1 100 -32.76800 32.76700 FORMAT "%8.5" ECU_ADDRESS 0x9FF0E4 /end MEASUREMENT
/begin MEASUREMENT EGSys_dmHCEngOpGvnr_mp "HC Massenstrom mit Temperaturregler in Abhängigkeit vom Betriebspunkt" SWORD InjMassPerTimeHigh 1 100 -32.76800 32.76700 FORMAT "%8.5" ECU_ADDRESS 0x9FF0E6 /end MEASUREMENT
/begin MEASUREMENT EGSys_dmHCOxiCat "HC Massenstrom am Eingang des OxiCat" SWORD InjMassPerTimeHigh 1 100 -32.76800 32.76700 FORMAT "%8.5" ECU_ADDRESS 0x7F987E /end MEASUREMENT
/begin MEASUREMENT EGSys_dtOxiCatSurf_mp "Änderung der OxiCat-Oberflächentemperatur [K]" SWORD Temp_Kelv_Sec 1 100 -327.6800 327.6700 FORMAT "%8.4" ARRAY_SIZE 2 ECU_ADDRESS 0x9FF114 /end MEASUREMENT
/begin MEASUREMENT EGSys_dtOxiCat_mp "Änderung des OxiCat-Temperaturaustritts [K]" SWORD Temp_Kelv_Sec 1 100 -327.6800 327.6700 FORMAT "%8.4" ARRAY_SIZE 2 ECU_ADDRESS 0x9FF118 /end MEASUREMENT
/begin MEASUREMENT EGSys_dtTube_mp "Temperaturänderung Abgasrohr" SWORD Temp_Kelv_Sec 1 100 -327.6800 327.6700 FORMAT "%8.4" ARRAY_SIZE 4 ECU_ADDRESS 0x9FF184 /end MEASUREMENT
/begin MEASUREMENT EGSys_dwEnvOxiCat "Wärmefluss vom modelierten OxiCat zur umgebung" SLONG Pwr1 1 100 -214748364.800 214748364.700 FORMAT "%13.3" ECU_ADDRESS 0x7F9DEC /end MEASUREMENT
/begin MEASUREMENT EGSys_dwEnvOxiCatOut "Wärmeaustausch des modellierten Oxicats mit der Umgebung [w]" SLONG Pwr1 1 100 -214748364.800 214748364.700 FORMAT "%13.3" ECU_ADDRESS 0x7F9DF0 /end MEASUREMENT
/begin MEASUREMENT EGSys_dwEnvOxiCatSurf "Wärmeaustausch mit der Umgebung für die OxiCat-Oberflächentemperatur" SLONG Pwr1 1 100 -214748364.800 214748364.700 FORMAT "%13.3" ECU_ADDRESS 0x7F9DF4 /end MEASUREMENT
/begin MEASUREMENT EGSys_dwEnvOxiCatSurf_mp "Wärmeaustausch mit der Umgebung für die OxiCat-Oberflächentemperatur [J/s]" SLONG Pwr1 1 100 -214748364.800 214748364.700 FORMAT "%13.3" ARRAY_SIZE 2 ECU_ADDRESS 0x9FE4E8 /end MEASUREMENT
/begin MEASUREMENT EGSys_dwEnvOxiCat_mp "Wärmeaustauch mit der Umgebung für die OxiCat-Austrittstemperatur" SLONG Pwr1 1 100 -214748364.800 214748364.700 FORMAT "%13.3" ARRAY_SIZE 2 ECU_ADDRESS 0x9FE4F0 /end MEASUREMENT
/begin MEASUREMENT EGSys_dwFlCmb_mp "Wärmestrom durch spät nacheingespritzte Kraftstoffmenge" SLONG Pwr1 1 100 -214748364.800 214748364.700 FORMAT "%13.3" ECU_ADDRESS 0x9FE520 /end MEASUREMENT
/begin MEASUREMENT EGSys_dwGasOxiCatSurf_mp "Wärmeaustausch mit der Umgebung für die OxiCat-Öberflächentemperatur" SLONG Pwr1 1 100 -214748364.800 214748364.700 FORMAT "%13.3" ARRAY_SIZE 2 ECU_ADDRESS 0x9FE4F8 /end MEASUREMENT
/begin MEASUREMENT EGSys_dwGasOxiCat_mp "Wärmestrom für OxiCat-Austrittstemperatur" SLONG Pwr1 1 100 -214748364.800 214748364.700 FORMAT "%13.3" ARRAY_SIZE 2 ECU_ADDRESS 0x9FE500 /end MEASUREMENT
/begin MEASUREMENT EGSys_dwHCCnvOxiCat_mp "Wärmestrom aus HC-Umsatz [J/s]" SLONG Pwr1 1 100 -214748364.800 214748364.700 FORMAT "%13.3" ARRAY_SIZE 2 ECU_ADDRESS 0x9FE508 /end MEASUREMENT
/begin MEASUREMENT EGSys_dwLSU_mp "Abgaswärmestrom an Sondenposition" SWORD Pwr_kW_Sec 1 100 -327.6800 327.6700 FORMAT "%8.4" ARRAY_SIZE 1 ECU_ADDRESS 0x9FF092 /end MEASUREMENT
/begin MEASUREMENT EGSys_dwOxiCatSurf_mp "EGSys_dwOxiCatSurf_mp [J/s]" SLONG Pwr1 1 100 -214748364.800 214748364.700 FORMAT "%13.3" ARRAY_SIZE 2 ECU_ADDRESS 0x9FE510 /end MEASUREMENT
/begin MEASUREMENT EGSys_dwOxiCat_mp "Wärmeänderung für den OxiCat-Austritt [J/s]" SLONG Pwr1 1 100 -214748364.800 214748364.700 FORMAT "%13.3" ARRAY_SIZE 2 ECU_ADDRESS 0x9FE518 /end MEASUREMENT
/begin MEASUREMENT EGSys_dwTubeIn_mp "Eintretender Wärmestrom Abgasrohr" SLONG Pwr1 1 100 -214748364.800 214748364.700 FORMAT "%13.3" ARRAY_SIZE 4 ECU_ADDRESS 0x9FE52C /end MEASUREMENT
/begin MEASUREMENT EGSys_dwTubeOut_mp "Austretender Wärmestrom Abgasrohr" SLONG Pwr1 1 100 -214748364.800 214748364.700 FORMAT "%13.3" ARRAY_SIZE 4 ECU_ADDRESS 0x9FE53C /end MEASUREMENT
/begin MEASUREMENT EGSys_dwTube_mp "Wärmeänderung Abgasrohr" SLONG Pwr1 1 100 -214748364.800 214748364.700 FORMAT "%13.3" ARRAY_SIZE 4 ECU_ADDRESS 0x9FE54C /end MEASUREMENT
/begin MEASUREMENT EGSys_etaChrg_mp "Gesamtwirkungsgrad Turbolader" SWORD Fact 1 100 -4.000000 3.999878 FORMAT "%8.6" ARRAY_SIZE 2 ECU_ADDRESS 0x9FF14E /end MEASUREMENT
/begin MEASUREMENT EGSys_facAirMass_mp "Luftmassen-Korrekturfaktor für stationäre Abgaskrümmertemperatur" SWORD Fact 1 100 -4.000000 3.999878 FORMAT "%8.6" ECU_ADDRESS 0x9FF0F4 /end MEASUREMENT
/begin MEASUREMENT EGSys_facHCCnvOxiCat_mp "HC-Umwandlungsfaktor [-]" SWORD Fact 1 100 -4.000000 3.999878 FORMAT "%8.6" ARRAY_SIZE 2 ECU_ADDRESS 0x9FF11C /end MEASUREMENT
/begin MEASUREMENT EGSys_facPT1Chrg_mp "Variabler Faktor für thermische Zeitkonstante Lader" SWORD Fact_PT1 1 100 -256.0000 255.9922 FORMAT "%8.4" ARRAY_SIZE 2 ECU_ADDRESS 0x9FF152 /end MEASUREMENT
/begin MEASUREMENT EGSys_facStrtDlv_mp "Förderbeginn-Korrekturfaktor für stationäre Abgaskrümmertemperatur" SWORD Fact 1 100 -4.000000 3.999878 FORMAT "%8.6" ECU_ADDRESS 0x9FF0F6 /end MEASUREMENT
/begin MEASUREMENT EGSys_nTrbnMax2_mp "Mögliche Antriebsdrehzahl der Turbine rechts" SWORD TurboN 1 100 -327680.0 327670.0 FORMAT "%8.1" ECU_ADDRESS 0x9FF0A2 /end MEASUREMENT
/begin MEASUREMENT EGSys_nTrbnMax_mp "Mögliche Antriebsdrehzahl der Turbine links" SWORD TurboN 1 100 -327680.0 327670.0 FORMAT "%8.1" ECU_ADDRESS 0x9FF0A8 /end MEASUREMENT
/begin MEASUREMENT EGSys_NuTubeEnv_mp "Nusselt-Zahl Aussenumströmung Abgasrohr" SWORD OneToOne 1 100 -32768.00 32767.00 FORMAT "%8.2" ARRAY_SIZE 4 ECU_ADDRESS 0x9FF18C /end MEASUREMENT
/begin MEASUREMENT EGSys_NuTube_mp "Nusselt-Zahl im Abgasrohr" SWORD OneToOne 1 100 -32768.00 32767.00 FORMAT "%8.2" ARRAY_SIZE 4 ECU_ADDRESS 0x9FF194 /end MEASUREMENT
/begin MEASUREMENT EGSys_pExhGas "Abgasgegendruck" SWORD Pres_hPa 1 100 -32768.00 32767.00 FORMAT "%8.2" ARRAY_SIZE 1 ECU_ADDRESS 0x7F9880 /end MEASUREMENT
/begin MEASUREMENT EGSys_phiDiffStrt_mp "Differenz zwischen Förderbeginn im Auslegungspunkt und aktuellem Wert" SWORD AngleCrS 1 100 -768.0000 767.9766 FORMAT "%8.4" ECU_ADDRESS 0x9FF0F8 /end MEASUREMENT
/begin MEASUREMENT EGSys_pPreTrbn "Abgasgegendruck for der Turbine links" SWORD Pres_hPa 1 100 -32768.00 32767.00 FORMAT "%8.2" ECU_ADDRESS 0x7F9882 /end MEASUREMENT
/begin MEASUREMENT EGSys_pPreTrbn2 "Abgasgegendruck vor der Turbine rechts" SWORD Pres_hPa 1 100 -32768.00 32767.00 FORMAT "%8.2" ECU_ADDRESS 0x7F9884 /end MEASUREMENT
/begin MEASUREMENT EGSys_pwrCmpr_mp "Verdichterleistung" SWORD Pwr 1 100 -308831.1 308821.7 FORMAT "%8.1" ECU_ADDRESS 0x9FF156 /end MEASUREMENT
/begin MEASUREMENT EGSys_qHCEngOpGvnr_mp "HC Masse mit Temperaturregler in Abhängigkeit vom Betriebspunkt" SWORD InjMass 1 100 -327.6800 327.6700 FORMAT "%8.4" ECU_ADDRESS 0x9FF0E8 /end MEASUREMENT
/begin MEASUREMENT EGSys_qHCEngOp_mp "HC Masse in Abhängigkeit vom Betriebspunkt" SWORD InjMass 1 100 -327.6800 327.6700 FORMAT "%8.4" ECU_ADDRESS 0x9FF0EA /end MEASUREMENT
/begin MEASUREMENT EGSys_qHCPoI1Gvnr_mp "HC Masse vom Temperaturregler PoI1" SWORD InjMass 1 100 -327.6800 327.6700 FORMAT "%8.4" ECU_ADDRESS 0x9FF0EC /end MEASUREMENT
/begin MEASUREMENT EGSys_qHCPoI2Gvnr_mp "HC Masse vom Temperaturregler PoI2" SWORD InjMass 1 100 -327.6800 327.6700 FORMAT "%8.4" ECU_ADDRESS 0x9FF0EE /end MEASUREMENT
/begin MEASUREMENT EGSys_qHCRgn_mp "HC Masse während Regeneration" SWORD InjMass 1 100 -327.6800 327.6700 FORMAT "%8.4" ECU_ADDRESS 0x9FF0F0 /end MEASUREMENT
/begin MEASUREMENT EGSys_qMIStd "Vor- und haupteingespritzte Kraftstoffmenge (im Brennraum verbrannt)" SWORD InjMassCyc 1 100 -327.6800 327.6700 FORMAT "%8.4" ECU_ADDRESS 0x7F9886 /end MEASUREMENT
/begin MEASUREMENT EGSys_qPoIRgn "Spät nacheingespritzte Kraftstoffmenge (nicht im Brennraum verbrannt)" SWORD InjMassInj 1 100 -327.6800 327.6700 FORMAT "%8.4" ECU_ADDRESS 0x7F9888 /end MEASUREMENT
/begin MEASUREMENT EGSys_rAirPerTime_mp "Verhältnis Luftmassenstrom im Auslegungspunkt zu aktuellem Wert" SWORD Fact 1 100 -4.000000 3.999878 FORMAT "%8.6" ECU_ADDRESS 0x9FF0FA /end MEASUREMENT
/begin MEASUREMENT EGSys_ReTubeEnvInpCrv_mp "Messpunkt Eingangswert Kurve EGSys_NuTubeEnv_CUR" SWORD OneToOne 1 100 -32768.00 32767.00 FORMAT "%8.2" ECU_ADDRESS 0x9FF19C /end MEASUREMENT
/begin MEASUREMENT EGSys_ReTubeEnv_mp "Reynolds-Zahl Aussenumströmung Abgasrohr" SWORD OneToOne 1 100 -32768.00 32767.00 FORMAT "%8.2" ARRAY_SIZE 4 ECU_ADDRESS 0x9FF19E /end MEASUREMENT
/begin MEASUREMENT EGSys_ReTubeInpCrv_mp "Messpunkt Eingang Kurve EGSys_NuTube_CUR" SWORD ReynoldsNum 1 100 -3276800. 3276700. FORMAT "%8.0" ECU_ADDRESS 0x9FF1A6 /end MEASUREMENT
/begin MEASUREMENT EGSys_ReTube_mp "Reynolds-Zahl im Abgasrohr" SWORD ReynoldsNum 1 100 -3276800. 3276700. FORMAT "%8.0" ARRAY_SIZE 4 ECU_ADDRESS 0x9FF1A8 /end MEASUREMENT
/begin MEASUREMENT EGSys_rLmbdAprx "näherungsweiser Lambda-Wert" SWORD lambda 1 100 -32.76800 32.76700 FORMAT "%8.5" ECU_ADDRESS 0x7F988A /end MEASUREMENT
/begin MEASUREMENT EGSys_rPres2_mp "Abgasgegendruckverhältnis vor und nach Turbine rechts" SWORD Fact 1 100 -4.000000 3.999878 FORMAT "%8.6" ECU_ADDRESS 0x9FF0A4 /end MEASUREMENT
/begin MEASUREMENT EGSys_rPresCmpr_mp "Verdichterdruckverhältnis" SWORD Fact 1 100 -4.000000 3.999878 FORMAT "%8.6" ECU_ADDRESS 0x9FF158 /end MEASUREMENT
/begin MEASUREMENT EGSys_rPres_mp "Abgasgegendruckverhältnis vor und nach Turbine links" SWORD Fact 1 100 -4.000000 3.999878 FORMAT "%8.6" ECU_ADDRESS 0x9FF0AA /end MEASUREMENT
/begin MEASUREMENT EGSys_rTempClnt_mp "Verhältnis Motorübertemperatur Motorstart / -stop" SWORD Fact 1 100 -4.000000 3.999878 FORMAT "%8.6" ECU_ADDRESS 0x9FF13E /end MEASUREMENT
/begin MEASUREMENT EGSys_rTimeNSC_mp "Verhältnis Standzeit zu Halbwertszeit NSC" SWORD Fact1 1 100 -256.0000 255.9922 FORMAT "%8.4" ECU_ADDRESS 0x9FF140 /end MEASUREMENT
/begin MEASUREMENT EGSys_rTimeOxiCatBrik_mp "Verhältnis Standzeit zu Halbwertszeit neu OxiKat [-]" SWORD Fact1 1 100 -256.0000 255.9922 FORMAT "%8.4" ARRAY_SIZE 2 ECU_ADDRESS 0x9FF12E /end MEASUREMENT
/begin MEASUREMENT EGSys_rTimeOxiCat_mp "Verhältnis Standzeit zu Halbwertszeit Oxidationskatalysator" SWORD Fact1 1 100 -256.0000 255.9922 FORMAT "%8.4" ECU_ADDRESS 0x9FF142 /end MEASUREMENT
/begin MEASUREMENT EGSys_rTimeTrb_mp "Verhältnis-Stillstand-Zeit / Halbzeit-Periode turbocharger" SWORD Fact1 1 100 -256.0000 255.9922 FORMAT "%8.4" ARRAY_SIZE 2 ECU_ADDRESS 0x9FF132 /end MEASUREMENT
/begin MEASUREMENT EGSys_rTimeTube_mp "Verhältnis Standzeit zu Halbwertszeit Abgasrohr" SWORD Fact1 1 100 -256.0000 255.9922 FORMAT "%8.4" ARRAY_SIZE 4 ECU_ADDRESS 0x9FF136 /end MEASUREMENT
/begin MEASUREMENT EGSys_sqTube_mp "Oberfläche Abgasrohr" SWORD Area 1 100 -4.000000 3.999878 FORMAT "%8.6" ARRAY_SIZE 4 ECU_ADDRESS 0x9FF1B0 /end MEASUREMENT
/begin MEASUREMENT EGSys_stDewDetTstDem_mp "Anzeige der Umschaltung in Servicetest-Modus" UBYTE OneToOne 1 100 0.00 255.0 FORMAT "%5.1" ECU_ADDRESS 0x9FFE1F /end MEASUREMENT
/begin MEASUREMENT EGSys_stDiaLSUStopPerm_mp "Anzeige Rückgabeparameter für STOP-Erlaubnis des Servicetests" UBYTE OneToOne 1 100 0.00 255.0 FORMAT "%5.1" ECU_ADDRESS 0x9FFE20 /end MEASUREMENT
/begin MEASUREMENT EGSys_stDiaLSUStrtPerm_mp "Anzeige Rückgabeparameter für START-Erlaubnis des Servicetests" UBYTE OneToOne 1 100 0.00 255.0 FORMAT "%5.1" ECU_ADDRESS 0x9FFE21 /end MEASUREMENT
/begin MEASUREMENT EGSys_stDiaLSUTst_mp "Anzeige Rückgabeparameter für Teststatus" UBYTE OneToOne 1 100 0.00 255.0 FORMAT "%5.1" ECU_ADDRESS 0x9FFE22 /end MEASUREMENT
/begin MEASUREMENT EGSys_stHtgLSU "Statusbit Freigabe Sensor-Heizung" UBYTE OneToOne 1 100 0.00 255.0 FORMAT "%5.1" ARRAY_SIZE 1 ECU_ADDRESS 0x7F93AA /end MEASUREMENT
/begin MEASUREMENT EGSys_stHtgLSULstTrp_mp "Status der Taupunktfreigabe des letzten Fahrzyklus" UBYTE OneToOne 1 100 0.00 255.0 FORMAT "%5.1" ARRAY_SIZE 1 ECU_ADDRESS 0x9FFE1B /end MEASUREMENT
/begin MEASUREMENT EGSys_stHtgThresLSUHit_mp "Statusmessage für Überschreiten des Wärmemengenschwellwertes" UBYTE OneToOne 1 100 0.00 255.0 FORMAT "%5.1" ARRAY_SIZE 1 ECU_ADDRESS 0x9FFE1C /end MEASUREMENT
/begin MEASUREMENT EGSys_stIntegIni_mp "Status Integrator Initialisierung" UBYTE OneToOne 1 100 0.00 255.0 FORMAT "%5.1" ARRAY_SIZE 1 ECU_ADDRESS 0x9FFE1D /end MEASUREMENT
/begin MEASUREMENT EGSys_stPlsLSU_mp "Status-Bit gültiger Gaspuls" UBYTE OneToOne 1 100 0.00 255.0 FORMAT "%5.1" ARRAY_SIZE 1 ECU_ADDRESS 0x9FFE1E /end MEASUREMENT
/begin MEASUREMENT EGSys_stSrvTstDem "Status LSU-Diasgnose mit Servicetester" UWORD OneToOne 1 100 0.00 65535.00 FORMAT "%8.2" ECU_ADDRESS 0x7F988C /end MEASUREMENT
/begin MEASUREMENT EGSys_stSrvTst_mp "Status Servicetest-Aktivierung" UBYTE OneToOne 1 100 0.00 255.0 FORMAT "%5.1" ECU_ADDRESS 0x9FFE23 /end MEASUREMENT
/begin MEASUREMENT EGSys_tAirStrt_mp "Umgebungstemperatur aus Luft-Temperaturfeld" SWORD Temp_Cels 1 100 -3549.940 3003.560 FORMAT "%8.3" ECU_ADDRESS 0x9FF144 /end MEASUREMENT
/begin MEASUREMENT EGSys_tAvrgEGTrbn_mp "Mittlere Abgastemperatur in Turbine" SWORD Temp_Cels 1 100 -3549.940 3003.560 FORMAT "%8.3" ECU_ADDRESS 0x9FF15A /end MEASUREMENT
/begin MEASUREMENT EGSys_tAvrgNSC_mp "Mittlere Temperatur NSC" SWORD Temp_Cels 1 100 -3549.940 3003.560 FORMAT "%8.3" ECU_ADDRESS 0x9FF108 /end MEASUREMENT
/begin MEASUREMENT EGSys_tAvrgOxiCat_mp "Mittlere Temperatur Oxidationskatalysator" SWORD Temp_Cels 1 100 -3549.940 3003.560 FORMAT "%8.3" ECU_ADDRESS 0x9FF126 /end MEASUREMENT
/begin MEASUREMENT EGSys_tCorrIAT_mp "Temperaturoffset aufgrund Schwankungen der Ansauglufttemperatur" SWORD TempDiff_Kelv 1 100 -3276.800 3276.700 FORMAT "%8.3" ECU_ADDRESS 0x9FF0FC /end MEASUREMENT
/begin MEASUREMENT EGSys_tCorrManf_mp "Temperaturoffset Krümmer bei kaltem Motor" SWORD TempDiff_Kelv 1 100 -3276.800 3276.700 FORMAT "%8.3" ECU_ADDRESS 0x9FF0FE /end MEASUREMENT
/begin MEASUREMENT EGSys_tDiffCldEng_mp "Abweichung aktuelle Motortemperatur von stationärem Wert" SWORD TempDiff_Kelv 1 100 -3276.800 3276.700 FORMAT "%8.3" ECU_ADDRESS 0x9FF100 /end MEASUREMENT
/begin MEASUREMENT EGSys_tDiffEGTube_mp "Temperaturdifferenz Abgas / Abgasrohr" SWORD TempDiff_Kelv 1 100 -3276.800 3276.700 FORMAT "%8.3" ARRAY_SIZE 4 ECU_ADDRESS 0x9FF1B8 /end MEASUREMENT
/begin MEASUREMENT EGSys_tDiffIAT_mp "Differenz zwischen Ansaulglufttemperatur im Auslegungspunkt und aktuellem Wert" SWORD TempDiff_Kelv 1 100 -3276.800 3276.700 FORMAT "%8.3" ECU_ADDRESS 0x9FF102 /end MEASUREMENT
/begin MEASUREMENT EGSys_tDiffTrbn "Temperaturdifferenz über Turbine" SWORD TempDiff_Kelv 1 100 -3276.800 3276.700 FORMAT "%8.3" ARRAY_SIZE 2 ECU_ADDRESS 0x7F9DF8 /end MEASUREMENT
/begin MEASUREMENT EGSys_tDiffTubeEnv_mp "Temperaturdifferenz Abgasrohr / Umgebung" SWORD TempDiff_Kelv 1 100 -3276.800 3276.700 FORMAT "%8.3" ARRAY_SIZE 4 ECU_ADDRESS 0x9FF1C0 /end MEASUREMENT
/begin MEASUREMENT EGSys_tEGInpCrv_mp "Meßpunkt für Abgastemperatur in allen Temperaturmodellen" SWORD Temp_Cels 1 100 -3549.940 3003.560 FORMAT "%8.3" ECU_ADDRESS 0x9FF0AC /end MEASUREMENT
/begin MEASUREMENT EGSys_tEGLSU "Abgas-Temperatur an Sensor-Position" SWORD Temp_Cels 1 100 -3549.940 3003.560 FORMAT "%8.3" ARRAY_SIZE 1 ECU_ADDRESS 0x7F988E /end MEASUREMENT
/begin MEASUREMENT EGSys_tEGLSUInpCrv0_mp "Messpunkt Eingang der Kennlinien" SWORD Temp_Cels 1 100 -3549.940 3003.560 FORMAT "%8.3" ECU_ADDRESS 0x9FF0AE /end MEASUREMENT
/begin MEASUREMENT EGSys_tEGPreNSC "Abgastemperatur am NSC-Eintritt" SWORD Temp_Cels 1 100 -3549.940 3003.560 FORMAT "%8.3" ARRAY_SIZE 1 ECU_ADDRESS 0x7F9890 /end MEASUREMENT
/begin MEASUREMENT EGSys_tEGPreOxiCat "Abgastemperatur am Oxidationskatalysator-Eintritt" SWORD Temp_Cels 1 100 -3549.940 3003.560 FORMAT "%8.3" ECU_ADDRESS 0x7F9892 /end MEASUREMENT
/begin MEASUREMENT EGSys_tEGPreOxiCatBrik "Abgastemperatur am Oxidationskatalysator-Eintritt (Brick Modell)" SWORD Temp_Cels 1 100 -3549.940 3003.560 FORMAT "%8.3" ARRAY_SIZE 2 ECU_ADDRESS 0x7F9DFC /end MEASUREMENT
/begin MEASUREMENT EGSys_tEGPreTrbn "Abgas-Temperatur vor Turbine" SWORD Temp_Cels 1 100 -3549.940 3003.560 FORMAT "%8.3" ECU_ADDRESS 0x7F9894 /end MEASUREMENT
/begin MEASUREMENT EGSys_tEGPreTrbnMod "Modellierter Wert der Abgastemperatur vor Turbo" SWORD Temp_Cels 1 100 -3549.940 3003.560 FORMAT "%8.3" ARRAY_SIZE 2 ECU_ADDRESS 0x7F9E00 /end MEASUREMENT
/begin MEASUREMENT EGSys_tEGPreTube "Abgastemperatur am Abgasrohr-Eintritt" SWORD Temp_Cels 1 100 -3549.940 3003.560 FORMAT "%8.3" ARRAY_SIZE 4 ECU_ADDRESS 0x7F9F0C /end MEASUREMENT
/begin MEASUREMENT EGSys_tEGPstNSC "Abgastemperatur nach NSC" SWORD Temp_Cels 1 100 -3549.940 3003.560 FORMAT "%8.3" ARRAY_SIZE 1 ECU_ADDRESS 0x7F9896 /end MEASUREMENT
/begin MEASUREMENT EGSys_tEGPstTrbnStat "stationäre Abgastemperatur nach Turbolader" SWORD Temp_Cels 1 100 -3549.940 3003.560 FORMAT "%8.3" ARRAY_SIZE 2 ECU_ADDRESS 0x7F9E04 /end MEASUREMENT
/begin MEASUREMENT EGSys_tEGPstTube "Abgastemperatur am Abgasrohr-Auslass" SWORD Temp_Cels 1 100 -3549.940 3003.560 FORMAT "%8.3" ARRAY_SIZE 4 ECU_ADDRESS 0x7F9F14 /end MEASUREMENT
/begin MEASUREMENT EGSys_tEngDewDet_mp "Motortemperatur aus Motor-Temperaturfeld" SWORD Temp_Cels 1 100 -3549.940 3003.560 FORMAT "%8.3" ECU_ADDRESS 0x9FF09E /end MEASUREMENT
/begin MEASUREMENT EGSys_tEngStrt_mp "Motortemperatur aus Motor-Temperaturfeld" SWORD Temp_Cels 1 100 -3549.940 3003.560 FORMAT "%8.3" ECU_ADDRESS 0x9FF146 /end MEASUREMENT
/begin MEASUREMENT EGSys_tExcClntStrtCs_mp "Motorübertemperatur bei Motorstart" SWORD TempDiff_Kelv 1 100 -3276.800 3276.700 FORMAT "%8.3" ECU_ADDRESS 0x9FF148 /end MEASUREMENT
/begin MEASUREMENT EGSys_tiClg "cooling time" SWORD Time_ms 1 100 -327680.0 327670.0 FORMAT "%8.1" ECU_ADDRESS 0x7F98A4 /end MEASUREMENT
/begin MEASUREMENT EGSys_tiClg_mp "Abkühlzeit" ULONG Time_s 1 100 0.00 42949672.9500 FORMAT "%13.4" ECU_ADDRESS 0x9FE524 /end MEASUREMENT
/begin MEASUREMENT EGSys_tIncrPoI_mp "Temperaturerhöhung im Oxidationskatalysator aufgrund später Nacheinspritzung" SWORD TempDiff_Kelv 1 100 -3276.800 3276.700 FORMAT "%8.3" ECU_ADDRESS 0x9FF128 /end MEASUREMENT
/begin MEASUREMENT EGSys_tiRefClg_mp "Referenz-Abkühlzeit aus Motor-Abkühlung" ULONG Time_s 1 100 0.00 42949672.9500 FORMAT "%13.4" ECU_ADDRESS 0x9FE528 /end MEASUREMENT
/begin MEASUREMENT EGSys_tManfStat "stationäre Abgastemperatur im Abgaskrümmer" SWORD Temp_Cels 1 100 -3549.940 3003.560 FORMAT "%8.3" ECU_ADDRESS 0x7F9898 /end MEASUREMENT
/begin MEASUREMENT EGSys_tManfStat_mp "stationäre Abgastemperatur im Abgaskrümmer ohne Korrekturen" SWORD Temp_Cels 1 100 -3549.940 3003.560 FORMAT "%8.3" ECU_ADDRESS 0x9FF104 /end MEASUREMENT
/begin MEASUREMENT EGSys_tMem_mp "Zwischenspeicher für Temperaturen" SWORD Temp_Cels 1 100 -3549.940 3003.560 FORMAT "%8.3" ARRAY_SIZE 24 ECU_ADDRESS 0x9FF0B0 /end MEASUREMENT
/begin MEASUREMENT EGSys_tMidEGTube_mp "Mittlere Temperatur zwischen Abgas und Abgasrohrwand" SWORD Temp_Cels 1 100 -3549.940 3003.560 FORMAT "%8.3" ARRAY_SIZE 4 ECU_ADDRESS 0x9FF1C8 /end MEASUREMENT
/begin MEASUREMENT EGSys_tMidTubeEnv_mp "Mittlere Temperatur zwischen Abgasrohr und Umgebung" SWORD Temp_Cels 1 100 -3549.940 3003.560 FORMAT "%8.3" ARRAY_SIZE 4 ECU_ADDRESS 0x9FF1D0 /end MEASUREMENT
/begin MEASUREMENT EGSys_tMon "Abgastemperaturfeld mit simulierten Temperaturwerte" SWORD Temp_Cels 1 100 -3549.940 3003.560 FORMAT "%8.3" ARRAY_SIZE 3 ECU_ADDRESS 0x7F9EF2 /end MEASUREMENT
/begin MEASUREMENT EGSys_tNSCExoIncr_mp "Temperaturerhöhung im NSC durch chemische Reaktionen" SWORD TempDiff_Kelv 1 100 -3276.800 3276.700 FORMAT "%8.3" ECU_ADDRESS 0x9FF10A /end MEASUREMENT
/begin MEASUREMENT EGSys_tNSCStat_mp "Stationäre Temperatur NSC" SWORD Temp_Cels 1 100 -3549.940 3003.560 FORMAT "%8.3" ECU_ADDRESS 0x9FF10C /end MEASUREMENT
/begin MEASUREMENT EGSys_tNSCStrtCs "Temperatur NSC bei Motorstart" SWORD Temp_Cels 1 100 -3549.940 3003.560 FORMAT "%8.3" ECU_ADDRESS 0x7F989A /end MEASUREMENT
/begin MEASUREMENT EGSys_tOxiCat "Temperatur Oxidationskatalysator (Austritt)" SWORD Temp_Cels 1 100 -3549.940 3003.560 FORMAT "%8.3" ECU_ADDRESS 0x7F989C /end MEASUREMENT
/begin MEASUREMENT EGSys_tOxiCatAvrg_mp "Mittlere Temperatur-OxiCat" SWORD Temp_Cels 1 100 -3549.940 3003.560 FORMAT "%8.3" ARRAY_SIZE 2 ECU_ADDRESS 0x9FF120 /end MEASUREMENT
/begin MEASUREMENT EGSys_tOxiCatBrik "Ausgangstemperatur des modellierten OxiCat (°C)" SWORD Temp_Cels 1 100 -3549.940 3003.560 FORMAT "%8.3" ARRAY_SIZE 2 ECU_ADDRESS 0x7F9E08 /end MEASUREMENT
/begin MEASUREMENT EGSys_tOxiCatExoIncr_mp "Temperaturerhöhung im Oxidationskatalysator durch chemische Reaktionen" SWORD TempDiff_Kelv 1 100 -3276.800 3276.700 FORMAT "%8.3" ECU_ADDRESS 0x9FF12A /end MEASUREMENT
/begin MEASUREMENT EGSys_tOxiCatOutBrik "Ausgangstemperatur des modellierten OxiCat (°C)" SWORD Temp_Cels 1 100 -3549.940 3003.560 FORMAT "%8.3" ECU_ADDRESS 0x7F989E /end MEASUREMENT
/begin MEASUREMENT EGSys_tOxiCatStat_mp "Stationäre Temperatur Oxidationskatalysator" SWORD Temp_Cels 1 100 -3549.940 3003.560 FORMAT "%8.3" ECU_ADDRESS 0x9FF12C /end MEASUREMENT
/begin MEASUREMENT EGSys_tOxiCatStrtCs "Temperatur Oxidationskatalysator bei Motorstart" SWORD Temp_Cels 1 100 -3549.940 3003.560 FORMAT "%8.3" ECU_ADDRESS 0x7F98A0 /end MEASUREMENT
/begin MEASUREMENT EGSys_tOxiCatStrtCsBrik "Temperatur Oxidationskatalysator bei Motorstart [°C]" SWORD Temp_Cels 1 100 -3549.940 3003.560 FORMAT "%8.3" ARRAY_SIZE 2 ECU_ADDRESS 0x7F9E0C /end MEASUREMENT
/begin MEASUREMENT EGSys_tOxiCatSurfBrik "Ausgangstemperatur des modellierten OxiCat (°C)" SWORD Temp_Cels 1 100 -3549.940 3003.560 FORMAT "%8.3" ARRAY_SIZE 2 ECU_ADDRESS 0x7F9E10 /end MEASUREMENT
/begin MEASUREMENT EGSys_tShOffTExcClnt_mp "Motorübertemperature bei Motorstop" SWORD TempDiff_Kelv 1 100 -3276.800 3276.700 FORMAT "%8.3" ECU_ADDRESS 0x9FF0F2 /end MEASUREMENT
/begin MEASUREMENT EGSys_tTrbStrtCs "Turbocharger Temperatur an Maschinenanfang" SWORD Temp_Cels 1 100 -3549.940 3003.560 FORMAT "%8.3" ARRAY_SIZE 2 ECU_ADDRESS 0x7F9E14 /end MEASUREMENT
/begin MEASUREMENT EGSys_tTube "Wandtemperatur Abgasrohr" SWORD Temp_Cels 1 100 -3549.940 3003.560 FORMAT "%8.3" ARRAY_SIZE 4 ECU_ADDRESS 0x7F9F1C /end MEASUREMENT
/begin MEASUREMENT EGSys_tTubeStrtCs "Temperatur Abgasrohr bei Motorstart" SWORD Temp_Cels 1 100 -3549.940 3003.560 FORMAT "%8.3" ARRAY_SIZE 4 ECU_ADDRESS 0x7F9F24 /end MEASUREMENT
/begin MEASUREMENT EGSys_tWallLSU "Wandtemperatur am Sondeneinbauort" SWORD Temp_Cels 1 100 -3549.940 3003.560 FORMAT "%8.3" ARRAY_SIZE 1 ECU_ADDRESS 0x7F98A2 /end MEASUREMENT
/begin MEASUREMENT EGSys_wLSU_mp " integrierte Wärmemenge an Sensor-Position." SWORD Energy 1 100 -32768.00 32767.00 FORMAT "%8.2" ARRAY_SIZE 1 ECU_ADDRESS 0x9FF094 /end MEASUREMENT
/begin MEASUREMENT EGSys_wThresLSUAct_mp "aktueller Wärmeschwellwert an Sensorposition." SWORD Energy 1 100 -32768.00 32767.00 FORMAT "%8.2" ARRAY_SIZE 1 ECU_ADDRESS 0x9FF096 /end MEASUREMENT
/begin MEASUREMENT EGSys_wThresLSUNoPls_mp "Hitzeschwelle ohne gültigen Gaspuls." SWORD Energy 1 100 -32768.00 32767.00 FORMAT "%8.2" ARRAY_SIZE 1 ECU_ADDRESS 0x9FF098 /end MEASUREMENT
/begin MEASUREMENT EGSys_wThresLSUPls_mp "Hitzeschwelle für gültigen Gaspuls" SWORD Energy 1 100 -32768.00 32767.00 FORMAT "%8.2" ARRAY_SIZE 1 ECU_ADDRESS 0x9FF09A /end MEASUREMENT
/begin MEASUREMENT EGSys_wThresLSU_mp "Grundlegender Wert-Hitzeschwelle-Sensor" SWORD Energy 1 100 -32768.00 32767.00 FORMAT "%8.2" ARRAY_SIZE 1 ECU_ADDRESS 0x9FF09C /end MEASUREMENT
/begin MEASUREMENT EGT_facRmpVal "Zentraler Rampenwert (drehzahlsynchron)" SWORD EGTSwt_S16 1 100 -2.000000 1.999939 FORMAT "%8.6" ECU_ADDRESS 0x7F98A6 /end MEASUREMENT
/begin MEASUREMENT EGT_mAirDesTempGvnr "Temperaturreglerkorrektur für den Luftmassensollwert" SWORD AirMassPerCyl 1 100 -3276.800 3276.700 FORMAT "%8.3" ECU_ADDRESS 0x7F98A8 /end MEASUREMENT
/begin MEASUREMENT EGT_qPoI1TempGvnr "EGT Temperaturregler PoI1 Menge während einer Regeneration" SWORD InjMass 1 100 -327.6800 327.6700 FORMAT "%8.4" ECU_ADDRESS 0x7F98AA /end MEASUREMENT
/begin MEASUREMENT EGT_qPoI2TempGvnr "EGT Temperaturreglerkorrektur der angelagerten Nacheinspritzung 2 während einer Partikelfilterregeneration" SWORD InjMass 1 100 -327.6800 327.6700 FORMAT "%8.4" ECU_ADDRESS 0x7F98AC /end MEASUREMENT
/begin MEASUREMENT EGT_st "Regenerationsanforderung für Abgasnachbehandlung (drehzahlsynchron)" ULONG OneToOne 1 100 0.00 4294967295.00 FORMAT "%13.2" ECU_ADDRESS 0x7F9E18 /end MEASUREMENT
/begin MEASUREMENT EGT_stByp_mp "Meßpunkt für Bypass" ULONG OneToOne 1 100 0.00 4294967295.00 FORMAT "%13.2" ECU_ADDRESS 0x9FE55C /end MEASUREMENT
/begin MEASUREMENT EGT_stCoRgn "Innerer Zustand des Regenerationskoordinator (drehzahlsynchron)" UBYTE OneToOne 1 100 0.00 255.0 FORMAT "%5.1" ECU_ADDRESS 0x7F93AB /end MEASUREMENT
/begin MEASUREMENT EGT_stCoRgnTSync "Innerer Zustand des Regenerationskoordinator (zeitsynchron)" UBYTE OneToOne 1 100 0.00 255.0 FORMAT "%5.1" ECU_ADDRESS 0x7F93AC /end MEASUREMENT
/begin MEASUREMENT EGT_stIntOld_mp "Letzte interne Regenerationsanforderung nach Priorisierung" ULONG OneToOne 1 100 0.00 4294967295.00 FORMAT "%13.2" ECU_ADDRESS 0x9FE560 /end MEASUREMENT
/begin MEASUREMENT EGT_stInt_mp "Interne Regenerationsanforderung nach Priorisierung" ULONG OneToOne 1 100 0.00 4294967295.00 FORMAT "%13.2" ECU_ADDRESS 0x9FE564 /end MEASUREMENT
/begin MEASUREMENT EGT_stLck "Status EGT_stTSync-Kopiervorgang (drehzahlsynchron)" UBYTE OneToOne 1 100 0.00 255.0 FORMAT "%5.1" ECU_ADDRESS 0x7F93AD /end MEASUREMENT
/begin MEASUREMENT EGT_stLckTSync "Verzögerte Regenerationsanforderung für die Abgasnachbehandlung (zeitsynchron)" UBYTE OneToOne 1 100 0.00 255.0 FORMAT "%5.1" ECU_ADDRESS 0x7F93AE /end MEASUREMENT
/begin MEASUREMENT EGT_stSubCoRgn_mp "Interner Zustand des Zustandsautomaten" UBYTE OneToOne 1 100 0.00 255.0 FORMAT "%5.1" ECU_ADDRESS 0x9FFE24 /end MEASUREMENT
/begin MEASUREMENT EGT_stTmp_mp "Temporäre Regenerationsanforderung nach Einfügung des Zustands ""adsorbe""" ULONG OneToOne 1 100 0.00 4294967295.00 FORMAT "%13.2" ECU_ADDRESS 0x9FE568 /end MEASUREMENT
/begin MEASUREMENT EGT_stTSync "Regenerationsanforderung für Abgasnachbehandlung (zeitsynchron)" ULONG OneToOne 1 100 0.00 4294967295.00 FORMAT "%13.2" ECU_ADDRESS 0x7F9E1C /end MEASUREMENT
/begin MEASUREMENT EGT_stTSyncByp_mp "Meßpunkt für Bypass Freischnitt" ULONG OneToOne 1 100 0.00 4294967295.00 FORMAT "%13.2" ECU_ADDRESS 0x9FE56C /end MEASUREMENT
/begin MEASUREMENT EGT_swtEGTActv "Message zur Deaktivierung der gesamten Funktionalität der Abgasnachbehandlung" UBYTE OneToOne 1 100 0.00 255.0 FORMAT "%5.1" ECU_ADDRESS 0x7F93AF /end MEASUREMENT
/begin MEASUREMENT EGT_tInrBiTrb "Temperatur des inneren Reglers für Bi-Turbo Motoren." SWORD Temp_Cels 1 100 -3549.940 3003.560 FORMAT "%8.3" ECU_ADDRESS 0x7F98AE /end MEASUREMENT
/begin MEASUREMENT EGT_tInrDesCorBiTrb "Vorgabe Korrekturwert des inneren Reglers für Bi_Turbo Motoren" SWORD Temp_Cels 1 100 -3549.940 3003.560 FORMAT "%8.3" ECU_ADDRESS 0x7F98B0 /end MEASUREMENT
/begin MEASUREMENT EGT_tInrDesInTempGvnr "Kundenspezifischer Temperaturvorgabewert des inneren Reglers." SWORD Temp_Cels 1 100 -3549.940 3003.560 FORMAT "%8.3" ECU_ADDRESS 0x7F98B2 /end MEASUREMENT
/begin MEASUREMENT EGT_tiRgn "Zeit seit letzter Änderung von EGT_st (drehzahlsynchron)" ULONG Time_s 1 100 0.00 42949672.9500 FORMAT "%13.4" ECU_ADDRESS 0x7F9E20 /end MEASUREMENT
/begin MEASUREMENT EGT_tiRgnTSync "Zeit seit letzter Änderung von EGT_st (zeitsynchron)" ULONG Time_s 1 100 0.00 42949672.9500 FORMAT "%13.4" ECU_ADDRESS 0x7F9E24 /end MEASUREMENT
/begin MEASUREMENT EGT_tOutrDesInTempGvnr "Kundenspezifischer Temperaturvorgabewert des äußeren Reglers." SWORD Temp_Cels 1 100 -3549.940 3003.560 FORMAT "%8.3" ECU_ADDRESS 0x7F98B4 /end MEASUREMENT
/begin MEASUREMENT EMCCD_stEngMntCtl1_mp "Status Motorlagersteuerung Ausgang 1" UBYTE OneToOne 1 100 0.00 255.0 FORMAT "%5.1" ECU_ADDRESS 0x9FFE25 /end MEASUREMENT
/begin MEASUREMENT EngMon_rO2Thres_mp "Ausgangsgröße des Schwellwertfilters der Funktion Verbrennungserkennung" SWORD O2 1 100 -0.3276800 0.3276700 FORMAT "%9.7" ECU_ADDRESS 0x9FF218 /end MEASUREMENT
/begin MEASUREMENT EngMon_stMon_mp "Zustand der Überwachung auf irreguläre Verbrennung (1=aktiv, 0=nicht aktiv)" UBYTE OneToOne 1 100 0.00 255.0 FORMAT "%5.1" ECU_ADDRESS 0x9FFE39 /end MEASUREMENT
/begin MEASUREMENT EngMon_stShOffIrrCmb "Abschaltbotschaft an Abschaltkoordinator auf Grund irregulärer Verbrennung" UBYTE OneToOne 1 100 0.00 255.0 FORMAT "%5.1" ECU_ADDRESS 0x7F93CE /end MEASUREMENT
/begin MEASUREMENT EngMon_stTstRslt_mp "Testergebnis der Überwachung auf irreguläre Verbrennung" UBYTE OneToOne 1 100 0.00 255.0 FORMAT "%5.1" ECU_ADDRESS 0x9FFE3A /end MEASUREMENT
/begin MEASUREMENT EngM_ctBackUpCnt_mp "Zähler wird bei jedem zurückschalten in den Notbetrieb inkrementiert." UBYTE OneToOne 1 100 0.00 255.0 FORMAT "%5.1" ECU_ADDRESS 0x9FFE33 /end MEASUREMENT
/begin MEASUREMENT EngM_ctFrstInj_mp "Anzahl der nachgeholten Interruptions MAIN / PILOT für Startsfunktion." UBYTE OneToOne 1 100 0.00 255.0 FORMAT "%5.1" ECU_ADDRESS 0x9FFE26 /end MEASUREMENT
/begin MEASUREMENT EngM_ctIncErrSigDiagCaSDef_mp "Inkrementezaehlerstand zur Erkennung gestörtes Nockenwellensignal" UWORD OneToOne 1 100 0.00 65535.00 FORMAT "%8.2" ECU_ADDRESS 0x9FF1E6 /end MEASUREMENT
/begin MEASUREMENT EngM_ctIncErrSigDiagCaSOk_mp "Inkrementezaehlerstand zur Erkennung gestörtes Nockenwellensignal geheilt" UWORD OneToOne 1 100 0.00 65535.00 FORMAT "%8.2" ECU_ADDRESS 0x9FF1E8 /end MEASUREMENT
/begin MEASUREMENT EngM_ctIncErrSigDiagCrSDef_mp "Inkrementezaehlerstand zur Erkennung eines gestörten Kurbelwellensignal" UWORD OneToOne 1 100 0.00 65535.00 FORMAT "%8.2" ECU_ADDRESS 0x9FF1EA /end MEASUREMENT
/begin MEASUREMENT EngM_ctIncErrSigDiagCrSOK_mp "Inkrementezaehlerstand zur Erkennung Kurbelwellensignal ohne Störungen" UWORD OneToOne 1 100 0.00 65535.00 FORMAT "%8.2" ECU_ADDRESS 0x9FF1EC /end MEASUREMENT
/begin MEASUREMENT EngM_ctIncErrSigDiagmaxCaSDef_mp "maximaler Inkrementezaehlerstand bei Erkennung gestörtes Nockenwellensignal" UWORD OneToOne 1 100 0.00 65535.00 FORMAT "%8.2" ECU_ADDRESS 0x9FF1EE /end MEASUREMENT
/begin MEASUREMENT EngM_ctIncErrSigDiagmaxCaSOk_mp "maximaler Inkrementezaehlerstand bei Erkennung gestörtes Nockenwellensignal geheilt" UWORD OneToOne 1 100 0.00 65535.00 FORMAT "%8.2" ECU_ADDRESS 0x9FF1F0 /end MEASUREMENT
/begin MEASUREMENT EngM_ctIncErrSigDiagmaxCrSDef_mp "maximeler Inkrementezaehlerstand bei Erkennung gestörtes Kurbelwellensignal" UWORD OneToOne 1 100 0.00 65535.00 FORMAT "%8.2" ECU_ADDRESS 0x9FF1F2 /end MEASUREMENT
/begin MEASUREMENT EngM_ctIncNoSigDiagCaS_mp "Inkrementezaehlerstand zur Erkennung ausgefallenes Nockenwellensignal" UWORD OneToOne 1 100 0.00 65535.00 FORMAT "%8.2" ECU_ADDRESS 0x9FF1F4 /end MEASUREMENT
/begin MEASUREMENT EngM_ctIncNoSigDiagmaxCaS_mp "maximaler Inkrementezaehlerstand bei Erkennung ausgefallenes Nockenwellensignal" UWORD OneToOne 1 100 0.00 65535.00 FORMAT "%8.2" ECU_ADDRESS 0x9FF1F6 /end MEASUREMENT
/begin MEASUREMENT EngM_ctIntOvrLoad_mp "Anzahl der statischen Interrupts, bei denen der zeitliche Abstand zu kurz ist" UBYTE OneToOne 1 100 0.00 255.0 FORMAT "%5.1" ECU_ADDRESS 0x9FFE27 /end MEASUREMENT
/begin MEASUREMENT EngM_ctPhErrSigDiagCrSDef_mp "Anzahl Nockenwellenzaehne zur Erkennung eines gestörten Kurbelwellensignal" UWORD OneToOne 1 100 0.00 65535.00 FORMAT "%8.2" ECU_ADDRESS 0x9FF1F8 /end MEASUREMENT
/begin MEASUREMENT EngM_ctPhErrSigDiagmaxCrSDef_mp "maximale Anzahl Nockenwellenzaehne bei Erkennung ausgefallenes Kurbelwellensignal" UWORD OneToOne 1 100 0.00 65535.00 FORMAT "%8.2" ECU_ADDRESS 0x9FF1FA /end MEASUREMENT
/begin MEASUREMENT EngM_ctPhRevCaSDrvDef_mp "Schwelle bis Störung auf Nockenwelle im Fahrbetrieb erkannt" UWORD OneToOne 1 100 0.00 65535.00 FORMAT "%8.2" ECU_ADDRESS 0x9FF1FC /end MEASUREMENT
/begin MEASUREMENT EngM_ctPhRevCaSDrvOk_mp "Schwelle bis Störung auf Nockenwelle im Fahrbetrieb geheilt" UWORD OneToOne 1 100 0.00 65535.00 FORMAT "%8.2" ECU_ADDRESS 0x9FF1FE /end MEASUREMENT
/begin MEASUREMENT EngM_ctPhRevEdg_mp "Zähler Anzahl Flanken auf einer Nockenwellenumdrehung" UBYTE OneToOne 1 100 0.00 255.0 FORMAT "%5.1" ECU_ADDRESS 0x9FFE32 /end MEASUREMENT
/begin MEASUREMENT EngM_ctPostSync_mp "Interruptzähler im State EngM_stSync = 64 (Post-Synchron)" UBYTE OneToOne 1 100 0.00 255.0 FORMAT "%5.1" ECU_ADDRESS 0x9FFE28 /end MEASUREMENT
/begin MEASUREMENT EngM_ctReSync "Resynchronisationszähler, wird bei jeder Resynchronisation inkrementiert" UBYTE OneToOne 1 100 0.00 255.0 FORMAT "%5.1" ECU_ADDRESS 0x7F93B4 /end MEASUREMENT
/begin MEASUREMENT EngM_ctRevIni "Umdrehzungszaehler seit Initialisierung" SWORD OneToOne 1 100 -32768.00 32767.00 FORMAT "%8.2" ECU_ADDRESS 0x7F98C0 /end MEASUREMENT
/begin MEASUREMENT EngM_ctRevSta "Umdrehungszaehler seit Startabwurf" SWORD OneToOne 1 100 -32768.00 32767.00 FORMAT "%8.2" ECU_ADDRESS 0x7F98C2 /end MEASUREMENT
/begin MEASUREMENT EngM_ctSpdtoZero_mp "Zähler Timeoutinterrupts bis Motordrehzahl  = Null" ULONG OneToOne 1 100 0.00 4294967295.00 FORMAT "%13.2" ECU_ADDRESS 0x9FE574 /end MEASUREMENT
/begin MEASUREMENT EngM_ctStrtBackUp_mp "Nummer des Nockenwellen-Segments für Beschleunigungslernen" SBYTE OneToOne 1 100 -128.0 127.0 FORMAT "%5.1" ECU_ADDRESS 0x9FFE34 /end MEASUREMENT
/begin MEASUREMENT EngM_ctVerSync_mp "Verif.zähler der Sync; Anzahl der MAIN, PILOT, UPDATE, SEGMENT Interrupts zur Plaus. der NW mit der KW" UBYTE OneToOne 1 100 0.00 255.0 FORMAT "%5.1" ECU_ADDRESS 0x9FFE29 /end MEASUREMENT
/begin MEASUREMENT EngM_nAvrg "Mittlere Motordrehzahl." SWORD EngN 1 100 -32768.00 32767.00 FORMAT "%8.2" ECU_ADDRESS 0x7F98C4 /end MEASUREMENT
/begin MEASUREMENT EngM_nCurr "Aktuelle Motordrehzahl" SWORD EngN 1 100 -32768.00 32767.00 FORMAT "%8.2" ECU_ADDRESS 0x7F98C6 /end MEASUREMENT
/begin MEASUREMENT EngM_nDyn "dynamische Drehzahl" SWORD EngN 1 100 -32768.00 32767.00 FORMAT "%8.2" ECU_ADDRESS 0x7F98C8 /end MEASUREMENT
/begin MEASUREMENT EngM_numCyl "Zylinderanzahl" UBYTE OneToOne 1 100 0.00 255.0 FORMAT "%5.1" ECU_ADDRESS 0x7F93B5 /end MEASUREMENT
/begin MEASUREMENT EngM_numInt "Interreupt-Klasse" UBYTE OneToOne 1 100 0.00 255.0 FORMAT "%5.1" ECU_ADDRESS 0x7F93B7 /end MEASUREMENT
/begin MEASUREMENT EngM_numLastTDC "Vorhergehender Zünd-OT" UBYTE OneToOne 1 100 0.00 255.0 FORMAT "%5.1" ECU_ADDRESS 0x7F93B8 /end MEASUREMENT
/begin MEASUREMENT EngM_numRevCnt "Zähler der Kurbelwellenumdrehungen" UWORD OneToOne 1 100 0.00 65535.00 FORMAT "%8.2" ECU_ADDRESS 0x7F98CA /end MEASUREMENT
/begin MEASUREMENT EngM_numSyncTDC "Zylindernummer an dem die Synchronisation erkannt wurde" UBYTE OneToOne 1 100 0.00 255.0 FORMAT "%5.1" ECU_ADDRESS 0x7F93B9 /end MEASUREMENT
/begin MEASUREMENT EngM_numTDC "Aktueller Zünd-OT" UBYTE OneToOne 1 100 0.00 255.0 FORMAT "%5.1" ECU_ADDRESS 0x7F93BA /end MEASUREMENT
/begin MEASUREMENT EngM_numTimeout_mp "Beschränkungszähler für TimeOut Interrupt" SBYTE OneToOne 1 100 -128.0 127.0 FORMAT "%5.1" ECU_ADDRESS 0x9FFE2A /end MEASUREMENT
/begin MEASUREMENT EngM_phiCaSOfs "Korrekturwinkel bei verdrehter Nockenwelle" SWORD AngleCrS 1 100 -768.0000 767.9766 FORMAT "%8.4" ECU_ADDRESS 0x7F98CC /end MEASUREMENT
/begin MEASUREMENT EngM_phiCaSOfsCorr "temperaturkorrigierter Nockenwellen-Verdrehwinkel" SWORD AngleCrS 1 100 -768.0000 767.9766 FORMAT "%8.4" ECU_ADDRESS 0x7F98CE /end MEASUREMENT
/begin MEASUREMENT EngM_phiCaSOfsCor_mp "Korrekturwinkel der Temperaturkorrektur" SWORD AngleCrS 1 100 -768.0000 767.9766 FORMAT "%8.4" ECU_ADDRESS 0x9FF204 /end MEASUREMENT
/begin MEASUREMENT EngM_phiCaSOfsFlt_mp "gefilterter Nockenwellen-Verdrehwinkel" SWORD AngleCrS 1 100 -768.0000 767.9766 FORMAT "%8.4" ECU_ADDRESS 0x9FF206 /end MEASUREMENT
/begin MEASUREMENT EngM_phiCaSOfsLrn_mp "Lernwert des Nockenwellen-Verdrehwinkels" SWORD AngleCrS 1 100 -768.0000 767.9766 FORMAT "%8.4" ECU_ADDRESS 0x9FF208 /end MEASUREMENT
/begin MEASUREMENT EngM_phiCaSOfsRaw_mp "arithmetischer Mittelwert der gültigen Verdrehwinkelwerte einer Nockenwellenumdrehung" SWORD AngleCrS 1 100 -768.0000 767.9766 FORMAT "%8.4" ECU_ADDRESS 0x9FF20A /end MEASUREMENT
/begin MEASUREMENT EngM_phiDiffTDC "Winkel zwischen TDC1 und dem in der Zündreihenfolge nächsten TDC auf diesem Steuergerät" SWORD AngleCrS 1 100 -768.0000 767.9766 FORMAT "%8.4" ECU_ADDRESS 0x7F98D0 /end MEASUREMENT
/begin MEASUREMENT EngM_phiInt "aktuelle Interrupt-Position" SWORD AngleCrS 1 100 -768.0000 767.9766 FORMAT "%8.4" ECU_ADDRESS 0x7F98D2 /end MEASUREMENT
/begin MEASUREMENT EngM_phiIntExt "aktuelle Interrupt-Position, extern vom Master zum Slave über CAN" SWORD AngleCrS 1 100 -768.0000 767.9766 FORMAT "%8.4" ECU_ADDRESS 0x7F98D4 /end MEASUREMENT
/begin MEASUREMENT EngM_phiIntExtCorr_mp "aktuelle Winkelposition an der Masterseite nach der Korrektur im Slave-Steuergerät" SWORD AngleCrS 1 100 -768.0000 767.9766 FORMAT "%8.4" ECU_ADDRESS 0x9FF1DC /end MEASUREMENT
/begin MEASUREMENT EngM_phiTDC "OT-Position der aktuellen Zumessung" SWORD AngleCrS 1 100 -768.0000 767.9766 FORMAT "%8.4" ECU_ADDRESS 0x7F98D8 /end MEASUREMENT
/begin MEASUREMENT EngM_rCaS_mp "Nockenwellendrehzahl(t) / Nockenwellendrehzahl(t-1) im BackUp-mode, für Beschleunigungsvorhersage" SWORD Fact1 1 100 -256.0000 255.9922 FORMAT "%8.4" ECU_ADDRESS 0x9FF200 /end MEASUREMENT
/begin MEASUREMENT EngM_SchedDelta_mp "Sprungweite in der Schedule-Tabelle" UBYTE OneToOne 1 100 0.00 255.0 FORMAT "%5.1" ECU_ADDRESS 0x9FFE2B /end MEASUREMENT
/begin MEASUREMENT EngM_SchedIndex_mp "Anzahl der abgearbeiteten Anweisungen der Schedule-Sequenz" UBYTE OneToOne 1 100 0.00 255.0 FORMAT "%5.1" ECU_ADDRESS 0x9FFE2C /end MEASUREMENT
/begin MEASUREMENT EngM_SchedLimitInt_mp "Nummer des Abschrankintervalls" UBYTE OneToOne 1 100 0.00 255.0 FORMAT "%5.1" ECU_ADDRESS 0x9FFE2D /end MEASUREMENT
/begin MEASUREMENT EngM_SchedSegID_mp "Nummer des Segments vor dem Interrupt" UBYTE OneToOne 1 100 0.00 255.0 FORMAT "%5.1" ECU_ADDRESS 0x9FFE2E /end MEASUREMENT
/begin MEASUREMENT EngM_stBackUp2SyncOk_mp "Bitfeld das den Status der Rückschaltbedingung darstellt (siehe Dokumentation)" UBYTE OneToOne 1 100 0.00 255.0 FORMAT "%5.1" ECU_ADDRESS 0x9FFE35 /end MEASUREMENT
/begin MEASUREMENT EngM_stCaSDrvOk "NW-Signalqualität der letzten NW- Umdrehung" UBYTE OneToOne 1 100 0.00 255.0 FORMAT "%5.1" ECU_ADDRESS 0x7F93BB /end MEASUREMENT
/begin MEASUREMENT EngM_stCaSExt "Statusinformation CaSCD_stPhaseSig_mp vom Mastersteuergeraet über CAN" UWORD OneToOne 1 100 0.00 65535.00 FORMAT "%8.2" ECU_ADDRESS 0x7F98DA /end MEASUREMENT
/begin MEASUREMENT EngM_stCaSOfsLrn_mp "Lernstatus des Nockenwellen-Verdrehwinkels" UBYTE OneToOne 1 100 0.00 255.0 FORMAT "%5.1" ECU_ADDRESS 0x9FFE38 /end MEASUREMENT
/begin MEASUREMENT EngM_stCaSVerifyDiag "Statusinformation der Diagnose aus den VERIFY Zustand" UBYTE OneToOne 1 100 0.00 255.0 FORMAT "%5.1" ECU_ADDRESS 0x7F93BC /end MEASUREMENT
/begin MEASUREMENT EngM_stEngMntCtl "Motorlagersteuerung-Zustandssignal" SWORD default 1 100 -32768.00 32767.00 FORMAT "%8.2" ECU_ADDRESS 0x7F98DC /end MEASUREMENT
/begin MEASUREMENT EngM_stEngMntCtl_GTL1 "Status von Motorlagersteuerung" UBYTE OneToOne 1 100 0.00 255.0 FORMAT "%5.1" ECU_ADDRESS 0x7F93BD /end MEASUREMENT
/begin MEASUREMENT EngM_stEngMntCtl_GTL2 "Status von Motorlagersteuerung" UBYTE OneToOne 1 100 0.00 255.0 FORMAT "%5.1" ECU_ADDRESS 0x7F93BE /end MEASUREMENT
/begin MEASUREMENT EngM_stEngMntCtl_MLS1 "Status von Motorlagersteuerung" UBYTE OneToOne 1 100 0.00 255.0 FORMAT "%5.1" ECU_ADDRESS 0x7F93BF /end MEASUREMENT
/begin MEASUREMENT EngM_stEngMntCtl_MLS2 "Status von Motorlagersteuerung" UBYTE OneToOne 1 100 0.00 255.0 FORMAT "%5.1" ECU_ADDRESS 0x7F93C0 /end MEASUREMENT
/begin MEASUREMENT EngM_stErrCanExt "CAN-Errorstatus der Botschaft MS_PHI_SNYC extern vom Master mit: EngM_phiIntExt, EngM_stNextExt" UBYTE OneToOne 1 100 0.00 255.0 FORMAT "%5.1" ECU_ADDRESS 0x7F93C1 /end MEASUREMENT
/begin MEASUREMENT EngM_stEvent "Interruptereignis" UBYTE OneToOne 1 100 0.00 255.0 FORMAT "%5.1" ECU_ADDRESS 0x7F93C2 /end MEASUREMENT
/begin MEASUREMENT EngM_stEventEnable_mp "n-synchrone Interrupts freigegeben" UWORD OneToOne 1 100 0.00 65535.00 FORMAT "%8.2" ECU_ADDRESS 0x9FF1DE /end MEASUREMENT
/begin MEASUREMENT EngM_stEventServed_mp "Aktuell bediente Interrupts" UWORD OneToOne 1 100 0.00 65535.00 FORMAT "%8.2" ECU_ADDRESS 0x9FF1E0 /end MEASUREMENT
/begin MEASUREMENT EngM_stFrstInj_mp "Status der ersten Einspritzung" UBYTE OneToOne 1 100 0.00 255.0 FORMAT "%5.1" ECU_ADDRESS 0x9FFE2F /end MEASUREMENT
/begin MEASUREMENT EngM_stIncErrBackUp "Sobald ein Inkrementfehler erkannt wird, wird das Flag EngM_stIncErrBackUp gesetzt" UBYTE OneToOne 1 100 0.00 255.0 FORMAT "%5.1" ECU_ADDRESS 0x7F93C3 /end MEASUREMENT
/begin MEASUREMENT EngM_stInjCharSetVal "Zeigt den Zustand der erlaubten Einspritzungen" UBYTE OneToOne 1 100 0.00 255.0 FORMAT "%5.1" ECU_ADDRESS 0x7F93C4 /end MEASUREMENT
/begin MEASUREMENT EngM_stInjRls "Freigabe der Einspritzung vom Modul EngM" UBYTE OneToOne 1 100 0.00 255.0 FORMAT "%5.1" ECU_ADDRESS 0x7F93C5 /end MEASUREMENT
/begin MEASUREMENT EngM_stLocking_mp "Sobald der Zähler EngM_ctBackUpCnt_mp sein Maximum EngM_ctBackUpMaxCh_C erreicht wird Locking (EngM_stLocking) aktiv" UBYTE OneToOne 1 100 0.00 255.0 FORMAT "%5.1" ECU_ADDRESS 0x9FFE36 /end MEASUREMENT
/begin MEASUREMENT EngM_stLopCnt "Zähler, welcher zur Ermittlung von dem Schleifenbetrieb in dem 8 Zyl. drehzahlsynchronen Scheduling verwendet wird" UBYTE OneToOne 1 100 0.00 255.0 FORMAT "%5.1" ECU_ADDRESS 0x7F93C6 /end MEASUREMENT
/begin MEASUREMENT EngM_stNext "Meta-Status der KW- und NW-Ereignisverwaltung (Motorpositions-Management), ohne Interim-Zustände" UBYTE OneToOne 1 100 0.00 255.0 FORMAT "%5.1" ECU_ADDRESS 0x7F93C7 /end MEASUREMENT
/begin MEASUREMENT EngM_stNextExt "Meta-Status der KW- und NW-Ereignisverwaltung, ohne Interim-Zustände, extern vom Master zum Slave über CAN" UBYTE OneToOne 1 100 0.00 255.0 FORMAT "%5.1" ECU_ADDRESS 0x7F93C8 /end MEASUREMENT
/begin MEASUREMENT EngM_stRlsInc "Sobald der Inkrementsignal lange genug als gültig eingestuft wird ist die Freigabebedingung aktiviert" UBYTE OneToOne 1 100 0.00 255.0 FORMAT "%5.1" ECU_ADDRESS 0x7F93C9 /end MEASUREMENT
/begin MEASUREMENT EngM_stSpd "Status der Motordrehzahl" UBYTE OneToOne 1 100 0.00 255.0 FORMAT "%5.1" ECU_ADDRESS 0x7F93CA /end MEASUREMENT
/begin MEASUREMENT EngM_stStatML_mp "Status der Motorlagerung" UWORD OneToOne 1 100 0.00 65535.00 FORMAT "%8.2" ECU_ADDRESS 0x9FF20E /end MEASUREMENT
/begin MEASUREMENT EngM_stStrtBackUpTest_mp "Status des Algorithmus zum Beschleunigungslernen" UBYTE OneToOne 1 100 0.00 255.0 FORMAT "%5.1" ECU_ADDRESS 0x9FFE37 /end MEASUREMENT
/begin MEASUREMENT EngM_stStrtRevRls "Status Drehzahl gleich 0 in der Motormechanikdiagnose der Winkelsysteme" UBYTE OneToOne 1 100 0.00 255.0 FORMAT "%5.1" ECU_ADDRESS 0x7F93CB /end MEASUREMENT
/begin MEASUREMENT EngM_stSync "Meta-Status der KW- und NW-Ereignisverwaltung (Motorpositions-Management)" UBYTE OneToOne 1 100 0.00 255.0 FORMAT "%5.1" ECU_ADDRESS 0x7F93CC /end MEASUREMENT
/begin MEASUREMENT EngM_stT50CDResetDiag_mp "Reset der Diagnosezähler mit T50CD_stDebVal (Klemme 50)" UBYTE OneToOne 1 100 0.00 255.0 FORMAT "%5.1" ECU_ADDRESS 0x9FFE31 /end MEASUREMENT
/begin MEASUREMENT EngM_stToggleBit "Toggelbit welches für die Prozesskomunikation zwischen der 100ms- und der n-synchronen-Task verwendet wird" UBYTE OneToOne 1 100 0.00 255.0 FORMAT "%5.1" ECU_ADDRESS 0x7F93CD /end MEASUREMENT
/begin MEASUREMENT EngM_stTstDem_mp "Status Testereingriff für Eng_nAvrg" UBYTE OneToOne 1 100 0.00 255.0 FORMAT "%5.1" ECU_ADDRESS 0x9FFE30 /end MEASUREMENT
/begin MEASUREMENT EngM_swtEngMntCtl "Softwareschalter Motorlagersteuerung" SWORD default 1 100 -32768.00 32767.00 FORMAT "%8.2" ECU_ADDRESS 0x7F98DE /end MEASUREMENT
/begin MEASUREMENT EngM_tCaSOfsDiff_mp "Temperaturdifferenz zur Bezugstemperatur" SWORD TempDiff_Kelv 1 100 -3276.800 3276.700 FORMAT "%8.3" ECU_ADDRESS 0x9FF20C /end MEASUREMENT
/begin MEASUREMENT EngM_tiBackUpTmr_mp "Wenn das Kurbelwellensignal länger als EngM_tiBackUpTmr_mp als gültig erkannt wird ist ein Rückschalten möglich" ULONG Time_ms 1 100 0.00 42949672950.0 FORMAT "%13.1" ECU_ADDRESS 0x9FE578 /end MEASUREMENT
/begin MEASUREMENT EngM_tiBackUp_mp "Wert des Heilungszählers" ULONG Time_ms 1 100 0.00 42949672950.0 FORMAT "%13.1" ECU_ADDRESS 0x9FE57C /end MEASUREMENT
/begin MEASUREMENT EngM_tiDiffInt_mp "Differenz zwischen zwei statische interrupts" ULONG TimeSys_us 1 100 0.00 1228361874.73 FORMAT "%13.2" ECU_ADDRESS 0x9FE570 /end MEASUREMENT
/begin MEASUREMENT EngM_tiHealBackUp_mp "Heilungszeit im SyncOk-Mode" UWORD Time_ms 1 100 0.00 655350.0 FORMAT "%8.1" ECU_ADDRESS 0x9FF202 /end MEASUREMENT
/begin MEASUREMENT EngM_tiSeg "Segmentzeit" UWORD TimeDT 1 100 0.00 65535.00 FORMAT "%8.2" ECU_ADDRESS 0x7F98E0 /end MEASUREMENT
/begin MEASUREMENT EngM_tiSegLimAvrg "gemittelte beschränkte Segmentzeit" UWORD TimeDT 1 100 0.00 65535.00 FORMAT "%8.2" ECU_ADDRESS 0x7F98E2 /end MEASUREMENT
/begin MEASUREMENT EngM_tiSegTimeoutCurr_mp "Zeit seit dem letzten TimeOut - Interrupt" UWORD TimeDT 1 100 0.00 65535.00 FORMAT "%8.2" ECU_ADDRESS 0x9FF1E4 /end MEASUREMENT
/begin MEASUREMENT EngM_tiSegTwo "Dauer der vergangenen beiden Segmente" UWORD TimeDT 1 100 0.00 65535.00 FORMAT "%8.2" ECU_ADDRESS 0x7F98E4 /end MEASUREMENT
/begin MEASUREMENT EngM_trqFrc "aktuelles Reibmoment" SWORD Trq 1 100 -3276.800 3276.700 FORMAT "%8.3" ECU_ADDRESS 0x7F98E6 /end MEASUREMENT
/begin MEASUREMENT EngM_trqFrcByp_mp "Bypass für EngM_trqFrc" SWORD Trq 1 100 -3276.800 3276.700 FORMAT "%8.3" ECU_ADDRESS 0x9FF210 /end MEASUREMENT
/begin MEASUREMENT EngM_trqFrcMin "minimum Reibmoment" SWORD Trq 1 100 -3276.800 3276.700 FORMAT "%8.3" ECU_ADDRESS 0x7F98E8 /end MEASUREMENT
/begin MEASUREMENT EngM_trqFrcMinByp_mp "Bypass für EngM_trqFrcMin" SWORD Trq 1 100 -3276.800 3276.700 FORMAT "%8.3" ECU_ADDRESS 0x9FF212 /end MEASUREMENT
/begin MEASUREMENT EngM_trqFrcSure "Sicheres Reibmoment" SWORD Trq 1 100 -3276.800 3276.700 FORMAT "%8.3" ECU_ADDRESS 0x7F98EA /end MEASUREMENT
/begin MEASUREMENT EngM_tTrqFrcMax_mp "Temperatur aus Maximumbildung zur Berechnung der Mindest-Reibmomente" SWORD Temp_Cels 1 100 -3549.940 3003.560 FORMAT "%8.3" ECU_ADDRESS 0x9FF214 /end MEASUREMENT
/begin MEASUREMENT EngM_tTrqFrc_mp "Ausgewählte Temperatur für die Reibmomentenberechnung" SWORD Temp_Cels 1 100 -3549.940 3003.560 FORMAT "%8.3" ECU_ADDRESS 0x9FF216 /end MEASUREMENT
/begin MEASUREMENT EngPrt_facAirOvhtLim_mp "Korrekturfaktor Ladelufttemperatur" SWORD Fact 1 100 -4.000000 3.999878 FORMAT "%8.6" ECU_ADDRESS 0x9FF21A /end MEASUREMENT
/begin MEASUREMENT EngPrt_facAPLim_mp "Korrekturfaktor höhenabhängige Drehzahlkorrektur" SWORD Fact 1 100 -4.000000 3.999878 FORMAT "%8.6" ECU_ADDRESS 0x9FF21C /end MEASUREMENT
/begin MEASUREMENT EngPrt_facBoost "Boost-Faktor zur Interpolation zwischen Faktor- und Momen-ten-" SWORD Fact 1 100 -4.000000 3.999878 FORMAT "%8.6" ECU_ADDRESS 0x7F98EC /end MEASUREMENT
/begin MEASUREMENT EngPrt_facBoostIn_mp "Faktor bei Eingang in Rampen- und Zähler-Block" SWORD Fact 1 100 -4.000000 3.999878 FORMAT "%8.6" ECU_ADDRESS 0x9FF236 /end MEASUREMENT
/begin MEASUREMENT EngPrt_facChgrSwt_mp "Begrenzungsfaktor bei defektem Lader" SWORD Fact 1 100 -4.000000 3.999878 FORMAT "%8.6" ECU_ADDRESS 0x9FF21E /end MEASUREMENT
/begin MEASUREMENT EngPrt_facCTOvhtLim_mp "Ueberhitzungsschutz in Abhaengigkeit von Motortemperatur und Fahrgeschwindigkeit" SWORD Fact 1 100 -4.000000 3.999878 FORMAT "%8.6" ECU_ADDRESS 0x9FF220 /end MEASUREMENT
/begin MEASUREMENT EngPrt_facCTOvhtSwt_mp "Ueberhitzungsschutz (Motortemp. und Fahrgeschw.) nach Rampenschalter" SWORD Fact 1 100 -4.000000 3.999878 FORMAT "%8.6" ECU_ADDRESS 0x9FF222 /end MEASUREMENT
/begin MEASUREMENT EngPrt_facCurOut_mp "Ausgang des Kennfeldes EngPrt_facChgrPrt_CUR" SWORD Fact 1 100 -4.000000 3.999878 FORMAT "%8.6" ECU_ADDRESS 0x9FF224 /end MEASUREMENT
/begin MEASUREMENT EngPrt_facFlClgLim_mp "Korrekturfaktor Kraftstofftemperatur" SWORD Fact 1 100 -4.000000 3.999878 FORMAT "%8.6" ECU_ADDRESS 0x9FF226 /end MEASUREMENT
/begin MEASUREMENT EngPrt_facInPreTrbn_mp "T3-Limitierung vor PT1-Filterung" SWORD Fact 1 100 -4.000000 3.999878 FORMAT "%8.6" ECU_ADDRESS 0x9FF228 /end MEASUREMENT
/begin MEASUREMENT EngPrt_facOilOvhtLim_mp "Korrekturfaktor Öltemperatur" SWORD Fact 1 100 -4.000000 3.999878 FORMAT "%8.6" ECU_ADDRESS 0x9FF22A /end MEASUREMENT
/begin MEASUREMENT EngPrt_facPrtLimCorr "Begrenzungsmengenkorrekturfaktor" SWORD Fact 1 100 -4.000000 3.999878 FORMAT "%8.6" ECU_ADDRESS 0x7F98EE /end MEASUREMENT
/begin MEASUREMENT EngPrt_facTempPreTrbn_mp "Begrenzungsfaktor zur Limitierung der Temperatur vor der Turbine" SWORD Fact 1 100 -4.000000 3.999878 FORMAT "%8.6" ECU_ADDRESS 0x9FF22C /end MEASUREMENT
/begin MEASUREMENT EngPrt_pVal_mp "Meßpunkt der Druckauswahl für Korrektur der Volllasterhöhung" SWORD Pres_hPa 1 100 -32768.00 32767.00 FORMAT "%8.2" ECU_ADDRESS 0x9FF22E /end MEASUREMENT
/begin MEASUREMENT EngPrt_qLimBoost_mp "Meßpunkt für das Motorschutzmenge unter Berücksichtigung von Overboost" SWORD InjMass 1 100 -327.6800 327.6700 FORMAT "%8.4" ECU_ADDRESS 0x9FF238 /end MEASUREMENT
/begin MEASUREMENT EngPrt_qLimP_mp "Meßpunkt für Motorschutz Mengenbegrenzung" SWORD InjMass 1 100 -327.6800 327.6700 FORMAT "%8.4" ECU_ADDRESS 0x9FF23A /end MEASUREMENT
/begin MEASUREMENT EngPrt_stFlClgDSP "Flag für dynamisches Schaltprogramm" UBYTE OneToOne 1 100 0.00 255.0 FORMAT "%5.1" ECU_ADDRESS 0x7F93CF /end MEASUREMENT
/begin MEASUREMENT EngPrt_stOvrSpd "Überdrehzahl-Status" UBYTE OneToOne 1 100 0.00 255.0 FORMAT "%5.1" ECU_ADDRESS 0x7F93D0 /end MEASUREMENT
/begin MEASUREMENT EngPrt_stOvrSpdMon "Zustand der Überdrehzahl-Überwachung" UBYTE OneToOne 1 100 0.00 255.0 FORMAT "%5.1" ECU_ADDRESS 0x7F93D1 /end MEASUREMENT
/begin MEASUREMENT EngPrt_stRamp2End_mp "Rampenstatus der maximalen Boosting Zeit" UBYTE OneToOne 1 100 0.00 255.0 FORMAT "%5.1" ECU_ADDRESS 0x9FFE3C /end MEASUREMENT
/begin MEASUREMENT EngPrt_stRmpEna_mp "Rampenstatus zur Momentenbegrenzung" UBYTE OneToOne 1 100 0.00 255.0 FORMAT "%5.1" ECU_ADDRESS 0x9FFE3B /end MEASUREMENT
/begin MEASUREMENT EngPrt_stTempPrtShiftUp "Hochschaltanforderung bei Übertemperatur" UBYTE OneToOne 1 100 0.00 255.0 FORMAT "%5.1" ECU_ADDRESS 0x7F93D2 /end MEASUREMENT
/begin MEASUREMENT EngPrt_stThrCloAct "Status ob Drosselklappe schließen aktiv ist" UBYTE OneToOne 1 100 0.00 255.0 FORMAT "%5.1" ECU_ADDRESS 0x7F93D3 /end MEASUREMENT
/begin MEASUREMENT EngPrt_stThrCloMon "Status ob Drosselklappe schließen im Überwachungszustand" UBYTE OneToOne 1 100 0.00 255.0 FORMAT "%5.1" ECU_ADDRESS 0x7F93D4 /end MEASUREMENT
/begin MEASUREMENT EngPrt_stTrqNLim "Status Bregenzungsmoment zum Schutz vor zu hoher Drehzahl. Bit0: Bregenzung aktiv" UBYTE OneToOne 1 100 0.00 255.0 FORMAT "%5.1" ECU_ADDRESS 0x7F93D5 /end MEASUREMENT
/begin MEASUREMENT EngPrt_swtOilOvhtPrv "Softwareschalter Öltemperaturüberhitzungsschutz" UBYTE OneToOne 1 100 0.00 255.0 FORMAT "%5.1" ECU_ADDRESS 0x7F93D6 /end MEASUREMENT
/begin MEASUREMENT EngPrt_swtPosRamp1_mp "Schalterposition des Rampenschalters des Boost Faktors" UBYTE OneToOne 1 100 0.00 255.0 FORMAT "%5.1" ECU_ADDRESS 0x9FFE3D /end MEASUREMENT
/begin MEASUREMENT EngPrt_swtPosRamp2_mp "Schalterposition der maximalen Boosting Zeit" UBYTE OneToOne 1 100 0.00 255.0 FORMAT "%5.1" ECU_ADDRESS 0x9FFE3E /end MEASUREMENT
/begin MEASUREMENT EngPrt_swtTempPreTrbn "Schalter zum Auswählen der Temperatur entweder aus Modellrechnung (1) oder vom Sensor (0)" UBYTE OneToOne 1 100 0.00 255.0 FORMAT "%5.1" ECU_ADDRESS 0x7F93D7 /end MEASUREMENT
/begin MEASUREMENT EngPrt_tFuelVirt_mp "virtuelle Kraftstofftemperatur" SWORD Temp_Cels 1 100 -3549.940 3003.560 FORMAT "%8.3" ECU_ADDRESS 0x9FF230 /end MEASUREMENT
/begin MEASUREMENT EngPrt_tFuel_mp "Kraftstofftemperatur" SWORD Temp_Cels 1 100 -3549.940 3003.560 FORMAT "%8.3" ECU_ADDRESS 0x9FF232 /end MEASUREMENT
/begin MEASUREMENT EngPrt_tiMax_mp "maximale Boosting Zeit bei aktuellem Boost Faktor" UWORD Time_s 1 100 0.00 655.3500 FORMAT "%8.4" ECU_ADDRESS 0x9FF23C /end MEASUREMENT
/begin MEASUREMENT EngPrt_tiRampMax_mp "aktuelle Boosting Zeit" UWORD Time_s 1 100 0.00 655.3500 FORMAT "%8.4" ECU_ADDRESS 0x9FF23E /end MEASUREMENT
/begin MEASUREMENT EngPrt_tPreTrbn "Temperaturewert vor der Turbine zur Berechnung des Korrekturfaktors" SWORD Temp_Cels 1 100 -3549.940 3003.560 FORMAT "%8.3" ECU_ADDRESS 0x7F98F0 /end MEASUREMENT
/begin MEASUREMENT EngPrt_trqIncLoad "Volllasterhöhung des Motorschutzes" SWORD Trq 1 100 -3276.800 3276.700 FORMAT "%8.3" ECU_ADDRESS 0x7F98F2 /end MEASUREMENT
/begin MEASUREMENT EngPrt_trqIncLoadClt_mp "Meßpunkt der motortemperaturabhängigen Volllasterhöhung" SWORD Trq 1 100 -3276.800 3276.700 FORMAT "%8.3" ECU_ADDRESS 0x9FF234 /end MEASUREMENT
/begin MEASUREMENT EngPrt_trqLim "Begrenzungsmoment zum Schutz vor zu hohem Drehmoment (als inneres Motormoment)" SWORD Trq 1 100 -3276.800 3276.700 FORMAT "%8.3" ECU_ADDRESS 0x7F98F4 /end MEASUREMENT
/begin MEASUREMENT EngPrt_trqLimBoost_mp "Drehmomentenbegrenzung nach Interpolation mit Boost-Faktor" SWORD Trq 1 100 -3276.800 3276.700 FORMAT "%8.3" ECU_ADDRESS 0x9FF240 /end MEASUREMENT
/begin MEASUREMENT EngPrt_trqLimP_mp "Motorschutz Drehmomentenbegrenzung durch Atmosphärendruck" SWORD Trq 1 100 -3276.800 3276.700 FORMAT "%8.3" ECU_ADDRESS 0x9FF242 /end MEASUREMENT
/begin MEASUREMENT EngPrt_trqLimrVn_mp "Begrenzungmoment aufgrund Verhältnis v/n" SWORD Trq 1 100 -3276.800 3276.700 FORMAT "%8.3" ECU_ADDRESS 0x9FF244 /end MEASUREMENT
/begin MEASUREMENT EngPrt_trqNLim "Begrenzungsmoment zum Schutz vor zu hoher Drehzahl (als inneres Motormoment)" SWORD Trq 1 100 -3276.800 3276.700 FORMAT "%8.3" ECU_ADDRESS 0x7F98F6 /end MEASUREMENT
/begin MEASUREMENT EngPrt_trqPrtLim "resultierendes Begrenzungsmoment für Motormechanikschutz (inneres Motormoment)" SWORD Trq 1 100 -3276.800 3276.700 FORMAT "%8.3" ECU_ADDRESS 0x7F98F8 /end MEASUREMENT
/begin MEASUREMENT Eng_dnAvrg "gemittelte Drehzahländerung pro Sekunde" SWORD Eng_dN 1 100 -32768.00 32767.00 FORMAT "%8.2" ECU_ADDRESS 0x7F98FA /end MEASUREMENT
/begin MEASUREMENT Eng_dtEngCorr_mp "der fuer Eng_tEng zu korregierende Temperaturwert nach dem Kennfeld" SWORD TempDiff_Kelv 1 100 -3276.800 3276.700 FORMAT "%8.3" ECU_ADDRESS 0x9FF1D8 /end MEASUREMENT
/begin MEASUREMENT Eng_dtEngSub_mp "der subtrahierte Temperaturwert vor dem Kennfeld" SWORD TempDiff_Kelv 1 100 -3276.800 3276.700 FORMAT "%8.3" ECU_ADDRESS 0x9FF1DA /end MEASUREMENT
/begin MEASUREMENT Eng_nAvrg "mittlere Motordrehzahl" SWORD EngN 1 100 -32768.00 32767.00 FORMAT "%8.2" ECU_ADDRESS 0x7F98FC /end MEASUREMENT
/begin MEASUREMENT Eng_nCurr "aktuelle Motordrehzahl" SWORD EngN 1 100 -32768.00 32767.00 FORMAT "%8.2" ECU_ADDRESS 0x7F98FE /end MEASUREMENT
/begin MEASUREMENT Eng_tEng "Motortemperatur" SWORD Temp_Cels 1 100 -3549.940 3003.560 FORMAT "%8.3" ECU_ADDRESS 0x7F9900 /end MEASUREMENT
/begin MEASUREMENT Eng_tFld "Motortemperatur-Feld [°C]" SWORD Temp_Cels 1 100 -3549.940 3003.560 FORMAT "%8.3" ARRAY_SIZE 5 ECU_ADDRESS 0x7F9FDE /end MEASUREMENT
/begin MEASUREMENT Eng_trqCrvMax "maximales Moment des Momentenintervalls (über Drehzahl)" SWORD Trq 1 100 -3276.800 3276.700 FORMAT "%8.3" ECU_ADDRESS 0x7F9902 /end MEASUREMENT
/begin MEASUREMENT EOPD_actRout_mp "Aktive EOPD-routine" UBYTE OneToOne 1 100 0.00 255.0 FORMAT "%5.1" ECU_ADDRESS 0x9FFFD7 /end MEASUREMENT
/begin MEASUREMENT EOPD_dispx_mp "dummy" UBYTE OneToOne 1 100 0.00 255.0 FORMAT "%5.1" ECU_ADDRESS 0x9FFFD8 /end MEASUREMENT
/begin MEASUREMENT ErLpCD_OrdGlwLamp "Message vom Fehlerlampen Handler and Glühzeitsteuerung, steuert die Glühlampe bei Systemlampenfehlern an." UBYTE OneToOne 1 100 0.00 255.0 FORMAT "%5.1" ECU_ADDRESS 0x7F93D8 /end MEASUREMENT
/begin MEASUREMENT ErLpCD_rHWEMILOut_mp "Meßpunkt des Ausgangswertes vom MIL-Signal zur Hardware" UWORD OneToOne 1 100 0.00 65535.00 FORMAT "%8.2" ECU_ADDRESS 0x9FF246 /end MEASUREMENT
/begin MEASUREMENT ErLpCD_rHWESysLampOut_mp "Meßpunkt des Ausgangswertes vom Systemlampe-Signal zur Hardware" UWORD OneToOne 1 100 0.00 65535.00 FORMAT "%8.2" ECU_ADDRESS 0x9FF248 /end MEASUREMENT
/begin MEASUREMENT ErLpCD_stMil "Gesamtatus der MIL und Status der Aktivierungsquellen" UBYTE OneToOne 1 100 0.00 255.0 FORMAT "%5.1" ECU_ADDRESS 0x7F93D9 /end MEASUREMENT
/begin MEASUREMENT ErLpCD_stMilReq "Status der externen MIL Ansteuerungs Anforderung (Achtung: wechselt während der Ansteuerung dauernd den Zustand)" UBYTE OneToOne 1 100 0.00 255.0 FORMAT "%5.1" ECU_ADDRESS 0x7F93DA /end MEASUREMENT
/begin MEASUREMENT ErLpCD_stMIL_mp "Testzustand und Fehlerspeicheranforderung der MIL" UBYTE OneToOne 1 100 0.00 255.0 FORMAT "%5.1" ECU_ADDRESS 0x9FFE3F /end MEASUREMENT
/begin MEASUREMENT ErLpCD_stSysLamp "Gesamtatus der System Lampe und Status der Aktivierungsquellen" UBYTE OneToOne 1 100 0.00 255.0 FORMAT "%5.1" ECU_ADDRESS 0x7F93DB /end MEASUREMENT
/begin MEASUREMENT ErLpCD_stSysLampOut "Status der Systemlampe" UBYTE OneToOne 1 100 0.00 255.0 FORMAT "%5.1" ECU_ADDRESS 0x7F93DC /end MEASUREMENT
/begin MEASUREMENT ErLpCD_stSysLampReq "Status der externen Systemlampen  Ansteuerungs Anforderung (Achtung: wechselt während der Ansteuerung dauernd den Zustand)" UBYTE OneToOne 1 100 0.00 255.0 FORMAT "%5.1" ECU_ADDRESS 0x7F93DD /end MEASUREMENT
/begin MEASUREMENT ErLpCD_stSysLamp_mp "Testzustand und Anforderung durch Fehlerspeicher für Systemlampe" UBYTE OneToOne 1 100 0.00 255.0 FORMAT "%5.1" ECU_ADDRESS 0x9FFE40 /end MEASUREMENT
/begin MEASUREMENT ErLpCD_swtMIL "Satusinformation des MIL-Lampen Schalters" UBYTE OneToOne 1 100 0.00 255.0 FORMAT "%5.1" ECU_ADDRESS 0x7F93DE /end MEASUREMENT
/begin MEASUREMENT ErLpCD_swtSYS "Satusinformation des SYS-Lampen Schalters" UBYTE OneToOne 1 100 0.00 255.0 FORMAT "%5.1" ECU_ADDRESS 0x7F93DF /end MEASUREMENT
/begin MEASUREMENT ESS_nBattMin "Leerlaufdrehzahl wegen schwacher Batterie" SWORD EngN 1 100 -32768.00 32767.00 FORMAT "%8.2" ECU_ADDRESS 0x7F98B6 /end MEASUREMENT
/begin MEASUREMENT ESS_nMax "Hoechstdrehzahl für ESS" SWORD EngN 1 100 -32768.00 32767.00 FORMAT "%8.2" ECU_ADDRESS 0x7F98B8 /end MEASUREMENT
/begin MEASUREMENT ESS_nMin "Leerlaufdrehzahl aus ESS" SWORD EngN 1 100 -32768.00 32767.00 FORMAT "%8.2" ECU_ADDRESS 0x7F98BA /end MEASUREMENT
/begin MEASUREMENT ESS_pwrDes "Leistungsbedarf aller Aggregate des Bordnetzes" SWORD Pwr 1 100 -308831.1 308821.7 FORMAT "%8.1" ECU_ADDRESS 0x7F98BC /end MEASUREMENT
/begin MEASUREMENT ESS_pwrLead "Vorhaltleistung des el. Bordnetzes" SWORD Pwr 1 100 -308831.1 308821.7 FORMAT "%8.1" ECU_ADDRESS 0x7F98BE /end MEASUREMENT
/begin MEASUREMENT ESS_stNBattFFRes_mp "Drehzahl Resetbedingung für batteriespannungsabhängige Leerlaufsolldrehzahlerhöhung" UBYTE OneToOne 1 100 0.00 255.0 FORMAT "%5.1" ECU_ADDRESS 0x9FFE41 /end MEASUREMENT
/begin MEASUREMENT ESS_stNBattFFSet_mp "Drehzahl Setbedingung für batteriespannungsabhängige Leerlaufsolldrehzahlerhöhung" UBYTE OneToOne 1 100 0.00 255.0 FORMAT "%5.1" ECU_ADDRESS 0x9FFE42 /end MEASUREMENT
/begin MEASUREMENT ESS_stStrtDoneFFSet_mp "Startabwurf Set-Bedingung für batteriespannungsabhängige Leerlaufsolldrehzahlerhöhung" UBYTE OneToOne 1 100 0.00 255.0 FORMAT "%5.1" ECU_ADDRESS 0x9FFE43 /end MEASUREMENT
/begin MEASUREMENT ESS_stUBattFFRes_mp "Reset-Bedingung batteriespannungsabhängige Leerlaufsolldrehzahlerhöhung" UBYTE OneToOne 1 100 0.00 255.0 FORMAT "%5.1" ECU_ADDRESS 0x9FFE44 /end MEASUREMENT
/begin MEASUREMENT ESS_stUBattFFSet_mp "Set-Bedingung batteriespannungsabhängige Leerlaufsolldrehzahlerhöhung" UBYTE OneToOne 1 100 0.00 255.0 FORMAT "%5.1" ECU_ADDRESS 0x9FFE45 /end MEASUREMENT
/begin MEASUREMENT FanCD_numFanCtlr1ErrCnt_mp "Anzahl der bisher empfangenen Fehler der gleichen Fehlerart" UBYTE OneToOne 1 100 0.00 255.0 FORMAT "%5.1" ECU_ADDRESS 0x9FFE46 /end MEASUREMENT
/begin MEASUREMENT FanCD_numFanCtlr2ErrCnt_mp "Anzahl bisher empfangener LOW Pegel für Fehlerart FanCD_ stFanCtlr2ErrStrt_ mp" UBYTE OneToOne 1 100 0.00 255.0 FORMAT "%5.1" ECU_ADDRESS 0x9FFE47 /end MEASUREMENT
/begin MEASUREMENT FanCD_rFan1HWE_mp "Duty Cycle für Actuator" SWORD DtyCyc 1 100 -327.6800 327.6700 FORMAT "%8.4" ECU_ADDRESS 0x7FDDEA /end MEASUREMENT
/begin MEASUREMENT FanCD_rFan2HWE_mp "dem HWK übergebenes TV der Lüfterendstufe A_T_MLR2" SWORD DtyCyc 1 100 -327.6800 327.6700 FORMAT "%8.4" ECU_ADDRESS 0x7FDDEC /end MEASUREMENT
/begin MEASUREMENT FanCD_stFanCtlr1ErrStrt_mp "Fehlerart die aktuell entprellt wird Lüftersteuergerät 1" UBYTE OneToOne 1 100 0.00 255.0 FORMAT "%5.1" ECU_ADDRESS 0x9FFE48 /end MEASUREMENT
/begin MEASUREMENT FanCD_stFanCtlr2ErrStrt_mp "Fehlerart die aktuell entprellt wird Lüftersteuergerät 2" UBYTE OneToOne 1 100 0.00 255.0 FORMAT "%5.1" ECU_ADDRESS 0x9FFE49 /end MEASUREMENT
/begin MEASUREMENT FanCD_stShutOff "Aktueller Zustand der Lüfterabschalt-Statemachine" UBYTE OneToOne 1 100 0.00 255.0 FORMAT "%5.1" ECU_ADDRESS 0x7F93EA /end MEASUREMENT
/begin MEASUREMENT FanCD_swtFanShutOff "Schalter zur Deaktivierung der Lüfterabschaltung bei Nicht-Öffnen des Hauptrelais." UBYTE OneToOne 1 100 0.00 255.0 FORMAT "%5.1" ECU_ADDRESS 0x7F93EB /end MEASUREMENT
/begin MEASUREMENT FanCtl_dcycFan1 "Tastverhältnis für Lüfter 1" SWORD DtyCyc 1 100 -327.6800 327.6700 FORMAT "%8.4" ECU_ADDRESS 0x7F995E /end MEASUREMENT
/begin MEASUREMENT FanCtl_dcycFan1BSG_mp "Duty Cycle für fan1 mit BSG-Anforderung , maximum und ramp" SWORD DtyCyc 1 100 -327.6800 327.6700 FORMAT "%8.4" ECU_ADDRESS 0x9FF24A /end MEASUREMENT
/begin MEASUREMENT FanCtl_dcycFan1RampSwt_mp "Augenblickwert von Duty cycle für fan1" SWORD DtyCyc 1 100 -327.6800 327.6700 FORMAT "%8.4" ECU_ADDRESS 0x9FF264 /end MEASUREMENT
/begin MEASUREMENT FanCtl_dcycFan1Rgn_mp "Ansteuerwert des Lüfters 1 nach Regenerationskorrektur" SWORD DtyCyc 1 100 -327.6800 327.6700 FORMAT "%8.4" ECU_ADDRESS 0x9FF266 /end MEASUREMENT
/begin MEASUREMENT FanCtl_dcycFan1_mp "Duty Cycle für Fan1" SWORD DtyCyc 1 100 -327.6800 327.6700 FORMAT "%8.4" ECU_ADDRESS 0x9FF268 /end MEASUREMENT
/begin MEASUREMENT FanCtl_dcycFan2 "Tastverhältnis für Lüfter 2" SWORD DtyCyc 1 100 -327.6800 327.6700 FORMAT "%8.4" ECU_ADDRESS 0x7F9960 /end MEASUREMENT
/begin MEASUREMENT FanCtl_dcycFan2BSG_mp "Dutycycle für fan1 mit BSG-Request, Maximum und Rampe" SWORD DtyCyc 1 100 -327.6800 327.6700 FORMAT "%8.4" ECU_ADDRESS 0x9FF24C /end MEASUREMENT
/begin MEASUREMENT FanCtl_dcycFan2RampSwt_mp "duty cycle nach fan 2 ramp switch" SWORD DtyCyc 1 100 -327.6800 327.6700 FORMAT "%8.4" ECU_ADDRESS 0x9FF26A /end MEASUREMENT
/begin MEASUREMENT FanCtl_dcycFan2Rgn_mp "Ansteuerwert des Lüfters 2 nach Regenerationskorrektur" SWORD DtyCyc 1 100 -327.6800 327.6700 FORMAT "%8.4" ECU_ADDRESS 0x9FF26C /end MEASUREMENT
/begin MEASUREMENT FanCtl_dcycFan2_mp "Messwert für Dutycycle von Fan2" SWORD DtyCyc 1 100 -327.6800 327.6700 FORMAT "%8.4" ECU_ADDRESS 0x9FF26E /end MEASUREMENT
/begin MEASUREMENT FanCtl_dtClntDes_mp "Temperaturdifferenz für FanCtl_dtClntDesCorr_MAP" SWORD TempDiff_Kelv 1 100 -3276.800 3276.700 FORMAT "%8.3" ECU_ADDRESS 0x9FF270 /end MEASUREMENT
/begin MEASUREMENT FanCtl_dtClntDiff_mp "Abweichung Soll-Temperatur am Kühleraustritt und tatsächliche Temperatur" SWORD TempDiff_Kelv 1 100 -3276.800 3276.700 FORMAT "%8.3" ECU_ADDRESS 0x9FF272 /end MEASUREMENT
/begin MEASUREMENT FanCtl_dtCOTSCrit_mp "Differenz zwischen aktueller Temperatur am Kühleraustritt und einem Schwellwert" SWORD TempDiff_Kelv 1 100 -3276.800 3276.700 FORMAT "%8.3" ECU_ADDRESS 0x9FF274 /end MEASUREMENT
/begin MEASUREMENT FanCtl_dvolFlConsumFltHold_mp "Meßpunkt des gefilterter Verbrauchs für den Nachlaufprozeß der Kühlerlüftersteuerung" SWORD FlConsum_l_h 1 100 -327.6800 327.6700 FORMAT "%8.4" ECU_ADDRESS 0x9FF276 /end MEASUREMENT
/begin MEASUREMENT FanCtl_factACReqCorr_mp "Drehzahlabhängige zusatzlast durch AC" SWORD Fact 1 100 -4.000000 3.999878 FORMAT "%8.6" ECU_ADDRESS 0x9FF24E /end MEASUREMENT
/begin MEASUREMENT FanCtl_factApReq_mp "Kühlbedarf bei Anfahren in der Höhe" SWORD Fact 1 100 -4.000000 3.999878 FORMAT "%8.6" ECU_ADDRESS 0x9FF250 /end MEASUREMENT
/begin MEASUREMENT FanCtl_nFan1 "Berechnete Umdrehung für Fan1" SWORD EngN 1 100 -32768.00 32767.00 FORMAT "%8.2" ECU_ADDRESS 0x7F9962 /end MEASUREMENT
/begin MEASUREMENT FanCtl_nFan1Base2_mp "Das Ergebnis für Drehzahlmaximum um Fan1 toggle zu verhindern." SWORD EngN 1 100 -32768.00 32767.00 FORMAT "%8.2" ECU_ADDRESS 0x9FF278 /end MEASUREMENT
/begin MEASUREMENT FanCtl_nFan1Base_mp "Berechnete Wert von FanCtl_nFan1Base_MAP" SWORD EngN 1 100 -32768.00 32767.00 FORMAT "%8.2" ECU_ADDRESS 0x9FF27A /end MEASUREMENT
/begin MEASUREMENT FanCtl_nFan2 "Drehzahl für Lüfter 2 mit ausgeblendeten Drehzahlbereichen" SWORD EngN 1 100 -32768.00 32767.00 FORMAT "%8.2" ECU_ADDRESS 0x7F9964 /end MEASUREMENT
/begin MEASUREMENT FanCtl_nFan2Base2_mp "Ergebnis von Maximumderahzahl um fan 2 toggle zu verhindern." SWORD EngN 1 100 -32768.00 32767.00 FORMAT "%8.2" ECU_ADDRESS 0x9FF27C /end MEASUREMENT
/begin MEASUREMENT FanCtl_nFan2Base_mp "Berechnete Wert von FanCtl_nFan2Base_MAP" SWORD EngN 1 100 -32768.00 32767.00 FORMAT "%8.2" ECU_ADDRESS 0x9FF27E /end MEASUREMENT
/begin MEASUREMENT FanCtl_pAcHold_mp "gespeicherter Klimadruck" SWORD PresAC_hPa 1 100 -65536.00 65534.00 FORMAT "%8.2" ECU_ADDRESS 0x9FF280 /end MEASUREMENT
/begin MEASUREMENT FanCtl_pAc_mp "EIngangswert für die Tabelle prcQKakt and prcQKdeakt" SWORD PresAC_hPa 1 100 -65536.00 65534.00 FORMAT "%8.2" ECU_ADDRESS 0x9FF282 /end MEASUREMENT
/begin MEASUREMENT FanCtl_prcACMnSw_mp "output value of the curve prcQKdeakt" SWORD Prc 1 100 -327.6800 327.6700 FORMAT "%8.4" ECU_ADDRESS 0x9FF284 /end MEASUREMENT
/begin MEASUREMENT FanCtl_prcACReq_mp "Leistungsanforderung von AC" SWORD Prc 1 100 -327.6800 327.6700 FORMAT "%8.4" ECU_ADDRESS 0x9FF252 /end MEASUREMENT
/begin MEASUREMENT FanCtl_prcAC_mp "relative zusatzbelastung von AC" SWORD Prc 1 100 -327.6800 327.6700 FORMAT "%8.4" ECU_ADDRESS 0x9FF254 /end MEASUREMENT
/begin MEASUREMENT FanCtl_prcAddReq "Geregelte und umgewandelte Ausgangtemperatur des Kühlmittels  von Ausfluss" SWORD Prc 1 100 -327.6800 327.6700 FORMAT "%8.4" ECU_ADDRESS 0x7F9966 /end MEASUREMENT
/begin MEASUREMENT FanCtl_prcCAN "relative Kühlleistung in Prozent für CAN" SWORD Prc 1 100 -327.6800 327.6700 FORMAT "%8.4" ECU_ADDRESS 0x7F9968 /end MEASUREMENT
/begin MEASUREMENT FanCtl_prcCanReq_mp "Berechnete Leistungsanforderung von CAN-Message" SWORD Prc 1 100 -327.6800 327.6700 FORMAT "%8.4" ECU_ADDRESS 0x9FF256 /end MEASUREMENT
/begin MEASUREMENT FanCtl_prcClntDesDiff_mp "relative Sollkühlleistung über den Kühler" SWORD Prc 1 100 -327.6800 327.6700 FORMAT "%8.4" ECU_ADDRESS 0x9FF286 /end MEASUREMENT
/begin MEASUREMENT FanCtl_prcClntInc_mp "Messwert für die Zusatzkühlung der angeforderten motortemperatur von CAN" SWORD Prc 1 100 -327.6800 327.6700 FORMAT "%8.4" ECU_ADDRESS 0x9FF258 /end MEASUREMENT
/begin MEASUREMENT FanCtl_prcCtl_mp "Angeforderte Kühlungstemperatur am Ausfluss. Convertiert zur Leistung" SWORD Prc 1 100 -327.6800 327.6700 FORMAT "%8.4" ECU_ADDRESS 0x9FF25A /end MEASUREMENT
/begin MEASUREMENT FanCtl_prcFan_mp "Berechnete Leistungsanforderung von CAN-Message" SWORD Prc 1 100 -327.6800 327.6700 FORMAT "%8.4" ECU_ADDRESS 0x9FF25C /end MEASUREMENT
/begin MEASUREMENT FanCtl_prcQDes_mp "Kühlleistung für Fan nach Maximum" SWORD Prc 1 100 -327.6800 327.6700 FORMAT "%8.4" ECU_ADDRESS 0x9FF25E /end MEASUREMENT
/begin MEASUREMENT FanCtl_prcRampFan1_mp "Kühlleistung für hydrofan nach maximum und rampe" SWORD Prc 1 100 -327.6800 327.6700 FORMAT "%8.4" ECU_ADDRESS 0x9FF260 /end MEASUREMENT
/begin MEASUREMENT FanCtl_prcRampFan2_mp "Kühlleistung für Lüfter 2 nach maximum und rampe" SWORD Prc 1 100 -327.6800 327.6700 FORMAT "%8.4" ECU_ADDRESS 0x9FF262 /end MEASUREMENT
/begin MEASUREMENT FanCtl_prcRelClntDes1_mp "Korrekturwert der Solltemperatur für den relativen dynamischen Kühlbedarf" SWORD Prc 1 100 -327.6800 327.6700 FORMAT "%8.4" ECU_ADDRESS 0x9FF288 /end MEASUREMENT
/begin MEASUREMENT FanCtl_prcRelClntDes2_mp "relativer dynamischer Kühlbedarf" SWORD Prc 1 100 -327.6800 327.6700 FORMAT "%8.4" ECU_ADDRESS 0x9FF28A /end MEASUREMENT
/begin MEASUREMENT FanCtl_prcRelClntDes_mp "Solltemperaturdifferenz des Kühlers für den relativen dynamische Kühlbedarf" SWORD Prc 1 100 -327.6800 327.6700 FORMAT "%8.4" ECU_ADDRESS 0x9FF28C /end MEASUREMENT
/begin MEASUREMENT FanCtl_stAfterrunRamp "Status der Rampe" UBYTE OneToOne 1 100 0.00 255.0 FORMAT "%5.1" ECU_ADDRESS 0x7F93EC /end MEASUREMENT
/begin MEASUREMENT FanCtl_stCtl_mp "bitcodierte Stati der Lüftersteuerung" UWORD OneToOne 1 100 0.00 65535.00 FORMAT "%8.2" ECU_ADDRESS 0x9FF28E /end MEASUREMENT
/begin MEASUREMENT FanCtl_stOut "Zustand Lüfternachlauf" UBYTE OneToOne 1 100 0.00 255.0 FORMAT "%5.1" ECU_ADDRESS 0x7F93ED /end MEASUREMENT
/begin MEASUREMENT FanCtl_stShutOffRamp "Status der Elektrolüfterabschaltrampe" UBYTE OneToOne 1 100 0.00 255.0 FORMAT "%5.1" ECU_ADDRESS 0x7F93EE /end MEASUREMENT
/begin MEASUREMENT FanCtl_stStrt "Startstatus - Drehzahl- und Zeitabhängig" UBYTE OneToOne 1 100 0.00 255.0 FORMAT "%5.1" ECU_ADDRESS 0x7F93EF /end MEASUREMENT
/begin MEASUREMENT FanCtl_swtClgModVar "Schalterzustand des Kühlleistungsvariantenschalters" UBYTE OneToOne 1 100 0.00 255.0 FORMAT "%5.1" ECU_ADDRESS 0x7F93F0 /end MEASUREMENT
/begin MEASUREMENT FanCtl_tAirHold_mp "Umgebungstemperatur  für den Nachlaufprozeß" SWORD Temp_Cels 1 100 -3549.940 3003.560 FORMAT "%8.3" ECU_ADDRESS 0x9FF290 /end MEASUREMENT
/begin MEASUREMENT FanCtl_tClntCrit "berechnete kritische Kühlmitteltemperatur" SWORD Temp_Cels 1 100 -3549.940 3003.560 FORMAT "%8.3" ECU_ADDRESS 0x7F996A /end MEASUREMENT
/begin MEASUREMENT FanCtl_tClntDesFlt_mp "PT1-gefilterter Kühlmitteltemperatursollwert" SWORD Temp_Cels 1 100 -3549.940 3003.560 FORMAT "%8.3" ECU_ADDRESS 0x9FF292 /end MEASUREMENT
/begin MEASUREMENT FanCtl_tCTSCurr_mp "aktuelle Eingangstemperatur des Kennfeld FanCtl_tClntDes_MAP" SWORD Temp_Cels 1 100 -3549.940 3003.560 FORMAT "%8.3" ECU_ADDRESS 0x9FF294 /end MEASUREMENT
/begin MEASUREMENT FanCtl_tiAfterrun_mp "berechnete Lüfternachlaufdauer" ULONG Time_ms 1 100 0.00 42949672950.0 FORMAT "%13.1" ECU_ADDRESS 0x9FE580 /end MEASUREMENT
/begin MEASUREMENT FanCtl_tiARprc_mp "prozentueller Anteil der 1. Lüfternachlaufzeit für die Ermittlung einer neuen Dauer" ULONG Time_ms 1 100 0.00 42949672950.0 FORMAT "%13.1" ECU_ADDRESS 0x9FE584 /end MEASUREMENT
/begin MEASUREMENT FanCtl_tiARremain_mp "verbleibende Nachlaufzeit" ULONG Time_ms 1 100 0.00 42949672950.0 FORMAT "%13.1" ECU_ADDRESS 0x9FE588 /end MEASUREMENT
/begin MEASUREMENT FanCtl_tiAR_mp "aktuelle Dauer des Lüfternachlaufs" ULONG Time_ms 1 100 0.00 42949672950.0 FORMAT "%13.1" ECU_ADDRESS 0x9FE58C /end MEASUREMENT
/begin MEASUREMENT FanCtl_vCurr2_mp "zweite verwendete Fahrzeuggeschwindigkeit" SWORD Vel 1 100 -327.6800 327.6700 FORMAT "%8.4" ECU_ADDRESS 0x9FF296 /end MEASUREMENT
/begin MEASUREMENT FanCtl_vCurr_mp "verwendete Fahrzeuggeschwindigkeit" SWORD Vel 1 100 -327.6800 327.6700 FORMAT "%8.4" ECU_ADDRESS 0x9FF298 /end MEASUREMENT
/begin MEASUREMENT FBC_AALOut_mp "Ausgang des Antialiasingfiler" FLOAT32_IEEE OneToOne 1 100 -150000000. 150000000. FORMAT "%10.0" ECU_ADDRESS 0x9FE5A4 /end MEASUREMENT
/begin MEASUREMENT FBC_Badpt "Adaptionsstatus" UBYTE OneToOne 1 100 0.00 255.0 FORMAT "%5.1" ECU_ADDRESS 0x7F93E0 /end MEASUREMENT
/begin MEASUREMENT FBC_BPAmpCaS_mp "aktueller Bandpass Zählerkoeffizient f=fNW (gangabhängig)" FLOAT32_IEEE OneToOne 1 100 -4.00000000 4.00000000 FORMAT "%10.8" ECU_ADDRESS 0x9FE590 /end MEASUREMENT
/begin MEASUREMENT FBC_cntIniBP_mp "Initialisierungszähler für Bandpässe der LRR" UWORD OneToOne 1 100 0.00 65535.00 FORMAT "%8.2" ECU_ADDRESS 0x9FF2B6 /end MEASUREMENT
/begin MEASUREMENT FBC_cntWcySettled_mp "Zähler für Arbeitsspiele in eingeregeltem Zustand" UWORD OneToOne 1 100 0.00 65535.00 FORMAT "%8.2" ECU_ADDRESS 0x9FF2B8 /end MEASUREMENT
/begin MEASUREMENT FBC_cntWcyStrt_mp "Zähler für Arbeitsspiele seit Motorstart" SWORD OneToOne 1 100 -32768.00 32767.00 FORMAT "%8.2" ECU_ADDRESS 0x9FF2BA /end MEASUREMENT
/begin MEASUREMENT FBC_ctSegInt "interner Segmentzähler von FBC" UBYTE OneToOne 1 100 0.00 255.0 FORMAT "%5.1" ECU_ADDRESS 0x7F93E2 /end MEASUREMENT
/begin MEASUREMENT FBC_dBPCaSOld_mp "Array mit alten Bandpassausgängen" FLOAT32_IEEE OneToOne 1 100 -150000000. 150000000. FORMAT "%10.0" ARRAY_SIZE 2 ECU_ADDRESS 0x9FE594 /end MEASUREMENT
/begin MEASUREMENT FBC_dBPCaS_mp "Array der Bandpassausgänge" SWORD EngN 1 100 -32768.00 32767.00 FORMAT "%8.2" ARRAY_SIZE 2 ECU_ADDRESS 0x9FF29A /end MEASUREMENT
/begin MEASUREMENT FBC_dBPSum "FBC Mengenersatzsignal, Eingang PI-Regler" SWORD OneToOne 1 100 -32768.00 32767.00 FORMAT "%8.2" ECU_ADDRESS 0x7F9904 /end MEASUREMENT
/begin MEASUREMENT FBC_DXadpt_mp "aktuelle Adaptionsgüte" SWORD Dxs 1 100 -0.8192000 0.8191750 FORMAT "%9.7" ECU_ADDRESS 0x9FF2D6 /end MEASUREMENT
/begin MEASUREMENT FBC_DXSfn_mp "Ausgang des negativen Bewertungsfilter" SWORD Dxs 1 100 -0.8192000 0.8191750 FORMAT "%9.7" ARRAY_SIZE 8 ECU_ADDRESS 0x9FF2D8 /end MEASUREMENT
/begin MEASUREMENT FBC_DXSfp_mp "Ausgang des positiven Bewertungsfilter" SWORD Dxs 1 100 -0.8192000 0.8191750 FORMAT "%9.7" ARRAY_SIZE 8 ECU_ADDRESS 0x9FF2E8 /end MEASUREMENT
/begin MEASUREMENT FBC_DXSf_mp "relative,aktuelle und gefilterte Zahnteilungsfehler (Adaptionsfilter)" SWORD Dxs 1 100 -0.8192000 0.8191750 FORMAT "%9.7" ARRAY_SIZE 8 ECU_ADDRESS 0x9FF2F8 /end MEASUREMENT
/begin MEASUREMENT FBC_DXSl_mp "relative, gefilterte Zahnteilungsfehler (Adaptionsfilter, eingelernte Werte)" SWORD Dxs 1 100 -0.8192000 0.8191750 FORMAT "%9.7" ARRAY_SIZE 8 ECU_ADDRESS 0x9FF308 /end MEASUREMENT
/begin MEASUREMENT FBC_DXS_mp "relative Zahnteilungsfehler (ungefiltert)" SWORD Dxs 1 100 -0.8192000 0.8191750 FORMAT "%9.7" ARRAY_SIZE 8 ECU_ADDRESS 0x9FF318 /end MEASUREMENT
/begin MEASUREMENT FBC_idxPreCtlApplyQnt_mp "Einspritzmengenindex des aktuellen Anwendungsbereiches" SWORD OneToOne 1 100 -32768.00 32767.00 FORMAT "%8.2" ECU_ADDRESS 0x9FF2BC /end MEASUREMENT
/begin MEASUREMENT FBC_idxPreCtlApplySpd_mp "Drehzahlindex des aktuellen Anwendungsbereiches" SWORD OneToOne 1 100 -32768.00 32767.00 FORMAT "%8.2" ECU_ADDRESS 0x9FF2BE /end MEASUREMENT
/begin MEASUREMENT FBC_idxPreCtlApplyTemp_mp "Temperaturindex des aktuellen Anwendungsbereiches" SWORD OneToOne 1 100 -32768.00 32767.00 FORMAT "%8.2" ECU_ADDRESS 0x9FF2C0 /end MEASUREMENT
/begin MEASUREMENT FBC_idxPreCtlLrnOutCyl_mp "Zylinder der sequentiellen Lernwertausgabe" SWORD OneToOne 1 100 -32768.00 32767.00 FORMAT "%8.2" ECU_ADDRESS 0x9FF2C2 /end MEASUREMENT
/begin MEASUREMENT FBC_idxPreCtlLrnOutQnt_mp "Mengenindex für sequentielle Lernwertausgabe" SWORD OneToOne 1 100 -32768.00 32767.00 FORMAT "%8.2" ECU_ADDRESS 0x9FF2C4 /end MEASUREMENT
/begin MEASUREMENT FBC_idxPreCtlLrnOutSpd_mp "Drehzahlindex für sequentielle Lernwertausgabe" SWORD OneToOne 1 100 -32768.00 32767.00 FORMAT "%8.2" ECU_ADDRESS 0x9FF2C6 /end MEASUREMENT
/begin MEASUREMENT FBC_idxPreCtlLrnOutTemp_mp "Temperaturindex für sequentielle Lernwertausgabe" SWORD OneToOne 1 100 -32768.00 32767.00 FORMAT "%8.2" ECU_ADDRESS 0x9FF2C8 /end MEASUREMENT
/begin MEASUREMENT FBC_idxPreCtlLrnQnt_mp "Einspritzmengenindex des aktuellen Lern-Arbeitsbereiches" SWORD OneToOne 1 100 -32768.00 32767.00 FORMAT "%8.2" ECU_ADDRESS 0x9FF2CA /end MEASUREMENT
/begin MEASUREMENT FBC_idxPreCtlLrnSpd_mp "Drehzahlindex des aktuellen Lern-Arbeitsbereiches" SWORD OneToOne 1 100 -32768.00 32767.00 FORMAT "%8.2" ECU_ADDRESS 0x9FF2CC /end MEASUREMENT
/begin MEASUREMENT FBC_idxPreCtlLrnTempRatio_mp "Index (MSB) und Verhältnis (LSB) der Temperaturbereiche" ULONG OneToOne 1 100 0.00 4294967295.00 FORMAT "%13.2" ECU_ADDRESS 0x9FE59C /end MEASUREMENT
/begin MEASUREMENT FBC_idxPreCtlLrnTemp_mp "Temperaturindex des aktuellen Lern-Arbeitsbereiches" SWORD OneToOne 1 100 -32768.00 32767.00 FORMAT "%8.2" ECU_ADDRESS 0x9FF2CE /end MEASUREMENT
/begin MEASUREMENT FBC_nCtlOfsMin "Message des Offset der unteren drehzahlabhängigen Steuerschwelle zur aktuellen Leerlaufdrehzahl" SWORD EngN 1 100 -32768.00 32767.00 FORMAT "%8.2" ECU_ADDRESS 0x7F9906 /end MEASUREMENT
/begin MEASUREMENT FBC_nCtlThresMax "Message der oberen Drehzahlsteuerschwelle" SWORD EngN 1 100 -32768.00 32767.00 FORMAT "%8.2" ECU_ADDRESS 0x7F9908 /end MEASUREMENT
/begin MEASUREMENT FBC_nGvrnOfsMin "Message des Offset der unteren drehzahlabhängigen Regelschwelle zur aktuellen Leerlaufdrehzahl" SWORD EngN 1 100 -32768.00 32767.00 FORMAT "%8.2" ECU_ADDRESS 0x7F990A /end MEASUREMENT
/begin MEASUREMENT FBC_nGvrnThresMax "Message der oberen Drehzahlregelschwelle" SWORD EngN 1 100 -32768.00 32767.00 FORMAT "%8.2" ECU_ADDRESS 0x7F990C /end MEASUREMENT
/begin MEASUREMENT FBC_q "Ausgangsmenge der Mengenausgleichsregelung" SWORD InjMass 1 100 -327.6800 327.6700 FORMAT "%8.4" ECU_ADDRESS 0x7F990E /end MEASUREMENT
/begin MEASUREMENT FBC_qCtlOfsMax "Message des Offset für obere mengenabhängige Steuerschwelle" SWORD InjMass 1 100 -327.6800 327.6700 FORMAT "%8.4" ECU_ADDRESS 0x7F9910 /end MEASUREMENT
/begin MEASUREMENT FBC_qCtlThresMin "Message der unteren Mengensteuerschwelle" SWORD InjMass 1 100 -327.6800 327.6700 FORMAT "%8.4" ECU_ADDRESS 0x7F9912 /end MEASUREMENT
/begin MEASUREMENT FBC_qDvtCyl "aktuelle zylinderindividuelle Korrekturmenge: I-Anteil" SWORD InjMass 1 100 -327.6800 327.6700 FORMAT "%8.4" ARRAY_SIZE 5 ECU_ADDRESS 0x7F9FE8 /end MEASUREMENT
/begin MEASUREMENT FBC_qGvrnThresMax "Message der oberen mengenabhängige Regelschwelle" SWORD InjMass 1 100 -327.6800 327.6700 FORMAT "%8.4" ECU_ADDRESS 0x9FE2D4 /end MEASUREMENT
/begin MEASUREMENT FBC_qGvrnThresMin "Message der unteren Mengenregelschwelle" SWORD InjMass 1 100 -327.6800 327.6700 FORMAT "%8.4" ECU_ADDRESS 0x7F9914 /end MEASUREMENT
/begin MEASUREMENT FBC_qIntegrator "Integratorwerte der Laufruheregelung" FLOAT32_IEEE InjMass_float 1 100 -20.0000000 20.0000000 FORMAT "%10.7" ARRAY_SIZE 4 ECU_ADDRESS 0x7FA000 /end MEASUREMENT
/begin MEASUREMENT FBC_qLimAct "Aktuelle Begrenzungsmenge für FBC_q" SWORD InjMass 1 100 -327.6800 327.6700 FORMAT "%8.4" ECU_ADDRESS 0x7F9916 /end MEASUREMENT
/begin MEASUREMENT FBC_qPreCtlApplyOutArr_mp "Vorzusteuernde Werte für den aktuellen Arbeitspunkt" SWORD FBCPreCtlInjRAM 1 100 -10.24000 10.23969 FORMAT "%8.5" ARRAY_SIZE 4 ECU_ADDRESS 0x9FF29E /end MEASUREMENT
/begin MEASUREMENT FBC_qPreCtlArr_mp "Letzter vorgesteuerter FBC-Wert" SWORD FBCPreCtlInjRAM 1 100 -10.24000 10.23969 FORMAT "%8.5" ARRAY_SIZE 4 ECU_ADDRESS 0x9FF2A6 /end MEASUREMENT
/begin MEASUREMENT FBC_qPreCtlLimAct_mp "Limit zur Vorsteuerung von FBC" SWORD InjMass 1 100 -327.6800 327.6700 FORMAT "%8.4" ECU_ADDRESS 0x9FF2D0 /end MEASUREMENT
/begin MEASUREMENT FBC_qPreCtlLrnOutArr_mp "Ausgabe der aktuellen Lernwerte" SWORD FBCPreCtlInjRAM 1 100 -10.24000 10.23969 FORMAT "%8.5" ARRAY_SIZE 4 ECU_ADDRESS 0x9FF2AE /end MEASUREMENT
/begin MEASUREMENT FBC_qPreCtlOut_mp "Korrekturmenge des aktuellen Ausgabeindex" SWORD FBCPreCtlInjRAM 1 100 -10.24000 10.23969 FORMAT "%8.5" ECU_ADDRESS 0x9FF2D2 /end MEASUREMENT
/begin MEASUREMENT FBC_RegionChng "signalisiert einen Wechsel der Lernregion in der FBC" UBYTE OneToOne 1 100 0.00 255.0 FORMAT "%5.1" ECU_ADDRESS 0x7F93E1 /end MEASUREMENT
/begin MEASUREMENT FBC_Region_mp "Drehzahl-/Mengenbereich für ""regeln - steuern - inaktiv""" UBYTE OneToOne 1 100 0.00 255.0 FORMAT "%5.1" ECU_ADDRESS 0x9FFE50 /end MEASUREMENT
/begin MEASUREMENT FBC_stActive "Status FBC-Regler -> '1': Regeln; '0': Steuern" UBYTE OneToOne 1 100 0.00 255.0 FORMAT "%5.1" ECU_ADDRESS 0x7F93E3 /end MEASUREMENT
/begin MEASUREMENT FBC_stBPRedNum_mp "Status der Reduzierung der Bandpassverstärkungen (TRUE:Aktiv;FALSE:Inaktiv)" UBYTE OneToOne 1 100 0.00 255.0 FORMAT "%5.1" ECU_ADDRESS 0x9FFE4A /end MEASUREMENT
/begin MEASUREMENT FBC_stEqualInit "Initialisierungsstatus für FBC-Regler" UBYTE OneToOne 1 100 0.00 255.0 FORMAT "%5.1" ECU_ADDRESS 0x7F93E4 /end MEASUREMENT
/begin MEASUREMENT FBC_stLearn "Bitfeld für Übergänge des Zustandsautomaten" UWORD OneToOne 1 100 0.00 65535.00 FORMAT "%8.2" ECU_ADDRESS 0x7F9918 /end MEASUREMENT
/begin MEASUREMENT FBC_stPreCtlApplyCond_mp "Bedingungen für Vorsteuern mit Korrekturmengen" UWORD OneToOne 1 100 0.00 65535.00 FORMAT "%8.2" ECU_ADDRESS 0x9FF2D4 /end MEASUREMENT
/begin MEASUREMENT FBC_stPreCtlApplyLrnFin_mp "Zustand des Vorsteuerns" UBYTE OneToOne 1 100 0.00 255.0 FORMAT "%5.1" ECU_ADDRESS 0x9FFE4C /end MEASUREMENT
/begin MEASUREMENT FBC_stPreCtlApply_mp "Statemachine Vorsteuern mit eingelernten Korrekturmengen" SBYTE OneToOne 1 100 -128.0 127.0 FORMAT "%5.1" ECU_ADDRESS 0x9FFE4D /end MEASUREMENT
/begin MEASUREMENT FBC_stPreCtlErrEEP_mp "Error-Status der EEPROM-Lesefunktion (0=OK)" SBYTE OneToOne 1 100 -128.0 127.0 FORMAT "%5.1" ECU_ADDRESS 0x9FFE4E /end MEASUREMENT
/begin MEASUREMENT FBC_stPreCtlLrnCond_mp "Bedingungen für Lernen von Korrekturmengen" ULONG OneToOne 1 100 0.00 4294967295.00 FORMAT "%13.2" ECU_ADDRESS 0x9FE5A0 /end MEASUREMENT
/begin MEASUREMENT FBC_stPreCtlLrn_mp "Statemachine Lernen von Korrekturmengen" SBYTE OneToOne 1 100 -128.0 127.0 FORMAT "%5.1" ECU_ADDRESS 0x9FFE4F /end MEASUREMENT
/begin MEASUREMENT FBC_stRegion "LRR-Zustand abhängig vom Mengen-/Drehzahlbereich" UBYTE OneToOne 1 100 0.00 255.0 FORMAT "%5.1" ECU_ADDRESS 0x7F93E5 /end MEASUREMENT
/begin MEASUREMENT FBC_stRegion_mp "Status  Regler in Abhängigkeit von Menge/Drehzahl ('regeln','steuern','inaktiv')" UBYTE OneToOne 1 100 0.00 255.0 FORMAT "%5.1" ECU_ADDRESS 0x9FFE4B /end MEASUREMENT
/begin MEASUREMENT FBC_stState_mp "Status des Zustandsautomates der Adaption" UBYTE FBC_LrnState 1 100 1.00000000000 5.00000000000 FORMAT "%13.11" ECU_ADDRESS 0x9FFE51 /end MEASUREMENT
/begin MEASUREMENT FBC_WheelLrnOut "Eingangsignal für FBC Bandpässe" FLOAT32_IEEE OneToOne 1 100 -1.00000000E+35 1.00000000E+35 FORMAT "%10.0" ECU_ADDRESS 0x7F9E28 /end MEASUREMENT
/begin MEASUREMENT FidCol_mp "Meßpunkt der gesammelt den Zustand aller Funktionsidentifier (Fid) zur Verfügung stellt." UWORD OneToOne 1 100 0.00 65535.00 FORMAT "%8.2" ARRAY_SIZE 30 ECU_ADDRESS 0x9FF004 /end MEASUREMENT
/begin MEASUREMENT Fid_AC1Can_mp "Messpunkt fuer Funktions Identifier Fid_AC1Can" UBYTE OneToOne 1 100 0.00 255.0 FORMAT "%5.1" ECU_ADDRESS 0x9FFC26 /end MEASUREMENT
/begin MEASUREMENT Fid_AC1PresCan_mp "Messpunkt fuer Funktions Identifier Fid_AC1PresCan" UBYTE OneToOne 1 100 0.00 255.0 FORMAT "%5.1" ECU_ADDRESS 0x9FFC27 /end MEASUREMENT
/begin MEASUREMENT Fid_AC1TrqCan_mp "Messpunkt fuer Funktions Identifier Fid_AC1TrqCan" UBYTE OneToOne 1 100 0.00 255.0 FORMAT "%5.1" ECU_ADDRESS 0x9FFC28 /end MEASUREMENT
/begin MEASUREMENT Fid_ACCAccPed_mp "Meßpunkt für Funktionsidentifier ACCAccPed (AccPed-Fehler)" UBYTE OneToOne 1 100 0.00 255.0 FORMAT "%5.1" ECU_ADDRESS 0x9FFC29 /end MEASUREMENT
/begin MEASUREMENT Fid_ACCAirbCDCrash_mp "Meßpunkt für Funktions-ID Abschaltung ACC durch Airbag" UBYTE OneToOne 1 100 0.00 255.0 FORMAT "%5.1" ECU_ADDRESS 0x9FFC2A /end MEASUREMENT
/begin MEASUREMENT Fid_ACCBrkErr_mp "CAN-Fehler Bremse1 und Bremse8 bei Audi-ACC" UBYTE OneToOne 1 100 0.00 255.0 FORMAT "%5.1" ECU_ADDRESS 0x9FFC2B /end MEASUREMENT
/begin MEASUREMENT Fid_ACCCDBrkIRev_mp "Fid für Irev shutoff ACC system" UBYTE OneToOne 1 100 0.00 255.0 FORMAT "%5.1" ECU_ADDRESS 0x9FFC2C /end MEASUREMENT
/begin MEASUREMENT Fid_ACCCDCan_mp "Meßpunkt für Funktionsidentifier ACCCDCan (Can-Fehler)" UBYTE OneToOne 1 100 0.00 255.0 FORMAT "%5.1" ECU_ADDRESS 0x9FFC2D /end MEASUREMENT
/begin MEASUREMENT Fid_ACCCDSens_mp "Messpunkt der Fid für ACCCD Sensor-Fehler" UBYTE OneToOne 1 100 0.00 255.0 FORMAT "%5.1" ECU_ADDRESS 0x9FFC2E /end MEASUREMENT
/begin MEASUREMENT Fid_ACCCD_frcRoad_mp "Meßpunkt Fid_ACCCD_frcRoad" UBYTE OneToOne 1 100 0.00 255.0 FORMAT "%5.1" ECU_ADDRESS 0x9FFC2F /end MEASUREMENT
/begin MEASUREMENT Fid_ACCCD_VehTrail_mp "Meßpunkt Fid_ACCCD_VehTrail : Trailer Defekt" UBYTE OneToOne 1 100 0.00 255.0 FORMAT "%5.1" ECU_ADDRESS 0x9FFC30 /end MEASUREMENT
/begin MEASUREMENT Fid_ACCECUIntErr_mp "Meßpunkt des Fehlerpfades ""Brake and OvRMon Errors""" UBYTE OneToOne 1 100 0.00 255.0 FORMAT "%5.1" ECU_ADDRESS 0x9FFC31 /end MEASUREMENT
/begin MEASUREMENT Fid_ACCEngCodPlb_mp "Fid für Unplausibilität bei Getriebecodierung im MSG" UBYTE OneToOne 1 100 0.00 255.0 FORMAT "%5.1" ECU_ADDRESS 0x9FFC32 /end MEASUREMENT
/begin MEASUREMENT Fid_ACCIRev_mp "Meßpunkt des Fehlerpfades ""Irreversible Abschaltung ACC/GRA""" UBYTE OneToOne 1 100 0.00 255.0 FORMAT "%5.1" ECU_ADDRESS 0x9FFC33 /end MEASUREMENT
/begin MEASUREMENT Fid_ACCMsgErr_mp "Meßpunkt des Fehlerpfades ""ACC-FrmMng Errors""" UBYTE OneToOne 1 100 0.00 255.0 FORMAT "%5.1" ECU_ADDRESS 0x9FFC34 /end MEASUREMENT
/begin MEASUREMENT Fid_ACCOffRev_mp "Meßpunkt des Fehlerpfades  Timeout der Airbag-Botshaft" UBYTE OneToOne 1 100 0.00 255.0 FORMAT "%5.1" ECU_ADDRESS 0x9FFC35 /end MEASUREMENT
/begin MEASUREMENT Fid_AccPedDO_mp "FID für Anfahrregler" UBYTE OneToOne 1 100 0.00 255.0 FORMAT "%5.1" ECU_ADDRESS 0x9FFC36 /end MEASUREMENT
/begin MEASUREMENT Fid_AccPedMstrShft_mp "Fid fuer Mastershift" UBYTE OneToOne 1 100 0.00 255.0 FORMAT "%5.1" ECU_ADDRESS 0x9FFC37 /end MEASUREMENT
/begin MEASUREMENT Fid_AccPedVel_mp "Messpunkt fuer Fid_AccPedVel" UBYTE OneToOne 1 100 0.00 255.0 FORMAT "%5.1" ECU_ADDRESS 0x9FFC38 /end MEASUREMENT
/begin MEASUREMENT Fid_AccPed_BrkCDBPTInvld_mp "FID für Unplausibilität BrkCD" UBYTE OneToOne 1 100 0.00 255.0 FORMAT "%5.1" ECU_ADDRESS 0x9FFC39 /end MEASUREMENT
/begin MEASUREMENT Fid_AccPed_Brk_mp "Verriegelung der Freigabe der Überprüfung auf Unplausibilität  bei defekter Bremse" UBYTE OneToOne 1 100 0.00 255.0 FORMAT "%5.1" ECU_ADDRESS 0x9FFC3A /end MEASUREMENT
/begin MEASUREMENT Fid_AccPed_mp "Funktionsidentifizierer des APP1-Sensors, APP2-Sensors und ADC in diesem Modul" UBYTE OneToOne 1 100 0.00 255.0 FORMAT "%5.1" ECU_ADDRESS 0x9FFC3B /end MEASUREMENT
/begin MEASUREMENT Fid_ACCPlCheck_mp "Meßpunkt des Fehlerpfades ""nichtplausiblesAUDI-ACC-SG""" UBYTE OneToOne 1 100 0.00 255.0 FORMAT "%5.1" ECU_ADDRESS 0x9FFC3C /end MEASUREMENT
/begin MEASUREMENT Fid_ACCtl_ACP_mp "Messpunkt fuer Funktions Identifier Fid_ACCtl_ACP" UBYTE OneToOne 1 100 0.00 255.0 FORMAT "%5.1" ECU_ADDRESS 0x9FFC3D /end MEASUREMENT
/begin MEASUREMENT Fid_ACCtl_EATSCD_mp "Messpunkt fuer Funktions Identifier Fid_ACCtl_EATSCD" UBYTE OneToOne 1 100 0.00 255.0 FORMAT "%5.1" ECU_ADDRESS 0x9FFC3E /end MEASUREMENT
/begin MEASUREMENT Fid_ACCtl_ESCUCan_mp "Messpunkt fuer Funktions Identifier Fid_ACCtl_ESCUCan" UBYTE OneToOne 1 100 0.00 255.0 FORMAT "%5.1" ECU_ADDRESS 0x9FFC3F /end MEASUREMENT
/begin MEASUREMENT Fid_ACCtl_FanCtl1_mp "FID für Fehler des Lüfters 1" UBYTE OneToOne 1 100 0.00 255.0 FORMAT "%5.1" ECU_ADDRESS 0x9FFC40 /end MEASUREMENT
/begin MEASUREMENT Fid_ACCtl_FanCtl2_mp "FID für Fehler der Lüfters 2" UBYTE OneToOne 1 100 0.00 255.0 FORMAT "%5.1" ECU_ADDRESS 0x9FFC41 /end MEASUREMENT
/begin MEASUREMENT Fid_ACCtl_SysErr_mp "Messpunkt fuer Funktions Identifier Fid_ACCtl_SysErr" UBYTE OneToOne 1 100 0.00 255.0 FORMAT "%5.1" ECU_ADDRESS 0x9FFC42 /end MEASUREMENT
/begin MEASUREMENT Fid_ACCtl_TSC1Can_mp "Messpunkt fuer Funktions Identifier Fid_ACCtl_TSC1Can" UBYTE OneToOne 1 100 0.00 255.0 FORMAT "%5.1" ECU_ADDRESS 0x9FFC43 /end MEASUREMENT
/begin MEASUREMENT Fid_ACCtl_VehStand_mp "Messpunkt fuer Funktions Identifier Fid_ACCtl_VehStand" UBYTE OneToOne 1 100 0.00 255.0 FORMAT "%5.1" ECU_ADDRESS 0x9FFC44 /end MEASUREMENT
/begin MEASUREMENT Fid_AFSCD_AirPerTime_mp "FID für Berechnung der Luftmasse pro Zeit" UBYTE OneToOne 1 100 0.00 255.0 FORMAT "%5.1" ECU_ADDRESS 0x9FFC45 /end MEASUREMENT
/begin MEASUREMENT Fid_AFSCD_mp "FID für Luftmassenberechnung" UBYTE OneToOne 1 100 0.00 255.0 FORMAT "%5.1" ECU_ADDRESS 0x9FFC46 /end MEASUREMENT
/begin MEASUREMENT Fid_AFSCD_PlOffsDrft_mp "FID für Funktion AFSCD_PlOffsDrft" UBYTE OneToOne 1 100 0.00 255.0 FORMAT "%5.1" ECU_ADDRESS 0x9FFC47 /end MEASUREMENT
/begin MEASUREMENT Fid_AFSCD_PlSetyDrft_mp "FID für Plausibilitätsprüfung für Empfindlichkeitsdrift des Sensorsignals" UBYTE OneToOne 1 100 0.00 255.0 FORMAT "%5.1" ECU_ADDRESS 0x9FFC48 /end MEASUREMENT
/begin MEASUREMENT Fid_AFSCD_SRCAirm_mp "FID für Funktion AFSCD_SRCAirm" UBYTE OneToOne 1 100 0.00 255.0 FORMAT "%5.1" ECU_ADDRESS 0x9FFC49 /end MEASUREMENT
/begin MEASUREMENT Fid_AFVCtlSigErr_mp "Messpunkt fuer Funktions Identifier Fid_AFVCtlSigErr" UBYTE OneToOne 1 100 0.00 255.0 FORMAT "%5.1" ECU_ADDRESS 0x9FFC4A /end MEASUREMENT
/begin MEASUREMENT Fid_AirbCDCan_mp "Messpunkt fuer Funktions Identifier Fid_AirbCDCan" UBYTE OneToOne 1 100 0.00 255.0 FORMAT "%5.1" ECU_ADDRESS 0x9FFC4B /end MEASUREMENT
/begin MEASUREMENT Fid_AirCtl_mp "AirCtl Fehler-Identifier" UBYTE OneToOne 1 100 0.00 255.0 FORMAT "%5.1" ECU_ADDRESS 0x9FFC4C /end MEASUREMENT
/begin MEASUREMENT Fid_AltCDLoad_mp "Meßpunkt für Funktionidentifier Fid_AltCDLoad" UBYTE OneToOne 1 100 0.00 255.0 FORMAT "%5.1" ECU_ADDRESS 0x9FFC4D /end MEASUREMENT
/begin MEASUREMENT Fid_AltCD_CANrDFM_mp "Funktion Identifier für Generatorlasterfassungsfehler über" UBYTE OneToOne 1 100 0.00 255.0 FORMAT "%5.1" ECU_ADDRESS 0x9FFC4E /end MEASUREMENT
/begin MEASUREMENT Fid_Alt_PwrCan_mp "FID für Energiemanager-Botschaft" UBYTE OneToOne 1 100 0.00 255.0 FORMAT "%5.1" ECU_ADDRESS 0x9FFC4F /end MEASUREMENT
/begin MEASUREMENT Fid_Alt_T15_mp "Funktions Identifier der Klemme 15" UBYTE OneToOne 1 100 0.00 255.0 FORMAT "%5.1" ECU_ADDRESS 0x9FFC50 /end MEASUREMENT
/begin MEASUREMENT Fid_AOHt_AC1Err_mp "Zusatzheizer kann nicht ausgeschalten werden wegen Anliegen des FrmMng_stAC Botschafts Fehlers" UBYTE OneToOne 1 100 0.00 255.0 FORMAT "%5.1" ECU_ADDRESS 0x9FFC51 /end MEASUREMENT
/begin MEASUREMENT Fid_AOHt_AltSRC_mp "Messpunkt fuer Funktions Identifier Fid_AOHt_AltSRC" UBYTE OneToOne 1 100 0.00 255.0 FORMAT "%5.1" ECU_ADDRESS 0x9FFC52 /end MEASUREMENT
/begin MEASUREMENT Fid_AOHt_CDHt1_mp "Fehler-Identifier Zusatzheizung 1" UBYTE OneToOne 1 100 0.00 255.0 FORMAT "%5.1" ECU_ADDRESS 0x9FFC53 /end MEASUREMENT
/begin MEASUREMENT Fid_AOHt_CDHt2_mp "Fehler-Identifier Zusatzheizung 2" UBYTE OneToOne 1 100 0.00 255.0 FORMAT "%5.1" ECU_ADDRESS 0x9FFC54 /end MEASUREMENT
/begin MEASUREMENT Fid_AOHt_ErrHt_mp "Messpunkt fuer Funktions Identifier Fid_AOHt_ErrHt" UBYTE OneToOne 1 100 0.00 255.0 FORMAT "%5.1" ECU_ADDRESS 0x9FFC55 /end MEASUREMENT
/begin MEASUREMENT Fid_AOHt_ESCUErr_mp "Zusatzheizer kann nicht ausgeschalten werden, wegen Anliegen des FrmMng_stESCU Botschafts Fehlers" UBYTE OneToOne 1 100 0.00 255.0 FORMAT "%5.1" ECU_ADDRESS 0x9FFC56 /end MEASUREMENT
/begin MEASUREMENT Fid_APP1_FiltOffRampOn_mp "Messpunkt fuer Funktions Identifier Fid_APP1_FiltOffRampOn" UBYTE OneToOne 1 100 0.00 255.0 FORMAT "%5.1" ECU_ADDRESS 0x9FFC57 /end MEASUREMENT
/begin MEASUREMENT Fid_APP1_mp "Fid für Fehlerpfad APP1" UBYTE OneToOne 1 100 0.00 255.0 FORMAT "%5.1" ECU_ADDRESS 0x9FFC58 /end MEASUREMENT
/begin MEASUREMENT Fid_APP1_Sens_mp "Messpunkt fuer Funktions Identifier Fid_APP1_Sens" UBYTE OneToOne 1 100 0.00 255.0 FORMAT "%5.1" ECU_ADDRESS 0x9FFC59 /end MEASUREMENT
/begin MEASUREMENT Fid_APP2_mp "Fid für Fehlerpfad APP2" UBYTE OneToOne 1 100 0.00 255.0 FORMAT "%5.1" ECU_ADDRESS 0x9FFC5A /end MEASUREMENT
/begin MEASUREMENT Fid_APP2_Sens_mp "Messpunkt fuer Funktions Identifier Fid_APP2_Sens" UBYTE OneToOne 1 100 0.00 255.0 FORMAT "%5.1" ECU_ADDRESS 0x9FFC5B /end MEASUREMENT
/begin MEASUREMENT Fid_APPCD_EEPROM_mp "Fid zum Sperren der EEPROM lesen Fehlererkennung" UBYTE OneToOne 1 100 0.00 255.0 FORMAT "%5.1" ECU_ADDRESS 0x9FFC5C /end MEASUREMENT
/begin MEASUREMENT Fid_APPCD_Prefill_mp "Fid zum Deaktivieren der Prefill Funktion" UBYTE OneToOne 1 100 0.00 255.0 FORMAT "%5.1" ECU_ADDRESS 0x9FFC5D /end MEASUREMENT
/begin MEASUREMENT Fid_APPKickdown_mp "Messpunkt für Fid_APPKickdown" UBYTE OneToOne 1 100 0.00 255.0 FORMAT "%5.1" ECU_ADDRESS 0x9FFC5E /end MEASUREMENT
/begin MEASUREMENT Fid_APPKickDown_VSS_mp "Fid zur Berechnung der Geschwindigkeit" UBYTE OneToOne 1 100 0.00 255.0 FORMAT "%5.1" ECU_ADDRESS 0x9FFC5F /end MEASUREMENT
/begin MEASUREMENT Fid_APSCD_mp "Fid für APSCD Fehlerpfad" UBYTE OneToOne 1 100 0.00 255.0 FORMAT "%5.1" ECU_ADDRESS 0x9FFC60 /end MEASUREMENT
/begin MEASUREMENT Fid_ASDdcNGvnr_mp "Status FID für Fehlerpfade die den Drehzahlregler deaktivieren" UBYTE OneToOne 1 100 0.00 255.0 FORMAT "%5.1" ECU_ADDRESS 0x9FFC61 /end MEASUREMENT
/begin MEASUREMENT Fid_ASDdcTrbnSpdCAN_mp "Messpunkt fuer Funktions Identifier Fid_ASDdcTrbnSpdCAN" UBYTE OneToOne 1 100 0.00 255.0 FORMAT "%5.1" ECU_ADDRESS 0x9FFC62 /end MEASUREMENT
/begin MEASUREMENT Fid_ASDdc_mp "FID zur Deaktivierung des ASDdc" UBYTE OneToOne 1 100 0.00 255.0 FORMAT "%5.1" ECU_ADDRESS 0x9FFC63 /end MEASUREMENT
/begin MEASUREMENT Fid_BIP_BattCD_mp "BIP_uBatt_mp gesetzt auf Default Label BIP_uBattDfl_C anstatt BattCD_u" UBYTE OneToOne 1 100 0.00 255.0 FORMAT "%5.1" ECU_ADDRESS 0x9FFC64 /end MEASUREMENT
/begin MEASUREMENT Fid_BIP_Control10_mp "Wechsel zur BIP-Steuerung gemäß BIP_stControl[10] = 1 für das SV in Zylinder 10" UBYTE OneToOne 1 100 0.00 255.0 FORMAT "%5.1" ECU_ADDRESS 0x9FFC65 /end MEASUREMENT
/begin MEASUREMENT Fid_BIP_Control11_mp "Wechsel zur BIP-Steuerung gemäß BIP_stControl[11] = 1 für das SV in Zylinder 11" UBYTE OneToOne 1 100 0.00 255.0 FORMAT "%5.1" ECU_ADDRESS 0x9FFC66 /end MEASUREMENT
/begin MEASUREMENT Fid_BIP_Control12_mp "Wechsel zur BIP-Steuerung gemäß BIP_stControl[12] = 1 für das SV in Zylinder 12" UBYTE OneToOne 1 100 0.00 255.0 FORMAT "%5.1" ECU_ADDRESS 0x9FFC67 /end MEASUREMENT
/begin MEASUREMENT Fid_BIP_Control1_mp "Wechsel zur BIP-Steuerung gemäß BIP_stControl[1] = 1 für das SV in Zylinder 1" UBYTE OneToOne 1 100 0.00 255.0 FORMAT "%5.1" ECU_ADDRESS 0x9FFC68 /end MEASUREMENT
/begin MEASUREMENT Fid_BIP_Control2_mp "Wechsel zur BIP-Steuerung gemäß BIP_stControl[2] = 1 für das SV in Zylinder 2" UBYTE OneToOne 1 100 0.00 255.0 FORMAT "%5.1" ECU_ADDRESS 0x9FFC69 /end MEASUREMENT
/begin MEASUREMENT Fid_BIP_Control3_mp "Wechsel zur BIP-Steuerung gemäß BIP_stControl[3] = 1 für das SV in Zylinder 3" UBYTE OneToOne 1 100 0.00 255.0 FORMAT "%5.1" ECU_ADDRESS 0x9FFC6A /end MEASUREMENT
/begin MEASUREMENT Fid_BIP_Control4_mp "Wechsel zur BIP-Steuerung gemäß BIP_stControl[4] = 1 für das SV in Zylinder 4" UBYTE OneToOne 1 100 0.00 255.0 FORMAT "%5.1" ECU_ADDRESS 0x9FFC6B /end MEASUREMENT
/begin MEASUREMENT Fid_BIP_Control5_mp "Wechsel zur BIP-Steuerung gemäß BIP_stControl[5] = 1 für das SV in Zylinder 5" UBYTE OneToOne 1 100 0.00 255.0 FORMAT "%5.1" ECU_ADDRESS 0x9FFC6C /end MEASUREMENT
/begin MEASUREMENT Fid_BIP_Control6_mp "Wechsel zur BIP-Steuerung gemäß BIP_stControl[6] = 1 für das SV in Zylinder 6" UBYTE OneToOne 1 100 0.00 255.0 FORMAT "%5.1" ECU_ADDRESS 0x9FFC6D /end MEASUREMENT
/begin MEASUREMENT Fid_BIP_Control7_mp "Wechsel zur BIP-Steuerung gemäß BIP_stControl[7] = 1 für das SV in Zylinder 7" UBYTE OneToOne 1 100 0.00 255.0 FORMAT "%5.1" ECU_ADDRESS 0x9FFC6E /end MEASUREMENT
/begin MEASUREMENT Fid_BIP_Control8_mp "Wechsel zur BIP-Steuerung gemäß BIP_stControl[8] = 1 für das SV in Zylinder 8" UBYTE OneToOne 1 100 0.00 255.0 FORMAT "%5.1" ECU_ADDRESS 0x9FFC6F /end MEASUREMENT
/begin MEASUREMENT Fid_BIP_Control9_mp "Wechsel zur BIP-Steuerung gemäß BIP_stControl[9] = 1 für das SV in Zylinder 9" UBYTE OneToOne 1 100 0.00 255.0 FORMAT "%5.1" ECU_ADDRESS 0x9FFC70 /end MEASUREMENT
/begin MEASUREMENT Fid_BIP_Err_mp "Abschaltung der BIP-Überwachung" UBYTE OneToOne 1 100 0.00 255.0 FORMAT "%5.1" ECU_ADDRESS 0x9FFC71 /end MEASUREMENT
/begin MEASUREMENT Fid_BIP_Set10_mp "Wechsel zur BIP-Steuerung gemäß BIP_stControl[10] = 2 für das SV in Zylinder 10" UBYTE OneToOne 1 100 0.00 255.0 FORMAT "%5.1" ECU_ADDRESS 0x9FFC72 /end MEASUREMENT
/begin MEASUREMENT Fid_BIP_Set11_mp "Wechsel zur BIP-Steuerung gemäß BIP_stControl[11] = 2 für das SV in Zylinder 11" UBYTE OneToOne 1 100 0.00 255.0 FORMAT "%5.1" ECU_ADDRESS 0x9FFC73 /end MEASUREMENT
/begin MEASUREMENT Fid_BIP_Set12_mp "Wechsel zur BIP-Steuerung gemäß BIP_stControl[12] = 2 für das SV in Zylinder 12" UBYTE OneToOne 1 100 0.00 255.0 FORMAT "%5.1" ECU_ADDRESS 0x9FFC74 /end MEASUREMENT
/begin MEASUREMENT Fid_BIP_Set1_mp "Wechsel zur BIP-Steuerung gemäß BIP_stControl[1] = 2 für das SV in Zylinder 1" UBYTE OneToOne 1 100 0.00 255.0 FORMAT "%5.1" ECU_ADDRESS 0x9FFC75 /end MEASUREMENT
/begin MEASUREMENT Fid_BIP_Set2_mp "Wechsel zur BIP-Steuerung gemäß BIP_stControl[2] = 2 für das SV in Zylinder 2" UBYTE OneToOne 1 100 0.00 255.0 FORMAT "%5.1" ECU_ADDRESS 0x9FFC76 /end MEASUREMENT
/begin MEASUREMENT Fid_BIP_Set3_mp "Wechsel zur BIP-Steuerung gemäß BIP_stControl[3] = 2 für das SV in Zylinder 3" UBYTE OneToOne 1 100 0.00 255.0 FORMAT "%5.1" ECU_ADDRESS 0x9FFC77 /end MEASUREMENT
/begin MEASUREMENT Fid_BIP_Set4_mp "Wechsel zur BIP-Steuerung gemäß BIP_stControl[4] = 2 für das SV in Zylinder 4" UBYTE OneToOne 1 100 0.00 255.0 FORMAT "%5.1" ECU_ADDRESS 0x9FFC78 /end MEASUREMENT
/begin MEASUREMENT Fid_BIP_Set5_mp "Wechsel zur BIP-Steuerung gemäß BIP_stControl[5] = 2 für das SV in Zylinder 5" UBYTE OneToOne 1 100 0.00 255.0 FORMAT "%5.1" ECU_ADDRESS 0x9FFC79 /end MEASUREMENT
/begin MEASUREMENT Fid_BIP_Set6_mp "Wechsel zur BIP-Steuerung gemäß BIP_stControl[6] = 2 für das SV in Zylinder 6" UBYTE OneToOne 1 100 0.00 255.0 FORMAT "%5.1" ECU_ADDRESS 0x9FFC7A /end MEASUREMENT
/begin MEASUREMENT Fid_BIP_Set7_mp "Wechsel zur BIP-Steuerung gemäß BIP_stControl[7] = 2 für das SV in Zylinder 7" UBYTE OneToOne 1 100 0.00 255.0 FORMAT "%5.1" ECU_ADDRESS 0x9FFC7B /end MEASUREMENT
/begin MEASUREMENT Fid_BIP_Set8_mp "Wechsel zur BIP-Steuerung gemäß BIP_stControl[8] = 2 für das SV in Zylinder 8" UBYTE OneToOne 1 100 0.00 255.0 FORMAT "%5.1" ECU_ADDRESS 0x9FFC7C /end MEASUREMENT
/begin MEASUREMENT Fid_BIP_Set9_mp "Wechsel zur BIP-Steuerung gemäß BIP_stControl[9] = 2 für das SV in Zylinder 9" UBYTE OneToOne 1 100 0.00 255.0 FORMAT "%5.1" ECU_ADDRESS 0x9FFC7D /end MEASUREMENT
/begin MEASUREMENT Fid_BPSErr_mp "Messpunkt fuer Funktions Identifier Fid_BPSErr" UBYTE OneToOne 1 100 0.00 255.0 FORMAT "%5.1" ECU_ADDRESS 0x9FFC7E /end MEASUREMENT
/begin MEASUREMENT Fid_BrkCDBPTInvld_mp "Funktionssperre für Bremsdruck-Status Fehler via CAN" UBYTE OneToOne 1 100 0.00 255.0 FORMAT "%5.1" ECU_ADDRESS 0x9FFC7F /end MEASUREMENT
/begin MEASUREMENT Fid_BrkCDCan_mp "Messpunkt fuer Funktions Identifier Fid_BrkCDCan" UBYTE OneToOne 1 100 0.00 255.0 FORMAT "%5.1" ECU_ADDRESS 0x9FFC80 /end MEASUREMENT
/begin MEASUREMENT Fid_BrkCDMnBrkCan_mp "FID for CAN error in BRK8 frame" UBYTE OneToOne 1 100 0.00 255.0 FORMAT "%5.1" ECU_ADDRESS 0x9FFC81 /end MEASUREMENT
/begin MEASUREMENT Fid_CaSCD_SegCor_mp "Fid von Dfp_EngMCaS1_mp Meßpunkt Nockenwellenfehlerpfad zur Freigabesperrung" UBYTE OneToOne 1 100 0.00 255.0 FORMAT "%5.1" ECU_ADDRESS 0x9FFC82 /end MEASUREMENT
/begin MEASUREMENT Fid_ClgDynTst_mp "Messpunkt fuer Funktions Identifier Fid_ClgDynTst" UBYTE OneToOne 1 100 0.00 255.0 FORMAT "%5.1" ECU_ADDRESS 0x9FFC83 /end MEASUREMENT
/begin MEASUREMENT Fid_CmbChb_mp "FID zur Aktivierung der Aussetzererkennung" UBYTE OneToOne 1 100 0.00 255.0 FORMAT "%5.1" ECU_ADDRESS 0x9FFC84 /end MEASUREMENT
/begin MEASUREMENT Fid_CoDT_GripDeb_mp "Fid für Kraftschlussentprellung" UBYTE OneToOne 1 100 0.00 255.0 FORMAT "%5.1" ECU_ADDRESS 0x9FFC85 /end MEASUREMENT
/begin MEASUREMENT Fid_CoEngAirbCDCrash_mp "Meßpunkt für Funktions-ID Abschaltung Motor durch Airbag" UBYTE OneToOne 1 100 0.00 255.0 FORMAT "%5.1" ECU_ADDRESS 0x9FFC86 /end MEASUREMENT
/begin MEASUREMENT Fid_CoEngGW1TO_mp "Fid für CAN Gateway Botschaft" UBYTE OneToOne 1 100 0.00 255.0 FORMAT "%5.1" ECU_ADDRESS 0x9FFC87 /end MEASUREMENT
/begin MEASUREMENT Fid_CoEng_ActrPrt_mp "Fid zur Vermeidung von dem aktiven Zustand der Stellerschutz, COENG_ACTR_PRT (0x40)" UBYTE OneToOne 1 100 0.00 255.0 FORMAT "%5.1" ECU_ADDRESS 0x9FFC88 /end MEASUREMENT
/begin MEASUREMENT Fid_CoEng_FrmMngAWD1_mp "Messpunkt fuer Funktions Identifier Fid_CoEng_FrmMngAWD1_mp" UBYTE OneToOne 1 100 0.00 255.0 FORMAT "%5.1" ECU_ADDRESS 0x9FFC89 /end MEASUREMENT
/begin MEASUREMENT Fid_CoEng_IRevSys2_mp "Freigabe, sofern kein irreversibler Systemfehler 2 vorliegt" UBYTE OneToOne 1 100 0.00 255.0 FORMAT "%5.1" ECU_ADDRESS 0x9FFC8A /end MEASUREMENT
/begin MEASUREMENT Fid_CoEng_IRevSys_mp "Freigabe, sofern kein irreversibler Systemfehler vorliegt" UBYTE OneToOne 1 100 0.00 255.0 FORMAT "%5.1" ECU_ADDRESS 0x9FFC8B /end MEASUREMENT
/begin MEASUREMENT Fid_CoEng_IRevVeh_mp "Freigabe, sofern kein irreversibler Fahrzeugfehler vorliegt" UBYTE OneToOne 1 100 0.00 255.0 FORMAT "%5.1" ECU_ADDRESS 0x9FFC8C /end MEASUREMENT
/begin MEASUREMENT Fid_CoEng_KickDown_mp "Messpunkt fuer Funktions Identifier Fid_CoEng_KickDown" UBYTE OneToOne 1 100 0.00 255.0 FORMAT "%5.1" ECU_ADDRESS 0x9FFC8D /end MEASUREMENT
/begin MEASUREMENT Fid_CoEng_PwrStgEnable_mp "Messpunkt fuer Funktions Identifier Fid_CoEng_PwrStgEnable" UBYTE OneToOne 1 100 0.00 255.0 FORMAT "%5.1" ECU_ADDRESS 0x9FFC8E /end MEASUREMENT
/begin MEASUREMENT Fid_CoEng_RevSys2_mp "Freigabe, sofern kein reversibler Systemfehler 2 vorliegt" UBYTE OneToOne 1 100 0.00 255.0 FORMAT "%5.1" ECU_ADDRESS 0x9FFC8F /end MEASUREMENT
/begin MEASUREMENT Fid_CoEng_RevSys_mp "Freigabe, sofern kein reversibler Systemfehler vorliegt" UBYTE OneToOne 1 100 0.00 255.0 FORMAT "%5.1" ECU_ADDRESS 0x9FFC90 /end MEASUREMENT
/begin MEASUREMENT Fid_CoEng_RevVeh_mp "Freigabe, sofern kein reversibler Fahrzeugfehler vorliegt" UBYTE OneToOne 1 100 0.00 255.0 FORMAT "%5.1" ECU_ADDRESS 0x9FFC91 /end MEASUREMENT
/begin MEASUREMENT Fid_CoEng_T15CD_mp "Messpunkt fuer Funktions Identifier Fid_CoEng_T15CD" UBYTE OneToOne 1 100 0.00 255.0 FORMAT "%5.1" ECU_ADDRESS 0x9FFC92 /end MEASUREMENT
/begin MEASUREMENT Fid_CoEng_TMFWShOff_mp "Messpunkt fuer Funktions Identifier Fid_CoEng_TMFWShOff" UBYTE OneToOne 1 100 0.00 255.0 FORMAT "%5.1" ECU_ADDRESS 0x9FFC93 /end MEASUREMENT
/begin MEASUREMENT Fid_CoEng_trqLimBiTurbo_mp "Fid für Momentenbegrenzung bei Bi-Turbo Fehler" UBYTE OneToOne 1 100 0.00 255.0 FORMAT "%5.1" ECU_ADDRESS 0x9FFC94 /end MEASUREMENT
/begin MEASUREMENT Fid_CoEng_trqLimErr_mp "Fid zur Momentbegrenzung im Systemfehlerfall" UBYTE OneToOne 1 100 0.00 255.0 FORMAT "%5.1" ECU_ADDRESS 0x9FFC95 /end MEASUREMENT
/begin MEASUREMENT Fid_ConvCDCan_mp "Messpunkt fuer Funktions Identifier Fid_ConvCDCan" UBYTE OneToOne 1 100 0.00 255.0 FORMAT "%5.1" ECU_ADDRESS 0x9FFC96 /end MEASUREMENT
/begin MEASUREMENT Fid_ConvCDEPB_mp "FID für CAN(EPB1)-Botschaftsfehler" UBYTE OneToOne 1 100 0.00 255.0 FORMAT "%5.1" ECU_ADDRESS 0x9FFC97 /end MEASUREMENT
/begin MEASUREMENT Fid_Conv_ClthPrt_mp "FID der Kupplungs-Schutzfunktion" UBYTE OneToOne 1 100 0.00 255.0 FORMAT "%5.1" ECU_ADDRESS 0x9FFC98 /end MEASUREMENT
/begin MEASUREMENT Fid_CoVehPnlFunc_mp "Fid für Systemfehler zur Deaktivierung der Brettfunktion" UBYTE OneToOne 1 100 0.00 255.0 FORMAT "%5.1" ECU_ADDRESS 0x9FFC99 /end MEASUREMENT
/begin MEASUREMENT Fid_CoVehtrqLimErr_mp "Fid zur Erkennung der auf dem Vortriebsmoment wirkenden Systemfehler" UBYTE OneToOne 1 100 0.00 255.0 FORMAT "%5.1" ECU_ADDRESS 0x9FFC9A /end MEASUREMENT
/begin MEASUREMENT Fid_CoVM_DCSErr_mp "Funktion Identifyer von dfp_CoVMDCSErr" UBYTE OneToOne 1 100 0.00 255.0 FORMAT "%5.1" ECU_ADDRESS 0x9FFC9B /end MEASUREMENT
/begin MEASUREMENT Fid_CoVM_DCSh_mp "Funktion Identifyer von dfp_CoVMCDSh" UBYTE OneToOne 1 100 0.00 255.0 FORMAT "%5.1" ECU_ADDRESS 0x9FFC9C /end MEASUREMENT
/begin MEASUREMENT Fid_CoVM_DCSp_mp "funtion identifyer von dfp_CoVMDCSh" UBYTE OneToOne 1 100 0.00 255.0 FORMAT "%5.1" ECU_ADDRESS 0x9FFC9D /end MEASUREMENT
/begin MEASUREMENT Fid_CoVM_TCSErr_mp "Funktion Identifyer von dfp_CoVMTCSErr" UBYTE OneToOne 1 100 0.00 255.0 FORMAT "%5.1" ECU_ADDRESS 0x9FFC9E /end MEASUREMENT
/begin MEASUREMENT Fid_CRCCDCan_mp "Messpunkt fuer Funktions Identifier Fid_CrCCDCan" UBYTE OneToOne 1 100 0.00 255.0 FORMAT "%5.1" ECU_ADDRESS 0x9FFC9F /end MEASUREMENT
/begin MEASUREMENT Fid_CRCCDTo_mp "FID für vorläufigen oder endgültigen Defekt der Cruise Control Botschaft" UBYTE OneToOne 1 100 0.00 255.0 FORMAT "%5.1" ECU_ADDRESS 0x9FFCA0 /end MEASUREMENT
/begin MEASUREMENT Fid_CrCtlACCErr_mp "Meßpunkt für Funktionsidentifier Fid_CrCtlACCErr (Fehler in CrCtl oder ACC)" UBYTE OneToOne 1 100 0.00 255.0 FORMAT "%5.1" ECU_ADDRESS 0x9FFCA1 /end MEASUREMENT
/begin MEASUREMENT Fid_CrCtlAirbCDCrash_mp "Meßpunkt für Funktions-ID Abschaltung CrCtl durch Airbag" UBYTE OneToOne 1 100 0.00 255.0 FORMAT "%5.1" ECU_ADDRESS 0x9FFCA2 /end MEASUREMENT
/begin MEASUREMENT Fid_CrCtlCanBrk1_mp "Messpunkt fuer Funktions Identifier Fid_CrCtlCanBrk1" UBYTE OneToOne 1 100 0.00 255.0 FORMAT "%5.1" ECU_ADDRESS 0x9FFCA3 /end MEASUREMENT
/begin MEASUREMENT Fid_CrCtlMsgErrBRK8_mp "Timeout, Checksum oder Counter Error in der CAN-Botschaft BRK8" UBYTE OneToOne 1 100 0.00 255.0 FORMAT "%5.1" ECU_ADDRESS 0x9FFCA4 /end MEASUREMENT
/begin MEASUREMENT Fid_CrCtlPAAGNpl_mp "Irreversible Abschaltbedingung d. Bremsanforderung: Botschaftszähler AAG nicht konsistent" UBYTE OneToOne 1 100 0.00 255.0 FORMAT "%5.1" ECU_ADDRESS 0x9FFCA5 /end MEASUREMENT
/begin MEASUREMENT Fid_CrCtlPAAGTlrDef_mp "Fid für defekte Anhängerlichter" UBYTE OneToOne 1 100 0.00 255.0 FORMAT "%5.1" ECU_ADDRESS 0x9FFCA6 /end MEASUREMENT
/begin MEASUREMENT Fid_CrCtlPAAGTO_mp "Irreversible Abschaltbedingung d. Bremsanforderung: Anhänger1 (AAG) von Gateway nicht empfangen" UBYTE OneToOne 1 100 0.00 255.0 FORMAT "%5.1" ECU_ADDRESS 0x9FFCA7 /end MEASUREMENT
/begin MEASUREMENT Fid_CrCtlPBRK8Npl_mp "Irreversible Abschaltbedingung für BRK8 ACC Konsistenz" UBYTE OneToOne 1 100 0.00 255.0 FORMAT "%5.1" ECU_ADDRESS 0x9FFCA8 /end MEASUREMENT
/begin MEASUREMENT Fid_CrCtlPBRK8TempErr_mp "Fid für Bremstemperaturfehler in CAN-Message BRK8" UBYTE OneToOne 1 100 0.00 255.0 FORMAT "%5.1" ECU_ADDRESS 0x9FFCA9 /end MEASUREMENT
/begin MEASUREMENT Fid_CrCtlPBRK8TO_mp "Irreversible Abschaltbedingung: Bremse8 (BRK8) nicht empfangen" UBYTE OneToOne 1 100 0.00 255.0 FORMAT "%5.1" ECU_ADDRESS 0x9FFCAA /end MEASUREMENT
/begin MEASUREMENT Fid_CrCtlPBRKDlyReg_mp "Reversible Abschaltbedingung d. Bremsanforderung: Status Verzögerungsregler aus Botschaft Bremse8" UBYTE OneToOne 1 100 0.00 255.0 FORMAT "%5.1" ECU_ADDRESS 0x9FFCAB /end MEASUREMENT
/begin MEASUREMENT Fid_CrCtlPECDAAG_mp "Irreversible Abschaltbedingung d. Bremsanforderung: AAG meldet unplausible Bremslichtansteuerung" UBYTE OneToOne 1 100 0.00 255.0 FORMAT "%5.1" ECU_ADDRESS 0x9FFCAC /end MEASUREMENT
/begin MEASUREMENT Fid_CrCtlPECDILM_mp "Irreversible Abschaltbedingung d. Bremsanforderung: ILM meldet unplausible Bremslichtansteuerung" UBYTE OneToOne 1 100 0.00 255.0 FORMAT "%5.1" ECU_ADDRESS 0x9FFCAD /end MEASUREMENT
/begin MEASUREMENT Fid_CrCtlPGW1TO_mp "Irreversible Abschaltbedingung d. Bremsanforderung: Gateway1 (GW1) nicht empfangen" UBYTE OneToOne 1 100 0.00 255.0 FORMAT "%5.1" ECU_ADDRESS 0x9FFCAE /end MEASUREMENT
/begin MEASUREMENT Fid_CrCtlPILMNpl_mp "Irreversible Abschaltbedingung d. Bremsanforderung: Botschaftszähler Licht hinten nicht konsistent" UBYTE OneToOne 1 100 0.00 255.0 FORMAT "%5.1" ECU_ADDRESS 0x9FFCAF /end MEASUREMENT
/begin MEASUREMENT Fid_CrCtlPILMTO_mp "Irreversible Abschaltbedingung d. Bremsanforderung: Licht hinten (ILM) nicht empfangen" UBYTE OneToOne 1 100 0.00 255.0 FORMAT "%5.1" ECU_ADDRESS 0x9FFCB0 /end MEASUREMENT
/begin MEASUREMENT Fid_CrCtlPMsgErrBRK8_mp "Fid für CAN-Botschaftfehler BRK8" UBYTE OneToOne 1 100 0.00 255.0 FORMAT "%5.1" ECU_ADDRESS 0x9FFCB1 /end MEASUREMENT
/begin MEASUREMENT Fid_CrCtlPstBLS_mp "Irreversible Abschaltbedingung: Fehlerstatus Bremslichtschalter (BLS)" UBYTE OneToOne 1 100 0.00 255.0 FORMAT "%5.1" ECU_ADDRESS 0x9FFCB2 /end MEASUREMENT
/begin MEASUREMENT Fid_CrCtlPstESP_mp "Fid für ESP-Systemstatus-Fehler in BRK1" UBYTE OneToOne 1 100 0.00 255.0 FORMAT "%5.1" ECU_ADDRESS 0x9FFCB3 /end MEASUREMENT
/begin MEASUREMENT Fid_CrCtlPStopLDef_mp "Irreversible Abschaltbedingung d. Bremsanforderung: alle Bremslichter defekt" UBYTE OneToOne 1 100 0.00 255.0 FORMAT "%5.1" ECU_ADDRESS 0x9FFCB4 /end MEASUREMENT
/begin MEASUREMENT Fid_CrCtl_CAN_mp "Messpunkt fuer Funktions Identifier Fid_CrCtl_CAN" UBYTE OneToOne 1 100 0.00 255.0 FORMAT "%5.1" ECU_ADDRESS 0x9FFCB5 /end MEASUREMENT
/begin MEASUREMENT Fid_CrCtl_DsplNotPlaus_mp "Fid für GRA-Zielgeschwindigkeit" UBYTE OneToOne 1 100 0.00 255.0 FORMAT "%5.1" ECU_ADDRESS 0x9FFCB6 /end MEASUREMENT
/begin MEASUREMENT Fid_CrCtl_Dspl_mp "Fid zur Funktionalität CrCtl-Dspl" UBYTE OneToOne 1 100 0.00 255.0 FORMAT "%5.1" ECU_ADDRESS 0x9FFCB7 /end MEASUREMENT
/begin MEASUREMENT Fid_CrCtl_stBrk_mp "Messpunkt fuer Funktions Identifier Fid_CrCtl_stBrk" UBYTE OneToOne 1 100 0.00 255.0 FORMAT "%5.1" ECU_ADDRESS 0x9FFCB8 /end MEASUREMENT
/begin MEASUREMENT Fid_CrCtl_stCaSCrS_mp "Messpunkt fuer Funktions Identifier Fid_CrCtl_stCaSCrS" UBYTE OneToOne 1 100 0.00 255.0 FORMAT "%5.1" ECU_ADDRESS 0x9FFCB9 /end MEASUREMENT
/begin MEASUREMENT Fid_CrCtl_stSpeedSensor_mp "Messpunkt fuer Funktions Identifier Fid_CrCtl_stSpeedSensor" UBYTE OneToOne 1 100 0.00 255.0 FORMAT "%5.1" ECU_ADDRESS 0x9FFCBA /end MEASUREMENT
/begin MEASUREMENT Fid_CrCtl_stSystem_mp "Meßpunkt für Funktions Identifier Fid_CrCtl_stSystem" UBYTE OneToOne 1 100 0.00 255.0 FORMAT "%5.1" ECU_ADDRESS 0x9FFCBB /end MEASUREMENT
/begin MEASUREMENT Fid_CrCtl_VDsplNotPlaus_mp "Fid fur status aus GRA-Zielgeschwindigkeit" UBYTE OneToOne 1 100 0.00 255.0 FORMAT "%5.1" ECU_ADDRESS 0x9FFCBC /end MEASUREMENT
/begin MEASUREMENT Fid_CTSCDCanInac_mp "Messpunkt fuer Funktions Identifier Fid_CTSCDCanInac" UBYTE OneToOne 1 100 0.00 255.0 FORMAT "%5.1" ECU_ADDRESS 0x9FFCBD /end MEASUREMENT
/begin MEASUREMENT Fid_CTSCDCanSig_mp "Messpunkt fuer Funktions Identifier Fid_CTSCDCanSig" UBYTE OneToOne 1 100 0.00 255.0 FORMAT "%5.1" ECU_ADDRESS 0x9FFCBE /end MEASUREMENT
/begin MEASUREMENT Fid_CTSCDCan_mp "Messpunkt fuer Funktions Identifier Fid_CTSCDCan" UBYTE OneToOne 1 100 0.00 255.0 FORMAT "%5.1" ECU_ADDRESS 0x9FFCBF /end MEASUREMENT
/begin MEASUREMENT Fid_CTSCDOTSErr_mp "Meßpunkt für Fid OTS Fehler" UBYTE OneToOne 1 100 0.00 255.0 FORMAT "%5.1" ECU_ADDRESS 0x9FFCC0 /end MEASUREMENT
/begin MEASUREMENT Fid_CTSCDPullup_mp "Fehleridentifier Wassertemperatur bei Zoom-in aktiv" UBYTE OneToOne 1 100 0.00 255.0 FORMAT "%5.1" ECU_ADDRESS 0x9FFCC1 /end MEASUREMENT
/begin MEASUREMENT Fid_CTSErr_mp "Messpunkt fuer Funktions Identifier Fid_CTSErr" UBYTE OneToOne 1 100 0.00 255.0 FORMAT "%5.1" ECU_ADDRESS 0x9FFCC2 /end MEASUREMENT
/begin MEASUREMENT Fid_CtTCtl_stStageErr_mp "Messpunkt fuer Funktions Identifier Fid_CtTCtl_stStageErr" UBYTE OneToOne 1 100 0.00 255.0 FORMAT "%5.1" ECU_ADDRESS 0x9FFCC3 /end MEASUREMENT
/begin MEASUREMENT Fid_CtTCtl_tClntDs1_Err_mp "Messpunkt fuer Funktions Identifier Fid_CtTCtl_tClntDs1_Err" UBYTE OneToOne 1 100 0.00 255.0 FORMAT "%5.1" ECU_ADDRESS 0x9FFCC4 /end MEASUREMENT
/begin MEASUREMENT Fid_CtTCtl_tClntDs2_Err_mp "Messpunkt fuer Funktions Identifier Fid_CtTCtl_tClntDs2_Err" UBYTE OneToOne 1 100 0.00 255.0 FORMAT "%5.1" ECU_ADDRESS 0x9FFCC5 /end MEASUREMENT
/begin MEASUREMENT Fid_CtTCtl_tClntDs3_Err_mp "Messpunkt fuer Funktions Identifier Fid_CtTCtl_tClntDs3_Err" UBYTE OneToOne 1 100 0.00 255.0 FORMAT "%5.1" ECU_ADDRESS 0x9FFCC6 /end MEASUREMENT
/begin MEASUREMENT Fid_CtTCtl_tClntDs4_Err_mp "Messpunkt fuer Funktions Identifier Fid_CtTCtl_tClntDs4_Err" UBYTE OneToOne 1 100 0.00 255.0 FORMAT "%5.1" ECU_ADDRESS 0x9FFCC7 /end MEASUREMENT
/begin MEASUREMENT Fid_CtT_SwtOff_EATMod_mp "Messpunkt für Funktionsidentifier Fid_CtT_SwtOff_EATMod" UBYTE OneToOne 1 100 0.00 255.0 FORMAT "%5.1" ECU_ADDRESS 0x9FFCC8 /end MEASUREMENT
/begin MEASUREMENT Fid_CtT_SwtOff_EAT_mp "Messpunkt für Funktionsidentifier Fid_CtT_SwtOff_EAT" UBYTE OneToOne 1 100 0.00 255.0 FORMAT "%5.1" ECU_ADDRESS 0x9FFCC9 /end MEASUREMENT
/begin MEASUREMENT Fid_CtT_SwtOff_mp "Measuring point for Fid_CtT_SwtOff" UBYTE OneToOne 1 100 0.00 255.0 FORMAT "%5.1" ECU_ADDRESS 0x9FFCCA /end MEASUREMENT
/begin MEASUREMENT Fid_DiffCANerr_mp "Messpunkt fuer Funktions Identifier Fid_DiffCANerr" UBYTE OneToOne 1 100 0.00 255.0 FORMAT "%5.1" ECU_ADDRESS 0x9FFCCB /end MEASUREMENT
/begin MEASUREMENT Fid_DIUMPRDenom_mp "Messpunkt fuer Funktions Identifier Fid_DIUMPRDenom" UBYTE OneToOne 1 100 0.00 255.0 FORMAT "%5.1" ECU_ADDRESS 0x9FFCCC /end MEASUREMENT
/begin MEASUREMENT Fid_DIUMPRIgn_mp "Messpunkt fuer Funktions Identifier Fid_DIUMPRIgn" UBYTE OneToOne 1 100 0.00 255.0 FORMAT "%5.1" ECU_ADDRESS 0x9FFCCD /end MEASUREMENT
/begin MEASUREMENT Fid_DrvTrn_TransConv_mp "zeigt ob die empfangene Triebstangsübersetzung FrmMng_rTrnasConv gültig ist, und getestet wurde" UBYTE OneToOne 1 100 0.00 255.0 FORMAT "%5.1" ECU_ADDRESS 0x9FFCCE /end MEASUREMENT
/begin MEASUREMENT Fid_DSM_Wuc_mp "Warm Up Cycle bei fehlerhafter Kühlmitteltemperatur deaktivieren" UBYTE OneToOne 1 100 0.00 255.0 FORMAT "%5.1" ECU_ADDRESS 0x9FFCCF /end MEASUREMENT
/begin MEASUREMENT Fid_EATSCDCanInac_mp "Messpunkt fuer Funktions Identifier Fid_EATSCDCanInac" UBYTE OneToOne 1 100 0.00 255.0 FORMAT "%5.1" ECU_ADDRESS 0x9FFCD0 /end MEASUREMENT
/begin MEASUREMENT Fid_EATSCDCanSig_mp "Messpunkt fuer Funktions Identifier Fid_EATSCDCanSig" UBYTE OneToOne 1 100 0.00 255.0 FORMAT "%5.1" ECU_ADDRESS 0x9FFCD1 /end MEASUREMENT
/begin MEASUREMENT Fid_EATSCDCan_mp "Messpunkt fuer Funktions Identifier Fid_EATSCDCan" UBYTE OneToOne 1 100 0.00 255.0 FORMAT "%5.1" ECU_ADDRESS 0x9FFCD2 /end MEASUREMENT
/begin MEASUREMENT Fid_EcuBoot_mp "Neue Bedingungen zum Ermöglichen des Programmiermodus einfügen" UBYTE OneToOne 1 100 0.00 255.0 FORMAT "%5.1" ECU_ADDRESS 0x9FFCD3 /end MEASUREMENT
/begin MEASUREMENT Fid_EcuInitTimestamp_mp "Messpunkt fuer Funktions Identifier Fid_EcuInitTimestamp" UBYTE OneToOne 1 100 0.00 255.0 FORMAT "%5.1" ECU_ADDRESS 0x9FFCD4 /end MEASUREMENT
/begin MEASUREMENT Fid_EGPpCDTempDfl_mp "Fid für EGPpCD" UBYTE OneToOne 1 100 0.00 255.0 FORMAT "%5.1" ECU_ADDRESS 0x9FFCD5 /end MEASUREMENT
/begin MEASUREMENT Fid_EGRSCDMon_mp "Messpunkt fuer Funktions Identifier Fid_EGRSCDMon" UBYTE OneToOne 1 100 0.00 255.0 FORMAT "%5.1" ECU_ADDRESS 0x9FFCD6 /end MEASUREMENT
/begin MEASUREMENT Fid_EGRSCDOfsLrnInh_mp "Messpunkt fuer Funktions Identifier Fid_EGRSCDOfsLrnInh" UBYTE OneToOne 1 100 0.00 255.0 FORMAT "%5.1" ECU_ADDRESS 0x9FFCD7 /end MEASUREMENT
/begin MEASUREMENT Fid_EGRVlvGvnrOff_mp "function identifier für Systemfehlerabfrage zur Abschaltung des Lagereglers" UBYTE OneToOne 1 100 0.00 255.0 FORMAT "%5.1" ECU_ADDRESS 0x9FFCD8 /end MEASUREMENT
/begin MEASUREMENT Fid_EGSysCoLSU0_mp "Meßpunkt für Umschaltung der Eingangstemperatur an der LSU bei fehlerhaftem Temperatursensor" UBYTE OneToOne 1 100 0.00 255.0 FORMAT "%5.1" ECU_ADDRESS 0x9FFCD9 /end MEASUREMENT
/begin MEASUREMENT Fid_EGSysCoNSC_mp "Meßpunkt für Umschaltung der Eingangstemperatur des NSC-Temperaturmodells bei fehlerhaftem Temperatursensor" UBYTE OneToOne 1 100 0.00 255.0 FORMAT "%5.1" ECU_ADDRESS 0x9FFCDA /end MEASUREMENT
/begin MEASUREMENT Fid_EGSysCoOxiBrik_mp "Meßpunkt für Umschaltung der Eingangstemperatur des OxiCat-Temperaturmodells (Brick Modell) bei fehlerhaftem Temperatursensor" UBYTE OneToOne 1 100 0.00 255.0 FORMAT "%5.1" ECU_ADDRESS 0x9FFCDB /end MEASUREMENT
/begin MEASUREMENT Fid_EGSysCoOxi_mp "Meßpunkt für Umschaltung der Eingangstemperatur des OxiCat-Temperaturmodells bei fehlerhaftem Temperatursensor" UBYTE OneToOne 1 100 0.00 255.0 FORMAT "%5.1" ECU_ADDRESS 0x9FFCDC /end MEASUREMENT
/begin MEASUREMENT Fid_EGSysCoTrbn0_mp "Messpunkt zum Umschalten der Eingangstemperatur des ersten Turbolader - Temperatur Modells im Falle defecter Temperatursensoren" UBYTE OneToOne 1 100 0.00 255.0 FORMAT "%5.1" ECU_ADDRESS 0x9FFCDD /end MEASUREMENT
/begin MEASUREMENT Fid_EGSysCoTrbn1_mp "Messpunkt zum Umschalten der Eingangstemperatur des zweiten Turbolader - Temperatur Modells im Falle defecter Temperatursensoren" UBYTE OneToOne 1 100 0.00 255.0 FORMAT "%5.1" ECU_ADDRESS 0x9FFCDE /end MEASUREMENT
/begin MEASUREMENT Fid_EGSysCoTube0_mp "Meßpunkt für Umschaltung der Eingangstemperatur des Rohr-Temperaturmodells bei fehlerhaftem Temperatursensor" UBYTE OneToOne 1 100 0.00 255.0 FORMAT "%5.1" ECU_ADDRESS 0x9FFCDF /end MEASUREMENT
/begin MEASUREMENT Fid_EGSysCoTube1_mp "Meßpunkt für Umschaltung der Eingangstemperatur des Rohr-Temperaturmodells bei fehlerhaftem Temperatursensor" UBYTE OneToOne 1 100 0.00 255.0 FORMAT "%5.1" ECU_ADDRESS 0x9FFCE0 /end MEASUREMENT
/begin MEASUREMENT Fid_EGSysCoTube2_mp "Meßpunkt für Umschaltung der Eingangstemperatur des Rohr-Temperaturmodells bei fehlerhaftem Temperatursensor" UBYTE OneToOne 1 100 0.00 255.0 FORMAT "%5.1" ECU_ADDRESS 0x9FFCE1 /end MEASUREMENT
/begin MEASUREMENT Fid_EGSysCoTube3_mp "Meßpunkt für Umschaltung der Eingangstemperatur des Rohr-Temperaturmodells bei fehlerhaftem Temperatursensor" UBYTE OneToOne 1 100 0.00 255.0 FORMAT "%5.1" ECU_ADDRESS 0x9FFCE2 /end MEASUREMENT
/begin MEASUREMENT Fid_EGSysHtgDel_mp "Meßpunkt für Umschaltung der Taupunkterkennung auf Zeitfreigabe fehlerhaften Eingangssignalen" UBYTE OneToOne 1 100 0.00 255.0 FORMAT "%5.1" ECU_ADDRESS 0x9FFCE3 /end MEASUREMENT
/begin MEASUREMENT Fid_EGSysNSC_mp "Meßpunkt für Abschaltung des NSC-Temperaturmodells bei fehlerhaften Eingangsgrößen" UBYTE OneToOne 1 100 0.00 255.0 FORMAT "%5.1" ECU_ADDRESS 0x9FFCE4 /end MEASUREMENT
/begin MEASUREMENT Fid_EGSysOxiCat_mp "Meßpunkt für Abschaltung des OxiCat-Temperaturmodells bei fehlerhaften Eingangsgrößen" UBYTE OneToOne 1 100 0.00 255.0 FORMAT "%5.1" ECU_ADDRESS 0x9FFCE5 /end MEASUREMENT
/begin MEASUREMENT Fid_EGSysPresEnv_mp "Meßpunkt für Umschaltung des Drucksignals im Turbolader-Temperaturmodells bei fehlerhafter Sensorgröße" UBYTE OneToOne 1 100 0.00 255.0 FORMAT "%5.1" ECU_ADDRESS 0x9FFCE6 /end MEASUREMENT
/begin MEASUREMENT Fid_EGSysStrt_mp "Meßpunkt für Umschaltung der Initialisierungstemperaturen auf Ersatzwert bei fehlerhaften Eingangswerten" UBYTE OneToOne 1 100 0.00 255.0 FORMAT "%5.1" ECU_ADDRESS 0x9FFCE7 /end MEASUREMENT
/begin COMPU_METHOD AirMassPerCyl "Luftmasse pro Zylinder" RAT_FUNC "%6.3" "[mg/Hub Luft]" COEFFS 0 10 0 0 0 1 /end COMPU_METHOD
/begin COMPU_METHOD AirMassPerTime "Luftmasse pro Zeit" RAT_FUNC "%6.3" "[Kg/h Luft]" COEFFS 0 10 0 0 0 1 /end COMPU_METHOD
/begin COMPU_METHOD AngleCrS "Winkel Kurbelwelle" RAT_FUNC "%6.4" "[deg CrS]" COEFFS 0 42.6666666666667 0 0 0 1 /end COMPU_METHOD
/begin COMPU_METHOD Area "Flaeche mit hoher Aufloesung" RAT_FUNC "%6.5" "[m*m]" COEFFS 0 8192 0 0 0 1 /end COMPU_METHOD
/begin COMPU_METHOD CubMtrPerHr "Volumsstrom in m^3/h" RAT_FUNC "%6.3" "[m^3/h]" COEFFS 0 10 0 0 0 1 /end COMPU_METHOD
/begin COMPU_METHOD Curr_A "Umrechnung für Strom in Ampere" RAT_FUNC "%6.4" "A" COEFFS 0 100 0 0 0 1 /end COMPU_METHOD
/begin COMPU_METHOD DfpName "Verbale Umrechnung für Fehlerpfadnamen" TAB_VERB "%6.3" "[-]" COMPU_TAB_REF DfpName /end COMPU_METHOD
/begin COMPU_VTAB DfpName "Verbale Umrechnung für Fehlerpfadnamen" TAB_VERB 385 0 "Dfp_unused" 1 "Dfp_ACCCD" 2 "Dfp_ACCCDBrkErr" 3 "Dfp_ACCCDBrkNPL" 4 "Dfp_ACCCDSensErr" 5 "Dfp_ACCCDWrongCoded" 6 "Dfp_ACCD" 7 "Dfp_ACCD_PAC" 8 "Dfp_ACCD_pCAN" 9 "Dfp_ACCD_trqCAN" 10 "Dfp_ACCIRevPanErr" 11 "Dfp_ACCIRevShOff" 12 "Dfp_ACCnotPlaus" 13 "Dfp_ADCMon" 14 "Dfp_AFSCD_PlOffsDrft" 15 "Dfp_AFSCD_PlSetyDrft" 16 "Dfp_AFSCD_SRCAirm" 17 "Dfp_AFVCD_Actr" 18 "Dfp_AOHtCDHt1" 19 "Dfp_AOHtCDHt2" 20 "Dfp_AOHtCDHt3" 21 "Dfp_APP1" 22 "Dfp_APP2" 23 "Dfp_APPCD_KickDown" 24 "Dfp_APPCD_PWGDrft" 25 "Dfp_APPSync" 26 "Dfp_APP_Npl" 27 "Dfp_APSCD" 28 "Dfp_AccPedPlausBrk" 29 "Dfp_AirCtl_GovDevMax" 30 "Dfp_AirCtl_GovDevMin" 31 "Dfp_AirCtl_GovDevRgnMax" 32 "Dfp_AirCtl_GovDevRgnMin" 33 "Dfp_AirbCDCrash" 34 "Dfp_AirbCDCrashCrCtl" 35 "Dfp_AirbCDCrashPSP" 36 "Dfp_AltCDExc" 37 "Dfp_AltCD_Load" 38 "Dfp_AltPwrCan" 39 "Dfp_BIP01" 40 "Dfp_BIP02" 41 "Dfp_BIP03" 42 "Dfp_BIP04" 43 "Dfp_BIP05" 44 "Dfp_BIP06" 45 "Dfp_BIP07" 46 "Dfp_BIP08" 47 "Dfp_BIP09" 48 "Dfp_BIP10" 49 "Dfp_BIP11" 50 "Dfp_BIP12" 51 "Dfp_BIP_Con" 52 "Dfp_BPACD_Max" 53 "Dfp_BPACD_Max2" 54 "Dfp_BPACD_Min" 55 "Dfp_BPACD_Min2" 56 "Dfp_BPACD_SigNpl" 57 "Dfp_BPACD_SigNpl2" 58 "Dfp_BPASCD" 59 "Dfp_BPSCD" 60 "Dfp_BPSCDPlaus" 61 "Dfp_BattCD" 62 "Dfp_BrkCD" 63 "Dfp_BrkCDBPTInvld" 64 "Dfp_BrkCDdynPl" 65 "Dfp_CANA" 66 "Dfp_CANB" 67 "Dfp_CANBus1" 68 "Dfp_CANBus2" 69 "Dfp_CANBus3" 70 "Dfp_CANC" 71 "Dfp_CANErrActA" 72 "Dfp_CANErrActB" 73 "Dfp_CANErrActC" 74 "Dfp_COTSCD" 75 "Dfp_CTSCD" 76 "Dfp_CTSCDCanInac" 77 "Dfp_CTSCDCanSig" 78 "Dfp_Clg_DynTst" 79 "Dfp_CmbChbMisfire1" 80 "Dfp_CmbChbMisfire2" 81 "Dfp_CmbChbMisfire3" 82 "Dfp_CmbChbMisfire4" 83 "Dfp_CmbChbMisfire5" 84 "Dfp_CmbChbMisfire6" 85 "Dfp_CmbChbMisfireMul" 86 "Dfp_CoVMDCSErr" 87 "Dfp_CoVMDCSh" 88 "Dfp_CoVMDCSp" 89 "Dfp_CoVMSumErr" 90 "Dfp_CoVMTCSErr" 91 "Dfp_CoVehLvl2" 92 "Dfp_ConvCD" 93 "Dfp_ConvCD_ConvErr" 94 "Dfp_ConvCD_EPB1" 95 "Dfp_CrCCDPanErrMSG" 96 "Dfp_CrCCDPanErrSMLS" 97 "Dfp_CrCCDPanMainSwtErr" 98 "Dfp_CrCtlDsplErrPat" 99 "Dfp_CrCtlDsplNotPlaus" 100 "Dfp_CrCtlPECDErr" 101 "Dfp_CrCtlPLmpDef" 102 "Dfp_CrCtlPShutOff" 103 "Dfp_CrCtlPTlrDef" 104 "Dfp_CrCtlVDsplNotPlaus" 105 "Dfp_CtApCD" 106 "Dfp_CtTCD" 107 "Dfp_CtT_Mon" 108 "Dfp_DifftrqLimErrPat" 109 "Dfp_EATSCD" 110 "Dfp_EATSCDCanInac" 111 "Dfp_EATSCDCanSig" 112 "Dfp_EEPCDVarMng" 113 "Dfp_EGPpCDTPreTrbn" 114 "Dfp_EGRCD_CBV" 115 "Dfp_EGRCD_Max" 116 "Dfp_EGRCD_Min" 117 "Dfp_EGRCD_Sig" 118 "Dfp_EGRCD_SigNpl" 119 "Dfp_EGRSCD" 120 "Dfp_EGRSCD_JamVlv" 121 "Dfp_EGRSCD_LgTimeDrft" 122 "Dfp_EGRSCD_ShTimeDrft" 123 "Dfp_EGRVlvGvnrDvt" 124 "Dfp_EGRVlv_JamVlv" 125 "Dfp_EMCCD_MLS1" 126 "Dfp_EngMBackUp" 127 "Dfp_EngMCaS1" 128 "Dfp_EngMCaSDrv" 129 "Dfp_EngMCrS1" 130 "Dfp_EngMOfsCaSCrS" 131 "Dfp_EngMonIrrCmb" 132 "Dfp_EngPrt" 133 "Dfp_ErLpCDMILReqON" 134 "Dfp_FMAErrMod" 135 "Dfp_FMTC_NonMonotonMap" 136 "Dfp_FQTSCD" 137 "Dfp_FQlSCD" 138 "Dfp_FTSCD" 139 "Dfp_FTSCDNpl" 140 "Dfp_FanCD_Fan1Ctlr1" 141 "Dfp_FanCD_Fan1Ctlr2" 142 "Dfp_FanCD_Fan2Ctlr1" 143 "Dfp_FanCD_Fan2Ctlr2" 144 "Dfp_FanCD_FanCtlr1" 145 "Dfp_FanCD_FanCtlr2" 146 "Dfp_FanCD_OutFanCtlr1" 147 "Dfp_FanCD_OutFanCtlr2" 148 "Dfp_FlClgCD" 149 "Dfp_FlPpCD" 150 "Dfp_FlSCDT1" 151 "Dfp_FrmMngAAGNpl" 152 "Dfp_FrmMngAAGTO" 153 "Dfp_FrmMngAC1Npl" 154 "Dfp_FrmMngAC1TO" 155 "Dfp_FrmMngACCNpl" 156 "Dfp_FrmMngACCTO" 157 "Dfp_FrmMngAIRBGNpl" 158 "Dfp_FrmMngAIRBGTO" 159 "Dfp_FrmMngAWD1Npl" 160 "Dfp_FrmMngAWD1TO" 161 "Dfp_FrmMngBEM1Npl" 162 "Dfp_FrmMngBEM1TO" 163 "Dfp_FrmMngBRK1Npl" 164 "Dfp_FrmMngBRK1TO" 165 "Dfp_FrmMngBRK2Npl" 166 "Dfp_FrmMngBRK2TO" 167 "Dfp_FrmMngBRK8Npl" 168 "Dfp_FrmMngBRK8TO" 169 "Dfp_FrmMngBSG3TO" 170 "Dfp_FrmMngCANVerErr" 171 "Dfp_FrmMngCCSel" 172 "Dfp_FrmMngCCTLNpl" 173 "Dfp_FrmMngCCTLTO" 174 "Dfp_FrmMngCHRGR1Npl" 175 "Dfp_FrmMngCHRGR1TO" 176 "Dfp_FrmMngCHRGR2Npl" 177 "Dfp_FrmMngCHRGR2TO" 178 "Dfp_FrmMngChrgr1A" 179 "Dfp_FrmMngChrgr1C" 180 "Dfp_FrmMngChrgr1N" 181 "Dfp_FrmMngChrgr1T" 182 "Dfp_FrmMngChrgr1V" 183 "Dfp_FrmMngChrgr2A" 184 "Dfp_FrmMngChrgr2C" 185 "Dfp_FrmMngChrgr2N" 186 "Dfp_FrmMngChrgr2T" 187 "Dfp_FrmMngChrgr2V" 188 "Dfp_FrmMngDIA1Npl" 189 "Dfp_FrmMngDIA1TO" 190 "Dfp_FrmMngDSP1Npl" 191 "Dfp_FrmMngDSP1TO" 192 "Dfp_FrmMngDSP2Npl" 193 "Dfp_FrmMngDSP2TO" 194 "Dfp_FrmMngDSP3Npl" 195 "Dfp_FrmMngDSP3TO" 196 "Dfp_FrmMngEPB1Npl" 197 "Dfp_FrmMngEPB1TO" 198 "Dfp_FrmMngESCUNpl" 199 "Dfp_FrmMngESCUTO" 200 "Dfp_FrmMngErrValDFM" 201 "Dfp_FrmMngGW1Npl" 202 "Dfp_FrmMngGW1TO" 203 "Dfp_FrmMngILMNpl" 204 "Dfp_FrmMngILMTO" 205 "Dfp_FrmMngLICHT1TO" 206 "Dfp_FrmMngLICHT2TO" 207 "Dfp_FrmMngNIV1WrngCod" 208 "Dfp_FrmMngNIVEAU1Npl" 209 "Dfp_FrmMngNIVEAU1TO" 210 "Dfp_FrmMngSA1Npl" 211 "Dfp_FrmMngSA1TO" 212 "Dfp_FrmMngSTIGNNpl" 213 "Dfp_FrmMngStIgnTO" 214 "Dfp_FrmMngTOSNpl" 215 "Dfp_FrmMngTOSTO" 216 "Dfp_FrmMngTSC1Npl" 217 "Dfp_FrmMngTSC1TO" 218 "Dfp_FrmMngTSC2Npl" 219 "Dfp_FrmMngTSC2TO" 220 "Dfp_FrmMngTSC3Npl" 221 "Dfp_FrmMngTSC3TO" 222 "Dfp_FrmMngTSC6Npl" 223 "Dfp_FrmMngTSC6TO" 224 "Dfp_FrmMngTrbnSpdErr" 225 "Dfp_FrmMngWIPERTO" 226 "Dfp_GbSSCD" 227 "Dfp_GbSSCD_HW" 228 "Dfp_GearbxCVTnMax" 229 "Dfp_GearbxClthPlaus" 230 "Dfp_GearbxINCCup" 231 "Dfp_GearbxNMinMon" 232 "Dfp_GearbxTSC" 233 "Dfp_GearbxTransConv" 234 "Dfp_GearbxTypeMTErr" 235 "Dfp_GlwCDDIAG" 236 "Dfp_GlwCDErr1" 237 "Dfp_GlwCDErr2" 238 "Dfp_GlwCDEvalCod" 239 "Dfp_GlwCDGSK2" 240 "Dfp_GlwCDGSK3" 241 "Dfp_GlwCDLmp" 242 "Dfp_GlwCDPLUG0" 243 "Dfp_GlwCDPLUG1" 244 "Dfp_GlwCDPLUG2" 245 "Dfp_GlwCDPLUG3" 246 "Dfp_GlwCDPLUG4" 247 "Dfp_GlwCDPLUG5" 248 "Dfp_GlwCD_LampCan" 249 "Dfp_GlwCDsfd" 250 "Dfp_HDSCD" 251 "Dfp_HWEMonCom" 252 "Dfp_HWEMonEEPROM" 253 "Dfp_HWEMonRcyLocked" 254 "Dfp_HWEMonRcySuppressed" 255 "Dfp_HWEMonRcyVisible" 256 "Dfp_HWEMonUMaxSupply" 257 "Dfp_HWEMonUMinSupply" 258 "Dfp_IATSCD" 259 "Dfp_IFCD" 260 "Dfp_ImmCtl" 261 "Dfp_IndSysMonIntMnf" 262 "Dfp_InjCrvT3DiaMax" 263 "Dfp_InjCrvT3DiaMin" 264 "Dfp_InjVlvBnk1A" 265 "Dfp_InjVlvBnk2A" 266 "Dfp_InjVlvCyl10A" 267 "Dfp_InjVlvCyl11A" 268 "Dfp_InjVlvCyl12A" 269 "Dfp_InjVlvCyl1A" 270 "Dfp_InjVlvCyl2A" 271 "Dfp_InjVlvCyl3A" 272 "Dfp_InjVlvCyl4A" 273 "Dfp_InjVlvCyl5A" 274 "Dfp_InjVlvCyl6A" 275 "Dfp_InjVlvCyl7A" 276 "Dfp_InjVlvCyl8A" 277 "Dfp_InjVlvCyl9A" 278 "Dfp_LASCD" 279 "Dfp_LSUCDCircNernst0" 280 "Dfp_LSUCDCircPumpCur0" 281 "Dfp_LSUCDCircVirtGnd0" 282 "Dfp_LSUCDHeater0" 283 "Dfp_LSUCDHtCoup0" 284 "Dfp_LSUCDO20" 285 "Dfp_LSUCDO2Clb0" 286 "Dfp_LSUCDRiClb0" 287 "Dfp_LSUCDSPI0" 288 "Dfp_LSUCDSPIBattLow0" 289 "Dfp_LSUCDWireIP0" 290 "Dfp_LSUCtlRiExc0" 291 "Dfp_LSUMonDyn0" 292 "Dfp_LSUMonFullLd0" 293 "Dfp_LSUMonOvrRun0" 294 "Dfp_LSUMonPartLd0" 295 "Dfp_MIL" 296 "Dfp_MRlyCD" 297 "Dfp_Montr" 298 "Dfp_OTSCD" 299 "Dfp_OTSCDCanInac" 300 "Dfp_OTSCDCanSig" 301 "Dfp_OTSCD_DynTst" 302 "Dfp_OvRMon" 303 "Dfp_OvRMonCrCtlP" 304 "Dfp_OvRMonSigA" 305 "Dfp_OxiCCDTPre" 306 "Dfp_OxiCCDTPre1" 307 "Dfp_PCR_BalGovDev" 308 "Dfp_PCR_GovDev" 309 "Dfp_PFltAPSens" 310 "Dfp_PFltCDHtg" 311 "Dfp_PFltCDHtg1" 312 "Dfp_PFltCDPDiff" 313 "Dfp_PFltCDTempPre" 314 "Dfp_PFltCDTempPre1" 315 "Dfp_PFltCDTempPst" 316 "Dfp_PFltChar" 317 "Dfp_PFltEngPrt" 318 "Dfp_PFltPresDynPlaus" 319 "Dfp_PFltPresHsChng" 320 "Dfp_PFltPresSens" 321 "Dfp_PFltPresSensFrz" 322 "Dfp_PFltPresSensHsLn" 323 "Dfp_PFltPresSensSot" 324 "Dfp_PFltRgnLckPerm" 325 "Dfp_PFltRgnLckPermTstr" 326 "Dfp_PFltRgnPerm" 327 "Dfp_PFltSotSimPresPerm" 328 "Dfp_PFltTempDwnStrm" 329 "Dfp_PFltTempDwnStrmMax" 330 "Dfp_PFltTempDwnStrmMin" 331 "Dfp_PFltTempPreOxiC" 332 "Dfp_PFltTempPrePFlt" 333 "Dfp_PFltTempPreTrbn" 334 "Dfp_PFltTempPst" 335 "Dfp_PFltTempPstPFlt" 336 "Dfp_PFltTempSens" 337 "Dfp_PFltTempSens2" 338 "Dfp_PFltTempUpStrm" 339 "Dfp_PFltTempUpStrmMax" 340 "Dfp_PFltTempUpStrmMin" 341 "Dfp_PSPCD_Actr" 342 "Dfp_PrpCtlvLimErrPat" 343 "Dfp_SOPTst" 344 "Dfp_SSpMon1" 345 "Dfp_SSpMon2" 346 "Dfp_SSpMon3" 347 "Dfp_Shtrp_EGRBA" 348 "Dfp_Shtrp_PCRBA" 349 "Dfp_SrvPmpStSAEcu" 350 "Dfp_StSysCtlShCirBatt" 351 "Dfp_StrtCDOffRly" 352 "Dfp_StrtCDOnRly" 353 "Dfp_StrtCtlIlsNotPlaus" 354 "Dfp_StrtCtlT50ROneRly1" 355 "Dfp_StrtCtlT50ROneRly2" 356 "Dfp_StrtCtlT50RZero" 357 "Dfp_SysLamp" 358 "Dfp_T15CD" 359 "Dfp_T50CD" 360 "Dfp_TPUMon" 361 "Dfp_TVACD_Max" 362 "Dfp_TVACD_Min" 363 "Dfp_TVACD_Sig" 364 "Dfp_TVACD_SigNpl" 365 "Dfp_TVACD_stLineDef" 366 "Dfp_TVASCD" 367 "Dfp_TVASCD_Drft" 368 "Dfp_ThrVlvGvnrDvt" 369 "Dfp_ThrVlvJamVlv" 370 "Dfp_UAcc_CodeBitErr" 371 "Dfp_USAp_DataVariant" 372 "Dfp_USAp_FuncCodeRead" 373 "Dfp_VSACD_Max" 374 "Dfp_VSACD_Min" 375 "Dfp_VSACD_SigNpl" 376 "Dfp_VSSCD" 377 "Dfp_VSSCD1" 378 "Dfp_VSSCD2" 379 "Dfp_VSSCD4" 380 "Dfp_VSSCDBrkLowVltg" 381 "Dfp_VSSCDCAN" 382 "Dfp_VSSCDNpl" 383 "Dfp_WDALCD" 384 "Dfp_WdCom" /end COMPU_VTAB
/begin COMPU_METHOD DIUMPR_Time_ms_100ms "Umrechnung für Zeitzähler für DIUMPR in ms in teh 100ms cycle" RAT_FUNC "%6.0" "ms" COEFFS 0 0.01 0 0 0 1 /end COMPU_METHOD
/begin COMPU_METHOD DtyCyc "Tastverhaeltnis" RAT_FUNC "%6.4" "[%]" COEFFS 0 100 0 0 0 1 /end COMPU_METHOD
/begin COMPU_METHOD Dxs "Prozentsatz fuer DXs (-100% ... 100%)" RAT_FUNC "%7.6" "[%]" COEFFS 0 40000 0 0 0 1 /end COMPU_METHOD
/begin COMPU_METHOD EGTSwt_S16 "Faktor (0...1) für sint16 Type mit 0.000061 Auflösung" RAT_FUNC "%7.6" "-" COEFFS 0 16384 0 0 0 1 /end COMPU_METHOD
/begin COMPU_METHOD Energy "Energie in Joule" RAT_FUNC "%6.2" "[kJ]" COEFFS 0 1 0 0 0 1 /end COMPU_METHOD
/begin COMPU_METHOD EngN "Motordrehzahl" RAT_FUNC "%6.2" "[rpm]" COEFFS 0 1 0 0 0 1 /end COMPU_METHOD
/begin COMPU_METHOD Eng_dN "Motorbeschleunigung" RAT_FUNC "%6.2" "rpm/s" COEFFS 0 1 0 0 0 1 /end COMPU_METHOD
/begin COMPU_METHOD Fact "Faktor mit Auflösung 1 / 8192, hauptsächlich für einen Faktorenbereich 0...1 verwendet" RAT_FUNC "%6.5" "[-]" COEFFS 0 8192 0 0 0 1 /end COMPU_METHOD
/begin COMPU_METHOD Fact1 "Faktor mit Auflösung 0,01 (100 mal höherer Bereich als Fact)" RAT_FUNC "%6.4" "[-]" COEFFS 0 128 0 0 0 1 /end COMPU_METHOD
/begin COMPU_METHOD Fact_PT1 "Faktor um die Zeitkonstante eines PT1 filters festzulegen (Taupunktermittlung)" RAT_FUNC "%6.4" "[W/K]" COEFFS 0 128 0 0 0 1 /end COMPU_METHOD
/begin COMPU_METHOD FBCPreCtlInjRAM "Umrechnung für die Darstellung von FBC-Werten im RAM" RAT_FUNC "%6.5" "[mg/hub]" COEFFS 0 3200 0 0 0 1 /end COMPU_METHOD
/begin COMPU_METHOD FBC_LrnState "Zustände des FBC Zustandsautomaten" TAB_VERB "%6.3" "[-]" COMPU_TAB_REF FBC_LrnState /end COMPU_METHOD
/begin COMPU_VTAB FBC_LrnState "Zustände des FBC Zustandsautomaten" TAB_VERB 5 1 "INIT   " 2 "DX_WAIT" 3 "LEARN  " 4 "APPLY  " 5 "DELAY  " /end COMPU_VTAB
/begin COMPU_METHOD FlConsum_l_h "Kraftstoffverbrauch" RAT_FUNC "%6.4" "[l/h]" COEFFS 0 100 0 0 0 1 /end COMPU_METHOD
/begin COMPU_METHOD InjMass "Einspritzmenge" RAT_FUNC "%6.4" "[mg/hub]" COEFFS 0 100 0 0 0 1 /end COMPU_METHOD
/begin COMPU_METHOD InjMassCyc "Einspritzmenge pro Zyklus (mg/Zyklus)" RAT_FUNC "%6.4" "[mg/cyc]" COEFFS 0 100 0 0 0 1 /end COMPU_METHOD
/begin COMPU_METHOD InjMassInj "Einspritzmenge pro Einspritzung (mg/Einspritzung)" RAT_FUNC "%6.4" "[mg/inj]" COEFFS 0 100 0 0 0 1 /end COMPU_METHOD
/begin COMPU_METHOD InjMassPerTimeHigh " Kraftstoffmassenstrom hohe Auflösung" RAT_FUNC "%6.5" "[kg/h]" COEFFS 0 1000 0 0 0 1 /end COMPU_METHOD
/begin COMPU_METHOD InjMass_float "Einspritzmenge" RAT_FUNC "%6.2" "[mg]" COEFFS 0 1 0 0 0 1 /end COMPU_METHOD
/begin COMPU_METHOD Ki_Temp2EGTFact "Umrechnung für die Integrator Verstärkung des PI Reglers im EGT_TempGvnr [1/K]" RAT_FUNC "%8.7" "-/(K*s)" COEFFS 0 429496.7296 0 0 0 1 /end COMPU_METHOD
/begin COMPU_METHOD Ki_Trq2TrqT "Integrale Verstärkung Ki (Getriebeausgangsmoment über die Zeit aufintegriert)" RAT_FUNC "%6.5" "[Nms]" COEFFS 0 1374.38953472 0 0 0 1 /end COMPU_METHOD
/begin COMPU_METHOD Ki_Trq2TrqT2 "Integrale Verstärkung Ki (Kupplungsmoment über die Zeit aufintegriert)" RAT_FUNC "%6.4" "[Nms]" COEFFS 0 429.4967296 0 0 0 1 /end COMPU_METHOD
/begin COMPU_METHOD Kp_1 "proportionale Verstärkung Kp (gleiche Einheit/Umrechnungsregel an Ein- und Ausgang; Umrechnung für sint16-Werte)" RAT_FUNC "%6.4" "[1/1]" COEFFS 0 64 0 0 0 1 /end COMPU_METHOD
/begin COMPU_METHOD KP_LMBD2PRC "Proportionalverstärkung (Lambdawert zu Prozent)" RAT_FUNC "%6.4" "[%/1]" COEFFS 0 51.2 0 0 0 1 /end COMPU_METHOD
/begin COMPU_METHOD Kp_LmbdRec2InjMass_2 "Proportionale Verstärkung Kp (reziprokes Lambda zu Einspritzmenge)" RAT_FUNC "%6.4" "[mg/stroke]" COEFFS 0 81.92 0 0 0 1 /end COMPU_METHOD
/begin COMPU_METHOD Kp_Temp2EGTFact "Umrechnung für die Proportional Verstärkung des PI Reglers im EGT_TempGvnr [1/K]" RAT_FUNC "%9.8" "-/(K*s)" COEFFS 0 6553600 0 0 0 1 /end COMPU_METHOD
/begin COMPU_METHOD lambda "Lambda" RAT_FUNC "%6.5" "[-]" COEFFS 0 1000 0 0 0 1 /end COMPU_METHOD
/begin COMPU_METHOD MolPerSecHCI "Einspritzungmasse in den Molen pro Sekunde" RAT_FUNC "%11.10" "[mol/s]" COEFFS 0 100000000 0 0 0 1 /end COMPU_METHOD
/begin COMPU_METHOD O2 "Sauerstoffkonzentration" RAT_FUNC "%8.7" "[-]" COEFFS 0 100000 0 0 0 1 /end COMPU_METHOD
/begin COMPU_METHOD O2MassPerTime "Sauerstoffmassenstrom" RAT_FUNC "%6.4" "[kg/h]" COEFFS 0 100 0 0 0 1 /end COMPU_METHOD
/begin COMPU_METHOD OneToOne "eins zu eins (physikalischer Wert ist gleich dem internen Wert)" RAT_FUNC "%6.2" "[-]" COEFFS 0 1 0 0 0 1 /end COMPU_METHOD
/begin COMPU_METHOD PartsPerMillion "Teile pro Million" RAT_FUNC "%6.3" "[ppm]" COEFFS 0 2 0 0 0 1 /end COMPU_METHOD
/begin COMPU_METHOD PmpQnt "Fördermenge der Pumpe / Umdrehung" RAT_FUNC "%6.3" "[mm^3/rev]" COEFFS 0 10 0 0 0 1 /end COMPU_METHOD
/begin COMPU_METHOD Prc "Prozent, gleiche interne Auflösung wie Fact, aber Darstellung in Prozent (0...100%)" RAT_FUNC "%6.4" "[%]" COEFFS 0 100 0 0 0 1 /end COMPU_METHOD
/begin COMPU_METHOD PrcLow "Prozentwert mit einer Auflösung von 0.02" RAT_FUNC "%6.4" "[%]" COEFFS 0 50 0 0 0 1 /end COMPU_METHOD
/begin COMPU_METHOD PresAC_hPa "Druck (Klimatisierung) angezeigt in [hPa]" RAT_FUNC "%6.2" "[hPa]" COEFFS 0 0.5 0 0 0 1 /end COMPU_METHOD
/begin COMPU_METHOD Pres_hPa "Druck (angezeigt in [hPa])" RAT_FUNC "%6.2" "[hPa]" COEFFS 0 1 0 0 0 1 /end COMPU_METHOD
/begin COMPU_METHOD Pwr "Leistung" RAT_FUNC "%6.2" "[W]" COEFFS 0 0.10610329539459 0 0 0 1 /end COMPU_METHOD
/begin COMPU_METHOD Pwr1 "Leistung mit Hoher Aufloesung" RAT_FUNC "%6.3" "[W]" COEFFS 0 10 0 0 0 1 /end COMPU_METHOD
/begin COMPU_METHOD Pwr_kW_Sec "Leistungsaenderungsrate in kW/s" RAT_FUNC "%6.4" "[kW/s]" COEFFS 0 100 0 0 0 1 /end COMPU_METHOD
/begin COMPU_METHOD ReynoldsNum "Reynolds Nummer um den thermischen Koeffizienten zu bestimmen" RAT_FUNC "%6.0" "[-]" COEFFS 0 0.01 0 0 0 1 /end COMPU_METHOD
/begin COMPU_METHOD SpecificHeat "spezifische Waermekapazitaet einer Substanz" RAT_FUNC "%7.6" "[J/g/K]" COEFFS 0 10000 0 0 0 1 /end COMPU_METHOD
/begin COMPU_METHOD TempDiff_Kelv "Offsettemperatur dargestellt in [K]" RAT_FUNC "%6.3" "[ deg C ]" COEFFS 0 10 0 0 0 1 /end COMPU_METHOD
/begin COMPU_METHOD Temp_Cels "Temperatur dargestellt in °C (gleiche interne Darstellung wie Temp_Kelv)" RAT_FUNC "%6.1" "[deg C]" COEFFS 0 10 2731.4 0 0 1 /end COMPU_METHOD
/begin COMPU_METHOD Temp_Kelv_Sec "Temperaturaenderungsrate" RAT_FUNC "%6.4" "[deg C/s]" COEFFS 0 100 0 0 0 1 /end COMPU_METHOD
/begin COMPU_METHOD ThermalCoEff "Waermekoeffiziens einer Substanz" RAT_FUNC "%6.3" "[W/m/m/K]" COEFFS 0 10 0 0 0 1 /end COMPU_METHOD
/begin COMPU_METHOD TimeDT "Abtastzeit (in us) für Library Regler, Filter, etc." RAT_FUNC "%6.2" "[us]" COEFFS 0 1 0 0 0 1 /end COMPU_METHOD
/begin COMPU_METHOD TimeSys_us "Zeit in [us] mit Systemzeit-Auflösung" RAT_FUNC "%6.3" "us" COEFFS 0 3.4965 0 0 0 1 /end COMPU_METHOD
/begin COMPU_METHOD Time_ms "Zeit in ms für Fehlerentprellung (DSM) und SW-Timer" RAT_FUNC "%6.1" "[ms]" COEFFS 0 0.1 0 0 0 1 /end COMPU_METHOD
/begin COMPU_METHOD Time_s "Zeit in s für Fehlerentprellung (DSM) und SW-Timer" RAT_FUNC "%6.4" "[s]" COEFFS 0 100 0 0 0 1 /end COMPU_METHOD
/begin COMPU_METHOD TransR "Übersetzungsverhältnis (Getriebe etc.)" RAT_FUNC "%6.4" "[-]" COEFFS 0 100 0 0 0 1 /end COMPU_METHOD
/begin COMPU_METHOD Trq "Motormoment" RAT_FUNC "%6.3" "[Nm]" COEFFS 0 10 0 0 0 1 /end COMPU_METHOD
/begin COMPU_METHOD TrqPrpHigh "vortriebsmoment" RAT_FUNC "%6.3" "[Nm]" COEFFS 0 10 0 0 0 1 /end COMPU_METHOD
/begin COMPU_METHOD TurboN "Turboladerdrehzahl" RAT_FUNC "%6.1" "[rpm]" COEFFS 0 1 0 0 0 10 /end COMPU_METHOD
/begin COMPU_METHOD Vel "Fahrzeuggeschwindigkeit, gleiche interne Auflösung wie Vel_SI" RAT_FUNC "%6.4" "[km/h]" COEFFS 0 100 0 0 0 1 /end COMPU_METHOD
/begin COMPU_METHOD Volt "Spannung in V (von ADC)" RAT_FUNC "%6.2" "[mV]" COEFFS 0 0.2046 0 0 0 1 /end COMPU_METHOD
/begin COMPU_METHOD default "" RAT_FUNC "%6.2" "" COEFFS 0 1 0 0 0 1 /end COMPU_METHOD
/end MODULE
/end PROJECT
