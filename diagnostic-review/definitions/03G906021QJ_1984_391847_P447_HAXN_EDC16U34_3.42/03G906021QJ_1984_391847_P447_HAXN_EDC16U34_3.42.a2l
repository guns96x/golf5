ASAP2_VERSION 1 3
/begin PROJECT X447 "EDC16U34"
/begin HEADER "" VERSION "VAA1" PROJECT_NO X447 /end HEADER
/begin MODULE DIM ""
/begin MOD_COMMON "" BYTE_ORDER MSB_FIRST ALIGNMENT_BYTE 1 ALIGNMENT_WORD 2 ALIGNMENT_LONG 4 ALIGNMENT_FLOAT32_IEEE 4 /end MOD_COMMON
/begin CHARACTERISTIC GlwCD_cntEepWr_C "Anzahl von EEPROM Schreibversuchen" VALUE 0x1D8694 Kw_Wu8 3.000 OneToOne 0.00 3.000 FORMAT "%5.3" EXTENDED_LIMITS 0.00 255.0 /end CHARACTERISTIC
/begin CHARACTERISTIC GlwCD_ctPwrStgLmpOnMax_C "maximale Anzahl von Endstufen-Einschaltungen pro Fahrzyklus bei SCB oder Übertemperatur" VALUE 0x1D8732 Kw_Wu16 65535.00 OneToOne 0.00 65535.00 FORMAT "%8.2" /end CHARACTERISTIC
/begin CHARACTERISTIC GlwCD_ctPwrStgOnMax_C "Maximale Anzahl von Endstufen - Einschaltungen pro Fahrzyklus bei SCB oder Übertemperatur" VALUE 0x1D8696 Kw_Wu16 65535.00 OneToOne 0.00 65535.00 FORMAT "%8.2" /end CHARACTERISTIC
/begin CHARACTERISTIC GlwCD_ctSyncMin_C "Anzahl von GSK3-Diagnoseprotokoll-Synchronisierbits" VALUE 0x1D8698 Kw_Wu8 17.00 OneToOne 0.00 17.00 FORMAT "%5.2" EXTENDED_LIMITS 0.00 255.0 /end CHARACTERISTIC
/begin CHARACTERISTIC GlwCD_ctTOInit_C "InitialisierungswertdesTimeout-Zählers(GSK3-Diagnoseprotokoll)" VALUE 0x1D8699 Kw_Wu8 128.0 OneToOne 0.00 128.0 FORMAT "%5.1" EXTENDED_LIMITS 0.00 255.0 /end CHARACTERISTIC
/begin CHARACTERISTIC GlwCD_ctTOReLd_C "Wert zum Neuladung des Timeout-Zählers (GSK3-Diagnoseprotokoll)" VALUE 0x1D869A Kw_Wu8 128.0 OneToOne 0.00 128.0 FORMAT "%5.1" EXTENDED_LIMITS 0.00 255.0 /end CHARACTERISTIC
/begin CHARACTERISTIC GlwCD_DebActrExcTempDef_C "Fehlerentprellzeit für EXC_TEMP für Aktorausgang" VALUE 0x1D869C Kw_Wu16 655350.0 Time_ms 0.00 655350.0 FORMAT "%8.1" /end CHARACTERISTIC
/begin CHARACTERISTIC GlwCD_DebActrExcTempOk_C "Heilungszeit für EXC_TEMP für Aktorausgang" VALUE 0x1D869E Kw_Wu16 655350.0 Time_ms 0.00 655350.0 FORMAT "%8.1" /end CHARACTERISTIC
/begin CHARACTERISTIC GlwCD_DebActrNoLdDef_C "Fehlerentprellzeit für NO_LOAD für Aktorausgang" VALUE 0x1D86A0 Kw_Wu16 65540.00 Time_ms 0.00 65540.00 FORMAT "%8.2" EXTENDED_LIMITS 0.00 655350.0 /end CHARACTERISTIC
/begin CHARACTERISTIC GlwCD_DebActrNoLdOk_C "Heilungszeit für NO_LOAD für Aktorausgang" VALUE 0x1D86A2 Kw_Wu16 65540.00 Time_ms 0.00 65540.00 FORMAT "%8.2" EXTENDED_LIMITS 0.00 655350.0 /end CHARACTERISTIC
/begin CHARACTERISTIC GlwCD_DebActrShCirBattDef_C "Fehlerentprellzeit für SHORT_CIRC_BAT für Aktorausgang" VALUE 0x1D86A4 Kw_Wu16 655350.0 Time_ms 0.00 655350.0 FORMAT "%8.1" /end CHARACTERISTIC
/begin CHARACTERISTIC GlwCD_DebActrShCirBattOk_C "Heilungszeit für SHORT_CIRC_BAT für Aktorausgang" VALUE 0x1D86A6 Kw_Wu16 655350.0 Time_ms 0.00 655350.0 FORMAT "%8.1" /end CHARACTERISTIC
/begin CHARACTERISTIC GlwCD_DebActrShCirGndDef_C "Fehlerentprellzeit für SHORT_CIRC_GND für Aktorausgang" VALUE 0x1D86A8 Kw_Wu16 655350.0 Time_ms 0.00 655350.0 FORMAT "%8.1" /end CHARACTERISTIC
/begin CHARACTERISTIC GlwCD_DebActrShCirGndOk_C "Heilungszeit für SHORT_CIRC_GND für Aktorausgang" VALUE 0x1D86AA Kw_Wu16 655350.0 Time_ms 0.00 655350.0 FORMAT "%8.1" /end CHARACTERISTIC
/begin CHARACTERISTIC GlwCD_DebCod2of3PlaDef_C "Entprellzaehler Defekterkennung" VALUE 0x1D86AC Kw_Wu16 65535.00 OneToOne 0.00 65535.00 FORMAT "%8.2" /end CHARACTERISTIC
/begin CHARACTERISTIC GlwCD_DebCod2of3PlaOk_C "Entprellzähler für Heilungserkennung" VALUE 0x1D86AE Kw_Wu16 65535.00 OneToOne 0.00 65535.00 FORMAT "%8.2" /end CHARACTERISTIC
/begin CHARACTERISTIC GlwCD_DebCod3DiffPlaDef_C "Entprellzähler für Defekterkennung" VALUE 0x1D86B0 Kw_Wu16 65535.00 OneToOne 0.00 65535.00 FORMAT "%8.2" /end CHARACTERISTIC
/begin CHARACTERISTIC GlwCD_DebCod3DiffPlaOk_C "Entprellzaehler Heilungserkennung" VALUE 0x1D86B2 Kw_Wu16 65535.00 OneToOne 0.00 65535.00 FORMAT "%8.2" /end CHARACTERISTIC
/begin CHARACTERISTIC GlwCD_DebExcTempDef_C "Fehlerentprellzeit für Übertemperaturfehler" VALUE 0x1D86B4 Kw_Wu16 655350.0 Time_ms 0.00 655350.0 FORMAT "%8.1" /end CHARACTERISTIC
/begin CHARACTERISTIC GlwCD_DebExcTempOk_C "Heilungsdauer für Fehler Übertemperatur" VALUE 0x1D86B6 Kw_Wu16 655350.0 Time_ms 0.00 655350.0 FORMAT "%8.1" /end CHARACTERISTIC
/begin CHARACTERISTIC GlwCD_DebGSK3DiaPlaDef_C "Schwelle für Fehlererkennung (GSK3-Diagnoseprotokoll)" VALUE 0x1D86B8 Kw_Wu16 65535.00 OneToOne 0.00 65535.00 FORMAT "%8.2" /end CHARACTERISTIC
/begin CHARACTERISTIC GlwCD_DebGSK3DiaPlaOk_C "Schwelle für Fehlerheilung (GSK3 Diagnoseprotokoll" VALUE 0x1D86BA Kw_Wu16 65535.00 OneToOne 0.00 65535.00 FORMAT "%8.2" /end CHARACTERISTIC
/begin CHARACTERISTIC GlwCD_DebGSK3Err1SigDef_C "Defektentprellungserreignisse/-zeit für Fehler der fehlenden K30" VALUE 0x1D86BC Kw_Wu16 65535.00 OneToOne 0.00 65535.00 FORMAT "%8.2" /end CHARACTERISTIC
/begin CHARACTERISTIC GlwCD_DebGSK3Err1SigOk_C "Defektheilungserreignisse/-zeit für Fehler der fehlenden K30" VALUE 0x1D86BE Kw_Wu16 65535.00 OneToOne 0.00 65535.00 FORMAT "%8.2" /end CHARACTERISTIC
/begin CHARACTERISTIC GlwCD_DebGSK3Err2PlaDef_C "Schwelle für Fehlererkennung(Glühmodul-Fehler)" VALUE 0x1D86C0 Kw_Wu16 65535.00 OneToOne 0.00 65535.00 FORMAT "%8.2" /end CHARACTERISTIC
/begin CHARACTERISTIC GlwCD_DebGSK3Err2PlaOk_C "Schwelle für Fehlerheilung (Glühmodul-Fehler)" VALUE 0x1D86C2 Kw_Wu16 65535.00 OneToOne 0.00 65535.00 FORMAT "%8.2" /end CHARACTERISTIC
/begin CHARACTERISTIC GlwCD_DebGSK3Plug0MinDef_C "Defektentprellungserreignisse/-zeit für Kurzschlussfehler auf der Glühkerze G1" VALUE 0x1D86C4 Kw_Wu16 65535.00 OneToOne 0.00 65535.00 FORMAT "%8.2" /end CHARACTERISTIC
/begin CHARACTERISTIC GlwCD_DebGSK3Plug0MinOk_C "Defektheilungserreignisse/-zeit für Kurzschlussfehler auf der Glühkerze G1" VALUE 0x1D86C6 Kw_Wu16 65535.00 OneToOne 0.00 65535.00 FORMAT "%8.2" /end CHARACTERISTIC
/begin CHARACTERISTIC GlwCD_DebGSK3Plug0PlaDef_C "Schwelle für Fehlererkennung" VALUE 0x1D86C8 Kw_Wu16 65535.00 OneToOne 0.00 65535.00 FORMAT "%8.2" /end CHARACTERISTIC
/begin CHARACTERISTIC GlwCD_DebGSK3Plug0PlaOk_C "Schwelle für Fehlerheilung" VALUE 0x1D86CA Kw_Wu16 65535.00 OneToOne 0.00 65535.00 FORMAT "%8.2" /end CHARACTERISTIC
/begin CHARACTERISTIC GlwCD_DebGSK3Plug1MinDef_C "Defektentprellungserreignisse/-zeit für Kurzschlussfehler auf der Glühkerze G2" VALUE 0x1D86CC Kw_Wu16 65535.00 OneToOne 0.00 65535.00 FORMAT "%8.2" /end CHARACTERISTIC
/begin CHARACTERISTIC GlwCD_DebGSK3Plug1MinOk_C "Defektheilungserreignisse/-zeit für Kurzschlussfehler auf der Glühkerze G2" VALUE 0x1D86CE Kw_Wu16 65535.00 OneToOne 0.00 65535.00 FORMAT "%8.2" /end CHARACTERISTIC
/begin CHARACTERISTIC GlwCD_DebGSK3Plug1PlaDef_C "Schwelle für Fehlererkennung" VALUE 0x1D86D0 Kw_Wu16 65535.00 OneToOne 0.00 65535.00 FORMAT "%8.2" /end CHARACTERISTIC
/begin CHARACTERISTIC GlwCD_DebGSK3Plug1PlaOk_C "Schwelle für Fehlerheilung" VALUE 0x1D86D2 Kw_Wu16 65535.00 OneToOne 0.00 65535.00 FORMAT "%8.2" /end CHARACTERISTIC
/begin CHARACTERISTIC GlwCD_DebGSK3Plug2MinDef_C "Defektentprellungserreignisse/-zeit für Kurzschlussfehler auf der Glühkerze G3" VALUE 0x1D86D4 Kw_Wu16 65535.00 OneToOne 0.00 65535.00 FORMAT "%8.2" /end CHARACTERISTIC
/begin CHARACTERISTIC GlwCD_DebGSK3Plug2MinOk_C "Defektheilungserreignisse/-zeit für Kurzschlussfehler auf der Glühkerze G3" VALUE 0x1D86D6 Kw_Wu16 65535.00 OneToOne 0.00 65535.00 FORMAT "%8.2" /end CHARACTERISTIC
/begin CHARACTERISTIC GlwCD_DebGSK3Plug2PlaDef_C "Schwelle für Fehlererkennung" VALUE 0x1D86D8 Kw_Wu16 65535.00 OneToOne 0.00 65535.00 FORMAT "%8.2" /end CHARACTERISTIC
/begin CHARACTERISTIC GlwCD_DebGSK3Plug2PlaOk_C "Schwelle für Fehlerheilung" VALUE 0x1D86DA Kw_Wu16 65535.00 OneToOne 0.00 65535.00 FORMAT "%8.2" /end CHARACTERISTIC
/begin CHARACTERISTIC GlwCD_DebGSK3Plug3MinDef_C "Defektentprellungserreignisse/-zeit für Kurzschlussfehler auf der Glühkerze G4" VALUE 0x1D86DC Kw_Wu16 65535.00 OneToOne 0.00 65535.00 FORMAT "%8.2" /end CHARACTERISTIC
/begin CHARACTERISTIC GlwCD_DebGSK3Plug3MinOk_C "Defektheilungserreignisse/-zeit für Kurzschlussfehler auf der Glühkerze G4" VALUE 0x1D86DE Kw_Wu16 65535.00 OneToOne 0.00 65535.00 FORMAT "%8.2" /end CHARACTERISTIC
/begin CHARACTERISTIC GlwCD_DebGSK3Plug3PlaDef_C "Schwelle für Fehlererkennung" VALUE 0x1D86E0 Kw_Wu16 65535.00 OneToOne 0.00 65535.00 FORMAT "%8.2" /end CHARACTERISTIC
/begin CHARACTERISTIC GlwCD_DebGSK3Plug3PlaOk_C "Schwelle für Fehlerheilung" VALUE 0x1D86E2 Kw_Wu16 65535.00 OneToOne 0.00 65535.00 FORMAT "%8.2" /end CHARACTERISTIC
/begin CHARACTERISTIC GlwCD_DebGSK3Plug4MinDef_C "Defektentprellungserreignisse/-zeit für Kurzschlussfehler auf der Glühkerze G5" VALUE 0x1D86E4 Kw_Wu16 65535.00 OneToOne 0.00 65535.00 FORMAT "%8.2" /end CHARACTERISTIC
/begin CHARACTERISTIC GlwCD_DebGSK3Plug4MinOk_C "Defektheilungserreignisse/-zeit für Kurzschlussfehler auf der Glühkerze G5" VALUE 0x1D86E6 Kw_Wu16 65535.00 OneToOne 0.00 65535.00 FORMAT "%8.2" /end CHARACTERISTIC
/begin CHARACTERISTIC GlwCD_DebGSK3Plug4PlaDef_C "Schwelle für Fehlererkennung" VALUE 0x1D86E8 Kw_Wu16 65535.00 OneToOne 0.00 65535.00 FORMAT "%8.2" /end CHARACTERISTIC
/begin CHARACTERISTIC GlwCD_DebGSK3Plug4PlaOk_C "Schwelle für Fehlerheilung" VALUE 0x1D86EA Kw_Wu16 65535.00 OneToOne 0.00 65535.00 FORMAT "%8.2" /end CHARACTERISTIC
/begin CHARACTERISTIC GlwCD_DebGSK3Plug5MinDef_C "Defektentprellungserreignisse/-zeit für Kurzschlussfehler auf der Glühkerze G6" VALUE 0x1D86EC Kw_Wu16 65535.00 OneToOne 0.00 65535.00 FORMAT "%8.2" /end CHARACTERISTIC
/begin CHARACTERISTIC GlwCD_DebGSK3Plug5MinOk_C "Defektheilungserreignisse/-zeit für Kurzschlussfehler auf der Glühkerze G6" VALUE 0x1D86EE Kw_Wu16 65535.00 OneToOne 0.00 65535.00 FORMAT "%8.2" /end CHARACTERISTIC
/begin CHARACTERISTIC GlwCD_DebGSK3Plug5PlaDef_C "Schwelle für Fehlererkennung" VALUE 0x1D86F0 Kw_Wu16 65535.00 OneToOne 0.00 65535.00 FORMAT "%8.2" /end CHARACTERISTIC
/begin CHARACTERISTIC GlwCD_DebGSK3Plug5PlaOk_C "Schwelle für Fehlerheilung" VALUE 0x1D86F2 Kw_Wu16 65535.00 OneToOne 0.00 65535.00 FORMAT "%8.2" /end CHARACTERISTIC
/begin CHARACTERISTIC GlwCD_DebNoLdDef_C "Fehlerentprellzeit für NO_LOAD für Aktorausgang" VALUE 0x1D86F4 Kw_Wu16 65540.00 Time_ms 0.00 65540.00 FORMAT "%8.2" EXTENDED_LIMITS 0.00 655350.0 /end CHARACTERISTIC
/begin CHARACTERISTIC GlwCD_DebNoLdOk_C "Heilungszeit für NO_LOAD für Aktorausgang" VALUE 0x1D86F6 Kw_Wu16 65540.00 Time_ms 0.00 65540.00 FORMAT "%8.2" EXTENDED_LIMITS 0.00 655350.0 /end CHARACTERISTIC
/begin CHARACTERISTIC GlwCD_DebShCirBattDef_C "Fehlerentprellzeit für SHORT_CIRC_BAT für Aktorausgang" VALUE 0x1D86F8 Kw_Wu16 655350.0 Time_ms 0.00 655350.0 FORMAT "%8.1" /end CHARACTERISTIC
/begin CHARACTERISTIC GlwCD_DebShCirBattOk_C "Heilungszeit für SHORT_CIRC_BAT für Aktorausgang" VALUE 0x1D86FA Kw_Wu16 655350.0 Time_ms 0.00 655350.0 FORMAT "%8.1" /end CHARACTERISTIC
/begin CHARACTERISTIC GlwCD_DebShCirGndDef_C "Fehlerentprellzeit für SHORT_CIRC_GND für Aktorausgang" VALUE 0x1D86FC Kw_Wu16 655350.0 Time_ms 0.00 655350.0 FORMAT "%8.1" /end CHARACTERISTIC
/begin CHARACTERISTIC GlwCD_DebShCirGndOk_C "Heilungszeit für SHORT_CIRC_GND für Aktorausgang" VALUE 0x1D86FE Kw_Wu16 655350.0 Time_ms 0.00 655350.0 FORMAT "%8.1" /end CHARACTERISTIC
/begin CHARACTERISTIC GlwCD_tiDigInDebNeg_C "Entprellteit für fallende Flanke der Glührückmeldung" VALUE 0x1D8700 Kw_Wu16 655350.0 TimeDeb 0.00 655350.0 FORMAT "%8.1" /end CHARACTERISTIC
/begin CHARACTERISTIC GlwCD_tiDigInDebPostv_C "Entprellzeit für steigende Flanke der Glührückmeldung" VALUE 0x1D8702 Kw_Wu16 655350.0 TimeDeb 0.00 655350.0 FORMAT "%8.1" /end CHARACTERISTIC
/begin CHARACTERISTIC GlwCD_LampCanDebNplDef_C "Entprellzeit für NPL Fehler für Vorglühlampe via CAN" VALUE 0x1D8734 Kw_Wu16 655350.0 Time_ms 0.00 655350.0 FORMAT "%8.1" /end CHARACTERISTIC
/begin CHARACTERISTIC GlwCD_LampCanDebNplOk_C "Fehlerheilzeit für NPL Fehler für Vorglühlampe via CAN" VALUE 0x1D8736 Kw_Wu16 655350.0 Time_ms 0.00 655350.0 FORMAT "%8.1" /end CHARACTERISTIC
/begin CHARACTERISTIC GlwCD_LampDebExcTempDef_C "Fehlerentprellzeit für EXC_TEMP für Lampenausgang" VALUE 0x1D8738 Kw_Wu16 655350.0 Time_ms 0.00 655350.0 FORMAT "%8.1" /end CHARACTERISTIC
/begin CHARACTERISTIC GlwCD_LampDebExcTempOk_C "Heilungszeit für EXC_TEMP für Lampenausgang" VALUE 0x1D873A Kw_Wu16 655350.0 Time_ms 0.00 655350.0 FORMAT "%8.1" /end CHARACTERISTIC
/begin CHARACTERISTIC GlwCD_LampDebNoLoadDef_C "Fehlerentprellzeit für NO_LOAD für Lampenausgang" VALUE 0x1D873C Kw_Wu16 655350.0 Time_ms 0.00 655350.0 FORMAT "%8.1" /end CHARACTERISTIC
/begin CHARACTERISTIC GlwCD_LampDebNoLoadOk_C "Heilungszeit für NO_LOAD für Lampenausgang" VALUE 0x1D873E Kw_Wu16 655350.0 Time_ms 0.00 655350.0 FORMAT "%8.1" /end CHARACTERISTIC
/begin CHARACTERISTIC GlwCD_LampDebShortCircBatDef_C "Fehlerentprellzeit für SHORT_CIRC_BAT Lampenausgang" VALUE 0x1D8740 Kw_Wu16 655350.0 Time_ms 0.00 655350.0 FORMAT "%8.1" /end CHARACTERISTIC
/begin CHARACTERISTIC GlwCD_LampDebShortCircBatOk_C "Heilungszeit für SHORT_CIRC_BAT Lampenausgang" VALUE 0x1D8742 Kw_Wu16 655350.0 Time_ms 0.00 655350.0 FORMAT "%8.1" /end CHARACTERISTIC
/begin CHARACTERISTIC GlwCD_LampDebShortCircGndDef_C "Fehlerentprellzeit für SHORT_CIRC_GND Lampenausgang" VALUE 0x1D8744 Kw_Wu16 655350.0 Time_ms 0.00 655350.0 FORMAT "%8.1" /end CHARACTERISTIC
/begin CHARACTERISTIC GlwCD_LampDebShortCircGndOk_C "Heilungszeit für SHORT_CIRC_GND Lampenausgang" VALUE 0x1D8746 Kw_Wu16 655350.0 Time_ms 0.00 655350.0 FORMAT "%8.1" /end CHARACTERISTIC
/begin CHARACTERISTIC GlwCD_numDiaGSK3_C "Parameter zur Pin-Auswahl der niedrigen Systemspannung der Hardware-Diagnose" VALUE 0x1D8704 Kw_Wu8 20.0000000000 NumPinDia 1.00000000000 21.0000000000 FORMAT "%13.10" /end CHARACTERISTIC
/begin CHARACTERISTIC GlwCD_numDiaRly_C "Auswahl des Diagnosesignal-Eingangs für den Digitalausgang Glührelay" VALUE 0x1D8705 Kw_Wu8 20.0000000000 NumPinDia 1.00000000000 21.0000000000 FORMAT "%13.10" /end CHARACTERISTIC
/begin CHARACTERISTIC GlwCD_numDioOutRly_C "Auswahl des Digitalausgangs für die Glührelayansteuerung" VALUE 0x1D8706 Kw_Wu8 22.0000000000 NumPinDioOut 0.00 22.0000000000 FORMAT "%13.10" /end CHARACTERISTIC
/begin CHARACTERISTIC GlwCD_numPwmOutGSK3_C "Parameter zur Auswahl der niedrigen Systemspannung des Hardware-PWM-Ausgangspins" VALUE 0x1D8707 Kw_Wu8 11.0000000000 NumPinPwmOut 2.00000000000 13.0000000000 FORMAT "%13.10" /end CHARACTERISTIC
/begin CHARACTERISTIC GlwCD_numStpDef_C "Schrittweite für Fehlererkennung (GSK3-Diagnose)" VALUE 0x1D8708 Kw_Wu8 3.000 OneToOne 0.00 3.000 FORMAT "%5.3" EXTENDED_LIMITS 0.00 255.0 /end CHARACTERISTIC
/begin CHARACTERISTIC GlwCD_numStpOk_C "Schrittweite für Fehlererkennung (GSK3-Diagnose)" VALUE 0x1D8709 Kw_Wu8 3.000 OneToOne 0.00 3.000 FORMAT "%5.3" EXTENDED_LIMITS 0.00 255.0 /end CHARACTERISTIC
/begin CHARACTERISTIC GlwCD_stInvOut_C "Invertierung des Glühausgangssignals" VALUE 0x1D870A Kw_Wu8 1.000 OneToOne 0.00 1.000 FORMAT "%5.3" EXTENDED_LIMITS 0.00 255.0 /end CHARACTERISTIC
/begin CHARACTERISTIC GlwCD_tiPer_C "Periodendauer des Glühausgangssignals" VALUE 0x1D870C Kw_Ws16 0.00 Period 31.00000 31.00000 FORMAT "%8.5" EXTENDED_LIMITS -3276.800 3276.700 /end CHARACTERISTIC
/begin CHARACTERISTIC GlwCD_rGSKCod_C "GSK3 Tastverhältnis für GCU-Kodierung" VALUE 0x1D870E Kw_Wu16 100.0000 DtyCyc 0.00 100.0000 FORMAT "%8.4" EXTENDED_LIMITS 0.00 655.3500 /end CHARACTERISTIC
/begin CHARACTERISTIC GlwCD_rGSKMax_C "max. Tastverhältnis für GSK3-Diagnose" VALUE 0x1D8710 Kw_Wu16 100.0000 DtyCyc 0.00 100.0000 FORMAT "%8.4" EXTENDED_LIMITS 0.00 655.3500 /end CHARACTERISTIC
/begin CHARACTERISTIC GlwCD_rGSKMin_C "min. Begrenzung des GSK3-Tastverhältnisses und untere Schwelle für GSK3-Diagnose" VALUE 0x1D8712 Kw_Wu16 100.0000 DtyCyc 0.00 100.0000 FORMAT "%8.4" EXTENDED_LIMITS 0.00 655.3500 /end CHARACTERISTIC
/begin CHARACTERISTIC GlwCD_rGSKTst_C "Tastverhaeltnis waehrend des Stellgliedtests" VALUE 0x1D8714 Kw_Wu16 100.0000 DtyCyc 0.00 100.0000 FORMAT "%8.4" EXTENDED_LIMITS 0.00 655.3500 /end CHARACTERISTIC
/begin CHARACTERISTIC GlwCD_stActrOutInv_C "Glührelaisausgang invertiert" VALUE 0x1D8716 Kw_Wu8 1.000 OneToOne 0.00 1.000 FORMAT "%5.3" EXTENDED_LIMITS 0.00 255.0 /end CHARACTERISTIC
/begin CHARACTERISTIC GlwCD_stDigInInv_C "Rückmeldesignal invertiert" VALUE 0x1D8717 Kw_Wu8 1.000 OneToOne 0.00 1.000 FORMAT "%5.3" EXTENDED_LIMITS 0.00 255.0 /end CHARACTERISTIC
/begin CHARACTERISTIC GlwCD_stGlwUnType_C "Codierungsvorgabe fuer das GZS" VALUE 0x1D8718 Kw_Wu8 7.000 OneToOne 0.00 7.000 FORMAT "%5.3" EXTENDED_LIMITS 0.00 255.0 /end CHARACTERISTIC
/begin CHARACTERISTIC GlwCD_stLampInvOut_C "Ausgang Glühsteuerung invertiert" VALUE 0x1D8748 Kw_Wu8 1.000 OneToOne 0.00 1.000 FORMAT "%5.3" EXTENDED_LIMITS 0.00 255.0 /end CHARACTERISTIC
/begin CHARACTERISTIC GlwCD_stLmpSPICtl_C "Parameter zur Anzeige der verwendeten Endstufenart ( 1 = SPI kontrollierbare Endstufe, 0 = nicht SPI-Endstufe )" VALUE 0x1D8749 Kw_Wu8 1.000 OneToOne 0.00 1.000 FORMAT "%5.3" EXTENDED_LIMITS 0.00 255.0 /end CHARACTERISTIC
/begin CHARACTERISTIC GlwCD_stPwrStgActrActv_C "Spezifikation des Abschaltverhaltens der Actuator Endstufe" VALUE 0x1D8719 Kw_Wu8 255.0 OneToOne 0.00 255.0 FORMAT "%5.1" /end CHARACTERISTIC
/begin CHARACTERISTIC GlwCD_stPwrStgActrDia_C "Spezifikation des Diagnoseabschaltverhaltens der Actuator Endstufe" VALUE 0x1D871A Kw_Wu8 255.0 OneToOne 0.00 255.0 FORMAT "%5.1" /end CHARACTERISTIC
/begin CHARACTERISTIC GlwCD_stPwrStgLampActv_C "Spezifikation des Diagnoseabschaltverhaltens der Lamp-Endstufe" VALUE 0x1D874A Kw_Wu8 255.0 OneToOne 0.00 255.0 FORMAT "%5.1" /end CHARACTERISTIC
/begin CHARACTERISTIC GlwCD_stPwrStgLampDia_C "Spezifikation des Diagnoseabschaltverhaltens der Lamp-Endstufe" VALUE 0x1D874B Kw_Wu8 255.0 OneToOne 0.00 255.0 FORMAT "%5.1" /end CHARACTERISTIC
/begin CHARACTERISTIC GlwCD_stSPICtl_C "Parameter zum Anzeigen von powerstage SPI/non SPI" VALUE 0x1D871B Kw_Wu8 1.000 OneToOne 0.00 1.000 FORMAT "%5.3" EXTENDED_LIMITS 0.00 255.0 /end CHARACTERISTIC
/begin CHARACTERISTIC GlwCD_swtBattCorEna_C "Schalter zum Deaktivieren der Batteriespannungskorrektur" VALUE 0x1D871C Kw_Wu8 1.000 OneToOne 0.00 1.000 FORMAT "%5.3" EXTENDED_LIMITS 0.00 255.0 /end CHARACTERISTIC
/begin CHARACTERISTIC GlwCD_swtDigInPrsnt_C "Schalter zur Deaktivierung des digitalen Eingangs von GlwCD" VALUE 0x1D871D Kw_Wu8 1.000 OneToOne 0.00 1.000 FORMAT "%5.3" EXTENDED_LIMITS 0.00 255.0 /end CHARACTERISTIC
/begin CHARACTERISTIC GlwCD_swtLampCan_C "Schalter für Vorglühlampe über CAN oder Endstufe" VALUE 0x1D874C Kw_Wu8 1.000 OneToOne 0.00 1.000 FORMAT "%5.3" EXTENDED_LIMITS 0.00 255.0 /end CHARACTERISTIC
/begin CHARACTERISTIC GlwCD_swtVarSfd_C "Schalter, ob Summenfehlerdiagnose verwendet werden soll" VALUE 0x1D871E Kw_Wu16 1.000000 OneToOne 0.00 1.000000 FORMAT "%8.6" EXTENDED_LIMITS 0.00 65535.00 /end CHARACTERISTIC
/begin CHARACTERISTIC GlwCD_tEngLim_C "Temperaturschwelle zur Erkennung des Glühmodulfehlers im System, das keine zusätzliche Fehler enthält" VALUE 0x1D8720 Kw_Ws16 250.0000 Temp_Cels -50.14000 199.8600 FORMAT "%8.4" EXTENDED_LIMITS -3549.940 3003.560 /end CHARACTERISTIC
/begin CHARACTERISTIC GlwCD_tiBtwTstLmp_C "Zeitabstand, in dem im Fehlerfall die Endstufe getestet wird" VALUE 0x1D874E Kw_Wu16 29900.00 Time_ms 100.0000 30000.00 FORMAT "%8.2" EXTENDED_LIMITS 0.00 655350.0 /end CHARACTERISTIC
/begin CHARACTERISTIC GlwCD_tiBtwTst_C "Zeitabstand, in dem im Fehlerfall die GSK3-Endstufe getestet wird" VALUE 0x1D8722 Kw_Wu16 29980.00 Time_ms 20.00000 30000.00 FORMAT "%8.2" EXTENDED_LIMITS 0.00 655350.0 /end CHARACTERISTIC
/begin CHARACTERISTIC GlwCD_tiMaxDef_C "Entprellzeit Max-Fehler für Dfp_GLWCD_SFD" VALUE 0x1D8724 Kw_Wu16 65540.00 Time_ms 0.00 65540.00 FORMAT "%8.2" EXTENDED_LIMITS 0.00 655350.0 /end CHARACTERISTIC
/begin CHARACTERISTIC GlwCD_tiMaxOk_C "Heilungszeit Max-Fehler für Dfp_GLWCD_SFD" VALUE 0x1D8726 Kw_Wu16 65540.00 Time_ms 0.00 65540.00 FORMAT "%8.2" EXTENDED_LIMITS 0.00 655350.0 /end CHARACTERISTIC
/begin CHARACTERISTIC GlwCD_tiMinDef_C "Entprellzeit für Min-Fehler für Dfp_GlwCD_SFD" VALUE 0x1D8728 Kw_Wu16 65540.00 Time_ms 0.00 65540.00 FORMAT "%8.2" EXTENDED_LIMITS 0.00 655350.0 /end CHARACTERISTIC
/begin CHARACTERISTIC GlwCD_tiMinOk_C "Heilungszeit für Min-Fehler für Dfp_GlwCD_SFD" VALUE 0x1D872A Kw_Wu16 65540.00 Time_ms 0.00 65540.00 FORMAT "%8.2" EXTENDED_LIMITS 0.00 655350.0 /end CHARACTERISTIC
/begin CHARACTERISTIC GlwCD_tiGlwLampAckIntr_C "Zeitverzögerung zum Zurücksetzen der Heilbedingung" VALUE 0x1D8750 Kw_Wu16 655350.0 Time_ms 0.00 655350.0 FORMAT "%8.1" /end CHARACTERISTIC
/begin CHARACTERISTIC GlwCD_tiPwrStgLmpOn_C "Zeit für welche die Endstufe im Fehlerfall eingeschalten wird (nur nicht SPI kontrolliert)" VALUE 0x1D8752 Kw_Wu16 30000.00 Time_ms 0.00 30000.00 FORMAT "%8.2" EXTENDED_LIMITS 0.00 655350.0 /end CHARACTERISTIC
/begin CHARACTERISTIC GlwCD_tiPwrStgOn_C "Zeit für welche die Enstufe im Fehlerfall eingeschalten wird (nur nicht SPI kontrolliert)" VALUE 0x1D872C Kw_Wu16 500.0000 Time_ms 0.00 500.0000 FORMAT "%8.4" EXTENDED_LIMITS 0.00 655350.0 /end CHARACTERISTIC
/begin CHARACTERISTIC GlwCD_uBattLim_C "minimaler Wert der Batteriespannung erforderlich zur Erkennung des Lastabfallfehlers der Endstufen" VALUE 0x1D872E Kw_Ws16 28603.18 Volt_Batt 0.00 28603.18 FORMAT "%8.2" EXTENDED_LIMITS -665674.1 665653.8 /end CHARACTERISTIC
/begin CHARACTERISTIC GlwCD_uRef_C "Referenzspannung für Batteriespannungskorrektur" VALUE 0x1D8730 Kw_Ws16 20010.04 Volt_Batt 0.00 20010.04 FORMAT "%8.2" EXTENDED_LIMITS -665674.1 665653.8 /end CHARACTERISTIC
/begin CHARACTERISTIC GlwCtl_dwEnrgSlp_CUR "negative Steigung des Energie Integrators" CURVE 0x1D8754 Kl_Xs16_Ws16 494.9799 RmpSqrVltg1_s 5.004883 499.9847 FORMAT "%8.4" EXTENDED_LIMITS -500.0000 499.9847
 /begin AXIS_DESCR STD_AXIS GlwCtl_wIntegEnrg_mp SqrVltg_s 6 0.00 3276.000 FORMAT "%8.3" EXTENDED_LIMITS -3276.800 3276.700 DEPOSIT ABSOLUTE /end AXIS_DESCR
/end CHARACTERISTIC
/begin CHARACTERISTIC GlwCtl_facGlwPwrRed_MAP "Faktor zur Absenkung der Bordnetzspannung im Nachglühen" MAP 0x1D8A2C Kf_Xs16_Ys16_Ws16 3.000000 Fact1 0.00 3.000000 FORMAT "%8.6" EXTENDED_LIMITS -256.0000 255.9922
 /begin AXIS_DESCR STD_AXIS Eng_nAvrg EngN 6 0.00 6000.000 FORMAT "%8.3" EXTENDED_LIMITS -32768.00 32767.00 DEPOSIT ABSOLUTE /end AXIS_DESCR
 /begin AXIS_DESCR STD_AXIS InjCtl_qCurr InjMass 6 0.00 327.6700 FORMAT "%8.4" EXTENDED_LIMITS -327.6800 327.6700 DEPOSIT ABSOLUTE /end AXIS_DESCR
/end CHARACTERISTIC
/begin CHARACTERISTIC GlwCtl_facPst1_C "Multiplikationsfaktor für die erste Nachglühphase" VALUE 0x1D8A90 Kw_Ws16 4.000000 Fact1 0.00 4.000000 FORMAT "%8.6" EXTENDED_LIMITS -256.0000 255.9922 /end CHARACTERISTIC
/begin CHARACTERISTIC GlwCtl_facPst2_C "Multiplikationsfaktor für die zweite Nachglühphase" VALUE 0x1D8A92 Kw_Ws16 4.000000 Fact1 0.00 4.000000 FORMAT "%8.6" EXTENDED_LIMITS -256.0000 255.9922 /end CHARACTERISTIC
/begin CHARACTERISTIC GlwCtl_nPre_C "oberer Schwellwert Drehzahl für Ende Vorglühen" VALUE 0x1D876E Kw_Wu16 5960.000 EngN 40.00000 6000.000 FORMAT "%8.3" EXTENDED_LIMITS 0.00 65535.00 /end CHARACTERISTIC
/begin CHARACTERISTIC GlwCtl_nPst_C "Oberer Schwellwert Drehzahl für Ende Nachglühen" VALUE 0x1D8770 Kw_Ws16 5960.000 EngN 40.00000 6000.000 FORMAT "%8.3" EXTENDED_LIMITS -32768.00 32767.00 /end CHARACTERISTIC
/begin CHARACTERISTIC GlwCtl_nRampEna_C "Motordrezahlschwelle für die activierung der Rampe für das Glüh-Tastverhältnis" VALUE 0x1D8A94 Kw_Wu16 5960.000 EngN 40.00000 6000.000 FORMAT "%8.3" EXTENDED_LIMITS 0.00 65535.00 /end CHARACTERISTIC
/begin CHARACTERISTIC GlwCtl_nRdy_C "Drehzahlschwelle Übergang Startglow zu Readinessglow" VALUE 0x1D8772 Kw_Ws16 5960.000 EngN 40.00000 6000.000 FORMAT "%8.3" EXTENDED_LIMITS -32768.00 32767.00 /end CHARACTERISTIC
/begin CHARACTERISTIC GlwCtl_nThresGSK3_C "Drehzahlschwelle für GSK3" VALUE 0x1D8774 Kw_Wu16 5960.000 EngN 40.00000 6000.000 FORMAT "%8.3" EXTENDED_LIMITS 0.00 65535.00 /end CHARACTERISTIC
/begin CHARACTERISTIC GlwCtl_nThresItmGlw_C "Drehzahlschwelle für Zwischenglühen bei PFlt Regeneration" VALUE 0x1D8776 Kw_Wu16 5960.000 EngN 40.00000 6000.000 FORMAT "%8.3" EXTENDED_LIMITS 0.00 65535.00 /end CHARACTERISTIC
/begin CHARACTERISTIC GlwCtl_nThresNoItmGlw_C "Drehzahlschwelle für Verlassen des Zwischenglühens bei PFlt Regeneration" VALUE 0x1D8778 Kw_Wu16 5960.000 EngN 40.00000 6000.000 FORMAT "%8.3" EXTENDED_LIMITS 0.00 65535.00 /end CHARACTERISTIC
/begin CHARACTERISTIC GlwCtl_dprcRmpGlwUp_C "Positive Rampensteigung für die Berechnung des Glühtastverhältnisses" VALUE 0x1D8A98 Kw_Wu32 10000.0000000 RmpPrc 0.00 10000.0000000 FORMAT "%13.7" EXTENDED_LIMITS 0.00 655359.999847 /end CHARACTERISTIC
/begin CHARACTERISTIC GlwCtl_dprcRmpGlwDwn_C "Negative Rampensteigung für die Berechnung des Glühtastverhältnisses" VALUE 0x1D8A9C Kw_Wu32 10000.0000000 RmpPrc 0.00 10000.0000000 FORMAT "%13.7" EXTENDED_LIMITS 0.00 655359.999847 /end CHARACTERISTIC
/begin CHARACTERISTIC GlwCtl_qPst_CUR "Schwellwert Einspritzmenge für Nachglühen" CURVE 0x1D877A Kl_Xs16_Ws16 327.6700 InjMass 0.00 327.6700 FORMAT "%8.4" EXTENDED_LIMITS -327.6800 327.6700
 /begin AXIS_DESCR STD_AXIS GlwCtl_tEng Temp_Cels 25 -50.14000 149.8600 FORMAT "%8.4" EXTENDED_LIMITS -3549.940 3003.560 DEPOSIT ABSOLUTE /end AXIS_DESCR
/end CHARACTERISTIC
/begin CHARACTERISTIC GlwCtl_qThresFlQnt_C "Mengenschwelle zum Verlassen des Zwischenglühens" VALUE 0x1D87E0 Kw_Ws16 327.6700 InjMass 0.00 327.6700 FORMAT "%8.4" EXTENDED_LIMITS -327.6800 327.6700 /end CHARACTERISTIC
/begin CHARACTERISTIC GlwCtl_qThresFl_C "Treibstoffmengenschwelle für Zwischenglühen" VALUE 0x1D87E2 Kw_Ws16 327.6700 InjMass 0.00 327.6700 FORMAT "%8.4" EXTENDED_LIMITS -327.6800 327.6700 /end CHARACTERISTIC
/begin CHARACTERISTIC GlwCtl_qThresItmGlwHi_C "Oberer Schwellenwert in state change ""Intermediate Glow => No glow"" in GlwCtl_Logic" VALUE 0x1D87E4 Kw_Ws16 327.6700 InjMass 0.00 327.6700 FORMAT "%8.4" EXTENDED_LIMITS -327.6800 327.6700 /end CHARACTERISTIC
/begin CHARACTERISTIC GlwCtl_qThresItmGlwLo_C "Unterer Schwellenwert in state change ""No Glow => Wait for intermediate glow"" in GlwCtl_Logic" VALUE 0x1D87E6 Kw_Ws16 327.6700 InjMass 0.00 327.6700 FORMAT "%8.4" EXTENDED_LIMITS -327.6800 327.6700 /end CHARACTERISTIC
/begin CHARACTERISTIC GlwCtl_qThresNoItmGlwHi_C "Oberer Schwellenwert in state change ""No Glow => Wait for intermediate glow"" in GlwCtl_Logic" VALUE 0x1D87E8 Kw_Ws16 327.6700 InjMass 0.00 327.6700 FORMAT "%8.4" EXTENDED_LIMITS -327.6800 327.6700 /end CHARACTERISTIC
/begin CHARACTERISTIC GlwCtl_qThresNoItmGlwLo_C "Unterer Schwellenwert in state change ""Intermediate Glow => No Glow"" in GlwCtl_Logic" VALUE 0x1D87EA Kw_Ws16 327.6700 InjMass 0.00 327.6700 FORMAT "%8.4" EXTENDED_LIMITS -327.6800 327.6700 /end CHARACTERISTIC
/begin CHARACTERISTIC GlwCtl_rGSKHiPreGlw_C "Tastverhältniskennfeld für Energieeintrag Glühen" VALUE 0x1D8AA0 Kw_Wu16 100.0000 DtyCyc 0.00 100.0000 FORMAT "%8.4" EXTENDED_LIMITS 0.00 655.3500 /end CHARACTERISTIC
/begin CHARACTERISTIC GlwCtl_rNomGSK_C "Nominales Tastverhältnis der Glühkerze" VALUE 0x1D8AA2 Kw_Wu16 100.0000 DtyCyc 0.00 100.0000 FORMAT "%8.4" EXTENDED_LIMITS 0.00 655.3500 /end CHARACTERISTIC
/begin CHARACTERISTIC GlwCtl_rOut1_C "Tastverhältnis für das Vorglühen, Phase 1" VALUE 0x1D8AA4 Kw_Ws16 100.0000 DtyCyc 0.00 100.0000 FORMAT "%8.4" EXTENDED_LIMITS -327.6800 327.6700 /end CHARACTERISTIC
/begin CHARACTERISTIC GlwCtl_rOut2_C "Tastverhältnis für das Vorglühen, Phase 2" VALUE 0x1D8AA6 Kw_Ws16 100.0000 DtyCyc 0.00 100.0000 FORMAT "%8.4" EXTENDED_LIMITS -327.6800 327.6700 /end CHARACTERISTIC
/begin CHARACTERISTIC GlwCtl_rOut3_C "Tastverhältnis für das Vorglühen, Phase 3" VALUE 0x1D8AA8 Kw_Ws16 100.0000 DtyCyc 0.00 100.0000 FORMAT "%8.4" EXTENDED_LIMITS -327.6800 327.6700 /end CHARACTERISTIC
/begin CHARACTERISTIC GlwCtl_rOut_MAP "Tastverhältniskennfeld für die Stati Bereitschaftsglühen, Nachglühen und Zwischenglühen" MAP 0x1D8AAA Kf_Xs16_Ys16_Ws16 300.0000 DtyCyc -100.0000 200.0000 FORMAT "%8.4" EXTENDED_LIMITS -327.6800 327.6700
 /begin AXIS_DESCR STD_AXIS Eng_nAvrg EngN 10 0.00 6000.000 FORMAT "%8.3" EXTENDED_LIMITS -32768.00 32767.00 DEPOSIT ABSOLUTE /end AXIS_DESCR
 /begin AXIS_DESCR STD_AXIS InjCtl_qCurr InjMass 10 0.00 327.6700 FORMAT "%8.4" EXTENDED_LIMITS -327.6800 327.6700 DEPOSIT ABSOLUTE /end AXIS_DESCR
/end CHARACTERISTIC
/begin CHARACTERISTIC GlwCtl_rPstCor_MAP "Korrekturkennfeld für Tastverhältnis im Nachglühen abhängig von Umdrehungen seit Motorstart und Motortemperatur" MAP 0x1D8B9E Kf_Xs16_Ys16_Ws16 200.0000 DtyCyc -100.0000 100.0000 FORMAT "%8.4" EXTENDED_LIMITS -327.6800 327.6700
 /begin AXIS_DESCR STD_AXIS EngM_ctRevSta OneToOne 6 0.00 3277.000 FORMAT "%8.3" EXTENDED_LIMITS -32768.00 32767.00 DEPOSIT ABSOLUTE /end AXIS_DESCR
 /begin AXIS_DESCR STD_AXIS GlwCtl_tEng Temp_Cels 6 -0.04000000 3276.660 FORMAT "%8.3" EXTENDED_LIMITS -3549.940 3003.560 DEPOSIT ABSOLUTE /end AXIS_DESCR
/end CHARACTERISTIC
/begin CHARACTERISTIC GlwCtl_rStrt_C "Tastverhältnis für das Startglühen" VALUE 0x1D8C02 Kw_Ws16 100.0000 DtyCyc 0.00 100.0000 FORMAT "%8.4" EXTENDED_LIMITS -327.6800 327.6700 /end CHARACTERISTIC
/begin CHARACTERISTIC GlwCtl_stEGTRgnGlwEnaMsk_C "Schalter für die Aktivierung des Zwischenglühens bei Regeneration Partikelfilter" VALUE 0x1D87EC Kw_Wu32 4294967295.00 OneToOne 0.00 4294967295.00 FORMAT "%13.2" /end CHARACTERISTIC
/begin CHARACTERISTIC GlwCtl_swtClgMode_C "Schalter für Abkühltimer, Abkühlen in No Glow" VALUE 0x1D87F0 Kw_Wu8 255.0 OneToOne 0.00 255.0 FORMAT "%5.1" /end CHARACTERISTIC
/begin CHARACTERISTIC GlwCtl_swtDycStrt_C "Schalter-Wert für die Auswahl des Ausgangs-Tastverhältnis im Zustand Startglühen" VALUE 0x1D8C04 Kw_Wu8 1.000 OneToOne 0.00 1.000 FORMAT "%5.3" EXTENDED_LIMITS 0.00 255.0 /end CHARACTERISTIC
/begin CHARACTERISTIC GlwCtl_swtEnrgPreEnaVal_C "S/w Schalter für Vorglühen mit Energieeintrag" VALUE 0x1D87F1 Kw_Wu8 1.000 OneToOne 0.00 1.000 FORMAT "%5.3" EXTENDED_LIMITS 0.00 255.0 /end CHARACTERISTIC
/begin CHARACTERISTIC GlwCtl_swtGSKModeVal_C "Schalterwert zur Wahl von GSK-Modus" VALUE 0x1D87F2 Kw_Wu8 1.000 OneToOne 0.00 1.000 FORMAT "%5.3" EXTENDED_LIMITS 0.00 255.0 /end CHARACTERISTIC
/begin CHARACTERISTIC GlwCtl_swtGSKModeType_C "Typ des Schalters zur Wahl von GSK-Modus" VALUE 0x1D87F3 Kw_Wu8 2.000 OneToOne 0.00 2.000 FORMAT "%5.3" EXTENDED_LIMITS 0.00 255.0 /end CHARACTERISTIC
/begin CHARACTERISTIC GlwCtl_swtInjQnt_C "Auswahl der Einspritzmenge (mit bzw. ohne FMA) in GlwCtl_Logic" VALUE 0x1D87F4 Kw_Wu8 255.0 OneToOne 0.00 255.0 FORMAT "%5.1" /end CHARACTERISTIC
/begin CHARACTERISTIC GlwCtl_swtPreGlwVal_C "Schalterwert zur Wahl der Glühkontrolllampenansteuerung" VALUE 0x1D8C05 Kw_Wu8 1.000 OneToOne 0.00 1.000 FORMAT "%5.3" EXTENDED_LIMITS 0.00 255.0 /end CHARACTERISTIC
/begin CHARACTERISTIC GlwCtl_swtPreGlwType_C "Typ des Softwareschalters zur Wahl der Glühkontrolllampenansteuerung" VALUE 0x1D8C06 Kw_Wu8 2.000 OneToOne 0.00 2.000 FORMAT "%5.3" EXTENDED_LIMITS 0.00 255.0 /end CHARACTERISTIC
/begin CHARACTERISTIC GlwCtl_swtRlsPshDisbl_C "Schalter um das Pushverbot zu deaktivieren" VALUE 0x1D87F5 Kw_Wu8 1.000 OneToOne 0.00 1.000 FORMAT "%5.3" EXTENDED_LIMITS 0.00 255.0 /end CHARACTERISTIC
/begin CHARACTERISTIC GlwCtl_swtSpareStrtEna_C "Abschalten Nachglühen bei Notstart" VALUE 0x1D87F6 Kw_Wu16 1.000000 OneToOne 0.00 1.000000 FORMAT "%8.6" EXTENDED_LIMITS 0.00 65535.00 /end CHARACTERISTIC
/begin CHARACTERISTIC GlwCtl_swtTempVal_C "Schalter der Temperaturwert des Arrays auswählt" VALUE 0x1D87F8 Kw_Wu8 4.00000000000 EngTempFldSel 0.00 4.00000000000 FORMAT "%13.11" /end CHARACTERISTIC
/begin CHARACTERISTIC GlwCtl_swtVarBatt_C "Variantenschalter zur Auswahl von Batteriespannungskennfeld oder Luftkennfeld zur Berechnung der Vorglühzeit" VALUE 0x1D87FA Kw_Wu16 1.000000 OneToOne 0.00 1.000000 FORMAT "%8.6" EXTENDED_LIMITS 0.00 65535.00 /end CHARACTERISTIC
/begin CHARACTERISTIC GlwCtl_swtWakeUpPrs_C "Schalter zum Umgehen der Abfrage von CoEng_stEng in GlwCtl_Logic" VALUE 0x1D87FC Kw_Wu8 1.000 OneToOne 0.00 1.000 FORMAT "%5.3" EXTENDED_LIMITS 0.00 255.0 /end CHARACTERISTIC
/begin CHARACTERISTIC GlwCtl_tAdjMax_C "Maximaler Abgleichwert f. Abgleich Kühlmitteltemperaturbegrenzung" VALUE 0x1D87FE Kw_Ws16 100.0000 TempDiff_Kelv -50.00000 50.00000 FORMAT "%8.5" EXTENDED_LIMITS -3276.800 3276.700 /end CHARACTERISTIC
/begin CHARACTERISTIC GlwCtl_tAdjMin_C "Minimaler Abgleichwert f. Abgleich Kühlmitteltemperaturbegrenzung" VALUE 0x1D8800 Kw_Ws16 100.0000 TempDiff_Kelv -50.00000 50.00000 FORMAT "%8.5" EXTENDED_LIMITS -3276.800 3276.700 /end CHARACTERISTIC
/begin CHARACTERISTIC GlwCtl_tAdjVal_C "Referenzwert f. Abgleich Kühlmitteltemperaturbegrenzung" VALUE 0x1D8802 Kw_Ws16 100.0000 TempDiff_Kelv -50.00000 50.00000 FORMAT "%8.5" EXTENDED_LIMITS -3276.800 3276.700 /end CHARACTERISTIC
/begin CHARACTERISTIC GlwCtl_tDflEng_C "Temperaturersatzwert" VALUE 0x1D8804 Kw_Ws16 250.0000 Temp_Cels -50.14000 199.8600 FORMAT "%8.4" EXTENDED_LIMITS -3549.940 3003.560 /end CHARACTERISTIC
/begin CHARACTERISTIC GlwCtl_tiChk_C "Sperrzeit für Zwischenglühfall" VALUE 0x1D8806 Kw_Wu16 655350.0 Time_ms 0.00 655350.0 FORMAT "%8.1" /end CHARACTERISTIC
/begin CHARACTERISTIC GlwCtl_tiClgHi_C "Ablaufzeit des Glühkerzen Abkühl-Timers höherer Motortemperatur" VALUE 0x1D8808 Kw_Wu16 655140.0 Time_ms 0.00 655140.0 FORMAT "%8.1" EXTENDED_LIMITS 0.00 655350.0 /end CHARACTERISTIC
/begin CHARACTERISTIC GlwCtl_tiClgLo_C "Ablaufzeit des Glühkerzen Abkühl-Timers bei niederer Motortemperatur" VALUE 0x1D880A Kw_Wu16 655140.0 Time_ms 0.00 655140.0 FORMAT "%8.1" EXTENDED_LIMITS 0.00 655350.0 /end CHARACTERISTIC
/begin CHARACTERISTIC GlwCtl_tiDebPre_C "Entprellzeit für Ende Vorglühen falls Schwellwert Drehzahl erreicht ist" VALUE 0x1D880C Kw_Wu16 655350.0 Time_ms 0.00 655350.0 FORMAT "%8.1" /end CHARACTERISTIC
/begin CHARACTERISTIC GlwCtl_tiDebPwrRed_C "Entprellzeit zur Absenkung der Bordnetzspannung" VALUE 0x1D8C08 Kw_Wu16 200000.0 Time_ms 0.00 200000.0 FORMAT "%8.1" EXTENDED_LIMITS 0.00 655350.0 /end CHARACTERISTIC
/begin CHARACTERISTIC GlwCtl_tiDebT50_C "Entprellzeit für Zustandswechsel nach START GLOW" VALUE 0x1D880E Kw_Wu16 655350.0 Time_ms 0.00 655350.0 FORMAT "%8.1" /end CHARACTERISTIC
/begin CHARACTERISTIC GlwCtl_tiDel_C "Wartezeit für Nach- oder Zwischenglühen" VALUE 0x1D8810 Kw_Wu16 655350.0 Time_ms 0.00 655350.0 FORMAT "%8.1" /end CHARACTERISTIC
/begin CHARACTERISTIC GlwCtl_tiGlwMax_C "maximale Dauer des Zwischenglühens" VALUE 0x1D8812 Kw_Wu16 655350.0 Time_ms 0.00 655350.0 FORMAT "%8.1" /end CHARACTERISTIC
/begin CHARACTERISTIC GlwCtl_tiOut1_CUR "Vorglühzeit in Phase 1" CURVE 0x1D8814 Kl_Xs16_Ws16 335500.0 GlwCtl_Time_ms 0.00 335500.0 FORMAT "%8.1" EXTENDED_LIMITS -3276800. 3276700.
 /begin AXIS_DESCR STD_AXIS GlwCtl_tEng Temp_Cels 25 -50.14000 199.8600 FORMAT "%8.4" EXTENDED_LIMITS -3549.940 3003.560 DEPOSIT ABSOLUTE /end AXIS_DESCR
/end CHARACTERISTIC
/begin CHARACTERISTIC GlwCtl_tiOut2_C "Vorglühzeit in Phase 1" VALUE 0x1D8C0C Kw_Wu32 429496729500. GlwCtl_Time_ms 0.00 429496729500. FORMAT "%13.0" /end CHARACTERISTIC
/begin CHARACTERISTIC GlwCtl_tiPre1_MAP "Vorglühzeit (1)  als Funktion von Batteriespannung und Wassertemperatur" MAP 0x1D887A Kf_Xs16_Ys16_Ws16 335500.0 GlwCtl_Time_ms 0.00 335500.0 FORMAT "%8.1" EXTENDED_LIMITS -3276800. 3276700.
 /begin AXIS_DESCR STD_AXIS BattCD_u Volt_Batt 4 0.00 20842.94 FORMAT "%8.2" EXTENDED_LIMITS -665674.1 665653.8 DEPOSIT ABSOLUTE /end AXIS_DESCR
 /begin AXIS_DESCR STD_AXIS GlwCtl_tEngAdj Temp_Cels 7 -50.14000 199.8600 FORMAT "%8.4" EXTENDED_LIMITS -3549.940 3003.560 DEPOSIT ABSOLUTE /end AXIS_DESCR
/end CHARACTERISTIC
/begin CHARACTERISTIC GlwCtl_tiPre2_MAP "Vorglühzeit (2) als Funktion des Luftdruckes und der Wassertemperatur" MAP 0x1D88CC Kf_Xs16_Ys16_Ws16 335500.0 GlwCtl_Time_ms 0.00 335500.0 FORMAT "%8.1" EXTENDED_LIMITS -3276800. 3276700.
 /begin AXIS_DESCR STD_AXIS APSCD_pVal Pres_hPa 4 0.00 3500.000 FORMAT "%8.3" EXTENDED_LIMITS -32768.00 32767.00 DEPOSIT ABSOLUTE /end AXIS_DESCR
 /begin AXIS_DESCR STD_AXIS GlwCtl_tEngAdj Temp_Cels 7 -50.14000 199.8600 FORMAT "%8.4" EXTENDED_LIMITS -3549.940 3003.560 DEPOSIT ABSOLUTE /end AXIS_DESCR
/end CHARACTERISTIC
/begin CHARACTERISTIC GlwCtl_tiPreGlwPsh_CUR "Dauer der Ansteuerung der Glühkontrolllampe während des Pushens" CURVE 0x1D8C10 Kl_Xs16_Ws16 335500.0 GlwCtl_Time_ms 0.00 335500.0 FORMAT "%8.1" EXTENDED_LIMITS -3276800. 3276700.
 /begin AXIS_DESCR STD_AXIS GlwCtl_tEng Temp_Cels 8 -50.14000 199.8600 FORMAT "%8.4" EXTENDED_LIMITS -3549.940 3003.560 DEPOSIT ABSOLUTE /end AXIS_DESCR
/end CHARACTERISTIC
/begin CHARACTERISTIC GlwCtl_tiPreGlw_CUR "Dauer der Ansteuerung der Glühkontrolllampe" CURVE 0x1D8C32 Kl_Xs16_Ws16 335500.0 GlwCtl_Time_ms 0.00 335500.0 FORMAT "%8.1" EXTENDED_LIMITS -3276800. 3276700.
 /begin AXIS_DESCR STD_AXIS GlwCtl_tEng Temp_Cels 8 -50.14000 199.8600 FORMAT "%8.4" EXTENDED_LIMITS -3549.940 3003.560 DEPOSIT ABSOLUTE /end AXIS_DESCR
/end CHARACTERISTIC
/begin CHARACTERISTIC GlwCtl_tiPst1_C "Dauer der ersten Nachglühphase" VALUE 0x1D8C54 Kw_Wu16 6553500. GlwCtl_Time_ms 0.00 6553500. FORMAT "%8.0" /end CHARACTERISTIC
/begin CHARACTERISTIC GlwCtl_tiPst2_C "Dauer der zweiten Nachglühphase" VALUE 0x1D8C56 Kw_Wu16 6553500. GlwCtl_Time_ms 0.00 6553500. FORMAT "%8.0" /end CHARACTERISTIC
/begin CHARACTERISTIC GlwCtl_tiPst_CUR "Kurve Nachglühverlauf" CURVE 0x1D891E Kl_Xs16_Ws16 335500.0 GlwCtl_Time_ms 0.00 335500.0 FORMAT "%8.1" EXTENDED_LIMITS -3276800. 3276700.
 /begin AXIS_DESCR STD_AXIS GlwCtl_tEng Temp_Cels 25 -50.14000 199.8600 FORMAT "%8.4" EXTENDED_LIMITS -3549.940 3003.560 DEPOSIT ABSOLUTE /end AXIS_DESCR
/end CHARACTERISTIC
/begin CHARACTERISTIC GlwCtl_tiRdy1_C "Dauer der ersten Startbereitschaftsglühphase" VALUE 0x1D8C58 Kw_Wu32 429496729500. GlwCtl_Time_ms 0.00 429496729500. FORMAT "%13.0" /end CHARACTERISTIC
/begin CHARACTERISTIC GlwCtl_tiRdy_CUR "Dauer Status Startbereitschaftsglühen" CURVE 0x1D8984 Kl_Xs16_Ws16 655140.0 Time_ms 0.00 655140.0 FORMAT "%8.1" EXTENDED_LIMITS -327680.0 327670.0
 /begin AXIS_DESCR STD_AXIS GlwCtl_tEng Temp_Cels 4 -50.14000 199.8600 FORMAT "%8.4" EXTENDED_LIMITS -3549.940 3003.560 DEPOSIT ABSOLUTE /end AXIS_DESCR
/end CHARACTERISTIC
/begin CHARACTERISTIC GlwCtl_tiSpareStrtDel_C "Nachglüh Verzögerungszeit im Notstartfall" VALUE 0x1D8996 Kw_Wu16 65540.00 Time_ms 0.00 65540.00 FORMAT "%8.2" EXTENDED_LIMITS 0.00 655350.0 /end CHARACTERISTIC
/begin CHARACTERISTIC GlwCtl_tiStrt_C "Dauer Status Startglühen" VALUE 0x1D8998 Kw_Wu16 655350.0 Time_ms 0.00 655350.0 FORMAT "%8.1" /end CHARACTERISTIC
/begin CHARACTERISTIC GlwCtl_tiThresFl1_CUR "Kennlinie für Wartezeit für Übergang ""Kein Glühen"" zu ""Warten auf Zwischenglühen""" CURVE 0x1D899A Kl_Xs16_Ws16 327570.0 Time_ms 0.00 327570.0 FORMAT "%8.1" EXTENDED_LIMITS -327680.0 327670.0
 /begin AXIS_DESCR STD_AXIS IATSCD_tAir Temp_Cels 25 -50.14000 199.8600 FORMAT "%8.4" EXTENDED_LIMITS -3549.940 3003.560 DEPOSIT ABSOLUTE /end AXIS_DESCR
/end CHARACTERISTIC
/begin CHARACTERISTIC GlwCtl_tiThresFl2_C "Wartezeit für Übergang ""Zwischenglühen"" nach ""Kein Glühen""" VALUE 0x1D8A00 Kw_Wu16 655350.0 Time_ms 0.00 655350.0 FORMAT "%8.1" /end CHARACTERISTIC
/begin CHARACTERISTIC GlwCtl_tiThresFl3_C "Wartezeit für Übergang ""Warten auf Zwischenglühen"" zu ""Kein Glühen""" VALUE 0x1D8A02 Kw_Wu16 655350.0 Time_ms 0.00 655350.0 FORMAT "%8.1" /end CHARACTERISTIC
/begin CHARACTERISTIC GlwCtl_tStrt_C "Oberer Schwellwert der Wassertemperatur für Startglühen" VALUE 0x1D8A04 Kw_Ws16 250.0000 Temp_Cels -50.14000 199.8600 FORMAT "%8.4" EXTENDED_LIMITS -3549.940 3003.560 /end CHARACTERISTIC
/begin CHARACTERISTIC GlwCtl_tThresSwtTClg_C "Temperaturschwelle für Auswahl der Glühkerzen Abkühlzeit" VALUE 0x1D8A06 Kw_Ws16 250.0000 Temp_Cels -50.14000 199.8600 FORMAT "%8.4" EXTENDED_LIMITS -3549.940 3003.560 /end CHARACTERISTIC
/begin CHARACTERISTIC GlwCtl_uThresHiOvrVltg_C "Obere Grenze der Batteriespannungshysterese für Überspannung" VALUE 0x1D8C5C Kw_Ws16 20782.00 Volt_Batt 0.00 20782.00 FORMAT "%8.2" EXTENDED_LIMITS -665674.1 665653.8 /end CHARACTERISTIC
/begin CHARACTERISTIC GlwCtl_uThresHiUndVltg_C "Obere Grenze der Batteriespannungshysterese für Unterspannung" VALUE 0x1D8C5E Kw_Ws16 20782.00 Volt_Batt 0.00 20782.00 FORMAT "%8.2" EXTENDED_LIMITS -665674.1 665653.8 /end CHARACTERISTIC
/begin CHARACTERISTIC GlwCtl_uThresLoOvrVltg_C "Untere Grenze der Batteriespannungshysterese für Überspannung" VALUE 0x1D8C60 Kw_Ws16 20782.00 Volt_Batt 0.00 20782.00 FORMAT "%8.2" EXTENDED_LIMITS -665674.1 665653.8 /end CHARACTERISTIC
/begin CHARACTERISTIC GlwCtl_uThresLoUndVltg_C "Untere Grenze der Batteriespannungshysterese für Unterspannung" VALUE 0x1D8C62 Kw_Ws16 20782.00 Volt_Batt 0.00 20782.00 FORMAT "%8.2" EXTENDED_LIMITS -665674.1 665653.8 /end CHARACTERISTIC
/begin CHARACTERISTIC GlwCtl_wEnrgPre_CUR "Energie mit einer motortemperaturabhängigen Schwelle aus der Kennlinie" CURVE 0x1D8A08 Kl_Xs16_Ws16 500.0000 SqrVltg_s 0.00 500.0000 FORMAT "%8.4" EXTENDED_LIMITS -3276.800 3276.700
 /begin AXIS_DESCR STD_AXIS GlwCtl_tEng Temp_Cels 8 -50.14000 149.8600 FORMAT "%8.4" EXTENDED_LIMITS -3549.940 3003.560 DEPOSIT ABSOLUTE /end AXIS_DESCR
/end CHARACTERISTIC
/begin CHARACTERISTIC HDSCD_uSRCMin_C "Minimalwert für SRC HZA-Sensor" VALUE 0x1D8C64 Kw_Ws16 5200.391 Volt 0.00 5200.391 FORMAT "%8.3" EXTENDED_LIMITS -160156.4 160151.5 /end CHARACTERISTIC
/begin CHARACTERISTIC HDSCD_uSRCMax_C "Maximalwert für SRC HZA-Sensor" VALUE 0x1D8C66 Kw_Ws16 5200.391 Volt 0.00 5200.391 FORMAT "%8.3" EXTENDED_LIMITS -160156.4 160151.5 /end CHARACTERISTIC
/begin CHARACTERISTIC HDSCD_prcLin_CUR "Linearisierungskennlinie für Heizungsanforderung" CURVE 0x1D8C68 Kl_Xs16_Ws16 100.0000 Prc 0.00 100.0000 FORMAT "%8.4" EXTENDED_LIMITS -327.6800 327.6700
 /begin AXIS_DESCR STD_AXIS HDSCD_uRaw Volt 4 0.00 5200.391 FORMAT "%8.3" EXTENDED_LIMITS -160156.4 160151.5 DEPOSIT ABSOLUTE /end AXIS_DESCR
/end CHARACTERISTIC
/begin CHARACTERISTIC HDSCD_DebSRCHighDef_C "HZA Fehlerentprellzeit fuer SRC-High" VALUE 0x1D8C7A Kw_Wu16 655350.0 Time_ms 0.00 655350.0 FORMAT "%8.1" /end CHARACTERISTIC
/begin CHARACTERISTIC HDSCD_DebSRCHighOk_C "HZA Heilungsentprellzeit fuer SRC-High" VALUE 0x1D8C7C Kw_Wu16 655350.0 Time_ms 0.00 655350.0 FORMAT "%8.1" /end CHARACTERISTIC
/begin CHARACTERISTIC HDSCD_DebSRCLowDef_C "HZA Fehlerentprellzeit fuer SRC-Low" VALUE 0x1D8C7E Kw_Wu16 655350.0 Time_ms 0.00 655350.0 FORMAT "%8.1" /end CHARACTERISTIC
/begin CHARACTERISTIC HDSCD_DebSRCLowOk_C "HZA Heilungsentprellzeit fuer SRC-Low" VALUE 0x1D8C80 Kw_Wu16 655350.0 Time_ms 0.00 655350.0 FORMAT "%8.1" /end CHARACTERISTIC
/begin CHARACTERISTIC HDSCD_dprcRmpSlpUp_C "positive Rampensteigung zum Erreichen des Vorgabewertes" VALUE 0x1D8C84 Kw_Wu32 100.000000000 RmpPrc 0.00 100.000000000 FORMAT "%13.9" EXTENDED_LIMITS 0.00 655359.999847 /end CHARACTERISTIC
/begin CHARACTERISTIC HDSCD_dprcRmpSlpDwn_C "negative Rampensteigung zum Erreichen des Vorgabewertes" VALUE 0x1D8C88 Kw_Wu32 100.000000000 RmpPrc 0.00 100.000000000 FORMAT "%13.9" EXTENDED_LIMITS 0.00 655359.999847 /end CHARACTERISTIC
/begin CHARACTERISTIC HDSCD_stSensIDWord_C "Geberkennwort HZA-Sensor" VALUE 0x1D8C8C Kw_Wu16 65535.00 OneToOne 0.00 65535.00 FORMAT "%8.2" /end CHARACTERISTIC
/begin CHARACTERISTIC HDSCD_prcAirDfl_C "Ersatzwert für Heizungsanforderung" VALUE 0x1D8C8E Kw_Ws16 100.0000 Prc 0.00 100.0000 FORMAT "%8.4" EXTENDED_LIMITS -327.6800 327.6700 /end CHARACTERISTIC
/begin CHARACTERISTIC HWEMon_DebComStepDown_C "Abwärts Schrittweite für Entprellung SPI Kommunikation" VALUE 0x1D8C90 Kw_Wu8 3.000 OneToOne 0.00 3.000 FORMAT "%5.3" EXTENDED_LIMITS 0.00 255.0 /end CHARACTERISTIC
/begin CHARACTERISTIC HWEMon_DebComStepUp_C "Aufwärts Schrittweite für Entprellung SPI Kommunikation" VALUE 0x1D8C91 Kw_Wu8 3.000 OneToOne 0.00 3.000 FORMAT "%5.3" EXTENDED_LIMITS 0.00 255.0 /end CHARACTERISTIC
/begin CHARACTERISTIC HWEMon_DebComDef_C "Entprellung für defekt Erkennung der SPI Kommunikation" VALUE 0x1D8C92 Kw_Wu16 65535.00 OneToOne 0.00 65535.00 FORMAT "%8.2" /end CHARACTERISTIC
/begin CHARACTERISTIC HWEMon_DebComOk_C "Entprellung für intakt Erkennung der SPI Kommunikation" VALUE 0x1D8C94 Kw_Wu16 65535.00 OneToOne 0.00 65535.00 FORMAT "%8.2" /end CHARACTERISTIC
/begin CHARACTERISTIC HWEMon_DebEepDef_C "Defektschwelle für einfach abgelegte Blöcke" VALUE 0x1D8C96 Kw_Wu8 255.0 OneToOne 0.00 255.0 FORMAT "%5.1" /end CHARACTERISTIC
/begin CHARACTERISTIC HWEMon_lStoreEEP_C "zu fahrende Strecke zwischen E2PROM schreiben" VALUE 0x1D8C98 Kw_Wu32 4294957295.00 Length 10000.0000000 4294967295.00 FORMAT "%13.2" EXTENDED_LIMITS 0.00 4294967295.00 /end CHARACTERISTIC
/begin CHARACTERISTIC HWEMon_nAvrg_C "Motordrehzahlschwelle zum E2PROM schreiben" VALUE 0x1D8C9C Kw_Ws16 6000.000 EngN 0.00 6000.000 FORMAT "%8.3" EXTENDED_LIMITS -32768.00 32767.00 /end CHARACTERISTIC
/begin CHARACTERISTIC HWEMon_nThres_C "Drehzahlschwelle für Latchbetrieb der Überspannungsüberwachung (nur für CJ945)" VALUE 0x1D8C9E Kw_Ws16 300.0000 EngN 300.0000 600.0000 FORMAT "%8.4" EXTENDED_LIMITS -32768.00 32767.00 /end CHARACTERISTIC
/begin CHARACTERISTIC HWEMon_numTrigRecovery_C "Nummer der durch Änderung dieses Labels auszulösenden Recovery" VALUE 0x1D8CA0 Kw_Wu16 65535.00 OneToOne 0.00 65535.00 FORMAT "%8.2" /end CHARACTERISTIC
/begin CHARACTERISTIC HWEMon_tiStoreEEP_C "zu fahrende Zeit zwischen dem zyklischen Abspeichern von Daten in das EEPROM" VALUE 0x1D8CA4 Kw_Wu32 42948772.9500 Time_s 900.000000000 42949672.9500 FORMAT "%13.4" EXTENDED_LIMITS 0.00 42949672.9500 /end CHARACTERISTIC
/begin CHARACTERISTIC IATSCD_uSRCMin_C "Minimalwert für SRC LTF-Sensor" VALUE 0x1D8CA8 Kw_Ws16 5200.391 Volt 0.00 5200.391 FORMAT "%8.3" EXTENDED_LIMITS -160156.4 160151.5 /end CHARACTERISTIC
/begin CHARACTERISTIC IATSCD_uSRCMax_C "Maximalwert für SRC LTF-Sensor" VALUE 0x1D8CAA Kw_Ws16 5200.391 Volt 0.00 5200.391 FORMAT "%8.3" EXTENDED_LIMITS -160156.4 160151.5 /end CHARACTERISTIC
/begin CHARACTERISTIC IATSCD_tLin_CUR "Linearisierungskennlinie für LTF-Sensor" CURVE 0x1D8CAC Kl_Xs16_Ws16 250.0000 Temp_Cels -50.04000 199.9600 FORMAT "%8.4" EXTENDED_LIMITS -3549.940 3003.560
 /begin AXIS_DESCR STD_AXIS IATSCD_uRaw Volt 25 0.00 5200.391 FORMAT "%8.3" EXTENDED_LIMITS -160156.4 160151.5 DEPOSIT ABSOLUTE /end AXIS_DESCR
/end CHARACTERISTIC
/begin CHARACTERISTIC IATSCD_DebSigDef_C "Ladelufttemperatur - Entprellzeit bis Signal defekt" VALUE 0x1D8D12 Kw_Wu16 655350.0 Time_ms 0.00 655350.0 FORMAT "%8.1" /end CHARACTERISTIC
/begin CHARACTERISTIC IATSCD_DebSigOk_C "Ladelufttemperatur - Entprellzeit bis Signal geheilt" VALUE 0x1D8D14 Kw_Wu16 655350.0 Time_ms 0.00 655350.0 FORMAT "%8.1" /end CHARACTERISTIC
/begin CHARACTERISTIC IATSCD_DebSRCHighDef_C "LTF Fehlerentprellzeit fuer SRC-High" VALUE 0x1D8D16 Kw_Wu16 655350.0 Time_ms 0.00 655350.0 FORMAT "%8.1" /end CHARACTERISTIC
/begin CHARACTERISTIC IATSCD_DebSRCHighOk_C "LTF Heilungsentprellzeit fuer SRC-High" VALUE 0x1D8D18 Kw_Wu16 655350.0 Time_ms 0.00 655350.0 FORMAT "%8.1" /end CHARACTERISTIC
/begin CHARACTERISTIC IATSCD_DebSRCLowDef_C "LTF Fehlerentprellzeit fuer SRC-Low" VALUE 0x1D8D1A Kw_Wu16 655350.0 Time_ms 0.00 655350.0 FORMAT "%8.1" /end CHARACTERISTIC
/begin CHARACTERISTIC IATSCD_DebSRCLowOk_C "LTF Heilungsentprellzeit fuer SRC-Low" VALUE 0x1D8D1C Kw_Wu16 655350.0 Time_ms 0.00 655350.0 FORMAT "%8.1" /end CHARACTERISTIC
/begin CHARACTERISTIC IATSCD_dtRmpSlpUp_C "Rampensteigung bei Heilung/Vorgabewert für LTF" VALUE 0x1D8D20 Kw_Wu32 6553599.99847 RmpTemp 0.00 6553599.99847 FORMAT "%13.5" /end CHARACTERISTIC
/begin CHARACTERISTIC IATSCD_dtRmpSlpDwn_C "Rampensteigung bei Heilung/Vorgabewert für LTF" VALUE 0x1D8D24 Kw_Wu32 6553599.99847 RmpTemp 0.00 6553599.99847 FORMAT "%13.5" /end CHARACTERISTIC
/begin CHARACTERISTIC IATSCD_swtSigVal_C "Lufttemperatur - Funktionsschalter Signalquelle ADC oder CAN (0=ADC, 1= CAN)" VALUE 0x1D8D28 Kw_Wu8 1.000 OneToOne 0.00 1.000 FORMAT "%5.3" EXTENDED_LIMITS 0.00 255.0 /end CHARACTERISTIC
/begin CHARACTERISTIC IATSCD_stSensIDWord_C "Geberkennwort LTF-Sensor" VALUE 0x1D8D2A Kw_Wu16 65535.00 OneToOne 0.00 65535.00 FORMAT "%8.2" /end CHARACTERISTIC
/begin CHARACTERISTIC IATSCD_tDfl_C "Vorgabewert bei defektem LTF-Sensor" VALUE 0x1D8D2C Kw_Ws16 200.0000 Temp_Cels -50.14000 149.8600 FORMAT "%8.4" EXTENDED_LIMITS -3549.940 3003.560 /end CHARACTERISTIC
/begin CHARACTERISTIC IFCD_ctPwrStgOnMax_C "maximale Anzahl von Endstufen-Einschaltungen pro Fahrzyklus bei SCB oder Übertemperatur" VALUE 0x1D8D30 Kw_Wu16 65535.00 OneToOne 0.00 65535.00 FORMAT "%8.2" /end CHARACTERISTIC
/begin CHARACTERISTIC IFCD_DebExcTempDef_C "Fehlerentprellzeit für Übertemperatur" VALUE 0x1D8D32 Kw_Wu16 655350.0 Time_ms 0.00 655350.0 FORMAT "%8.1" /end CHARACTERISTIC
/begin CHARACTERISTIC IFCD_DebExcTempOK_C "Heilungsentprellzeit für Übertemperatur" VALUE 0x1D8D34 Kw_Wu16 655350.0 Time_ms 0.00 655350.0 FORMAT "%8.1" /end CHARACTERISTIC
/begin CHARACTERISTIC IFCD_DebNoLoadDef_C "Fehlerentprellzeit für Lastabfall" VALUE 0x1D8D36 Kw_Wu16 655350.0 Time_ms 0.00 655350.0 FORMAT "%8.1" /end CHARACTERISTIC
/begin CHARACTERISTIC IFCD_DebNoLoadOK_C "Heilungsentprellzeit für Lastabfall" VALUE 0x1D8D38 Kw_Wu16 655350.0 Time_ms 0.00 655350.0 FORMAT "%8.1" /end CHARACTERISTIC
/begin CHARACTERISTIC IFCD_DebShortCircBatDef_C "Fehlerentprellzeit für Kurzschluß nach Batteriespannung" VALUE 0x1D8D3A Kw_Wu16 655350.0 Time_ms 0.00 655350.0 FORMAT "%8.1" /end CHARACTERISTIC
/begin CHARACTERISTIC IFCD_DebShortCircBatOK_C "Heilungsentprellzeit für Kurzschluß nach Batteriespannung" VALUE 0x1D8D3C Kw_Wu16 655350.0 Time_ms 0.00 655350.0 FORMAT "%8.1" /end CHARACTERISTIC
/begin CHARACTERISTIC IFCD_DebShortCircGndDef_C "Fehlerentprellzeit für Kurzschluss nach Masse" VALUE 0x1D8D3E Kw_Wu16 655350.0 Time_ms 0.00 655350.0 FORMAT "%8.1" /end CHARACTERISTIC
/begin CHARACTERISTIC IFCD_DebShortCircGndOK_C "Heilungsentprellzeit für Kurzschluss nach Masse" VALUE 0x1D8D40 Kw_Wu16 655350.0 Time_ms 0.00 655350.0 FORMAT "%8.1" /end CHARACTERISTIC
/begin CHARACTERISTIC IFCD_stInvOut_C "Invertierungsparameter für das Endstufensignal der Lüftersteuerung für den Ladeluftkühler" VALUE 0x1D8D42 Kw_Wu8 1.000 OneToOne 0.00 1.000 FORMAT "%5.3" EXTENDED_LIMITS 0.00 255.0 /end CHARACTERISTIC
/begin CHARACTERISTIC IFCD_stPwrStgActv_C "Statuswort für die Deaktivierung der Endsufe" VALUE 0x1D8D43 Kw_Wu8 255.0 OneToOne 0.00 255.0 FORMAT "%5.1" /end CHARACTERISTIC
/begin CHARACTERISTIC IFCD_stPwrStgDia_C "Status Wort für die Deaktivierung der Diagnose" VALUE 0x1D8D44 Kw_Wu8 255.0 OneToOne 0.00 255.0 FORMAT "%5.1" /end CHARACTERISTIC
/begin CHARACTERISTIC IFCD_stSPICtl_C "Parameter zur Anzeige der verwendeten Endstufenart ( 1 = SPI kontrollierbare Endstufe, 0 = nicht SPI-Endstufe )" VALUE 0x1D8D45 Kw_Wu8 1.000 OneToOne 0.00 1.000 FORMAT "%5.3" EXTENDED_LIMITS 0.00 255.0 /end CHARACTERISTIC
/begin CHARACTERISTIC IFCD_tiBtwTst_C "Zeitabstand, in dem im Fehlerfall die Endstufe getestet wird" VALUE 0x1D8D46 Kw_Wu16 29900.00 Time_ms 100.0000 30000.00 FORMAT "%8.2" EXTENDED_LIMITS 0.00 655350.0 /end CHARACTERISTIC
/begin CHARACTERISTIC IFCD_tiPwrStgOn_C "Zeit für welche die Endstufe im Fehlerfall eingeschalten wird (nur nicht SPI kontrolliert)" VALUE 0x1D8D48 Kw_Wu16 500.0000 Time_ms 0.00 500.0000 FORMAT "%8.4" EXTENDED_LIMITS 0.00 655350.0 /end CHARACTERISTIC
/begin CHARACTERISTIC IFCtl_stFanOffMsk_C "Bitmaske zur Auswahl der Regenerationsstati für die Abschaltung des Lüfters" VALUE 0x1D8D4C Kw_Wu32 4294967295.00 OneToOne 0.00 4294967295.00 FORMAT "%13.2" /end CHARACTERISTIC
/begin CHARACTERISTIC IFCtl_stOff_C "Abschaltung der Funktion" VALUE 0x1D8D50 Kw_Wu8 1.000 OneToOne 0.00 1.000 FORMAT "%5.3" EXTENDED_LIMITS 0.00 255.0 /end CHARACTERISTIC
/begin CHARACTERISTIC IFCtl_tAirHysHi_CUR "Obere Fahrgeschwindigkeitsabhängige Hystereseschwelle für die Lüftersteuerung über  die Ladelufttemperatur" CURVE 0x1D8D52 Kl_Xs16_Ws16 250.0000 Temp_Cels -50.14000 199.8600 FORMAT "%8.4" EXTENDED_LIMITS -3549.940 3003.560
 /begin AXIS_DESCR STD_AXIS VSSCD_v Vel 5 0.00 300.0000 FORMAT "%8.4" EXTENDED_LIMITS -327.6800 327.6700 DEPOSIT ABSOLUTE /end AXIS_DESCR
/end CHARACTERISTIC
/begin CHARACTERISTIC IFCtl_tAirHysLo_CUR "Untere geschwindigkeitsabhängige Hysteresisschwelle zur Ventilatorsteuerung über die Einlaßlufttemperatur" CURVE 0x1D8D68 Kl_Xs16_Ws16 250.0000 Temp_Cels -50.14000 199.8600 FORMAT "%8.4" EXTENDED_LIMITS -3549.940 3003.560
 /begin AXIS_DESCR STD_AXIS VSSCD_v Vel 5 0.00 300.0000 FORMAT "%8.4" EXTENDED_LIMITS -327.6800 327.6700 DEPOSIT ABSOLUTE /end AXIS_DESCR
/end CHARACTERISTIC
/begin CHARACTERISTIC IFCtl_tClntThrHiHysHi_CUR "Obere Geschwindigkeitsabhängige Hystereseschwelle für die obere Kühlmitteltemperaturschwelle der Lüftersteuerung" CURVE 0x1D8D7E Kl_Xs16_Ws16 200.0000 Temp_Cels -50.14000 149.8600 FORMAT "%8.4" EXTENDED_LIMITS -3549.940 3003.560
 /begin AXIS_DESCR STD_AXIS VSSCD_v Vel 5 0.00 300.0000 FORMAT "%8.4" EXTENDED_LIMITS -327.6800 327.6700 DEPOSIT ABSOLUTE /end AXIS_DESCR
/end CHARACTERISTIC
/begin CHARACTERISTIC IFCtl_tClntThrHiHysLo_CUR "Untere Geschwindigkeitsabhängige Hystereseschwelle für die obere Kühlmitteltemperaturschwelle der Lüftersteuerung" CURVE 0x1D8D94 Kl_Xs16_Ws16 200.0000 Temp_Cels -50.14000 149.8600 FORMAT "%8.4" EXTENDED_LIMITS -3549.940 3003.560
 /begin AXIS_DESCR STD_AXIS VSSCD_v Vel 5 0.00 300.0000 FORMAT "%8.4" EXTENDED_LIMITS -327.6800 327.6700 DEPOSIT ABSOLUTE /end AXIS_DESCR
/end CHARACTERISTIC
/begin CHARACTERISTIC IFCtl_tClntThrLoHysHi_C "Obere Hystereseschwelle für die untere Kühlmitteltemperaturschwelle der Lüftersteuerung" VALUE 0x1D8DAA Kw_Ws16 200.0000 Temp_Cels -50.14000 149.8600 FORMAT "%8.4" EXTENDED_LIMITS -3549.940 3003.560 /end CHARACTERISTIC
/begin CHARACTERISTIC IFCtl_tClntThrLoHysLo_C "Untere Hysteresisschwelle für die unterere Kühlmitteltemperaturschwelle der Lüftersteuerung" VALUE 0x1D8DAC Kw_Ws16 200.0000 Temp_Cels -50.14000 149.8600 FORMAT "%8.4" EXTENDED_LIMITS -3549.940 3003.560 /end CHARACTERISTIC
/begin CHARACTERISTIC ImmCtl_cntNegRespMaxAuto_C "Maximale Anzahl an negativen Antworten von WFS4 (Automatik)" VALUE 0x1D8DB0 Kw_Wu8 255.0 OneToOne 0.00 255.0 FORMAT "%5.1" /end CHARACTERISTIC
/begin CHARACTERISTIC ImmCtl_cntNegRespMaxMnl_C "Maximale Anzahl an negativen Antworten von WFS4 (Manuel)" VALUE 0x1D8DB1 Kw_Wu8 255.0 OneToOne 0.00 255.0 FORMAT "%5.1" /end CHARACTERISTIC
/begin CHARACTERISTIC ImmCtl_Labelkey_C "Markenkennung" VALUE 0x1D8DB6 Kw_Wu8 255.0 OneToOne 0.00 255.0 FORMAT "%5.1" /end CHARACTERISTIC
/begin CHARACTERISTIC ImmCtl_P_Class_C "Leistungsklasse MSG" VALUE 0x1D8DB7 Kw_Wu8 255.0 OneToOne 0.00 255.0 FORMAT "%5.1" /end CHARACTERISTIC
/begin CHARACTERISTIC ImmCtl_stAutoLrnActv_C "Zustand von Erlaubnis des automatischen Lernens" VALUE 0x1D8DB8 Kw_Wu8 255.0 OneToOne 0.00 255.0 FORMAT "%5.1" /end CHARACTERISTIC
/begin CHARACTERISTIC ImmCtl_stDatChanAcc_C "WFS Datenannahme erlaubt" VALUE 0x1D8DB9 Kw_Wu8 255.0 OneToOne 0.00 255.0 FORMAT "%5.1" /end CHARACTERISTIC
/begin CHARACTERISTIC ImmCtl_stDatChan_C "Status Wegfahrsperre - Datentransfer erlaubt" VALUE 0x1D8DBA Kw_Wu8 255.0 OneToOne 0.00 255.0 FORMAT "%5.1" /end CHARACTERISTIC
/begin CHARACTERISTIC ImmCtl_stDattest_C "WFS Daten-Download vom Diagnosetester erlaubt" VALUE 0x1D8DBB Kw_Wu8 255.0 OneToOne 0.00 255.0 FORMAT "%5.1" /end CHARACTERISTIC
/begin CHARACTERISTIC ImmCtl_swtpasswd_ECU_C "Selektiert ob der Kennwort aus der Seriennummer extrahiert wird oder aus der EEPROM gelesen wird" VALUE 0x1D8DBC Kw_Wu8 1.000 OneToOne 0.00 1.000 FORMAT "%5.3" EXTENDED_LIMITS 0.00 255.0 /end CHARACTERISTIC
/begin CHARACTERISTIC ImmCtl_swtStartSKC_C "Schalter zur Auswahl des SKC-Starts aus dem EEPROM (1) oder des SKC-Standardstarts (0)" VALUE 0x1D8DBD Kw_Wu8 1.000 OneToOne 0.00 1.000 FORMAT "%5.3" EXTENDED_LIMITS 0.00 255.0 /end CHARACTERISTIC
/begin CHARACTERISTIC ImmCtl_tiDataReq_C "Zeit fuer Wiederholungen der Datenanforderung" VALUE 0x1D8DC4 Kw_Wu32 42949672.9500 Time_s 0.00 42949672.9500 FORMAT "%13.4" /end CHARACTERISTIC
/begin CHARACTERISTIC ImmCtl_tiLrnReqRep_C "Wartezeit für Wiederholung der Anfrage für das Anlernen" VALUE 0x1D8DCA Kw_Wu16 655140.0 Time_ms 0.00 655140.0 FORMAT "%8.1" EXTENDED_LIMITS 0.00 655350.0 /end CHARACTERISTIC
/begin CHARACTERISTIC ImmCtl_tiP2CANLimit_C "Zeit nach der bei Nichtantworten der WFS der TP-Kanal geschlossen wird" VALUE 0x1D8DCC Kw_Wu16 655.1400 Time_s 0.00 655.1400 FORMAT "%8.4" EXTENDED_LIMITS 0.00 655.3500 /end CHARACTERISTIC
/begin CHARACTERISTIC ImmCtl_tiP2CANMax_C "Überwachung zeit für P2CAN TIMEOUT" VALUE 0x1D8DCE Kw_Wu16 655140.0 Time_ms 0.00 655140.0 FORMAT "%8.1" EXTENDED_LIMITS 0.00 655350.0 /end CHARACTERISTIC
/begin CHARACTERISTIC IndSys_tiDebNegErrMonVac_C "Entprellzeit zur Meldung von normalen Druck  im Ansaugkrümmer" VALUE 0x1D96E0 Kw_Wu16 2000.000 TimeDeb 0.00 2000.000 FORMAT "%8.3" EXTENDED_LIMITS 0.00 655350.0 /end CHARACTERISTIC
/begin CHARACTERISTIC IndSys_tiDebPosErrMonVac_C "Entprellzeit zur Meldung von Unterdruck im Ansaugkrümmer" VALUE 0x1D96E2 Kw_Wu16 2000.000 TimeDeb 0.00 2000.000 FORMAT "%8.3" EXTENDED_LIMITS 0.00 655350.0 /end CHARACTERISTIC
/begin CHARACTERISTIC IndSys_tiDebMonIntMnfDef_C "Entprellzeit für Defekterkennung von Dfp_IndSysMonIntMnf_mp" VALUE 0x1D95F4 Kw_Wu16 655350.0 Time_ms 0.00 655350.0 FORMAT "%8.1" /end CHARACTERISTIC
/begin CHARACTERISTIC IndSys_tiDebMonIntMnfOk_C "Entprellzeit für Heilung des Dfp_IndSysMonIntMnf_mp" VALUE 0x1D95F6 Kw_Wu16 655350.0 Time_ms 0.00 655350.0 FORMAT "%8.1" /end CHARACTERISTIC
/begin CHARACTERISTIC IndSys_facAPCorRgn_CUR "Atmosphärendruckkorrekturkennlinie zur Dralldeaktivierung im Regenerationsbetrieb" CURVE 0x1D8DD4 Kl_Xs16_Ws16 1.000000 Fact 0.00 1.000000 FORMAT "%8.6" EXTENDED_LIMITS -4.000000 3.999878
 /begin AXIS_DESCR STD_AXIS APSCD_pVal Pres_hPa 12 0.00 3500.000 FORMAT "%8.3" EXTENDED_LIMITS -32768.00 32767.00 DEPOSIT ABSOLUTE /end AXIS_DESCR
/end CHARACTERISTIC
/begin CHARACTERISTIC IndSys_facAPCor_CUR "Atmosphärendruckkorrekturkennlinie zur Dralldeaktivierung" CURVE 0x1D8E06 Kl_Xs16_Ws16 1.000000 Fact 0.00 1.000000 FORMAT "%8.6" EXTENDED_LIMITS -4.000000 3.999878
 /begin AXIS_DESCR STD_AXIS APSCD_pVal Pres_hPa 5 0.00 3500.000 FORMAT "%8.3" EXTENDED_LIMITS -32768.00 32767.00 DEPOSIT ABSOLUTE /end AXIS_DESCR
/end CHARACTERISTIC
/begin CHARACTERISTIC IndSys_facTempMonIntMnf_CUR "Gewichtungsfaktoren für Einfluß von Eng_tEng auf IndSys_pDiffMonIntMnf" CURVE 0x1D95F8 Kl_Xs16_Ws16 1.000000 Fact1000 0.00 1.000000 FORMAT "%8.6" EXTENDED_LIMITS -32.76800 32.76700
 /begin AXIS_DESCR STD_AXIS Eng_tEng Temp_Cels 8 -50.14000 199.8600 FORMAT "%8.4" EXTENDED_LIMITS -3549.940 3003.560 DEPOSIT ABSOLUTE /end AXIS_DESCR
/end CHARACTERISTIC
/begin CHARACTERISTIC IndSys_facWtTempCor_CUR "Kühlmitteltemperaturkorrekturkennlinie zur Dralldeaktivierung" CURVE 0x1D8E1C Kl_Xs16_Ws16 1.000000 Fact 0.00 1.000000 FORMAT "%8.6" EXTENDED_LIMITS -4.000000 3.999878
 /begin AXIS_DESCR STD_AXIS CTSCD_tClnt Temp_Cels 5 -50.14000 149.8600 FORMAT "%8.4" EXTENDED_LIMITS -3549.940 3003.560 DEPOSIT ABSOLUTE /end AXIS_DESCR
/end CHARACTERISTIC
/begin CHARACTERISTIC IndSys_nAvrgThrHiPlHi_C "Obere Drehzahlschwelle für die Fehlererkennung für die Abfall" VALUE 0x1D961A Kw_Ws16 6000.000 EngN 0.00 6000.000 FORMAT "%8.3" EXTENDED_LIMITS -32768.00 32767.00 /end CHARACTERISTIC
/begin CHARACTERISTIC IndSys_nAvrgThrLoPlHi_C "Untere Drehzahlschwelle für die Fehlererkennung für die Abfall" VALUE 0x1D961C Kw_Ws16 6000.000 EngN 0.00 6000.000 FORMAT "%8.3" EXTENDED_LIMITS -32768.00 32767.00 /end CHARACTERISTIC
/begin CHARACTERISTIC IndSys_nAvrg_C "Motordrehzahlgrenze unter der die Erkennung von Unterdruck deaktiviert wird (Motor läuft normal)" VALUE 0x1D96E4 Kw_Ws16 6500.000 EngN 0.00 6500.000 FORMAT "%8.3" EXTENDED_LIMITS -32768.00 32767.00 /end CHARACTERISTIC
/begin CHARACTERISTIC IndSys_pAdjDiffMax_C "Absolute maximal gültige Differenz für den Abgleich" VALUE 0x1D9764 Kw_Ws16 32767.00 Pres_hPa 0.00 32767.00 FORMAT "%8.2" EXTENDED_LIMITS -32768.00 32767.00 /end CHARACTERISTIC
/begin CHARACTERISTIC IndSys_pAdjMax_C "Absoluter maximaler gültiger Wert für den Abgleich" VALUE 0x1D9766 Kw_Ws16 32767.00 Pres_hPa 0.00 32767.00 FORMAT "%8.2" EXTENDED_LIMITS -32768.00 32767.00 /end CHARACTERISTIC
/begin CHARACTERISTIC IndSys_pAirThrLo_C "untere Atmosphärendruckschwelle für die Plausibilitätsprüfung" VALUE 0x1D961E Kw_Ws16 1000.000 Pres_hPa 500.0000 1500.000 FORMAT "%8.3" EXTENDED_LIMITS -32768.00 32767.00 /end CHARACTERISTIC
/begin CHARACTERISTIC IndSys_pBstThrHiPlHi_C "Obere Ladedruckschwelle für Plausibilisierung der oberene" VALUE 0x1D9620 Kw_Ws16 3500.000 Pres_hPa 0.00 3500.000 FORMAT "%8.3" EXTENDED_LIMITS -32768.00 32767.00 /end CHARACTERISTIC
/begin CHARACTERISTIC IndSys_pDiffHigh_CUR "Kennlinie zur Berechnung der oberen Schwelle zur Erkennung des normalen Luftdrucks im Ansaugkrümmer" CURVE 0x1D96E6 Kl_Xs16_Ws16 7000.000 Pres_hPa -3500.000 3500.000 FORMAT "%8.3" EXTENDED_LIMITS -32768.00 32767.00
 /begin AXIS_DESCR STD_AXIS Eng_nAvrg EngN 15 0.00 6000.000 FORMAT "%8.3" EXTENDED_LIMITS -32768.00 32767.00 DEPOSIT ABSOLUTE /end AXIS_DESCR
/end CHARACTERISTIC
/begin CHARACTERISTIC IndSys_pDiffLow_CUR "Kennlnie zur Berechnung der unteren Schwelle zur Erkennung des Unterdrucks im Ansaugkrümmer" CURVE 0x1D9724 Kl_Xs16_Ws16 7000.000 Pres_hPa -3500.000 3500.000 FORMAT "%8.3" EXTENDED_LIMITS -32768.00 32767.00
 /begin AXIS_DESCR STD_AXIS Eng_nAvrg EngN 15 0.00 6000.000 FORMAT "%8.3" EXTENDED_LIMITS -32768.00 32767.00 DEPOSIT ABSOLUTE /end AXIS_DESCR
/end CHARACTERISTIC
/begin CHARACTERISTIC IndSys_pDiffMonIntMnf_MAP "Kennfeld zur Bestimmung des minimal notwendigen Luft-Differenzdruckes" MAP 0x1D9622 Kf_Xs16_Ys16_Ws16 5500.000 Pres_hPa -5000.000 500.0000 FORMAT "%8.3" EXTENDED_LIMITS -32768.00 32767.00
 /begin AXIS_DESCR STD_AXIS Eng_nAvrg EngN 8 0.00 6000.000 FORMAT "%8.3" EXTENDED_LIMITS -32768.00 32767.00 DEPOSIT ABSOLUTE /end AXIS_DESCR
 /begin AXIS_DESCR STD_AXIS InjCtl_qSetUnBal InjMass 8 0.00 327.6700 FORMAT "%8.4" EXTENDED_LIMITS -327.6800 327.6700 DEPOSIT ABSOLUTE /end AXIS_DESCR
/end CHARACTERISTIC
/begin CHARACTERISTIC IndSys_qLdDet_CUR "Kennlinie zur Lasterkennung" CURVE 0x1D8E32 Kl_Xs16_Ws16 327.6700 InjMass 0.00 327.6700 FORMAT "%8.4" EXTENDED_LIMITS -327.6800 327.6700
 /begin AXIS_DESCR STD_AXIS Eng_nAvrg EngN 2 0.00 6000.000 FORMAT "%8.3" EXTENDED_LIMITS -32768.00 32767.00 DEPOSIT ABSOLUTE /end AXIS_DESCR
/end CHARACTERISTIC
/begin CHARACTERISTIC IndSys_qRawThrHi_C "Maximale Einspritzmenge für Plausibilisierungsfreigabe der" VALUE 0x1D96C6 Kw_Ws16 150.0000 InjMass 0.00 150.0000 FORMAT "%8.4" EXTENDED_LIMITS -327.6800 327.6700 /end CHARACTERISTIC
/begin CHARACTERISTIC IndSys_rAirMonIntMnfHi_C "Obere Hysterese Schwelle für AFSCD_rAirNorm" VALUE 0x1D96C8 Kw_Ws16 3.000000 Fact 0.00 3.000000 FORMAT "%8.6" EXTENDED_LIMITS -4.000000 3.999878 /end CHARACTERISTIC
/begin CHARACTERISTIC IndSys_rAirMonIntMnfLo_C "Untere Hysterese Schwelle für AFSCD_rAirNorm" VALUE 0x1D96CA Kw_Ws16 3.000000 Fact 0.00 3.000000 FORMAT "%8.6" EXTENDED_LIMITS -4.000000 3.999878 /end CHARACTERISTIC
/begin CHARACTERISTIC IndSys_rAPCorVSARgn_MAP "Atmosphärendruckkorrekturkennfeld zur Dralldeaktivierung im Regenerationsbetrieb" MAP 0x1D8E3C Kf_Xs16_Ys16_Ws16 100.0000 DtyCyc 0.00 100.0000 FORMAT "%8.4" EXTENDED_LIMITS -327.6800 327.6700
 /begin AXIS_DESCR STD_AXIS Eng_nAvrg EngN 12 -32768.00 32767.00 FORMAT "%8.2" DEPOSIT ABSOLUTE /end AXIS_DESCR
 /begin AXIS_DESCR STD_AXIS InjCtl_qCurr InjMass 10 -327.6800 327.6700 FORMAT "%8.4" DEPOSIT ABSOLUTE /end AXIS_DESCR
/end CHARACTERISTIC
/begin CHARACTERISTIC IndSys_rAPCorVSA_MAP "Atmosphärendruckkorrekturkennfeld zur Dralldeaktivierung" MAP 0x1D8F5C Kf_Xs16_Ys16_Ws16 100.0000 DtyCyc 0.00 100.0000 FORMAT "%8.4" EXTENDED_LIMITS -327.6800 327.6700
 /begin AXIS_DESCR STD_AXIS Eng_nAvrg EngN 10 -32768.00 32767.00 FORMAT "%8.2" DEPOSIT ABSOLUTE /end AXIS_DESCR
 /begin AXIS_DESCR STD_AXIS InjCtl_qCurr InjMass 10 -327.6800 327.6700 FORMAT "%8.4" DEPOSIT ABSOLUTE /end AXIS_DESCR
/end CHARACTERISTIC
/begin CHARACTERISTIC IndSys_rAPP_C "Fahrpedalposition - Schwelle zur Erkennung von Unterdruck" VALUE 0x1D9762 Kw_Ws16 100.0000 Prc 0.00 100.0000 FORMAT "%8.4" EXTENDED_LIMITS -327.6800 327.6700 /end CHARACTERISTIC
/begin CHARACTERISTIC IndSys_rEGRLim_C "Grenzwert für erkannte inaktive Abgasrückführung" VALUE 0x1D9050 Kw_Ws16 655.3500 Prc -327.6800 327.6700 FORMAT "%8.4" /end CHARACTERISTIC
/begin CHARACTERISTIC IndSys_rEGRPThrHi_C "obere Abgasrueckfuehrsteller-Verhaeltnisschwelle fuer die Plausibilitaetspruefung der Luftmassenmessungsdriftempfindlichkeit" VALUE 0x1D96CC Kw_Ws16 400.0000 Prc -200.0000 200.0000 FORMAT "%8.4" EXTENDED_LIMITS -327.6800 327.6700 /end CHARACTERISTIC
/begin CHARACTERISTIC IndSys_rSwirlThrHi_C "Maximale Sollpossition der Einlasskanalabschaltung für Plausibilisierungsfreigabe" VALUE 0x1D96CE Kw_Ws16 100.0000 DtyCyc 0.00 100.0000 FORMAT "%8.4" EXTENDED_LIMITS -327.6800 327.6700 /end CHARACTERISTIC
/begin CHARACTERISTIC IndSys_rTVAPThrHi_C "obere Drosselklappenstellung fuer die Plausibilitaetspruefung der Luftmassenmessungsdriftempfindlichkeit" VALUE 0x1D96D0 Kw_Ws16 400.0000 Prc -200.0000 200.0000 FORMAT "%8.4" EXTENDED_LIMITS -327.6800 327.6700 /end CHARACTERISTIC
/begin CHARACTERISTIC IndSys_rVSAThresLo_C "Unterer Schwellwert Hysteres Drallniveausteuerung" VALUE 0x1D9052 Kw_Ws16 100.0000 DtyCyc 0.00 100.0000 FORMAT "%8.4" EXTENDED_LIMITS -327.6800 327.6700 /end CHARACTERISTIC
/begin CHARACTERISTIC IndSys_rVSAThresHi_C "Oberer Schwellwert Hysterese Drallniveausteuerung" VALUE 0x1D9054 Kw_Ws16 100.0000 DtyCyc 0.00 100.0000 FORMAT "%8.4" EXTENDED_LIMITS -327.6800 327.6700 /end CHARACTERISTIC
/begin CHARACTERISTIC IndSys_rVSAYLo_C "applikativer unterer Hystereseausgangswert" VALUE 0x1D9056 Kw_Ws16 100.0000 DtyCyc 0.00 100.0000 FORMAT "%8.4" EXTENDED_LIMITS -327.6800 327.6700 /end CHARACTERISTIC
/begin CHARACTERISTIC IndSys_rVSAYHi_C "applikativer oberer Hystereseausgangswert" VALUE 0x1D9058 Kw_Ws16 100.0000 DtyCyc 0.00 100.0000 FORMAT "%8.4" EXTENDED_LIMITS -327.6800 327.6700 /end CHARACTERISTIC
/begin CHARACTERISTIC IndSys_rVSAOpen_C "Tastverhältnis für Drallniveausteller bei inaktiver Abgasrückführung" VALUE 0x1D905A Kw_Ws16 655.3500 DtyCyc -327.6800 327.6700 FORMAT "%8.4" /end CHARACTERISTIC
/begin CHARACTERISTIC IndSys_rVSAOvrRun_MAP "Ausgabewert von IndSys_rVSA während aktivem Anti-Kaudern-Eingriff" MAP 0x1D905C Kf_Xs16_Ys16_Ws16 100.0000 DtyCyc 0.00 100.0000 FORMAT "%8.4" EXTENDED_LIMITS -327.6800 327.6700
 /begin AXIS_DESCR STD_AXIS PCR_nAvrgFrz EngN 6 0.00 6000.000 FORMAT "%8.3" EXTENDED_LIMITS -32768.00 32767.00 DEPOSIT ABSOLUTE /end AXIS_DESCR
 /begin AXIS_DESCR STD_AXIS PCR_rBPAPRatFrz Fact 6 0.00 3.000000 FORMAT "%8.6" EXTENDED_LIMITS -4.000000 3.999878 DEPOSIT ABSOLUTE /end AXIS_DESCR
/end CHARACTERISTIC
/begin CHARACTERISTIC IndSys_rVSARgn1_MAP "Kennfeld für Drallniveausteuerung bei Regenerationsstufe 1" MAP 0x1D90C0 Kf_Xs16_Ys16_Ws16 100.0000 DtyCyc 0.00 100.0000 FORMAT "%8.4" EXTENDED_LIMITS -327.6800 327.6700
 /begin AXIS_DESCR STD_AXIS Eng_nAvrg EngN 8 -32768.00 32767.00 FORMAT "%8.2" DEPOSIT ABSOLUTE /end AXIS_DESCR
 /begin AXIS_DESCR STD_AXIS InjCtl_qCurr InjMass 8 -327.6800 327.6700 FORMAT "%8.4" DEPOSIT ABSOLUTE /end AXIS_DESCR
/end CHARACTERISTIC
/begin CHARACTERISTIC IndSys_rVSARgn2_MAP "Kennfeld für Drallniveausteuerung bei Regenerationsstufe 2" MAP 0x1D9164 Kf_Xs16_Ys16_Ws16 100.0000 DtyCyc 0.00 100.0000 FORMAT "%8.4" EXTENDED_LIMITS -327.6800 327.6700
 /begin AXIS_DESCR STD_AXIS Eng_nAvrg EngN 8 -32768.00 32767.00 FORMAT "%8.2" DEPOSIT ABSOLUTE /end AXIS_DESCR
 /begin AXIS_DESCR STD_AXIS InjCtl_qCurr InjMass 8 -327.6800 327.6700 FORMAT "%8.4" DEPOSIT ABSOLUTE /end AXIS_DESCR
/end CHARACTERISTIC
/begin CHARACTERISTIC IndSys_rVSARgn3_MAP "Kennfeld für Drallniveausteuerung bei Regenerationsstufe 3" MAP 0x1D9208 Kf_Xs16_Ys16_Ws16 100.0000 DtyCyc 0.00 100.0000 FORMAT "%8.4" EXTENDED_LIMITS -327.6800 327.6700
 /begin AXIS_DESCR STD_AXIS Eng_nAvrg EngN 8 -32768.00 32767.00 FORMAT "%8.2" DEPOSIT ABSOLUTE /end AXIS_DESCR
 /begin AXIS_DESCR STD_AXIS InjCtl_qCurr InjMass 8 -327.6800 327.6700 FORMAT "%8.4" DEPOSIT ABSOLUTE /end AXIS_DESCR
/end CHARACTERISTIC
/begin CHARACTERISTIC IndSys_rVSA_MAP "Kennfeld für Drallniveausteuerung" MAP 0x1D92AC Kf_Xs16_Ys16_Ws16 100.0000 DtyCyc 0.00 100.0000 FORMAT "%8.4" EXTENDED_LIMITS -327.6800 327.6700
 /begin AXIS_DESCR STD_AXIS Eng_nAvrg EngN 16 -32768.00 32767.00 FORMAT "%8.2" DEPOSIT ABSOLUTE /end AXIS_DESCR
 /begin AXIS_DESCR STD_AXIS InjCtl_qCurr InjMass 16 -327.6800 327.6700 FORMAT "%8.4" DEPOSIT ABSOLUTE /end AXIS_DESCR
/end CHARACTERISTIC
/begin CHARACTERISTIC IndSys_rWtTempCorVSA_MAP "Kühlmitteltemperaturkorrekturkennfeld zur Dralldeaktivierung" MAP 0x1D94F0 Kf_Xs16_Ys16_Ws16 100.0000 DtyCyc 0.00 100.0000 FORMAT "%8.4" EXTENDED_LIMITS -327.6800 327.6700
 /begin AXIS_DESCR STD_AXIS Eng_nAvrg EngN 10 -32768.00 32767.00 FORMAT "%8.2" DEPOSIT ABSOLUTE /end AXIS_DESCR
 /begin AXIS_DESCR STD_AXIS InjCtl_qCurr InjMass 10 -327.6800 327.6700 FORMAT "%8.4" DEPOSIT ABSOLUTE /end AXIS_DESCR
/end CHARACTERISTIC
/begin CHARACTERISTIC IndSys_stRgnMsk_CA "Applizierbare Bitmasken für die Regenerationsstufen" VAL_BLK 0x1D95E4 Kwb_Wu32 4294967295.00 OneToOne 0.00 4294967295.00 FORMAT "%13.2" NUMBER 3 /end CHARACTERISTIC
/begin CHARACTERISTIC IndSys_swtHys_C "Auswahlschalter kontinuierliche - 2-Positionsdrallniveausteuerung" VALUE 0x1D95F0 Kw_Wu8 1.000 OneToOne 0.00 1.000 FORMAT "%5.3" EXTENDED_LIMITS 0.00 255.0 /end CHARACTERISTIC
/begin CHARACTERISTIC IndSys_swtNSActv_C "Aktivierungsschalter des Anti-Kaudern-Eingriffs bei VSA" VALUE 0x1D95F1 Kw_Wu8 1.000 OneToOne 0.00 1.000 FORMAT "%5.3" EXTENDED_LIMITS 0.00 255.0 /end CHARACTERISTIC
/begin CHARACTERISTIC IndSys_tAirMinAdj_C "Minimale Lufttemperatur zu Druckabgleich zwischen Lade -und Atmosphärendrucksensor" VALUE 0x1D9768 Kw_Ws16 3003.600 Temp_Cels -0.04000000 3003.560 FORMAT "%8.3" EXTENDED_LIMITS -3549.940 3003.560 /end CHARACTERISTIC
/begin CHARACTERISTIC IndSys_tClntThrHi_C "Untere Kühlwassertemperaturschwelle für die Plausibilitätsprüfung der Driftempfindlichkeit der Saugrohrleckage" VALUE 0x1D96D2 Kw_Ws16 200.0000 Temp_Cels -50.14000 149.8600 FORMAT "%8.4" EXTENDED_LIMITS -3549.940 3003.560 /end CHARACTERISTIC
/begin CHARACTERISTIC IndSys_tClntThrLo_C "Untere Kühlwassertemperaturschwelle für die Plausibilitätsprüfung der Driftempfindlichkeit der Saugrohrleckage" VALUE 0x1D96D4 Kw_Ws16 200.0000 Temp_Cels -50.14000 149.8600 FORMAT "%8.4" EXTENDED_LIMITS -3549.940 3003.560 /end CHARACTERISTIC
/begin CHARACTERISTIC IndSys_tiAftLdDet_C "Zeit zum einfrieren des Drallklappenwertes nach negativen Lastwechsel" VALUE 0x1D95F2 Kw_Wu16 655350.0 Time_ms 0.00 655350.0 FORMAT "%8.1" /end CHARACTERISTIC
/begin CHARACTERISTIC IndSys_tiDebAdj_C "Wartezeit für vollständige Entprellung der anderen Sensoren" VALUE 0x1D976A Kw_Wu16 214700.0 Time_ms 0.00 214700.0 FORMAT "%8.1" EXTENDED_LIMITS 0.00 655350.0 /end CHARACTERISTIC
/begin CHARACTERISTIC IndSys_tiDelAdjRcy_C "Verzugszeit seit Init für Druckabgleich zwischen BPS und APS nach recoveries" VALUE 0x1D976C Kw_Wu16 655350.0 Time_ms 0.00 655350.0 FORMAT "%8.1" /end CHARACTERISTIC
/begin CHARACTERISTIC IndSys_tiDelAdj_C "Verzugseit seit Init für Druckabgleich zwischen BPS und APS" VALUE 0x1D976E Kw_Wu16 655350.0 Time_ms 0.00 655350.0 FORMAT "%8.1" /end CHARACTERISTIC
/begin CHARACTERISTIC IndSys_tiDlyEGR_C "Verzögerungszeit nach Veränderung der Abgasrückführung für Plausibilisierungsfreigabe der Luftmassensensor-Empfindlichkeitsdrift" VALUE 0x1D96D8 Kw_Wu32 65540.0000000 Time_ms 0.00 65540.0000000 FORMAT "%13.7" EXTENDED_LIMITS 0.00 42949672950.0 /end CHARACTERISTIC
/begin CHARACTERISTIC IndSys_tiDlyMonIntMnf_C "Verzögerungszeit nach Motorstart für Plausibilisierungsfreigabe der Luftmassensensor-Empfindlichkeitsdrift" VALUE 0x1D96DC Kw_Wu16 65540.00 Time_ms 0.00 65540.00 FORMAT "%8.2" EXTENDED_LIMITS 0.00 655350.0 /end CHARACTERISTIC
/begin CHARACTERISTIC InjCrv_ctRevCor3RpOil_MAP "Umdrehungsschwelle für Korrekturwert bei RME-Kraftstoff = f (Wassertemperatur, Luftdruck)" MAP 0x1DD7C8 Kf_Xs16_Ys16_Ws16 32000.00 OneToOne 0.00 32000.00 FORMAT "%8.2" EXTENDED_LIMITS -32768.00 32767.00
 /begin AXIS_DESCR STD_AXIS InjCrv_tClnt Temp_Cels 8 -50.14000 149.8600 FORMAT "%8.4" EXTENDED_LIMITS -3549.940 3003.560 DEPOSIT ABSOLUTE /end AXIS_DESCR
 /begin AXIS_DESCR STD_AXIS APSCD_pVal Pres_hPa 8 0.00 3500.000 FORMAT "%8.3" EXTENDED_LIMITS -32768.00 32767.00 DEPOSIT ABSOLUTE /end AXIS_DESCR
/end CHARACTERISTIC
/begin CHARACTERISTIC InjCrv_ctRevCor3_MAP "Umdrehungsschwelle Korrekturwert  = f (Wassertemperatur, Luftdruck)" MAP 0x1DD86C Kf_Xs16_Ys16_Ws16 32000.00 OneToOne 0.00 32000.00 FORMAT "%8.2" EXTENDED_LIMITS -32768.00 32767.00
 /begin AXIS_DESCR STD_AXIS InjCrv_tClnt Temp_Cels 8 -50.14000 149.8600 FORMAT "%8.4" EXTENDED_LIMITS -3549.940 3003.560 DEPOSIT ABSOLUTE /end AXIS_DESCR
 /begin AXIS_DESCR STD_AXIS APSCD_pVal Pres_hPa 8 0.00 3500.000 FORMAT "%8.3" EXTENDED_LIMITS -32768.00 32767.00 DEPOSIT ABSOLUTE /end AXIS_DESCR
/end CHARACTERISTIC
/begin CHARACTERISTIC InjCrv_dFacPiI1QCorSlp_CA "Rampenzeit Mengenkorrekturfaktor Haupteinspritzung" VAL_BLK 0x1DEA00 Kwb_Wu32 100000.000000 Rmp 0.00 100000.000000 FORMAT "%13.6" EXTENDED_LIMITS 0.00 65535999.9847 NUMBER 3 /end CHARACTERISTIC
/begin CHARACTERISTIC InjCrv_dFacPoI2QCorSlp_C "Rampenzeit für Mengenkorrekturfaktor Nacheinspritzung" VALUE 0x1DFCC0 Kw_Wu32 100000.000000 Rmp 0.00 100000.000000 FORMAT "%13.6" EXTENDED_LIMITS 0.00 65535999.9847 /end CHARACTERISTIC
/begin CHARACTERISTIC InjCrv_dphiCor3_C "Förderbeginn Absenkrampe Korrekturwert 3" VALUE 0x1DD910 Kw_Ws16 9.967089 RmpCrsAg_InjCrv 0.03290176 9.999990 FORMAT "%8.5" EXTENDED_LIMITS -11.71875 11.71839 /end CHARACTERISTIC
/begin CHARACTERISTIC InjCrv_dPhiMI1EGTSlp_C "Rampenzeit FB-Berechnung Haupteinspritzung" VALUE 0x1DDAFC Kw_Wu32 100000.000000 Rmp 0.00 100000.000000 FORMAT "%13.6" EXTENDED_LIMITS 0.00 65535999.9847 /end CHARACTERISTIC
/begin CHARACTERISTIC InjCrv_dPhiPiI1CorSlp_CA "Rampenzeit FB-Korrektur Haupteinspritzung" VAL_BLK 0x1DEA0C Kwb_Wu32 100000.000000 Rmp 0.00 100000.000000 FORMAT "%13.6" EXTENDED_LIMITS 0.00 65535999.9847 NUMBER 4 /end CHARACTERISTIC
/begin CHARACTERISTIC InjCrv_dPhiPiI1Slp_CA "Rampenzeit zur FB Ermittlung Voreinspritzung" VAL_BLK 0x1DFE38 Kwb_Wu32 100000.000000 Rmp 0.00 100000.000000 FORMAT "%13.6" EXTENDED_LIMITS 0.00 65535999.9847 NUMBER 3 /end CHARACTERISTIC
/begin CHARACTERISTIC InjCrv_dPhiPoI2Slp_C "Rampenzeit für Förderbeginn Nacheinspritzung" VALUE 0x1E0628 Kw_Wu32 100000.000000 Rmp 0.00 100000.000000 FORMAT "%13.6" EXTENDED_LIMITS 0.00 65535999.9847 /end CHARACTERISTIC
/begin CHARACTERISTIC InjCrv_dQEGTCorSlp_C "Rampenzeit für Mengenkorrektur Haupteinspritzung" VALUE 0x1DEEF0 Kw_Wu32 100000.000000 Rmp 0.00 100000.000000 FORMAT "%13.6" EXTENDED_LIMITS 0.00 65535999.9847 /end CHARACTERISTIC
/begin CHARACTERISTIC InjCrv_dQPiI1Slp_CA "Rampenzeit Mengenermittlung Voreinspritzung" VAL_BLK 0x1DFE44 Kwb_Wu32 100000.000000 Rmp 0.00 100000.000000 FORMAT "%13.6" EXTENDED_LIMITS 0.00 65535999.9847 NUMBER 4 /end CHARACTERISTIC
/begin CHARACTERISTIC InjCrv_dQPoI2Slp_C "Rampenzeit für Menge Nacheinspritzung" VALUE 0x1E062C Kw_Wu32 100000.000000 Rmp 0.00 100000.000000 FORMAT "%13.6" EXTENDED_LIMITS 0.00 65535999.9847 /end CHARACTERISTIC
/begin CHARACTERISTIC InjCrv_dRmpSlpSOI_C "Rampensteigung für gangabhängige MI1 Förderbeginne" VALUE 0x1D9770 Kw_Wu32 100000.000000 Rmp 0.00 100000.000000 FORMAT "%13.6" EXTENDED_LIMITS 0.00 65535999.9847 /end CHARACTERISTIC
/begin CHARACTERISTIC InjCrv_facEGTWghCor_CUR "Kennlinie Gewichtungsfaktor für Haupteinspritzmengenkorrektur" CURVE 0x1DEEF4 Kl_Xs16_Ws16 1.000000 Fact 0.00 1.000000 FORMAT "%8.6" EXTENDED_LIMITS -4.000000 3.999878
 /begin AXIS_DESCR STD_AXIS APSCD_pVal Pres_hPa 2 0.00 3500.000 FORMAT "%8.3" EXTENDED_LIMITS -32768.00 32767.00 DEPOSIT ABSOLUTE /end AXIS_DESCR
/end CHARACTERISTIC
/begin CHARACTERISTIC InjCrv_facFBDyn_CUR "Kennlinie zur Berechnung des Skalierungsfaktors der FB-Korrektur in der Dynamik" CURVE 0x1DD912 Kl_Xs16_Ws16 1.000000 Fact 0.00 1.000000 FORMAT "%8.6" EXTENDED_LIMITS -4.000000 3.999878
 /begin AXIS_DESCR STD_AXIS InjCrv_mAirGovDevFlt AirMassPerCyl 11 -100.0000 100.0000 FORMAT "%8.4" EXTENDED_LIMITS -3276.800 3276.700 DEPOSIT ABSOLUTE /end AXIS_DESCR
/end CHARACTERISTIC
/begin CHARACTERISTIC InjCrv_facMI1EGTCor1_MAP "KTF- und Athmosphärendruck-abhängiger Gewichtungsfaktor 1 für Förderbeginnberechnung" MAP 0x1DDB00 Kf_Xs16_Ys16_Ws16 1.000000 Fact 0.00 1.000000 FORMAT "%8.6" EXTENDED_LIMITS -4.000000 3.999878
 /begin AXIS_DESCR STD_AXIS Eng_tEng Temp_Cels 6 -50.14000 149.8600 FORMAT "%8.4" EXTENDED_LIMITS -3549.940 3003.560 DEPOSIT ABSOLUTE /end AXIS_DESCR
 /begin AXIS_DESCR STD_AXIS APSCD_pVal Pres_hPa 6 0.00 3500.000 FORMAT "%8.3" EXTENDED_LIMITS -32768.00 32767.00 DEPOSIT ABSOLUTE /end AXIS_DESCR
/end CHARACTERISTIC
/begin CHARACTERISTIC InjCrv_facMI1EGTCor2_MAP "KTF- und Athmosphärendruck-abhängiger Gewichtungsfaktor 2 für Förderbeginnberechnung" MAP 0x1DDB64 Kf_Xs16_Ys16_Ws16 1.000000 Fact 0.00 1.000000 FORMAT "%8.6" EXTENDED_LIMITS -4.000000 3.999878
 /begin AXIS_DESCR STD_AXIS Eng_tEng Temp_Cels 6 -50.14000 149.8600 FORMAT "%8.4" EXTENDED_LIMITS -3549.940 3003.560 DEPOSIT ABSOLUTE /end AXIS_DESCR
 /begin AXIS_DESCR STD_AXIS APSCD_pVal Pres_hPa 6 0.00 3500.000 FORMAT "%8.3" EXTENDED_LIMITS -32768.00 32767.00 DEPOSIT ABSOLUTE /end AXIS_DESCR
/end CHARACTERISTIC
/begin CHARACTERISTIC InjCrv_facMI1EGTCor3_MAP "KTF- und Athmosphärendruck-abhängiger Gewichtungsfaktor 3 für Förderbeginnberechnung" MAP 0x1DDBC8 Kf_Xs16_Ys16_Ws16 1.000000 Fact 0.00 1.000000 FORMAT "%8.6" EXTENDED_LIMITS -4.000000 3.999878
 /begin AXIS_DESCR STD_AXIS Eng_tEng Temp_Cels 6 -50.14000 149.8600 FORMAT "%8.4" EXTENDED_LIMITS -3549.940 3003.560 DEPOSIT ABSOLUTE /end AXIS_DESCR
 /begin AXIS_DESCR STD_AXIS APSCD_pVal Pres_hPa 6 0.00 3500.000 FORMAT "%8.3" EXTENDED_LIMITS -32768.00 32767.00 DEPOSIT ABSOLUTE /end AXIS_DESCR
/end CHARACTERISTIC
/begin CHARACTERISTIC InjCrv_facMI1EGTCor4_MAP "KTF- und Athmosphärendruck-abhängiger Gewichtungsfaktor 4 für Förderbeginnberechnung" MAP 0x1DDC2C Kf_Xs16_Ys16_Ws16 1.000000 Fact 0.00 1.000000 FORMAT "%8.6" EXTENDED_LIMITS -4.000000 3.999878
 /begin AXIS_DESCR STD_AXIS Eng_tEng Temp_Cels 2 -50.14000 149.8600 FORMAT "%8.4" EXTENDED_LIMITS -3549.940 3003.560 DEPOSIT ABSOLUTE /end AXIS_DESCR
 /begin AXIS_DESCR STD_AXIS APSCD_pVal Pres_hPa 2 0.00 3500.000 FORMAT "%8.3" EXTENDED_LIMITS -32768.00 32767.00 DEPOSIT ABSOLUTE /end AXIS_DESCR
/end CHARACTERISTIC
/begin CHARACTERISTIC InjCrv_facMI1PCRPhiCor_MAP "Kennfeld für den Korrekturfaktor für die Haupteinspritzung der von der Ladedruckreglerabweichung abhängig ist" MAP 0x1DBC14 Kf_Xs16_Ys16_Ws16 1.000000 Fact 0.00 1.000000 FORMAT "%8.6" EXTENDED_LIMITS -4.000000 3.999878
 /begin AXIS_DESCR STD_AXIS Eng_tEng Temp_Cels 8 -50.14000 149.8600 FORMAT "%8.4" EXTENDED_LIMITS -3549.940 3003.560 DEPOSIT ABSOLUTE /end AXIS_DESCR
 /begin AXIS_DESCR STD_AXIS InjCtl_qSetUnBal InjMass 6 0.00 327.6700 FORMAT "%8.4" EXTENDED_LIMITS -327.6800 327.6700 DEPOSIT ABSOLUTE /end AXIS_DESCR
/end CHARACTERISTIC
/begin CHARACTERISTIC InjCrv_facPiI1QCor0_MAP "Kennfeld  0 Mengenkorrektur Haupteinspritzung" MAP 0x1DEA1C Kf_Xs16_Ys16_Ws16 1.000000 Fact -1.000000 0.00 FORMAT "%8.6" EXTENDED_LIMITS -4.000000 3.999878
 /begin AXIS_DESCR STD_AXIS Eng_nAvrg EngN 8 0.00 6000.000 FORMAT "%8.3" EXTENDED_LIMITS -32768.00 32767.00 DEPOSIT ABSOLUTE /end AXIS_DESCR
 /begin AXIS_DESCR STD_AXIS InjCtl_qSetUnBal InjMass 8 0.00 327.6700 FORMAT "%8.4" EXTENDED_LIMITS -327.6800 327.6700 DEPOSIT ABSOLUTE /end AXIS_DESCR
/end CHARACTERISTIC
/begin CHARACTERISTIC InjCrv_facPiI1QCor1_MAP "Kennfeld  1 Mengenkorrektur Haupteinspritzung" MAP 0x1DEAC0 Kf_Xs16_Ys16_Ws16 1.000000 Fact -1.000000 0.00 FORMAT "%8.6" EXTENDED_LIMITS -4.000000 3.999878
 /begin AXIS_DESCR STD_AXIS Eng_nAvrg EngN 8 0.00 6000.000 FORMAT "%8.3" EXTENDED_LIMITS -32768.00 32767.00 DEPOSIT ABSOLUTE /end AXIS_DESCR
 /begin AXIS_DESCR STD_AXIS InjCtl_qSetUnBal InjMass 8 0.00 327.6700 FORMAT "%8.4" EXTENDED_LIMITS -327.6800 327.6700 DEPOSIT ABSOLUTE /end AXIS_DESCR
/end CHARACTERISTIC
/begin CHARACTERISTIC InjCrv_facPiI1QCor2_MAP "Kennfeld  2 Mengenkorrektur Haupteinspritzung" MAP 0x1DEB64 Kf_Xs16_Ys16_Ws16 1.000000 Fact -1.000000 0.00 FORMAT "%8.6" EXTENDED_LIMITS -4.000000 3.999878
 /begin AXIS_DESCR STD_AXIS Eng_nAvrg EngN 8 0.00 6000.000 FORMAT "%8.3" EXTENDED_LIMITS -32768.00 32767.00 DEPOSIT ABSOLUTE /end AXIS_DESCR
 /begin AXIS_DESCR STD_AXIS InjCtl_qSetUnBal InjMass 8 0.00 327.6700 FORMAT "%8.4" EXTENDED_LIMITS -327.6800 327.6700 DEPOSIT ABSOLUTE /end AXIS_DESCR
/end CHARACTERISTIC
/begin CHARACTERISTIC InjCrv_facPoI2PhiWgh_CUR "Gewichtungsfaktor durch Atmosphärendruck für Förderbeginn Nacheinspritzung" CURVE 0x1E0630 Kl_Xs16_Ws16 1.000000 Fact 0.00 1.000000 FORMAT "%8.6" EXTENDED_LIMITS -4.000000 3.999878
 /begin AXIS_DESCR STD_AXIS APSCD_pVal Pres_hPa 2 0.00 3500.000 FORMAT "%8.3" EXTENDED_LIMITS -32768.00 32767.00 DEPOSIT ABSOLUTE /end AXIS_DESCR
/end CHARACTERISTIC
/begin CHARACTERISTIC InjCrv_facPoI2QCor1_MAP "Kennfeld Mengenkorrekturfaktor 1 Nacheinspritzung" MAP 0x1DFCC4 Kf_Xs16_Ys16_Ws16 1.000000 Fact -1.000000 0.00 FORMAT "%8.6" EXTENDED_LIMITS -4.000000 3.999878
 /begin AXIS_DESCR STD_AXIS Eng_nAvrg EngN 8 0.00 6000.000 FORMAT "%8.3" EXTENDED_LIMITS -32768.00 32767.00 DEPOSIT ABSOLUTE /end AXIS_DESCR
 /begin AXIS_DESCR STD_AXIS InjCrv_qPoI2Op InjMass 8 0.00 327.6700 FORMAT "%8.4" EXTENDED_LIMITS -327.6800 327.6700 DEPOSIT ABSOLUTE /end AXIS_DESCR
/end CHARACTERISTIC
/begin CHARACTERISTIC InjCrv_facPoI2QCor2_MAP "Kennfeld Mengenkorrekturfaktor 2 Nacheinspritzung" MAP 0x1DFD68 Kf_Xs16_Ys16_Ws16 1.000000 Fact -1.000000 0.00 FORMAT "%8.6" EXTENDED_LIMITS -4.000000 3.999878
 /begin AXIS_DESCR STD_AXIS Eng_nAvrg EngN 8 0.00 6000.000 FORMAT "%8.3" EXTENDED_LIMITS -32768.00 32767.00 DEPOSIT ABSOLUTE /end AXIS_DESCR
 /begin AXIS_DESCR STD_AXIS InjCrv_qPoI2Op InjMass 8 0.00 327.6700 FORMAT "%8.4" EXTENDED_LIMITS -327.6800 327.6700 DEPOSIT ABSOLUTE /end AXIS_DESCR
/end CHARACTERISTIC
/begin CHARACTERISTIC InjCrv_facPoI2QCor3_MAP "Kennfeld Mengenkorrekturfaktor 3 Nacheinspritzung" MAP 0x1DFE0C Kf_Xs16_Ys16_Ws16 1.000000 Fact -1.000000 0.00 FORMAT "%8.6" EXTENDED_LIMITS -4.000000 3.999878
 /begin AXIS_DESCR STD_AXIS Eng_nAvrg EngN 2 0.00 6000.000 FORMAT "%8.3" EXTENDED_LIMITS -32768.00 32767.00 DEPOSIT ABSOLUTE /end AXIS_DESCR
 /begin AXIS_DESCR STD_AXIS InjCrv_qPoI2Op InjMass 2 0.00 327.6700 FORMAT "%8.4" EXTENDED_LIMITS -327.6800 327.6700 DEPOSIT ABSOLUTE /end AXIS_DESCR
/end CHARACTERISTIC
/begin CHARACTERISTIC InjCrv_facPoI2QCor4_MAP "Kennfeld Mengenkorrekturfaktor 4 Nacheinspritzung" MAP 0x1DFE20 Kf_Xs16_Ys16_Ws16 1.000000 Fact -1.000000 0.00 FORMAT "%8.6" EXTENDED_LIMITS -4.000000 3.999878
 /begin AXIS_DESCR STD_AXIS Eng_nAvrg EngN 2 0.00 6000.000 FORMAT "%8.3" EXTENDED_LIMITS -32768.00 32767.00 DEPOSIT ABSOLUTE /end AXIS_DESCR
 /begin AXIS_DESCR STD_AXIS InjCrv_qPoI2Op InjMass 2 0.00 327.6700 FORMAT "%8.4" EXTENDED_LIMITS -327.6800 327.6700 DEPOSIT ABSOLUTE /end AXIS_DESCR
/end CHARACTERISTIC
/begin CHARACTERISTIC InjCrv_facPoI2QCorStd_C "Standardwert Mengenkorrekturfaktor Nacheinspritzung" VALUE 0x1DFE34 Kw_Ws16 1.000000 Fact -1.000000 0.00 FORMAT "%8.6" EXTENDED_LIMITS -4.000000 3.999878 /end CHARACTERISTIC
/begin CHARACTERISTIC InjCrv_facPoI2QntWgh_CUR "Gewichtungsfaktor durch Atmosphärendruck für Menge der Nacheinspritzung" CURVE 0x1E063A Kl_Xs16_Ws16 1.000000 Fact 0.00 1.000000 FORMAT "%8.6" EXTENDED_LIMITS -4.000000 3.999878
 /begin AXIS_DESCR STD_AXIS APSCD_pVal Pres_hPa 2 0.00 3500.000 FORMAT "%8.3" EXTENDED_LIMITS -32768.00 32767.00 DEPOSIT ABSOLUTE /end AXIS_DESCR
/end CHARACTERISTIC
/begin CHARACTERISTIC InjCrv_tiPT1FBDynAir_C "Zeitkonstante des PT1-Gliedes zur Filterung von AirCtl_mGovDev" VALUE 0x1DD940 Kw_Wu32 4294.9663 TimeDelay_s 0.0010000001 4294.9673 FORMAT "%9.4" EXTENDED_LIMITS 0.0000010000000 4294.9673 /end CHARACTERISTIC
/begin CHARACTERISTIC InjCrv_nPoI2OvRHi_C "Maximale Drehzahl für PoI2 im Schub" VALUE 0x1E0644 Kw_Wu16 0.00 EngN 2750.000 2750.000 FORMAT "%8.3" EXTENDED_LIMITS 0.00 65535.00 /end CHARACTERISTIC
/begin CHARACTERISTIC InjCrv_nPoI2OvRLo_C "Minimale Drehzahl für PoI2 im Schub" VALUE 0x1E0646 Kw_Wu16 0.00 EngN 1100.000 1100.000 FORMAT "%8.3" EXTENDED_LIMITS 0.00 65535.00 /end CHARACTERISTIC
/begin CHARACTERISTIC InjCrv_numPoI2HC_MAP "Periode der HC-Nacheinspritzung" MAP 0x1E0648 Kf_Xs16_Ys16_Ws16 254.0000 OneToOne 1.000000 255.0000 FORMAT "%8.4" EXTENDED_LIMITS -32768.00 32767.00
 /begin AXIS_DESCR STD_AXIS Eng_nAvrg EngN 10 0.00 6000.000 FORMAT "%8.3" EXTENDED_LIMITS -32768.00 32767.00 DEPOSIT ABSOLUTE /end AXIS_DESCR
 /begin AXIS_DESCR STD_AXIS InjCrv_qPoI2Op InjMass 10 0.00 327.6700 FORMAT "%8.4" EXTENDED_LIMITS -327.6800 327.6700 DEPOSIT ABSOLUTE /end AXIS_DESCR
/end CHARACTERISTIC
/begin CHARACTERISTIC InjCrv_pPiI1Low_C "untere Schaltschwelle Athmosphärendruck-auswahlhysterese" VALUE 0x1E022C Kw_Ws16 3500.000 Pres_hPa 0.00 3500.000 FORMAT "%8.3" EXTENDED_LIMITS -32768.00 32767.00 /end CHARACTERISTIC
/begin CHARACTERISTIC InjCrv_pPiI1Hgh_C "obere Schaltschwelle Athmosphärendruck-Auswahlhysterese" VALUE 0x1E022E Kw_Ws16 3500.000 Pres_hPa 0.00 3500.000 FORMAT "%8.3" EXTENDED_LIMITS -32768.00 32767.00 /end CHARACTERISTIC
/begin CHARACTERISTIC InjCrv_stPiI1LowPres_C "Ausschaltergebnis der Athmosphärendruck-Auswahlhysterese" VALUE 0x1E0230 Kw_Ws16 65535.00 OneToOne -32768.00 32767.00 FORMAT "%8.2" READ_ONLY /end CHARACTERISTIC
/begin CHARACTERISTIC InjCrv_stPiI1HghPres_C "Einschaltergebnis der Athmosphärendruck-Auswahlhysterese" VALUE 0x1E0232 Kw_Ws16 65535.00 OneToOne -32768.00 32767.00 FORMAT "%8.2" READ_ONLY /end CHARACTERISTIC
/begin CHARACTERISTIC InjCrv_pDynAPHigh_C "Aktivierung dyn. Frühverstellung: Oberer Hysteresewert für atmosphärischen Druck" VALUE 0x1D9774 Kw_Ws16 65535.00 Pres_hPa -32768.00 32767.00 FORMAT "%8.2" /end CHARACTERISTIC
/begin CHARACTERISTIC InjCrv_pDynAPLow_C "Aktivierung dyn. Frühverstellung: Unterer Hysteresewert für atmosphärischen Druck" VALUE 0x1D9776 Kw_Ws16 65535.00 Pres_hPa -32768.00 32767.00 FORMAT "%8.2" /end CHARACTERISTIC
/begin CHARACTERISTIC InjCrv_phiAirCor0_GMAP "Förderbeginn Lufttemperaturkorrektur" MAP 0x1DBC94 Gkf_Ws16 180.0000 AngleCrS -90.00000 90.00000 FORMAT "%8.5" EXTENDED_LIMITS -768.0000 767.9766
 /begin AXIS_DESCR COM_AXIS Eng_nAvrg EngN 16 0.00 6000.000 FORMAT "%8.3" EXTENDED_LIMITS -32768.00 32767.00 AXIS_PTS_REF InjCrv_phiAirCorX_AXIS /end AXIS_DESCR
 /begin AXIS_DESCR COM_AXIS InjCrv_qSOI InjMass 14 0.00 327.6700 FORMAT "%8.4" EXTENDED_LIMITS -327.6800 327.6700 AXIS_PTS_REF InjCrv_phiAirCorY_AXIS /end AXIS_DESCR
/end CHARACTERISTIC
/begin CHARACTERISTIC InjCrv_phiAirCor1_GMAP "Förderbeginn Lufttemperaturkorrektur" MAP 0x1DBE54 Gkf_Ws16 180.0000 AngleCrS -90.00000 90.00000 FORMAT "%8.5" EXTENDED_LIMITS -768.0000 767.9766
 /begin AXIS_DESCR COM_AXIS Eng_nAvrg EngN 16 0.00 6000.000 FORMAT "%8.3" EXTENDED_LIMITS -32768.00 32767.00 AXIS_PTS_REF InjCrv_phiAirCorX_AXIS /end AXIS_DESCR
 /begin AXIS_DESCR COM_AXIS InjCrv_qSOI InjMass 14 0.00 327.6700 FORMAT "%8.4" EXTENDED_LIMITS -327.6800 327.6700 AXIS_PTS_REF InjCrv_phiAirCorY_AXIS /end AXIS_DESCR
/end CHARACTERISTIC
/begin CHARACTERISTIC InjCrv_phiAirCor2_GMAP "Förderbeginn Lufttemperaturkorrektur" MAP 0x1DC014 Gkf_Ws16 180.0000 AngleCrS -90.00000 90.00000 FORMAT "%8.5" EXTENDED_LIMITS -768.0000 767.9766
 /begin AXIS_DESCR COM_AXIS Eng_nAvrg EngN 16 0.00 6000.000 FORMAT "%8.3" EXTENDED_LIMITS -32768.00 32767.00 AXIS_PTS_REF InjCrv_phiAirCorX_AXIS /end AXIS_DESCR
 /begin AXIS_DESCR COM_AXIS InjCrv_qSOI InjMass 14 0.00 327.6700 FORMAT "%8.4" EXTENDED_LIMITS -327.6800 327.6700 AXIS_PTS_REF InjCrv_phiAirCorY_AXIS /end AXIS_DESCR
/end CHARACTERISTIC
/begin CHARACTERISTIC InjCrv_phiAirCor3_GMAP "Förderbeginn Lufttemperaturkorrektur" MAP 0x1DC1D4 Gkf_Ws16 180.0000 AngleCrS -90.00000 90.00000 FORMAT "%8.5" EXTENDED_LIMITS -768.0000 767.9766
 /begin AXIS_DESCR COM_AXIS Eng_nAvrg EngN 16 0.00 6000.000 FORMAT "%8.3" EXTENDED_LIMITS -32768.00 32767.00 AXIS_PTS_REF InjCrv_phiAirCorX_AXIS /end AXIS_DESCR
 /begin AXIS_DESCR COM_AXIS InjCrv_qSOI InjMass 14 0.00 327.6700 FORMAT "%8.4" EXTENDED_LIMITS -327.6800 327.6700 AXIS_PTS_REF InjCrv_phiAirCorY_AXIS /end AXIS_DESCR
/end CHARACTERISTIC
/begin CHARACTERISTIC InjCrv_phiAirCor4_GMAP "Förderbeginn Lufttemperaturkorrektur" MAP 0x1DC394 Gkf_Ws16 180.0000 AngleCrS -90.00000 90.00000 FORMAT "%8.5" EXTENDED_LIMITS -768.0000 767.9766
 /begin AXIS_DESCR COM_AXIS Eng_nAvrg EngN 16 0.00 6000.000 FORMAT "%8.3" EXTENDED_LIMITS -32768.00 32767.00 AXIS_PTS_REF InjCrv_phiAirCorX_AXIS /end AXIS_DESCR
 /begin AXIS_DESCR COM_AXIS InjCrv_qSOI InjMass 14 0.00 327.6700 FORMAT "%8.4" EXTENDED_LIMITS -327.6800 327.6700 AXIS_PTS_REF InjCrv_phiAirCorY_AXIS /end AXIS_DESCR
/end CHARACTERISTIC
/begin CHARACTERISTIC InjCrv_phiAirCor5_GMAP "Förderbeginn Lufttemperaturkorrektur" MAP 0x1DC554 Gkf_Ws16 180.0000 AngleCrS -90.00000 90.00000 FORMAT "%8.5" EXTENDED_LIMITS -768.0000 767.9766
 /begin AXIS_DESCR COM_AXIS Eng_nAvrg EngN 16 0.00 6000.000 FORMAT "%8.3" EXTENDED_LIMITS -32768.00 32767.00 AXIS_PTS_REF InjCrv_phiAirCorX_AXIS /end AXIS_DESCR
 /begin AXIS_DESCR COM_AXIS InjCrv_qSOI InjMass 14 0.00 327.6700 FORMAT "%8.4" EXTENDED_LIMITS -327.6800 327.6700 AXIS_PTS_REF InjCrv_phiAirCorY_AXIS /end AXIS_DESCR
/end CHARACTERISTIC
/begin AXIS_PTS InjCrv_phiAirCorX_AXIS "X-Achse für InjCrv_phiAirCor<x>_GMAP" 0x1DC714 Eng_nAvrg GSst_Xs16 6000.000 EngN 16 0.00 6000.000 FORMAT "%8.3" EXTENDED_LIMITS -32768.00 32767.00 DEPOSIT ABSOLUTE /end AXIS_PTS
/begin AXIS_PTS InjCrv_phiAirCorY_AXIS "Y-Achse für InjCrv_phiAirCor<x>_GMAP" 0x1DC736 InjCrv_qSOI GSst_Xs16 327.6700 InjMass 14 0.00 327.6700 FORMAT "%8.4" EXTENDED_LIMITS -327.6800 327.6700 DEPOSIT ABSOLUTE /end AXIS_PTS
/begin CHARACTERISTIC InjCrv_phiAirCor_CUR "Förderbeginn Kennfeldauswahl der Lufttemperaturkorrektur" CURVE 0x1DC754 Kl_Xs16_Ws16 5.000000 Map_Select 0.00 5.000000 FORMAT "%8.6" EXTENDED_LIMITS -128.0000 127.9961
 /begin AXIS_DESCR STD_AXIS IATSCD_tAir Temp_Cels 6 -50.14000 199.8600 FORMAT "%8.4" EXTENDED_LIMITS -3549.940 3003.560 DEPOSIT ABSOLUTE /end AXIS_DESCR
/end CHARACTERISTIC
/begin CHARACTERISTIC InjCrv_phiBas0_GMAP "Förderbeginn Grundkorrektur" MAP 0x1D9778 Gkf_Ws16 109.9922 AngleCrS -60.00000 49.99219 FORMAT "%8.5" EXTENDED_LIMITS -768.0000 767.9766
 /begin AXIS_DESCR COM_AXIS Eng_nAvrg EngN 16 0.00 6000.000 FORMAT "%8.3" EXTENDED_LIMITS -32768.00 32767.00 AXIS_PTS_REF InjCrv_phiBasX_AXIS /end AXIS_DESCR
 /begin AXIS_DESCR COM_AXIS InjCrv_qSOI InjMass 14 0.00 327.6700 FORMAT "%8.4" EXTENDED_LIMITS -327.6800 327.6700 AXIS_PTS_REF InjCrv_phiBasY_AXIS /end AXIS_DESCR
/end CHARACTERISTIC
/begin CHARACTERISTIC InjCrv_phiBas1_GMAP "Förderbeginn Grundkorrektur" MAP 0x1D9938 Gkf_Ws16 109.9922 AngleCrS -60.00000 49.99219 FORMAT "%8.5" EXTENDED_LIMITS -768.0000 767.9766
 /begin AXIS_DESCR COM_AXIS Eng_nAvrg EngN 16 0.00 6000.000 FORMAT "%8.3" EXTENDED_LIMITS -32768.00 32767.00 AXIS_PTS_REF InjCrv_phiBasX_AXIS /end AXIS_DESCR
 /begin AXIS_DESCR COM_AXIS InjCrv_qSOI InjMass 14 0.00 327.6700 FORMAT "%8.4" EXTENDED_LIMITS -327.6800 327.6700 AXIS_PTS_REF InjCrv_phiBasY_AXIS /end AXIS_DESCR
/end CHARACTERISTIC
/begin CHARACTERISTIC InjCrv_phiBas2_GMAP "Förderbeginn Grundkorrektur" MAP 0x1D9AF8 Gkf_Ws16 109.9922 AngleCrS -60.00000 49.99219 FORMAT "%8.5" EXTENDED_LIMITS -768.0000 767.9766
 /begin AXIS_DESCR COM_AXIS Eng_nAvrg EngN 16 0.00 6000.000 FORMAT "%8.3" EXTENDED_LIMITS -32768.00 32767.00 AXIS_PTS_REF InjCrv_phiBasX_AXIS /end AXIS_DESCR
 /begin AXIS_DESCR COM_AXIS InjCrv_qSOI InjMass 14 0.00 327.6700 FORMAT "%8.4" EXTENDED_LIMITS -327.6800 327.6700 AXIS_PTS_REF InjCrv_phiBasY_AXIS /end AXIS_DESCR
/end CHARACTERISTIC
/begin CHARACTERISTIC InjCrv_phiBas3_GMAP "Förderbeginn Grundkorrektur" MAP 0x1D9CB8 Gkf_Ws16 109.9922 AngleCrS -60.00000 49.99219 FORMAT "%8.5" EXTENDED_LIMITS -768.0000 767.9766
 /begin AXIS_DESCR COM_AXIS Eng_nAvrg EngN 16 0.00 6000.000 FORMAT "%8.3" EXTENDED_LIMITS -32768.00 32767.00 AXIS_PTS_REF InjCrv_phiBasX_AXIS /end AXIS_DESCR
 /begin AXIS_DESCR COM_AXIS InjCrv_qSOI InjMass 14 0.00 327.6700 FORMAT "%8.4" EXTENDED_LIMITS -327.6800 327.6700 AXIS_PTS_REF InjCrv_phiBasY_AXIS /end AXIS_DESCR
/end CHARACTERISTIC
/begin CHARACTERISTIC InjCrv_phiBas4_GMAP "Förderbeginn Grundkorrektur" MAP 0x1D9E78 Gkf_Ws16 109.9922 AngleCrS -60.00000 49.99219 FORMAT "%8.5" EXTENDED_LIMITS -768.0000 767.9766
 /begin AXIS_DESCR COM_AXIS Eng_nAvrg EngN 16 0.00 6000.000 FORMAT "%8.3" EXTENDED_LIMITS -32768.00 32767.00 AXIS_PTS_REF InjCrv_phiBasX_AXIS /end AXIS_DESCR
 /begin AXIS_DESCR COM_AXIS InjCrv_qSOI InjMass 14 0.00 327.6700 FORMAT "%8.4" EXTENDED_LIMITS -327.6800 327.6700 AXIS_PTS_REF InjCrv_phiBasY_AXIS /end AXIS_DESCR
/end CHARACTERISTIC
/begin CHARACTERISTIC InjCrv_phiBas5_GMAP "Förderbeginn Grundkorrektur" MAP 0x1DA038 Gkf_Ws16 109.9922 AngleCrS -60.00000 49.99219 FORMAT "%8.5" EXTENDED_LIMITS -768.0000 767.9766
 /begin AXIS_DESCR COM_AXIS Eng_nAvrg EngN 16 0.00 6000.000 FORMAT "%8.3" EXTENDED_LIMITS -32768.00 32767.00 AXIS_PTS_REF InjCrv_phiBasX_AXIS /end AXIS_DESCR
 /begin AXIS_DESCR COM_AXIS InjCrv_qSOI InjMass 14 0.00 327.6700 FORMAT "%8.4" EXTENDED_LIMITS -327.6800 327.6700 AXIS_PTS_REF InjCrv_phiBasY_AXIS /end AXIS_DESCR
/end CHARACTERISTIC
/begin CHARACTERISTIC InjCrv_phiBas6_GMAP "Förderbeginn Grundkorrektur" MAP 0x1DA1F8 Gkf_Ws16 109.9922 AngleCrS -60.00000 49.99219 FORMAT "%8.5" EXTENDED_LIMITS -768.0000 767.9766
 /begin AXIS_DESCR COM_AXIS Eng_nAvrg EngN 16 0.00 6000.000 FORMAT "%8.3" EXTENDED_LIMITS -32768.00 32767.00 AXIS_PTS_REF InjCrv_phiBasX_AXIS /end AXIS_DESCR
 /begin AXIS_DESCR COM_AXIS InjCrv_qSOI InjMass 14 0.00 327.6700 FORMAT "%8.4" EXTENDED_LIMITS -327.6800 327.6700 AXIS_PTS_REF InjCrv_phiBasY_AXIS /end AXIS_DESCR
/end CHARACTERISTIC
/begin CHARACTERISTIC InjCrv_phiBas7_GMAP "Förderbeginn Grundkorrektur" MAP 0x1DA3B8 Gkf_Ws16 109.9922 AngleCrS -60.00000 49.99219 FORMAT "%8.5" EXTENDED_LIMITS -768.0000 767.9766
 /begin AXIS_DESCR COM_AXIS Eng_nAvrg EngN 16 0.00 6000.000 FORMAT "%8.3" EXTENDED_LIMITS -32768.00 32767.00 AXIS_PTS_REF InjCrv_phiBasX_AXIS /end AXIS_DESCR
 /begin AXIS_DESCR COM_AXIS InjCrv_qSOI InjMass 14 0.00 327.6700 FORMAT "%8.4" EXTENDED_LIMITS -327.6800 327.6700 AXIS_PTS_REF InjCrv_phiBasY_AXIS /end AXIS_DESCR
/end CHARACTERISTIC
/begin CHARACTERISTIC InjCrv_phiBas8_GMAP "Förderbeginn Grundkorrektur" MAP 0x1DA578 Gkf_Ws16 109.9922 AngleCrS -60.00000 49.99219 FORMAT "%8.5" EXTENDED_LIMITS -768.0000 767.9766
 /begin AXIS_DESCR COM_AXIS Eng_nAvrg EngN 16 0.00 6000.000 FORMAT "%8.3" EXTENDED_LIMITS -32768.00 32767.00 AXIS_PTS_REF InjCrv_phiBasX_AXIS /end AXIS_DESCR
 /begin AXIS_DESCR COM_AXIS InjCrv_qSOI InjMass 14 0.00 327.6700 FORMAT "%8.4" EXTENDED_LIMITS -327.6800 327.6700 AXIS_PTS_REF InjCrv_phiBasY_AXIS /end AXIS_DESCR
/end CHARACTERISTIC
/begin CHARACTERISTIC InjCrv_phiBas9_GMAP "Förderbeginn Grundkorrektur" MAP 0x1DA738 Gkf_Ws16 109.9922 AngleCrS -60.00000 49.99219 FORMAT "%8.5" EXTENDED_LIMITS -768.0000 767.9766
 /begin AXIS_DESCR COM_AXIS Eng_nAvrg EngN 16 0.00 6000.000 FORMAT "%8.3" EXTENDED_LIMITS -32768.00 32767.00 AXIS_PTS_REF InjCrv_phiBasX_AXIS /end AXIS_DESCR
 /begin AXIS_DESCR COM_AXIS InjCrv_qSOI InjMass 14 0.00 327.6700 FORMAT "%8.4" EXTENDED_LIMITS -327.6800 327.6700 AXIS_PTS_REF InjCrv_phiBasY_AXIS /end AXIS_DESCR
/end CHARACTERISTIC
/begin CHARACTERISTIC InjCrv_phiBasGear12_MAP "Förderbeginn Grundkennfeld MI1 für Gänge 1 und 2" MAP 0x1DA8F8 Kf_Xs16_Ys16_Ws16 109.9922 AngleCrS -60.00000 49.99219 FORMAT "%8.5" EXTENDED_LIMITS -768.0000 767.9766
 /begin AXIS_DESCR STD_AXIS Eng_nAvrg EngN 16 0.00 6000.000 FORMAT "%8.3" EXTENDED_LIMITS -32768.00 32767.00 DEPOSIT ABSOLUTE /end AXIS_DESCR
 /begin AXIS_DESCR STD_AXIS InjCrv_qSOI InjMass 14 0.00 327.6700 FORMAT "%8.4" EXTENDED_LIMITS -327.6800 327.6700 DEPOSIT ABSOLUTE /end AXIS_DESCR
/end CHARACTERISTIC
/begin CHARACTERISTIC InjCrv_phiBasGear34_MAP "Förderbeginn Grundkennfeld MI1 für Gänge 3 und 4" MAP 0x1DAAF8 Kf_Xs16_Ys16_Ws16 109.9922 AngleCrS -60.00000 49.99219 FORMAT "%8.5" EXTENDED_LIMITS -768.0000 767.9766
 /begin AXIS_DESCR STD_AXIS Eng_nAvrg EngN 16 0.00 6000.000 FORMAT "%8.3" EXTENDED_LIMITS -32768.00 32767.00 DEPOSIT ABSOLUTE /end AXIS_DESCR
 /begin AXIS_DESCR STD_AXIS InjCrv_qSOI InjMass 14 0.00 327.6700 FORMAT "%8.4" EXTENDED_LIMITS -327.6800 327.6700 DEPOSIT ABSOLUTE /end AXIS_DESCR
/end CHARACTERISTIC
/begin CHARACTERISTIC InjCrv_phiBasGear56_MAP "Förderbeginn Grundkennfeld MI1 für Gänge 5 und 6" MAP 0x1DACF8 Kf_Xs16_Ys16_Ws16 109.9922 AngleCrS -60.00000 49.99219 FORMAT "%8.5" EXTENDED_LIMITS -768.0000 767.9766
 /begin AXIS_DESCR STD_AXIS Eng_nAvrg EngN 16 0.00 6000.000 FORMAT "%8.3" EXTENDED_LIMITS -32768.00 32767.00 DEPOSIT ABSOLUTE /end AXIS_DESCR
 /begin AXIS_DESCR STD_AXIS InjCrv_qSOI InjMass 14 0.00 327.6700 FORMAT "%8.4" EXTENDED_LIMITS -327.6800 327.6700 DEPOSIT ABSOLUTE /end AXIS_DESCR
/end CHARACTERISTIC
/begin AXIS_PTS InjCrv_phiBasX_AXIS "X-Achse für InjCrv_phiBas<x>_GMAP" 0x1DAEF8 Eng_nAvrg GSst_Xs16 6000.000 EngN 16 0.00 6000.000 FORMAT "%8.3" EXTENDED_LIMITS -32768.00 32767.00 DEPOSIT ABSOLUTE /end AXIS_PTS
/begin AXIS_PTS InjCrv_phiBasY_AXIS "Y-Achse für InjCrv_phiBase<x>_GMAP" 0x1DAF1A InjCrv_qSOI GSst_Xs16 327.6700 InjMass 14 0.00 327.6700 FORMAT "%8.4" EXTENDED_LIMITS -327.6800 327.6700 DEPOSIT ABSOLUTE /end AXIS_PTS
/begin CHARACTERISTIC InjCrv_phiBas_CUR "Förderbeginn Kennfeldauswahl der Grundkorrektur" CURVE 0x1DAF38 Kl_Xs16_Ws16 20.00000 Map_Select 0.00 20.00000 FORMAT "%8.5" EXTENDED_LIMITS -128.0000 127.9961
 /begin AXIS_DESCR STD_AXIS InjCrv_tClnt Temp_Cels 10 -50.14000 149.8600 FORMAT "%8.4" EXTENDED_LIMITS -3549.940 3003.560 DEPOSIT ABSOLUTE /end AXIS_DESCR
/end CHARACTERISTIC
/begin CHARACTERISTIC InjCrv_phiCor3_MAP "Spritzbeginn-Sollwert Korrekturkennfeld 3 = f(Drehzahl, Menge)" MAP 0x1DD944 Kf_Xs16_Ys16_Ws16 39.98437 AngleCrS -19.99219 19.99219 FORMAT "%8.5" EXTENDED_LIMITS -768.0000 767.9766
 /begin AXIS_DESCR STD_AXIS InjCrv_tClnt Temp_Cels 8 -50.14000 149.8600 FORMAT "%8.4" EXTENDED_LIMITS -3549.940 3003.560 DEPOSIT ABSOLUTE /end AXIS_DESCR
 /begin AXIS_DESCR STD_AXIS APSCD_pVal Pres_hPa 8 0.00 3500.000 FORMAT "%8.3" EXTENDED_LIMITS -32768.00 32767.00 DEPOSIT ABSOLUTE /end AXIS_DESCR
/end CHARACTERISTIC
/begin CHARACTERISTIC InjCrv_phiDyn0_GMAP "Förderbeginn dynamische Korrektur" MAP 0x1DAF62 Gkf_Ws16 109.9922 AngleCrS -60.00000 49.99219 FORMAT "%8.5" EXTENDED_LIMITS -768.0000 767.9766
 /begin AXIS_DESCR COM_AXIS Eng_nAvrg EngN 16 0.00 6000.000 FORMAT "%8.3" EXTENDED_LIMITS -32768.00 32767.00 AXIS_PTS_REF InjCrv_phiDynX_AXIS /end AXIS_DESCR
 /begin AXIS_DESCR COM_AXIS InjCrv_qSOI InjMass 14 0.00 327.6700 FORMAT "%8.4" EXTENDED_LIMITS -327.6800 327.6700 AXIS_PTS_REF InjCrv_phiDynY_AXIS /end AXIS_DESCR
/end CHARACTERISTIC
/begin CHARACTERISTIC InjCrv_phiDyn1_GMAP "Förderbeginn dynamische Korrektur" MAP 0x1DB122 Gkf_Ws16 109.9922 AngleCrS -60.00000 49.99219 FORMAT "%8.5" EXTENDED_LIMITS -768.0000 767.9766
 /begin AXIS_DESCR COM_AXIS Eng_nAvrg EngN 16 0.00 6000.000 FORMAT "%8.3" EXTENDED_LIMITS -32768.00 32767.00 AXIS_PTS_REF InjCrv_phiDynX_AXIS /end AXIS_DESCR
 /begin AXIS_DESCR COM_AXIS InjCrv_qSOI InjMass 14 0.00 327.6700 FORMAT "%8.4" EXTENDED_LIMITS -327.6800 327.6700 AXIS_PTS_REF InjCrv_phiDynY_AXIS /end AXIS_DESCR
/end CHARACTERISTIC
/begin CHARACTERISTIC InjCrv_phiDyn2_GMAP "Förderbeginn dynamische Korrektur" MAP 0x1DB2E2 Gkf_Ws16 109.9922 AngleCrS -60.00000 49.99219 FORMAT "%8.5" EXTENDED_LIMITS -768.0000 767.9766
 /begin AXIS_DESCR COM_AXIS Eng_nAvrg EngN 16 0.00 6000.000 FORMAT "%8.3" EXTENDED_LIMITS -32768.00 32767.00 AXIS_PTS_REF InjCrv_phiDynX_AXIS /end AXIS_DESCR
 /begin AXIS_DESCR COM_AXIS InjCrv_qSOI InjMass 14 0.00 327.6700 FORMAT "%8.4" EXTENDED_LIMITS -327.6800 327.6700 AXIS_PTS_REF InjCrv_phiDynY_AXIS /end AXIS_DESCR
/end CHARACTERISTIC
/begin CHARACTERISTIC InjCrv_phiDyn3_GMAP "Förderbeginn dynamische Korrektur" MAP 0x1DB4A2 Gkf_Ws16 109.9922 AngleCrS -60.00000 49.99219 FORMAT "%8.5" EXTENDED_LIMITS -768.0000 767.9766
 /begin AXIS_DESCR COM_AXIS Eng_nAvrg EngN 16 0.00 6000.000 FORMAT "%8.3" EXTENDED_LIMITS -32768.00 32767.00 AXIS_PTS_REF InjCrv_phiDynX_AXIS /end AXIS_DESCR
 /begin AXIS_DESCR COM_AXIS InjCrv_qSOI InjMass 14 0.00 327.6700 FORMAT "%8.4" EXTENDED_LIMITS -327.6800 327.6700 AXIS_PTS_REF InjCrv_phiDynY_AXIS /end AXIS_DESCR
/end CHARACTERISTIC
/begin CHARACTERISTIC InjCrv_phiDyn4_GMAP "Förderbeginn dynamische Korrektur" MAP 0x1DB662 Gkf_Ws16 109.9922 AngleCrS -60.00000 49.99219 FORMAT "%8.5" EXTENDED_LIMITS -768.0000 767.9766
 /begin AXIS_DESCR COM_AXIS Eng_nAvrg EngN 16 0.00 6000.000 FORMAT "%8.3" EXTENDED_LIMITS -32768.00 32767.00 AXIS_PTS_REF InjCrv_phiDynX_AXIS /end AXIS_DESCR
 /begin AXIS_DESCR COM_AXIS InjCrv_qSOI InjMass 14 0.00 327.6700 FORMAT "%8.4" EXTENDED_LIMITS -327.6800 327.6700 AXIS_PTS_REF InjCrv_phiDynY_AXIS /end AXIS_DESCR
/end CHARACTERISTIC
/begin AXIS_PTS InjCrv_phiDynX_AXIS "X-Achse für InjCrv_phiDyn<x>_GMAP" 0x1DB822 Eng_nAvrg GSst_Xs16 6000.000 EngN 16 0.00 6000.000 FORMAT "%8.3" EXTENDED_LIMITS -32768.00 32767.00 DEPOSIT ABSOLUTE /end AXIS_PTS
/begin AXIS_PTS InjCrv_phiDynY_AXIS "Y-Achse für InjCrv_phiDyn<x>_GMAP" 0x1DB844 InjCrv_qSOI GSst_Xs16 327.6700 InjMass 14 0.00 327.6700 FORMAT "%8.4" EXTENDED_LIMITS -327.6800 327.6700 DEPOSIT ABSOLUTE /end AXIS_PTS
/begin CHARACTERISTIC InjCrv_phiDyn_CUR "Förderbeginn Kennfeldauswahl der dynamischen Korrektur" CURVE 0x1DB862 Kl_Xs16_Ws16 20.00000 Map_Select 0.00 20.00000 FORMAT "%8.5" EXTENDED_LIMITS -128.0000 127.9961
 /begin AXIS_DESCR STD_AXIS InjCrv_tClnt Temp_Cels 5 -50.14000 149.8600 FORMAT "%8.4" EXTENDED_LIMITS -3549.940 3003.560 DEPOSIT ABSOLUTE /end AXIS_DESCR
/end CHARACTERISTIC
/begin CHARACTERISTIC InjCrv_phiFBDynAirLck_MAP "Kennfeld zur Berechnung der maximalen Verschiebung des FB bei Luftüberschuss" MAP 0x1DC76E Kf_Xs16_Ys16_Ws16 20.01562 AngleCrS -10.00781 10.00781 FORMAT "%8.5" EXTENDED_LIMITS -768.0000 767.9766
 /begin AXIS_DESCR STD_AXIS Eng_nAvrg EngN 16 0.00 6000.000 FORMAT "%8.3" EXTENDED_LIMITS -32768.00 32767.00 DEPOSIT ABSOLUTE /end AXIS_DESCR
 /begin AXIS_DESCR STD_AXIS InjCrv_qSOI InjMass 16 0.00 327.6700 FORMAT "%8.4" EXTENDED_LIMITS -327.6800 327.6700 DEPOSIT ABSOLUTE /end AXIS_DESCR
/end CHARACTERISTIC
/begin CHARACTERISTIC InjCrv_phiFBDynAirSrPls_MAP "Kennfeld zur Berechnung der maximalen Verschiebung des FB bei Luftmangel" MAP 0x1DC9B2 Kf_Xs16_Ys16_Ws16 20.01562 AngleCrS -10.00781 10.00781 FORMAT "%8.5" EXTENDED_LIMITS -768.0000 767.9766
 /begin AXIS_DESCR STD_AXIS Eng_nAvrg EngN 16 0.00 6000.000 FORMAT "%8.3" EXTENDED_LIMITS -32768.00 32767.00 DEPOSIT ABSOLUTE /end AXIS_DESCR
 /begin AXIS_DESCR STD_AXIS InjCrv_qSOI InjMass 16 0.00 327.6700 FORMAT "%8.4" EXTENDED_LIMITS -327.6800 327.6700 DEPOSIT ABSOLUTE /end AXIS_DESCR
/end CHARACTERISTIC
/begin CHARACTERISTIC InjCrv_phiHghtCor0_GMAP "Förderbeginn Höhenkorrektur" MAP 0x1DCBF6 Gkf_Ws16 180.0000 AngleCrS -90.00000 90.00000 FORMAT "%8.5" EXTENDED_LIMITS -768.0000 767.9766
 /begin AXIS_DESCR COM_AXIS Eng_nAvrg EngN 16 0.00 6000.000 FORMAT "%8.3" EXTENDED_LIMITS -32768.00 32767.00 AXIS_PTS_REF InjCrv_phiHghtCorX_AXIS /end AXIS_DESCR
 /begin AXIS_DESCR COM_AXIS InjCrv_qSOI InjMass 14 0.00 327.6700 FORMAT "%8.4" EXTENDED_LIMITS -327.6800 327.6700 AXIS_PTS_REF InjCrv_phiHghtCorY_AXIS /end AXIS_DESCR
/end CHARACTERISTIC
/begin CHARACTERISTIC InjCrv_phiHghtCor1_GMAP "Förderbeginn Höhenkorrektur" MAP 0x1DCDB6 Gkf_Ws16 180.0000 AngleCrS -90.00000 90.00000 FORMAT "%8.5" EXTENDED_LIMITS -768.0000 767.9766
 /begin AXIS_DESCR COM_AXIS Eng_nAvrg EngN 16 0.00 6000.000 FORMAT "%8.3" EXTENDED_LIMITS -32768.00 32767.00 AXIS_PTS_REF InjCrv_phiHghtCorX_AXIS /end AXIS_DESCR
 /begin AXIS_DESCR COM_AXIS InjCrv_qSOI InjMass 14 0.00 327.6700 FORMAT "%8.4" EXTENDED_LIMITS -327.6800 327.6700 AXIS_PTS_REF InjCrv_phiHghtCorY_AXIS /end AXIS_DESCR
/end CHARACTERISTIC
/begin CHARACTERISTIC InjCrv_phiHghtCor2_GMAP "Förderbeginn Höhenkorrektur" MAP 0x1DCF76 Gkf_Ws16 180.0000 AngleCrS -90.00000 90.00000 FORMAT "%8.5" EXTENDED_LIMITS -768.0000 767.9766
 /begin AXIS_DESCR COM_AXIS Eng_nAvrg EngN 16 0.00 6000.000 FORMAT "%8.3" EXTENDED_LIMITS -32768.00 32767.00 AXIS_PTS_REF InjCrv_phiHghtCorX_AXIS /end AXIS_DESCR
 /begin AXIS_DESCR COM_AXIS InjCrv_qSOI InjMass 14 0.00 327.6700 FORMAT "%8.4" EXTENDED_LIMITS -327.6800 327.6700 AXIS_PTS_REF InjCrv_phiHghtCorY_AXIS /end AXIS_DESCR
/end CHARACTERISTIC
/begin CHARACTERISTIC InjCrv_phiHghtCor3_GMAP "Förderbeginn Höhenkorrektur" MAP 0x1DD136 Gkf_Ws16 180.0000 AngleCrS -90.00000 90.00000 FORMAT "%8.5" EXTENDED_LIMITS -768.0000 767.9766
 /begin AXIS_DESCR COM_AXIS Eng_nAvrg EngN 16 0.00 6000.000 FORMAT "%8.3" EXTENDED_LIMITS -32768.00 32767.00 AXIS_PTS_REF InjCrv_phiHghtCorX_AXIS /end AXIS_DESCR
 /begin AXIS_DESCR COM_AXIS InjCrv_qSOI InjMass 14 0.00 327.6700 FORMAT "%8.4" EXTENDED_LIMITS -327.6800 327.6700 AXIS_PTS_REF InjCrv_phiHghtCorY_AXIS /end AXIS_DESCR
/end CHARACTERISTIC
/begin CHARACTERISTIC InjCrv_phiHghtCor4_GMAP "Förderbeginn Höhenkorrektur" MAP 0x1DD2F6 Gkf_Ws16 180.0000 AngleCrS -90.00000 90.00000 FORMAT "%8.5" EXTENDED_LIMITS -768.0000 767.9766
 /begin AXIS_DESCR COM_AXIS Eng_nAvrg EngN 16 0.00 6000.000 FORMAT "%8.3" EXTENDED_LIMITS -32768.00 32767.00 AXIS_PTS_REF InjCrv_phiHghtCorX_AXIS /end AXIS_DESCR
 /begin AXIS_DESCR COM_AXIS InjCrv_qSOI InjMass 14 0.00 327.6700 FORMAT "%8.4" EXTENDED_LIMITS -327.6800 327.6700 AXIS_PTS_REF InjCrv_phiHghtCorY_AXIS /end AXIS_DESCR
/end CHARACTERISTIC
/begin CHARACTERISTIC InjCrv_phiHghtCor5_GMAP "Förderbeginn Höhenkorrektur" MAP 0x1DD4B6 Gkf_Ws16 180.0000 AngleCrS -90.00000 90.00000 FORMAT "%8.5" EXTENDED_LIMITS -768.0000 767.9766
 /begin AXIS_DESCR COM_AXIS Eng_nAvrg EngN 16 0.00 6000.000 FORMAT "%8.3" EXTENDED_LIMITS -32768.00 32767.00 AXIS_PTS_REF InjCrv_phiHghtCorX_AXIS /end AXIS_DESCR
 /begin AXIS_DESCR COM_AXIS InjCrv_qSOI InjMass 14 0.00 327.6700 FORMAT "%8.4" EXTENDED_LIMITS -327.6800 327.6700 AXIS_PTS_REF InjCrv_phiHghtCorY_AXIS /end AXIS_DESCR
/end CHARACTERISTIC
/begin AXIS_PTS InjCrv_phiHghtCorX_AXIS "X-Achse für InjCrv_phiHghtCor<x>_GMAP" 0x1DD676 Eng_nAvrg GSst_Xs16 6000.000 EngN 16 0.00 6000.000 FORMAT "%8.3" EXTENDED_LIMITS -32768.00 32767.00 DEPOSIT ABSOLUTE /end AXIS_PTS
/begin AXIS_PTS InjCrv_phiHghtCorY_AXIS "Y-Achse für InjCrv_phiHghtCor<x>_GMAP" 0x1DD698 InjCrv_qSOI GSst_Xs16 327.6700 InjMass 14 0.00 327.6700 FORMAT "%8.4" EXTENDED_LIMITS -327.6800 327.6700 DEPOSIT ABSOLUTE /end AXIS_PTS
/begin CHARACTERISTIC InjCrv_phiHghtCor_CUR "Förderbeginn Kennfeldauswahl der Höhenkorrektur" CURVE 0x1DD6B6 Kl_Xs16_Ws16 20.00000 Map_Select 0.00 20.00000 FORMAT "%8.5" EXTENDED_LIMITS -128.0000 127.9961
 /begin AXIS_DESCR STD_AXIS APSCD_pVal Pres_hPa 6 0.00 3500.000 FORMAT "%8.3" EXTENDED_LIMITS -32768.00 32767.00 DEPOSIT ABSOLUTE /end AXIS_DESCR
/end CHARACTERISTIC
/begin CHARACTERISTIC InjCrv_phiMI1EGTBas1_MAP "FB-Grundkennfeld 1 für Förderbeginn der Haupteinspritzung im Regenerationsbetrieb" MAP 0x1DDC40 Kf_Xs16_Ys16_Ws16 109.9922 AngleCrS -60.00000 49.99219 FORMAT "%8.5" EXTENDED_LIMITS -768.0000 767.9766
 /begin AXIS_DESCR STD_AXIS Eng_nAvrg EngN 16 0.00 6000.000 FORMAT "%8.3" EXTENDED_LIMITS -32768.00 32767.00 DEPOSIT ABSOLUTE /end AXIS_DESCR
 /begin AXIS_DESCR STD_AXIS InjCrv_qPoI2Op InjMass 16 0.00 327.6700 FORMAT "%8.4" EXTENDED_LIMITS -327.6800 327.6700 DEPOSIT ABSOLUTE /end AXIS_DESCR
/end CHARACTERISTIC
/begin CHARACTERISTIC InjCrv_phiMI1EGTBas2_MAP "FB-Grundkennfeld 2 für Förderbeginn der Haupteinspritzung im Regenerationsbetrieb" MAP 0x1DDE84 Kf_Xs16_Ys16_Ws16 109.9922 AngleCrS -60.00000 49.99219 FORMAT "%8.5" EXTENDED_LIMITS -768.0000 767.9766
 /begin AXIS_DESCR STD_AXIS Eng_nAvrg EngN 16 0.00 6000.000 FORMAT "%8.3" EXTENDED_LIMITS -32768.00 32767.00 DEPOSIT ABSOLUTE /end AXIS_DESCR
 /begin AXIS_DESCR STD_AXIS InjCrv_qPoI2Op InjMass 16 0.00 327.6700 FORMAT "%8.4" EXTENDED_LIMITS -327.6800 327.6700 DEPOSIT ABSOLUTE /end AXIS_DESCR
/end CHARACTERISTIC
/begin CHARACTERISTIC InjCrv_phiMI1EGTBas3_MAP "FB-Grundkennfeld 3 für Förderbeginn der Haupteinspritzung im Regenerationsbetrieb" MAP 0x1DE0C8 Kf_Xs16_Ys16_Ws16 109.9922 AngleCrS -60.00000 49.99219 FORMAT "%8.5" EXTENDED_LIMITS -768.0000 767.9766
 /begin AXIS_DESCR STD_AXIS Eng_nAvrg EngN 16 0.00 6000.000 FORMAT "%8.3" EXTENDED_LIMITS -32768.00 32767.00 DEPOSIT ABSOLUTE /end AXIS_DESCR
 /begin AXIS_DESCR STD_AXIS InjCrv_qPoI2Op InjMass 16 0.00 327.6700 FORMAT "%8.4" EXTENDED_LIMITS -327.6800 327.6700 DEPOSIT ABSOLUTE /end AXIS_DESCR
/end CHARACTERISTIC
/begin CHARACTERISTIC InjCrv_phiMI1EGTBas4_MAP "FB-Grundkennfeld 4 für Förderbeginn der Haupteinspritzung im Regenerationsbetrieb" MAP 0x1DE30C Kf_Xs16_Ys16_Ws16 109.9922 AngleCrS -60.00000 49.99219 FORMAT "%8.5" EXTENDED_LIMITS -768.0000 767.9766
 /begin AXIS_DESCR STD_AXIS Eng_nAvrg EngN 2 0.00 6000.000 FORMAT "%8.3" EXTENDED_LIMITS -32768.00 32767.00 DEPOSIT ABSOLUTE /end AXIS_DESCR
 /begin AXIS_DESCR STD_AXIS InjCrv_qPoI2Op InjMass 2 0.00 327.6700 FORMAT "%8.4" EXTENDED_LIMITS -327.6800 327.6700 DEPOSIT ABSOLUTE /end AXIS_DESCR
/end CHARACTERISTIC
/begin CHARACTERISTIC InjCrv_phiMI1EGTCor1_MAP "Startwert 1 für Förderbeginn der Haupteinspritzung im Regenerationsbetrieb" MAP 0x1DE320 Kf_Xs16_Ys16_Ws16 39.98437 AngleCrS -19.99219 19.99219 FORMAT "%8.5" EXTENDED_LIMITS -768.0000 767.9766
 /begin AXIS_DESCR STD_AXIS Eng_nAvrg EngN 16 0.00 6000.000 FORMAT "%8.3" EXTENDED_LIMITS -32768.00 32767.00 DEPOSIT ABSOLUTE /end AXIS_DESCR
 /begin AXIS_DESCR STD_AXIS InjCrv_qPoI2Op InjMass 16 0.00 327.6700 FORMAT "%8.4" EXTENDED_LIMITS -327.6800 327.6700 DEPOSIT ABSOLUTE /end AXIS_DESCR
/end CHARACTERISTIC
/begin CHARACTERISTIC InjCrv_phiMI1EGTCor2_MAP "Startwert 2 für Förderbeginn der Haupteinspritzung im Regenerationsbetrieb" MAP 0x1DE564 Kf_Xs16_Ys16_Ws16 39.98437 AngleCrS -19.99219 19.99219 FORMAT "%8.5" EXTENDED_LIMITS -768.0000 767.9766
 /begin AXIS_DESCR STD_AXIS Eng_nAvrg EngN 16 0.00 6000.000 FORMAT "%8.3" EXTENDED_LIMITS -32768.00 32767.00 DEPOSIT ABSOLUTE /end AXIS_DESCR
 /begin AXIS_DESCR STD_AXIS InjCrv_qPoI2Op InjMass 16 0.00 327.6700 FORMAT "%8.4" EXTENDED_LIMITS -327.6800 327.6700 DEPOSIT ABSOLUTE /end AXIS_DESCR
/end CHARACTERISTIC
/begin CHARACTERISTIC InjCrv_phiMI1EGTCor3_MAP "Startwert 3 für Förderbeginn der Haupteinspritzung im Regenerationsbetrieb" MAP 0x1DE7A8 Kf_Xs16_Ys16_Ws16 39.98437 AngleCrS -19.99219 19.99219 FORMAT "%8.5" EXTENDED_LIMITS -768.0000 767.9766
 /begin AXIS_DESCR STD_AXIS Eng_nAvrg EngN 16 0.00 6000.000 FORMAT "%8.3" EXTENDED_LIMITS -32768.00 32767.00 DEPOSIT ABSOLUTE /end AXIS_DESCR
 /begin AXIS_DESCR STD_AXIS InjCrv_qPoI2Op InjMass 16 0.00 327.6700 FORMAT "%8.4" EXTENDED_LIMITS -327.6800 327.6700 DEPOSIT ABSOLUTE /end AXIS_DESCR
/end CHARACTERISTIC
/begin CHARACTERISTIC InjCrv_phiMI1EGTCor4_MAP "Startwert 4 für Förderbeginn der Haupteinspritzung im Regenerationsbetrieb" MAP 0x1DE9EC Kf_Xs16_Ys16_Ws16 39.98437 AngleCrS -19.99219 19.99219 FORMAT "%8.5" EXTENDED_LIMITS -768.0000 767.9766
 /begin AXIS_DESCR STD_AXIS Eng_nAvrg EngN 2 0.00 6000.000 FORMAT "%8.3" EXTENDED_LIMITS -32768.00 32767.00 DEPOSIT ABSOLUTE /end AXIS_DESCR
 /begin AXIS_DESCR STD_AXIS InjCrv_qPoI2Op InjMass 2 0.00 327.6700 FORMAT "%8.4" EXTENDED_LIMITS -327.6800 327.6700 DEPOSIT ABSOLUTE /end AXIS_DESCR
/end CHARACTERISTIC
/begin CHARACTERISTIC InjCrv_phiMI1HCDes_MAP "gewünschte Bezugswinkelkomponente für Beginn der MI1 während PoI2HC" MAP 0x1DD9F0 Kf_Xs16_Ys16_Ws16 109.9922 AngleCrS -60.00000 49.99219 FORMAT "%8.5" EXTENDED_LIMITS -768.0000 767.9766
 /begin AXIS_DESCR STD_AXIS Eng_nAvrg EngN 10 0.00 6000.000 FORMAT "%8.3" EXTENDED_LIMITS -32768.00 32767.00 DEPOSIT ABSOLUTE /end AXIS_DESCR
 /begin AXIS_DESCR STD_AXIS InjCrv_qPoI2Op InjMass 11 0.00 327.6700 FORMAT "%8.4" EXTENDED_LIMITS -327.6800 327.6700 DEPOSIT ABSOLUTE /end AXIS_DESCR
/end CHARACTERISTIC
/begin CHARACTERISTIC InjCrv_phiMI1PCRCor_MAP "Kennfeld für die Winkelkorrektur für die Haupteinspritzung, die von der Ladedruckreglerabweichung abhängig ist" MAP 0x1DD6D0 Kf_Xs16_Ys16_Ws16 20.01562 AngleCrS -10.00781 10.00781 FORMAT "%8.5" EXTENDED_LIMITS -768.0000 767.9766
 /begin AXIS_DESCR STD_AXIS Eng_nAvrg EngN 12 0.00 6000.000 FORMAT "%8.3" EXTENDED_LIMITS -32768.00 32767.00 DEPOSIT ABSOLUTE /end AXIS_DESCR
 /begin AXIS_DESCR STD_AXIS PCR_pBGDev Pres_hPa 8 0.00 4000.000 FORMAT "%8.3" EXTENDED_LIMITS -32768.00 32767.00 DEPOSIT ABSOLUTE /end AXIS_DESCR
/end CHARACTERISTIC
/begin CHARACTERISTIC InjCrv_phiMIMax_MAP "Förderbeginn-Begrenzungskennfeld" MAP 0x1DB878 Kf_Xs16_Ys16_Ws16 109.9922 AngleCrS -60.00000 49.99219 FORMAT "%8.5" EXTENDED_LIMITS -768.0000 767.9766
 /begin AXIS_DESCR STD_AXIS Eng_nAvrg EngN 14 0.00 6000.000 FORMAT "%8.3" EXTENDED_LIMITS -32768.00 32767.00 DEPOSIT ABSOLUTE /end AXIS_DESCR
 /begin AXIS_DESCR STD_AXIS InjCrv_tClnt Temp_Cels 11 -50.14000 149.8600 FORMAT "%8.4" EXTENDED_LIMITS -3549.940 3003.560 DEPOSIT ABSOLUTE /end AXIS_DESCR
/end CHARACTERISTIC
/begin CHARACTERISTIC InjCrv_phiPiI1Cor0_MAP "Kennfeld  0 FB-Korrektur Haupteinspritzung" MAP 0x1DEC08 Kf_Xs16_Ys16_Ws16 109.9922 AngleCrS -60.00000 49.99219 FORMAT "%8.5" EXTENDED_LIMITS -768.0000 767.9766
 /begin AXIS_DESCR STD_AXIS Eng_nAvrg EngN 8 0.00 6000.000 FORMAT "%8.3" EXTENDED_LIMITS -32768.00 32767.00 DEPOSIT ABSOLUTE /end AXIS_DESCR
 /begin AXIS_DESCR STD_AXIS InjCtl_qSetUnBal InjMass 8 0.00 327.6700 FORMAT "%8.4" EXTENDED_LIMITS -327.6800 327.6700 DEPOSIT ABSOLUTE /end AXIS_DESCR
/end CHARACTERISTIC
/begin CHARACTERISTIC InjCrv_phiPiI1Cor1_MAP "Kennfeld  1 FB-Korrektur Haupteinspritzung" MAP 0x1DECAC Kf_Xs16_Ys16_Ws16 109.9922 AngleCrS -60.00000 49.99219 FORMAT "%8.5" EXTENDED_LIMITS -768.0000 767.9766
 /begin AXIS_DESCR STD_AXIS Eng_nAvrg EngN 8 0.00 6000.000 FORMAT "%8.3" EXTENDED_LIMITS -32768.00 32767.00 DEPOSIT ABSOLUTE /end AXIS_DESCR
 /begin AXIS_DESCR STD_AXIS InjCtl_qSetUnBal InjMass 8 0.00 327.6700 FORMAT "%8.4" EXTENDED_LIMITS -327.6800 327.6700 DEPOSIT ABSOLUTE /end AXIS_DESCR
/end CHARACTERISTIC
/begin CHARACTERISTIC InjCrv_phiPiI1Cor2_MAP "Kennfeld 2 FB-Korrektur Haupteinspritzung" MAP 0x1DED50 Kf_Xs16_Ys16_Ws16 109.9922 AngleCrS -60.00000 49.99219 FORMAT "%8.5" EXTENDED_LIMITS -768.0000 767.9766
 /begin AXIS_DESCR STD_AXIS Eng_nAvrg EngN 8 0.00 6000.000 FORMAT "%8.3" EXTENDED_LIMITS -32768.00 32767.00 DEPOSIT ABSOLUTE /end AXIS_DESCR
 /begin AXIS_DESCR STD_AXIS InjCtl_qSetUnBal InjMass 8 0.00 327.6700 FORMAT "%8.4" EXTENDED_LIMITS -327.6800 327.6700 DEPOSIT ABSOLUTE /end AXIS_DESCR
/end CHARACTERISTIC
/begin CHARACTERISTIC InjCrv_phiPiI1Rng0_MAP "Kennfeld 0 Förderbeginnermittlung Voreinspritzung" MAP 0x1DFE54 Kf_Xs16_Ys16_Ws16 109.9922 AngleCrS -60.00000 49.99219 FORMAT "%8.5" EXTENDED_LIMITS -768.0000 767.9766
 /begin AXIS_DESCR STD_AXIS Eng_nAvrg EngN 8 0.00 6000.000 FORMAT "%8.3" EXTENDED_LIMITS -32768.00 32767.00 DEPOSIT ABSOLUTE /end AXIS_DESCR
 /begin AXIS_DESCR STD_AXIS InjCtl_qSetUnBal InjMass 8 0.00 327.6700 FORMAT "%8.4" EXTENDED_LIMITS -327.6800 327.6700 DEPOSIT ABSOLUTE /end AXIS_DESCR
/end CHARACTERISTIC
/begin CHARACTERISTIC InjCrv_phiPiI1Rng1_MAP "Kennfeld 1 Förderbeginnermittlung Voreinspritzung" MAP 0x1DFEF8 Kf_Xs16_Ys16_Ws16 109.9922 AngleCrS -60.00000 49.99219 FORMAT "%8.5" EXTENDED_LIMITS -768.0000 767.9766
 /begin AXIS_DESCR STD_AXIS Eng_nAvrg EngN 8 0.00 6000.000 FORMAT "%8.3" EXTENDED_LIMITS -32768.00 32767.00 DEPOSIT ABSOLUTE /end AXIS_DESCR
 /begin AXIS_DESCR STD_AXIS InjCtl_qSetUnBal InjMass 8 0.00 327.6700 FORMAT "%8.4" EXTENDED_LIMITS -327.6800 327.6700 DEPOSIT ABSOLUTE /end AXIS_DESCR
/end CHARACTERISTIC
/begin CHARACTERISTIC InjCrv_phiPiI1Rng2_MAP "Kennfeld 2 Förderbeginnermittlung Voreinspritzung" MAP 0x1DFF9C Kf_Xs16_Ys16_Ws16 109.9922 AngleCrS -60.00000 49.99219 FORMAT "%8.5" EXTENDED_LIMITS -768.0000 767.9766
 /begin AXIS_DESCR STD_AXIS Eng_nAvrg EngN 8 0.00 6000.000 FORMAT "%8.3" EXTENDED_LIMITS -32768.00 32767.00 DEPOSIT ABSOLUTE /end AXIS_DESCR
 /begin AXIS_DESCR STD_AXIS InjCtl_qSetUnBal InjMass 8 0.00 327.6700 FORMAT "%8.4" EXTENDED_LIMITS -327.6800 327.6700 DEPOSIT ABSOLUTE /end AXIS_DESCR
/end CHARACTERISTIC
/begin CHARACTERISTIC InjCrv_phiPoI2HCDes_MAP "gweünschte Bezugswinkelkomponente für Beginn der PoI2 HC" MAP 0x1E073C Kf_Xs16_Ys16_Ws16 109.9922 AngleCrS -60.00000 49.99219 FORMAT "%8.5" EXTENDED_LIMITS -768.0000 767.9766
 /begin AXIS_DESCR STD_AXIS Eng_nAvrg EngN 10 0.00 6000.000 FORMAT "%8.3" EXTENDED_LIMITS -32768.00 32767.00 DEPOSIT ABSOLUTE /end AXIS_DESCR
 /begin AXIS_DESCR STD_AXIS InjCrv_qPoI2Op InjMass 10 0.00 327.6700 FORMAT "%8.4" EXTENDED_LIMITS -327.6800 327.6700 DEPOSIT ABSOLUTE /end AXIS_DESCR
/end CHARACTERISTIC
/begin CHARACTERISTIC InjCrv_phiPoI2Rgn10_MAP "Grundwert 0 für Förderbeginn NE im Reg. Mode 1" MAP 0x1E0830 Kf_Xs16_Ys16_Ws16 109.9922 AngleCrS -60.00000 49.99219 FORMAT "%8.5" EXTENDED_LIMITS -768.0000 767.9766
 /begin AXIS_DESCR STD_AXIS Eng_nAvrg EngN 16 0.00 6000.000 FORMAT "%8.3" EXTENDED_LIMITS -32768.00 32767.00 DEPOSIT ABSOLUTE /end AXIS_DESCR
 /begin AXIS_DESCR STD_AXIS InjCrv_qPoI2Op InjMass 16 0.00 327.6700 FORMAT "%8.4" EXTENDED_LIMITS -327.6800 327.6700 DEPOSIT ABSOLUTE /end AXIS_DESCR
/end CHARACTERISTIC
/begin CHARACTERISTIC InjCrv_phiPoI2Rgn11_MAP "Grundwert 1 für Förderbeginn NE im Reg. Mode 1" MAP 0x1E0A74 Kf_Xs16_Ys16_Ws16 109.9922 AngleCrS -60.00000 49.99219 FORMAT "%8.5" EXTENDED_LIMITS -768.0000 767.9766
 /begin AXIS_DESCR STD_AXIS Eng_nAvrg EngN 16 0.00 6000.000 FORMAT "%8.3" EXTENDED_LIMITS -32768.00 32767.00 DEPOSIT ABSOLUTE /end AXIS_DESCR
 /begin AXIS_DESCR STD_AXIS InjCrv_qPoI2Op InjMass 16 0.00 327.6700 FORMAT "%8.4" EXTENDED_LIMITS -327.6800 327.6700 DEPOSIT ABSOLUTE /end AXIS_DESCR
/end CHARACTERISTIC
/begin CHARACTERISTIC InjCrv_phiPoI2Rgn20_MAP "Grundwert 0 für Förderbeginn NE im Reg. Mode 2" MAP 0x1E0CB8 Kf_Xs16_Ys16_Ws16 109.9922 AngleCrS -60.00000 49.99219 FORMAT "%8.5" EXTENDED_LIMITS -768.0000 767.9766
 /begin AXIS_DESCR STD_AXIS Eng_nAvrg EngN 16 0.00 6000.000 FORMAT "%8.3" EXTENDED_LIMITS -32768.00 32767.00 DEPOSIT ABSOLUTE /end AXIS_DESCR
 /begin AXIS_DESCR STD_AXIS InjCrv_qPoI2Op InjMass 16 0.00 327.6700 FORMAT "%8.4" EXTENDED_LIMITS -327.6800 327.6700 DEPOSIT ABSOLUTE /end AXIS_DESCR
/end CHARACTERISTIC
/begin CHARACTERISTIC InjCrv_phiPoI2Rgn21_MAP "Grundwert 1 für Förderbeginn NE im Reg. Mode 2" MAP 0x1E0EFC Kf_Xs16_Ys16_Ws16 109.9922 AngleCrS -60.00000 49.99219 FORMAT "%8.5" EXTENDED_LIMITS -768.0000 767.9766
 /begin AXIS_DESCR STD_AXIS Eng_nAvrg EngN 16 0.00 6000.000 FORMAT "%8.3" EXTENDED_LIMITS -32768.00 32767.00 DEPOSIT ABSOLUTE /end AXIS_DESCR
 /begin AXIS_DESCR STD_AXIS InjCrv_qPoI2Op InjMass 16 0.00 327.6700 FORMAT "%8.4" EXTENDED_LIMITS -327.6800 327.6700 DEPOSIT ABSOLUTE /end AXIS_DESCR
/end CHARACTERISTIC
/begin CHARACTERISTIC InjCrv_phiPoI2Rgn30_MAP "Grundwert 0 für Förderbeginn NE im Reg. Mode 3" MAP 0x1E1140 Kf_Xs16_Ys16_Ws16 109.9922 AngleCrS -60.00000 49.99219 FORMAT "%8.5" EXTENDED_LIMITS -768.0000 767.9766
 /begin AXIS_DESCR STD_AXIS Eng_nAvrg EngN 16 0.00 6000.000 FORMAT "%8.3" EXTENDED_LIMITS -32768.00 32767.00 DEPOSIT ABSOLUTE /end AXIS_DESCR
 /begin AXIS_DESCR STD_AXIS InjCrv_qPoI2Op InjMass 16 0.00 327.6700 FORMAT "%8.4" EXTENDED_LIMITS -327.6800 327.6700 DEPOSIT ABSOLUTE /end AXIS_DESCR
/end CHARACTERISTIC
/begin CHARACTERISTIC InjCrv_phiPoI2Rgn31_MAP "Grundwert 1 für Förderbeginn NE im Reg. Mode 3" MAP 0x1E1384 Kf_Xs16_Ys16_Ws16 109.9922 AngleCrS -60.00000 49.99219 FORMAT "%8.5" EXTENDED_LIMITS -768.0000 767.9766
 /begin AXIS_DESCR STD_AXIS Eng_nAvrg EngN 16 0.00 6000.000 FORMAT "%8.3" EXTENDED_LIMITS -32768.00 32767.00 DEPOSIT ABSOLUTE /end AXIS_DESCR
 /begin AXIS_DESCR STD_AXIS InjCrv_qPoI2Op InjMass 16 0.00 327.6700 FORMAT "%8.4" EXTENDED_LIMITS -327.6800 327.6700 DEPOSIT ABSOLUTE /end AXIS_DESCR
/end CHARACTERISTIC
/begin CHARACTERISTIC InjCrv_phiPoI2Rgn40_MAP "Grundwert 0 für Förderbeginn NE im Reg. Mode 4" MAP 0x1E15C8 Kf_Xs16_Ys16_Ws16 109.9922 AngleCrS -60.00000 49.99219 FORMAT "%8.5" EXTENDED_LIMITS -768.0000 767.9766
 /begin AXIS_DESCR STD_AXIS Eng_nAvrg EngN 2 0.00 6000.000 FORMAT "%8.3" EXTENDED_LIMITS -32768.00 32767.00 DEPOSIT ABSOLUTE /end AXIS_DESCR
 /begin AXIS_DESCR STD_AXIS InjCrv_qPoI2Op InjMass 2 0.00 327.6700 FORMAT "%8.4" EXTENDED_LIMITS -327.6800 327.6700 DEPOSIT ABSOLUTE /end AXIS_DESCR
/end CHARACTERISTIC
/begin CHARACTERISTIC InjCrv_phiPoI2Rgn41_MAP "Grundwert 1 für Förderbeginn NE im Reg. Mode 4" MAP 0x1E15DC Kf_Xs16_Ys16_Ws16 109.9922 AngleCrS -60.00000 49.99219 FORMAT "%8.5" EXTENDED_LIMITS -768.0000 767.9766
 /begin AXIS_DESCR STD_AXIS Eng_nAvrg EngN 2 0.00 6000.000 FORMAT "%8.3" EXTENDED_LIMITS -32768.00 32767.00 DEPOSIT ABSOLUTE /end AXIS_DESCR
 /begin AXIS_DESCR STD_AXIS InjCrv_qPoI2Op InjMass 2 0.00 327.6700 FORMAT "%8.4" EXTENDED_LIMITS -327.6800 327.6700 DEPOSIT ABSOLUTE /end AXIS_DESCR
/end CHARACTERISTIC
/begin CHARACTERISTIC InjCrv_phiPoI2Std_C "Standardwert Förderbeginn Nacheinspritzung" VALUE 0x1E15F0 Kw_Ws16 109.9922 AngleCrS -60.00000 49.99219 FORMAT "%8.5" EXTENDED_LIMITS -768.0000 767.9766 /end CHARACTERISTIC
/begin CHARACTERISTIC InjCrv_tiPT1FBDynCor_C "Zeitkonstante des PT1-Gliedes zur Filterung der dynamischen Korrektur des FB" VALUE 0x1DD7BC Kw_Wu32 4294.9663 TimeDelay_s 0.0010000001 4294.9673 FORMAT "%9.4" EXTENDED_LIMITS 0.0000010000000 4294.9673 /end CHARACTERISTIC
/begin CHARACTERISTIC InjCrv_phiStartBackUpAddCor_C "Frühverschiebung Förderbeginn Haupteinspritzung im Notfahren" VALUE 0x1DB9E2 Kw_Ws16 30.00000 AngleCrS 0.00 30.00000 FORMAT "%8.5" EXTENDED_LIMITS -768.0000 767.9766 /end CHARACTERISTIC
/begin CHARACTERISTIC InjCrv_phiStartOn_C "Umschalter für Frühverstellung nach Start" VALUE 0x1DB9E4 Kw_Ws16 1.000000 OneToOne 0.00 1.000000 FORMAT "%8.6" EXTENDED_LIMITS -32768.00 32767.00 /end CHARACTERISTIC
/begin CHARACTERISTIC InjCrv_phiStrt0_GMAP "Förderbeginn Start-Korrektur" MAP 0x1DB9E6 Gkf_Ws16 109.9922 AngleCrS -60.00000 49.99219 FORMAT "%8.5" EXTENDED_LIMITS -768.0000 767.9766
 /begin AXIS_DESCR COM_AXIS Eng_nAvrg EngN 6 0.00 6000.000 FORMAT "%8.3" EXTENDED_LIMITS -32768.00 32767.00 AXIS_PTS_REF InjCrv_phiStrtX_AXIS /end AXIS_DESCR
 /begin AXIS_DESCR COM_AXIS InjCrv_tClnt Temp_Cels 10 -50.14000 149.8600 FORMAT "%8.4" EXTENDED_LIMITS -3549.940 3003.560 AXIS_PTS_REF InjCrv_phiStrtY_AXIS /end AXIS_DESCR
/end CHARACTERISTIC
/begin CHARACTERISTIC InjCrv_phiStrt1_GMAP "Förderbeginn Start-Korrektur" MAP 0x1DBA5E Gkf_Ws16 109.9922 AngleCrS -60.00000 49.99219 FORMAT "%8.5" EXTENDED_LIMITS -768.0000 767.9766
 /begin AXIS_DESCR COM_AXIS Eng_nAvrg EngN 6 0.00 6000.000 FORMAT "%8.3" EXTENDED_LIMITS -32768.00 32767.00 AXIS_PTS_REF InjCrv_phiStrtX_AXIS /end AXIS_DESCR
 /begin AXIS_DESCR COM_AXIS InjCrv_tClnt Temp_Cels 10 -50.14000 149.8600 FORMAT "%8.4" EXTENDED_LIMITS -3549.940 3003.560 AXIS_PTS_REF InjCrv_phiStrtY_AXIS /end AXIS_DESCR
/end CHARACTERISTIC
/begin CHARACTERISTIC InjCrv_phiStrt2_GMAP "Förderbeginn Start-Korrektur" MAP 0x1DBAD6 Gkf_Ws16 109.9922 AngleCrS -60.00000 49.99219 FORMAT "%8.5" EXTENDED_LIMITS -768.0000 767.9766
 /begin AXIS_DESCR COM_AXIS Eng_nAvrg EngN 6 0.00 6000.000 FORMAT "%8.3" EXTENDED_LIMITS -32768.00 32767.00 AXIS_PTS_REF InjCrv_phiStrtX_AXIS /end AXIS_DESCR
 /begin AXIS_DESCR COM_AXIS InjCrv_tClnt Temp_Cels 10 -50.14000 149.8600 FORMAT "%8.4" EXTENDED_LIMITS -3549.940 3003.560 AXIS_PTS_REF InjCrv_phiStrtY_AXIS /end AXIS_DESCR
/end CHARACTERISTIC
/begin CHARACTERISTIC InjCrv_phiStrt3_GMAP "Förderbeginn Start-Korrektur" MAP 0x1DBB4E Gkf_Ws16 109.9922 AngleCrS -60.00000 49.99219 FORMAT "%8.5" EXTENDED_LIMITS -768.0000 767.9766
 /begin AXIS_DESCR COM_AXIS Eng_nAvrg EngN 6 0.00 6000.000 FORMAT "%8.3" EXTENDED_LIMITS -32768.00 32767.00 AXIS_PTS_REF InjCrv_phiStrtX_AXIS /end AXIS_DESCR
 /begin AXIS_DESCR COM_AXIS InjCrv_tClnt Temp_Cels 10 -50.14000 149.8600 FORMAT "%8.4" EXTENDED_LIMITS -3549.940 3003.560 AXIS_PTS_REF InjCrv_phiStrtY_AXIS /end AXIS_DESCR
/end CHARACTERISTIC
/begin AXIS_PTS InjCrv_phiStrtX_AXIS "X-Achse für InjCrv_phiStrt<x>_GMAP" 0x1DBBC6 Eng_nAvrg GSst_Xs16 6000.000 EngN 6 0.00 6000.000 FORMAT "%8.3" EXTENDED_LIMITS -32768.00 32767.00 DEPOSIT ABSOLUTE /end AXIS_PTS
/begin AXIS_PTS InjCrv_phiStrtY_AXIS "Y-Achse für InjCrv_phiStrt<x>_GMAP" 0x1DBBD4 InjCrv_tClnt GSst_Xs16 200.0000 Temp_Cels 10 -50.14000 149.8600 FORMAT "%8.4" EXTENDED_LIMITS -3549.940 3003.560 DEPOSIT ABSOLUTE /end AXIS_PTS
/begin CHARACTERISTIC InjCrv_phiStrt_CUR "Förderbeginn Kennfeldauswahl der Start-Korrektur" CURVE 0x1DBBEA Kl_Xs16_Ws16 20.00000 Map_Select 0.00 20.00000 FORMAT "%8.5" EXTENDED_LIMITS -128.0000 127.9961
 /begin AXIS_DESCR STD_AXIS APSCD_pVal Pres_hPa 4 0.00 3500.000 FORMAT "%8.3" EXTENDED_LIMITS -32768.00 32767.00 DEPOSIT ABSOLUTE /end AXIS_DESCR
/end CHARACTERISTIC
/begin CHARACTERISTIC InjCrv_phiTrmDfl_C "Spritzbeginn-Sollwert Vorgabe Abgleichwert" VALUE 0x1DBBFC Kw_Ws16 99.98437 AngleCrS -49.99219 49.99219 FORMAT "%8.5" EXTENDED_LIMITS -768.0000 767.9766 /end CHARACTERISTIC
/begin CHARACTERISTIC InjCrv_phiTrmMax_C "Spritzbeginn-Sollwert Vorgabewert für Abgleich" VALUE 0x1DBBFE Kw_Ws16 99.98437 AngleCrS -49.99219 49.99219 FORMAT "%8.5" EXTENDED_LIMITS -768.0000 767.9766 /end CHARACTERISTIC
/begin CHARACTERISTIC InjCrv_phiTrmMin_C "Spritzbeginn-Sollwert min. Abgleichwert" VALUE 0x1DBC00 Kw_Ws16 99.98437 AngleCrS -49.99219 49.99219 FORMAT "%8.5" EXTENDED_LIMITS -768.0000 767.9766 /end CHARACTERISTIC
/begin CHARACTERISTIC InjCrv_qEGTCor10_MAP "Kennfeldwert 0 für Mengenkorrektur 1 Haupteinspritzung" MAP 0x1DEEFE Kf_Xs16_Ys16_Ws16 35.00000 InjMass 0.00 35.00000 FORMAT "%8.5" EXTENDED_LIMITS -327.6800 327.6700
 /begin AXIS_DESCR STD_AXIS Eng_nAvrg EngN 16 0.00 6000.000 FORMAT "%8.3" EXTENDED_LIMITS -32768.00 32767.00 DEPOSIT ABSOLUTE /end AXIS_DESCR
 /begin AXIS_DESCR STD_AXIS InjCrv_qPoI2Op InjMass 16 0.00 327.6700 FORMAT "%8.4" EXTENDED_LIMITS -327.6800 327.6700 DEPOSIT ABSOLUTE /end AXIS_DESCR
/end CHARACTERISTIC
/begin CHARACTERISTIC InjCrv_qEGTCor11_MAP "Kennfeldwert 1 für Mengenkorrektur 1 Haupteinspritzung" MAP 0x1DF142 Kf_Xs16_Ys16_Ws16 35.00000 InjMass 0.00 35.00000 FORMAT "%8.5" EXTENDED_LIMITS -327.6800 327.6700
 /begin AXIS_DESCR STD_AXIS Eng_nAvrg EngN 16 0.00 6000.000 FORMAT "%8.3" EXTENDED_LIMITS -32768.00 32767.00 DEPOSIT ABSOLUTE /end AXIS_DESCR
 /begin AXIS_DESCR STD_AXIS InjCrv_qPoI2Op InjMass 16 0.00 327.6700 FORMAT "%8.4" EXTENDED_LIMITS -327.6800 327.6700 DEPOSIT ABSOLUTE /end AXIS_DESCR
/end CHARACTERISTIC
/begin CHARACTERISTIC InjCrv_qEGTCor20_MAP "Kennfeldwert 0 für Mengenkorrektur 2 Haupteinspritzung" MAP 0x1DF386 Kf_Xs16_Ys16_Ws16 35.00000 InjMass 0.00 35.00000 FORMAT "%8.5" EXTENDED_LIMITS -327.6800 327.6700
 /begin AXIS_DESCR STD_AXIS Eng_nAvrg EngN 16 0.00 6000.000 FORMAT "%8.3" EXTENDED_LIMITS -32768.00 32767.00 DEPOSIT ABSOLUTE /end AXIS_DESCR
 /begin AXIS_DESCR STD_AXIS InjCrv_qPoI2Op InjMass 16 0.00 327.6700 FORMAT "%8.4" EXTENDED_LIMITS -327.6800 327.6700 DEPOSIT ABSOLUTE /end AXIS_DESCR
/end CHARACTERISTIC
/begin CHARACTERISTIC InjCrv_qEGTCor21_MAP "Kennfeldwert 1 für Mengenkorrektur 2 Haupteinspritzung" MAP 0x1DF5CA Kf_Xs16_Ys16_Ws16 35.00000 InjMass 0.00 35.00000 FORMAT "%8.5" EXTENDED_LIMITS -327.6800 327.6700
 /begin AXIS_DESCR STD_AXIS Eng_nAvrg EngN 16 0.00 6000.000 FORMAT "%8.3" EXTENDED_LIMITS -32768.00 32767.00 DEPOSIT ABSOLUTE /end AXIS_DESCR
 /begin AXIS_DESCR STD_AXIS InjCrv_qPoI2Op InjMass 16 0.00 327.6700 FORMAT "%8.4" EXTENDED_LIMITS -327.6800 327.6700 DEPOSIT ABSOLUTE /end AXIS_DESCR
/end CHARACTERISTIC
/begin CHARACTERISTIC InjCrv_qEGTCor30_MAP "Kennfeldwert 0 für Mengenkorrektur 3 Haupteinspritzung" MAP 0x1DF80E Kf_Xs16_Ys16_Ws16 35.00000 InjMass 0.00 35.00000 FORMAT "%8.5" EXTENDED_LIMITS -327.6800 327.6700
 /begin AXIS_DESCR STD_AXIS Eng_nAvrg EngN 16 0.00 6000.000 FORMAT "%8.3" EXTENDED_LIMITS -32768.00 32767.00 DEPOSIT ABSOLUTE /end AXIS_DESCR
 /begin AXIS_DESCR STD_AXIS InjCrv_qPoI2Op InjMass 16 0.00 327.6700 FORMAT "%8.4" EXTENDED_LIMITS -327.6800 327.6700 DEPOSIT ABSOLUTE /end AXIS_DESCR
/end CHARACTERISTIC
/begin CHARACTERISTIC InjCrv_qEGTCor31_MAP "Kennfeldwert 1 für Mengenkorrektur 3 Haupteinspritzung" MAP 0x1DFA52 Kf_Xs16_Ys16_Ws16 35.00000 InjMass 0.00 35.00000 FORMAT "%8.5" EXTENDED_LIMITS -327.6800 327.6700
 /begin AXIS_DESCR STD_AXIS Eng_nAvrg EngN 16 0.00 6000.000 FORMAT "%8.3" EXTENDED_LIMITS -32768.00 32767.00 DEPOSIT ABSOLUTE /end AXIS_DESCR
 /begin AXIS_DESCR STD_AXIS InjCrv_qPoI2Op InjMass 16 0.00 327.6700 FORMAT "%8.4" EXTENDED_LIMITS -327.6800 327.6700 DEPOSIT ABSOLUTE /end AXIS_DESCR
/end CHARACTERISTIC
/begin CHARACTERISTIC InjCrv_qEGTCor40_MAP "Kennfeldwert 0 für Mengenkorrektur 4 Haupteinspritzung" MAP 0x1DFC96 Kf_Xs16_Ys16_Ws16 35.00000 InjMass 0.00 35.00000 FORMAT "%8.5" EXTENDED_LIMITS -327.6800 327.6700
 /begin AXIS_DESCR STD_AXIS Eng_nAvrg EngN 2 0.00 6000.000 FORMAT "%8.3" EXTENDED_LIMITS -32768.00 32767.00 DEPOSIT ABSOLUTE /end AXIS_DESCR
 /begin AXIS_DESCR STD_AXIS InjCrv_qPoI2Op InjMass 2 0.00 327.6700 FORMAT "%8.4" EXTENDED_LIMITS -327.6800 327.6700 DEPOSIT ABSOLUTE /end AXIS_DESCR
/end CHARACTERISTIC
/begin CHARACTERISTIC InjCrv_qEGTCor41_MAP "Kennfeldwert 1 für Mengenkorrektur 4 Haupteinspritzung" MAP 0x1DFCAA Kf_Xs16_Ys16_Ws16 35.00000 InjMass 0.00 35.00000 FORMAT "%8.5" EXTENDED_LIMITS -327.6800 327.6700
 /begin AXIS_DESCR STD_AXIS Eng_nAvrg EngN 2 0.00 6000.000 FORMAT "%8.3" EXTENDED_LIMITS -32768.00 32767.00 DEPOSIT ABSOLUTE /end AXIS_DESCR
 /begin AXIS_DESCR STD_AXIS InjCrv_qPoI2Op InjMass 2 0.00 327.6700 FORMAT "%8.4" EXTENDED_LIMITS -327.6800 327.6700 DEPOSIT ABSOLUTE /end AXIS_DESCR
/end CHARACTERISTIC
/begin CHARACTERISTIC InjCrv_qEGTCorStd_C "Standardwert Mengenkorrektur Haupteinspritzung" VALUE 0x1DFCBE Kw_Ws16 327.6700 InjMass 0.00 327.6700 FORMAT "%8.4" EXTENDED_LIMITS -327.6800 327.6700 /end CHARACTERISTIC
/begin CHARACTERISTIC InjCrv_qPiI1Rng0_MAP "Kennfeld 0 Mengenauswahl Voreinspritzung" MAP 0x1E0040 Kf_Xs16_Ys16_Ws16 30.00000 InjMass 0.00 30.00000 FORMAT "%8.5" EXTENDED_LIMITS -327.6800 327.6700
 /begin AXIS_DESCR STD_AXIS Eng_nAvrg EngN 8 0.00 6000.000 FORMAT "%8.3" EXTENDED_LIMITS -32768.00 32767.00 DEPOSIT ABSOLUTE /end AXIS_DESCR
 /begin AXIS_DESCR STD_AXIS InjCtl_qSetUnBal InjMass 8 0.00 327.6700 FORMAT "%8.4" EXTENDED_LIMITS -327.6800 327.6700 DEPOSIT ABSOLUTE /end AXIS_DESCR
/end CHARACTERISTIC
/begin CHARACTERISTIC InjCrv_qPiI1Rng1_MAP "Kennfeld 1 Mengenauswahl Voreinspritzung" MAP 0x1E00E4 Kf_Xs16_Ys16_Ws16 30.00000 InjMass 0.00 30.00000 FORMAT "%8.5" EXTENDED_LIMITS -327.6800 327.6700
 /begin AXIS_DESCR STD_AXIS Eng_nAvrg EngN 8 0.00 6000.000 FORMAT "%8.3" EXTENDED_LIMITS -32768.00 32767.00 DEPOSIT ABSOLUTE /end AXIS_DESCR
 /begin AXIS_DESCR STD_AXIS InjCtl_qSetUnBal InjMass 8 0.00 327.6700 FORMAT "%8.4" EXTENDED_LIMITS -327.6800 327.6700 DEPOSIT ABSOLUTE /end AXIS_DESCR
/end CHARACTERISTIC
/begin CHARACTERISTIC InjCrv_qPiI1Rng2_MAP "Kennfeld 2 Mengenauswahl Voreinspritzung" MAP 0x1E0188 Kf_Xs16_Ys16_Ws16 30.00000 InjMass 0.00 30.00000 FORMAT "%8.5" EXTENDED_LIMITS -327.6800 327.6700
 /begin AXIS_DESCR STD_AXIS Eng_nAvrg EngN 8 0.00 6000.000 FORMAT "%8.3" EXTENDED_LIMITS -32768.00 32767.00 DEPOSIT ABSOLUTE /end AXIS_DESCR
 /begin AXIS_DESCR STD_AXIS InjCtl_qSetUnBal InjMass 8 0.00 327.6700 FORMAT "%8.4" EXTENDED_LIMITS -327.6800 327.6700 DEPOSIT ABSOLUTE /end AXIS_DESCR
/end CHARACTERISTIC
/begin CHARACTERISTIC InjCrv_qPoI2HCAvrgCor_MAP "mittlere Zusatzmenge der HC-Nacheinspritzung" MAP 0x1E15F2 Kf_Xs16_Ys16_Ws16 327.6700 InjMass 0.00 327.6700 FORMAT "%8.4" EXTENDED_LIMITS -327.6800 327.6700
 /begin AXIS_DESCR STD_AXIS Eng_nAvrg EngN 10 0.00 6000.000 FORMAT "%8.3" EXTENDED_LIMITS -32768.00 32767.00 DEPOSIT ABSOLUTE /end AXIS_DESCR
 /begin AXIS_DESCR STD_AXIS InjCrv_qPoI2Op InjMass 10 0.00 327.6700 FORMAT "%8.4" EXTENDED_LIMITS -327.6800 327.6700 DEPOSIT ABSOLUTE /end AXIS_DESCR
/end CHARACTERISTIC
/begin CHARACTERISTIC InjCrv_qPoI2HCFBCCor_MAP "Kennfeld für die Korrekturmenge bei PoI2HC für die Laufruheanpassung" MAP 0x1E16E6 Kf_Xs16_Ys16_Ws16 655.3500 InjMass -327.6800 327.6700 FORMAT "%8.4"
 /begin AXIS_DESCR STD_AXIS Eng_nAvrg EngN 10 0.00 6000.000 FORMAT "%8.3" EXTENDED_LIMITS -32768.00 32767.00 DEPOSIT ABSOLUTE /end AXIS_DESCR
 /begin AXIS_DESCR STD_AXIS InjCrv_qPoI2Op InjMass 10 0.00 327.6700 FORMAT "%8.4" EXTENDED_LIMITS -327.6800 327.6700 DEPOSIT ABSOLUTE /end AXIS_DESCR
/end CHARACTERISTIC
/begin CHARACTERISTIC InjCrv_qPoI2HCHiOff_CUR "obere drehzahlabhängige Hystereseschwelle für Abschaltung PoI2 HC wegen zu großer PoI2 Menge" CURVE 0x1E17DA Kl_Xs16_Ws16 327.6700 InjMass 0.00 327.6700 FORMAT "%8.4" EXTENDED_LIMITS -327.6800 327.6700
 /begin AXIS_DESCR STD_AXIS Eng_nAvrg EngN 12 0.00 6000.000 FORMAT "%8.3" EXTENDED_LIMITS -32768.00 32767.00 DEPOSIT ABSOLUTE /end AXIS_DESCR
/end CHARACTERISTIC
/begin CHARACTERISTIC InjCrv_qPoI2HCHiOn_CUR "untere drehzahlabhängige Hystereseschwelle für Abschaltung PoI2 HC wegen zu großer PoI2 Menge" CURVE 0x1E180C Kl_Xs16_Ws16 327.6700 InjMass 0.00 327.6700 FORMAT "%8.4" EXTENDED_LIMITS -327.6800 327.6700
 /begin AXIS_DESCR STD_AXIS Eng_nAvrg EngN 12 0.00 6000.000 FORMAT "%8.3" EXTENDED_LIMITS -32768.00 32767.00 DEPOSIT ABSOLUTE /end AXIS_DESCR
/end CHARACTERISTIC
/begin CHARACTERISTIC InjCrv_qPoI2HCLoOff_CUR "obere drehzahlabhängige Hystereseschwelle für Abschaltung PoI2 HC wegen zu kleiner PoI2 Menge" CURVE 0x1E183E Kl_Xs16_Ws16 327.6700 InjMass 0.00 327.6700 FORMAT "%8.4" EXTENDED_LIMITS -327.6800 327.6700
 /begin AXIS_DESCR STD_AXIS Eng_nAvrg EngN 12 0.00 6000.000 FORMAT "%8.3" EXTENDED_LIMITS -32768.00 32767.00 DEPOSIT ABSOLUTE /end AXIS_DESCR
/end CHARACTERISTIC
/begin CHARACTERISTIC InjCrv_qPoI2HCLoOn_CUR "untere drehzahlabhängige Hystereseschwelle für Abschaltung PoI2 HC wegen zu kleiner PoI2 Menge" CURVE 0x1E1870 Kl_Xs16_Ws16 327.6700 InjMass 0.00 327.6700 FORMAT "%8.4" EXTENDED_LIMITS -327.6800 327.6700
 /begin AXIS_DESCR STD_AXIS Eng_nAvrg EngN 12 0.00 6000.000 FORMAT "%8.3" EXTENDED_LIMITS -32768.00 32767.00 DEPOSIT ABSOLUTE /end AXIS_DESCR
/end CHARACTERISTIC
/begin CHARACTERISTIC InjCrv_qPoI2HCTrqCor_MAP "Kennfeld für Korrekturmenge bei PoI2HC für Momentenkompensation" MAP 0x1E18A2 Kf_Xs16_Ys16_Ws16 655.3500 InjMass -327.6800 327.6700 FORMAT "%8.4"
 /begin AXIS_DESCR STD_AXIS Eng_nAvrg EngN 10 0.00 6000.000 FORMAT "%8.3" EXTENDED_LIMITS -32768.00 32767.00 DEPOSIT ABSOLUTE /end AXIS_DESCR
 /begin AXIS_DESCR STD_AXIS InjCrv_qPoI2Op InjMass 10 0.00 327.6700 FORMAT "%8.4" EXTENDED_LIMITS -327.6800 327.6700 DEPOSIT ABSOLUTE /end AXIS_DESCR
/end CHARACTERISTIC
/begin CHARACTERISTIC InjCrv_qPoI2Rgn10_MAP "Grundwert 0 für Menge NE im Reg. Mode 1" MAP 0x1E1996 Kf_Xs16_Ys16_Ws16 30.00000 InjMass 0.00 30.00000 FORMAT "%8.5" EXTENDED_LIMITS -327.6800 327.6700
 /begin AXIS_DESCR STD_AXIS Eng_nAvrg EngN 16 0.00 6000.000 FORMAT "%8.3" EXTENDED_LIMITS -32768.00 32767.00 DEPOSIT ABSOLUTE /end AXIS_DESCR
 /begin AXIS_DESCR STD_AXIS InjCrv_qPoI2Op InjMass 16 0.00 327.6700 FORMAT "%8.4" EXTENDED_LIMITS -327.6800 327.6700 DEPOSIT ABSOLUTE /end AXIS_DESCR
/end CHARACTERISTIC
/begin CHARACTERISTIC InjCrv_qPoI2Rgn11_MAP "Grundwert 1 für Menge NE im Reg. Mode 1" MAP 0x1E1BDA Kf_Xs16_Ys16_Ws16 30.00000 InjMass 0.00 30.00000 FORMAT "%8.5" EXTENDED_LIMITS -327.6800 327.6700
 /begin AXIS_DESCR STD_AXIS Eng_nAvrg EngN 16 0.00 6000.000 FORMAT "%8.3" EXTENDED_LIMITS -32768.00 32767.00 DEPOSIT ABSOLUTE /end AXIS_DESCR
 /begin AXIS_DESCR STD_AXIS InjCrv_qPoI2Op InjMass 16 0.00 327.6700 FORMAT "%8.4" EXTENDED_LIMITS -327.6800 327.6700 DEPOSIT ABSOLUTE /end AXIS_DESCR
/end CHARACTERISTIC
/begin CHARACTERISTIC InjCrv_qPoI2Rgn20_MAP "Grundwert 0 für Menge NE im Reg. Mode 2" MAP 0x1E1E1E Kf_Xs16_Ys16_Ws16 30.00000 InjMass 0.00 30.00000 FORMAT "%8.5" EXTENDED_LIMITS -327.6800 327.6700
 /begin AXIS_DESCR STD_AXIS Eng_nAvrg EngN 16 0.00 6000.000 FORMAT "%8.3" EXTENDED_LIMITS -32768.00 32767.00 DEPOSIT ABSOLUTE /end AXIS_DESCR
 /begin AXIS_DESCR STD_AXIS InjCrv_qPoI2Op InjMass 16 0.00 327.6700 FORMAT "%8.4" EXTENDED_LIMITS -327.6800 327.6700 DEPOSIT ABSOLUTE /end AXIS_DESCR
/end CHARACTERISTIC
/begin CHARACTERISTIC InjCrv_qPoI2Rgn21_MAP "Grundwert 1 für Menge NE im Reg. Mode 2" MAP 0x1E2062 Kf_Xs16_Ys16_Ws16 30.00000 InjMass 0.00 30.00000 FORMAT "%8.5" EXTENDED_LIMITS -327.6800 327.6700
 /begin AXIS_DESCR STD_AXIS Eng_nAvrg EngN 16 0.00 6000.000 FORMAT "%8.3" EXTENDED_LIMITS -32768.00 32767.00 DEPOSIT ABSOLUTE /end AXIS_DESCR
 /begin AXIS_DESCR STD_AXIS InjCrv_qPoI2Op InjMass 16 0.00 327.6700 FORMAT "%8.4" EXTENDED_LIMITS -327.6800 327.6700 DEPOSIT ABSOLUTE /end AXIS_DESCR
/end CHARACTERISTIC
/begin CHARACTERISTIC InjCrv_qPoI2Rgn30_MAP "Grundwert 0 für Menge NE im Reg. Mode 3" MAP 0x1E22A6 Kf_Xs16_Ys16_Ws16 30.00000 InjMass 0.00 30.00000 FORMAT "%8.5" EXTENDED_LIMITS -327.6800 327.6700
 /begin AXIS_DESCR STD_AXIS Eng_nAvrg EngN 16 0.00 6000.000 FORMAT "%8.3" EXTENDED_LIMITS -32768.00 32767.00 DEPOSIT ABSOLUTE /end AXIS_DESCR
 /begin AXIS_DESCR STD_AXIS InjCrv_qPoI2Op InjMass 16 0.00 327.6700 FORMAT "%8.4" EXTENDED_LIMITS -327.6800 327.6700 DEPOSIT ABSOLUTE /end AXIS_DESCR
/end CHARACTERISTIC
/begin CHARACTERISTIC InjCrv_qPoI2Rgn31_MAP "Grundwert 1 für Menge NE im Reg. Mode 3" MAP 0x1E24EA Kf_Xs16_Ys16_Ws16 30.00000 InjMass 0.00 30.00000 FORMAT "%8.5" EXTENDED_LIMITS -327.6800 327.6700
 /begin AXIS_DESCR STD_AXIS Eng_nAvrg EngN 16 0.00 6000.000 FORMAT "%8.3" EXTENDED_LIMITS -32768.00 32767.00 DEPOSIT ABSOLUTE /end AXIS_DESCR
 /begin AXIS_DESCR STD_AXIS InjCrv_qPoI2Op InjMass 16 0.00 327.6700 FORMAT "%8.4" EXTENDED_LIMITS -327.6800 327.6700 DEPOSIT ABSOLUTE /end AXIS_DESCR
/end CHARACTERISTIC
/begin CHARACTERISTIC InjCrv_qPoI2Rgn40_MAP "Grundwert 0 für Menge NE im Reg. Mode 4" MAP 0x1E272E Kf_Xs16_Ys16_Ws16 30.00000 InjMass 0.00 30.00000 FORMAT "%8.5" EXTENDED_LIMITS -327.6800 327.6700
 /begin AXIS_DESCR STD_AXIS Eng_nAvrg EngN 2 0.00 6000.000 FORMAT "%8.3" EXTENDED_LIMITS -32768.00 32767.00 DEPOSIT ABSOLUTE /end AXIS_DESCR
 /begin AXIS_DESCR STD_AXIS InjCrv_qPoI2Op InjMass 2 0.00 327.6700 FORMAT "%8.4" EXTENDED_LIMITS -327.6800 327.6700 DEPOSIT ABSOLUTE /end AXIS_DESCR
/end CHARACTERISTIC
/begin CHARACTERISTIC InjCrv_qPoI2Rgn41_MAP "Grundwert 1 für Menge NE im Reg. Mode 4" MAP 0x1E2742 Kf_Xs16_Ys16_Ws16 30.00000 InjMass 0.00 30.00000 FORMAT "%8.5" EXTENDED_LIMITS -327.6800 327.6700
 /begin AXIS_DESCR STD_AXIS Eng_nAvrg EngN 2 0.00 6000.000 FORMAT "%8.3" EXTENDED_LIMITS -32768.00 32767.00 DEPOSIT ABSOLUTE /end AXIS_DESCR
 /begin AXIS_DESCR STD_AXIS InjCrv_qPoI2Op InjMass 2 0.00 327.6700 FORMAT "%8.4" EXTENDED_LIMITS -327.6800 327.6700 DEPOSIT ABSOLUTE /end AXIS_DESCR
/end CHARACTERISTIC
/begin CHARACTERISTIC InjCrv_rFBDynEGRMax_C "ARF- obere Grenzen, unterhalb welcher eine dynamische Korrektur stattfindet" VALUE 0x1DD9E8 Kw_Ws16 100.0000 DtyCyc 0.00 100.0000 FORMAT "%8.4" EXTENDED_LIMITS -327.6800 327.6700 /end CHARACTERISTIC
/begin CHARACTERISTIC InjCrv_rFBDynEGRMin_C "ARF- untere Grenzen, oberhalb welcher eine dynamische Korrektur stattfindet" VALUE 0x1DD9EA Kw_Ws16 100.0000 DtyCyc 0.00 100.0000 FORMAT "%8.4" EXTENDED_LIMITS -327.6800 327.6700 /end CHARACTERISTIC
/begin CHARACTERISTIC InjCrv_rPoI2HCHysQnt_C "Nacheinspritzmengenl-Hystereseschwelle zur Bestimmung der PoI2-Periode" VALUE 0x1E2756 Kw_Wu16 50.00000 Prc 0.00 50.00000 FORMAT "%8.5" EXTENDED_LIMITS 0.00 655.3500 /end CHARACTERISTIC
/begin CHARACTERISTIC InjCrv_rPoI2HCHysSpd_C "Drehzahl-Hystereseschwelle zur Bestimmung der PoI2-Periode" VALUE 0x1E2758 Kw_Wu16 50.00000 Prc 0.00 50.00000 FORMAT "%8.5" EXTENDED_LIMITS 0.00 655.3500 /end CHARACTERISTIC
/begin CHARACTERISTIC InjCrv_stPiI1RlsEGT_C "Voreinspritzfreigabe in Abhängigkeit des Regenerationszustandes" VALUE 0x1E0234 Kw_Wu32 2147483647.00 OneToOne 0.00 2147483647.00 FORMAT "%13.2" EXTENDED_LIMITS 0.00 4294967295.00 /end CHARACTERISTIC
/begin CHARACTERISTIC InjCrv_stPiI1RlsOff0_MAP "Ausschaltkennfeld 0 Voreinspritzung" MAP 0x1E0238 Kf_Xs16_Ys16_Ws16 1.000000 OneToOne 0.00 1.000000 FORMAT "%8.6" EXTENDED_LIMITS -32768.00 32767.00
 /begin AXIS_DESCR STD_AXIS Eng_nAvrg EngN 8 0.00 6000.000 FORMAT "%8.3" EXTENDED_LIMITS -32768.00 32767.00 DEPOSIT ABSOLUTE /end AXIS_DESCR
 /begin AXIS_DESCR STD_AXIS InjCtl_qSetUnBal InjMass 8 0.00 327.6700 FORMAT "%8.4" EXTENDED_LIMITS -327.6800 327.6700 DEPOSIT ABSOLUTE /end AXIS_DESCR
/end CHARACTERISTIC
/begin CHARACTERISTIC InjCrv_stPiI1RlsOff1_MAP "Ausschaltkennfeld 1 Voreinspritzung" MAP 0x1E02DC Kf_Xs16_Ys16_Ws16 1.000000 OneToOne 0.00 1.000000 FORMAT "%8.6" EXTENDED_LIMITS -32768.00 32767.00
 /begin AXIS_DESCR STD_AXIS Eng_nAvrg EngN 8 0.00 6000.000 FORMAT "%8.3" EXTENDED_LIMITS -32768.00 32767.00 DEPOSIT ABSOLUTE /end AXIS_DESCR
 /begin AXIS_DESCR STD_AXIS InjCtl_qSetUnBal InjMass 8 0.00 327.6700 FORMAT "%8.4" EXTENDED_LIMITS -327.6800 327.6700 DEPOSIT ABSOLUTE /end AXIS_DESCR
/end CHARACTERISTIC
/begin CHARACTERISTIC InjCrv_stPiI1RlsOff2_MAP "Ausschaltkennfeld 2 Voreinspritzung" MAP 0x1E0380 Kf_Xs16_Ys16_Ws16 1.000000 OneToOne 0.00 1.000000 FORMAT "%8.6" EXTENDED_LIMITS -32768.00 32767.00
 /begin AXIS_DESCR STD_AXIS Eng_nAvrg EngN 8 0.00 6000.000 FORMAT "%8.3" EXTENDED_LIMITS -32768.00 32767.00 DEPOSIT ABSOLUTE /end AXIS_DESCR
 /begin AXIS_DESCR STD_AXIS InjCtl_qSetUnBal InjMass 8 0.00 327.6700 FORMAT "%8.4" EXTENDED_LIMITS -327.6800 327.6700 DEPOSIT ABSOLUTE /end AXIS_DESCR
/end CHARACTERISTIC
/begin CHARACTERISTIC InjCrv_stPiI1RlsOn0_MAP "Einschaltkennfeld 0 Voreinspritzung" MAP 0x1E0424 Kf_Xs16_Ys16_Ws16 1.000000 OneToOne 0.00 1.000000 FORMAT "%8.6" EXTENDED_LIMITS -32768.00 32767.00
 /begin AXIS_DESCR STD_AXIS Eng_nAvrg EngN 8 0.00 6000.000 FORMAT "%8.3" EXTENDED_LIMITS -32768.00 32767.00 DEPOSIT ABSOLUTE /end AXIS_DESCR
 /begin AXIS_DESCR STD_AXIS InjCtl_qSetUnBal InjMass 8 0.00 327.6700 FORMAT "%8.4" EXTENDED_LIMITS -327.6800 327.6700 DEPOSIT ABSOLUTE /end AXIS_DESCR
/end CHARACTERISTIC
/begin CHARACTERISTIC InjCrv_stPiI1RlsOn1_MAP "Einschaltkennfeld 1 Voreinspritzung" MAP 0x1E04C8 Kf_Xs16_Ys16_Ws16 1.000000 OneToOne 0.00 1.000000 FORMAT "%8.6" EXTENDED_LIMITS -32768.00 32767.00
 /begin AXIS_DESCR STD_AXIS Eng_nAvrg EngN 8 0.00 6000.000 FORMAT "%8.3" EXTENDED_LIMITS -32768.00 32767.00 DEPOSIT ABSOLUTE /end AXIS_DESCR
 /begin AXIS_DESCR STD_AXIS InjCtl_qSetUnBal InjMass 8 0.00 327.6700 FORMAT "%8.4" EXTENDED_LIMITS -327.6800 327.6700 DEPOSIT ABSOLUTE /end AXIS_DESCR
/end CHARACTERISTIC
/begin CHARACTERISTIC InjCrv_stPiI1RlsOn2_MAP "Einschaltkennfeld 2 Voreinspritzung" MAP 0x1E056C Kf_Xs16_Ys16_Ws16 1.000000 OneToOne 0.00 1.000000 FORMAT "%8.6" EXTENDED_LIMITS -32768.00 32767.00
 /begin AXIS_DESCR STD_AXIS Eng_nAvrg EngN 8 0.00 6000.000 FORMAT "%8.3" EXTENDED_LIMITS -32768.00 32767.00 DEPOSIT ABSOLUTE /end AXIS_DESCR
 /begin AXIS_DESCR STD_AXIS InjCtl_qSetUnBal InjMass 8 0.00 327.6700 FORMAT "%8.4" EXTENDED_LIMITS -327.6800 327.6700 DEPOSIT ABSOLUTE /end AXIS_DESCR
/end CHARACTERISTIC
/begin CHARACTERISTIC InjCrv_stPoI2HCOffMsk_C "Regenerationsmaske für Freigabe PoI2 HC" VALUE 0x1E275A Kw_Wu16 65535.00 OneToOne 0.00 65535.00 FORMAT "%8.2" /end CHARACTERISTIC
/begin CHARACTERISTIC InjCrv_nPoI2On_C "Einschaltschwelle der Nacheinspritzfunktion über Drehzahl" VALUE 0x1E276C Kw_Ws16 6000.000 EngN 0.00 6000.000 FORMAT "%8.3" EXTENDED_LIMITS -32768.00 32767.00 /end CHARACTERISTIC
/begin CHARACTERISTIC InjCrv_nPoI2Off_C "Ausschaltschwelle der Nacheinspritzfunktion über Drehzahl" VALUE 0x1E276E Kw_Ws16 6000.000 EngN 0.00 6000.000 FORMAT "%8.3" EXTENDED_LIMITS -32768.00 32767.00 /end CHARACTERISTIC
/begin CHARACTERISTIC InjCrv_stPoI2Act_C "Ausgabewert bei aktiver Nacheinspritzberechnung" VALUE 0x1E2770 Kw_Ws16 65535.00 OneToOne -32768.00 32767.00 FORMAT "%8.2" READ_ONLY /end CHARACTERISTIC
/begin CHARACTERISTIC InjCrv_stPoI2NoAct_C "Ausgabewert bei nicht aktiver Nacheinspritzberechnung" VALUE 0x1E2772 Kw_Ws16 65535.00 OneToOne -32768.00 32767.00 FORMAT "%8.2" READ_ONLY /end CHARACTERISTIC
/begin CHARACTERISTIC InjCrv_nPiI1On_C "Zuschaltschwelle der Voreinspritzberechnung" VALUE 0x1E0610 Kw_Ws16 6000.000 EngN 0.00 6000.000 FORMAT "%8.3" EXTENDED_LIMITS -32768.00 32767.00 /end CHARACTERISTIC
/begin CHARACTERISTIC InjCrv_nPiI1Off_C "Abschaltschwelle Voreinspritzberechnung" VALUE 0x1E0612 Kw_Ws16 6000.000 EngN 0.00 6000.000 FORMAT "%8.3" EXTENDED_LIMITS -32768.00 32767.00 /end CHARACTERISTIC
/begin CHARACTERISTIC InjCrv_stPiI1Act_C "Aktivierungskonstante Voreinspritzung (aktiv)" VALUE 0x1E0614 Kw_Ws16 65535.00 OneToOne -32768.00 32767.00 FORMAT "%8.2" READ_ONLY /end CHARACTERISTIC
/begin CHARACTERISTIC InjCrv_stPiI1NoAct_C "Aktivierungskonstante Voreinspritzung ( nicht aktiv)" VALUE 0x1E0616 Kw_Ws16 65535.00 OneToOne -32768.00 32767.00 FORMAT "%8.2" READ_ONLY /end CHARACTERISTIC
/begin CHARACTERISTIC InjCrv_swtCTSDfl_C "Auswahl Ersatzwert für InjCrv_tCInt bei defektem Temperatursensor" VALUE 0x1DD7C0 Kw_Wu8 1.000 OneToOne 0.00 1.000 FORMAT "%5.3" EXTENDED_LIMITS 0.00 255.0 /end CHARACTERISTIC
/begin CHARACTERISTIC InjCrv_swtDynCor_C "Schalter zur Aktivierung der dynamischen Korrektur" VALUE 0x1DD7C1 Kw_Wu8 1.000 OneToOne 0.00 1.000 FORMAT "%5.3" EXTENDED_LIMITS 0.00 255.0 /end CHARACTERISTIC
/begin CHARACTERISTIC InjCrv_swtDyn_C "Schalter für dynamische Frühverstellung" VALUE 0x1DBC02 Kw_Wu8 1.000 OneToOne 0.00 1.000 FORMAT "%5.3" EXTENDED_LIMITS 0.00 255.0 /end CHARACTERISTIC
/begin CHARACTERISTIC InjCrv_swtFBDynEnaAll_C "Schalter zu parallel Schaltung beider dynamischen Korrekturen des FB" VALUE 0x1DD9EC Kw_Wu8 1.000 OneToOne 0.00 1.000 FORMAT "%5.3" EXTENDED_LIMITS 0.00 255.0 /end CHARACTERISTIC
/begin CHARACTERISTIC InjCrv_swtPoI2HCLmbd_C "Überbrückungsanforderung Lamdaregler bei aktiver HC Nacheinspritzung" VALUE 0x1E3338 Kw_Wu8 1.000 OneToOne 0.00 1.000 FORMAT "%5.3" EXTENDED_LIMITS 0.00 255.0 /end CHARACTERISTIC
/begin CHARACTERISTIC InjCrv_swtPoI2HCT3_C "Überbrückungsanforderung T3-Regler bei aktiver HC Nacheinspritzung" VALUE 0x1E3339 Kw_Wu8 1.000 OneToOne 0.00 1.000 FORMAT "%5.3" EXTENDED_LIMITS 0.00 255.0 /end CHARACTERISTIC
/begin CHARACTERISTIC InjCrv_swtPoI2NSOff_C "Schalter zur Abschaltung der Nacheinspritzung bei Anti-Kaudern" VALUE 0x1E2774 Kw_Wu8 1.000 OneToOne 0.00 1.000 FORMAT "%5.3" EXTENDED_LIMITS 0.00 255.0 /end CHARACTERISTIC
/begin CHARACTERISTIC InjCrv_swtPoI2Op_C "Umschalter für Eingangsmenge der Nacheinspritzkennfelder" VALUE 0x1E2775 Kw_Wu8 3.000 OneToOne 0.00 3.000 FORMAT "%5.3" EXTENDED_LIMITS 0.00 255.0 /end CHARACTERISTIC
/begin CHARACTERISTIC InjCrv_swtQntySelVal_C "Schalter für Mengenauswahl der Förderbeginnberechnung" VALUE 0x1DD7C2 Kw_Wu8 1.000 OneToOne 0.00 1.000 FORMAT "%5.3" EXTENDED_LIMITS 0.00 255.0 /end CHARACTERISTIC
/begin CHARACTERISTIC InjCrv_swtQntySelType_C "Typ des Schalters für Mengenauswahl" VALUE 0x1DD7C3 Kw_Wu8 0.00 OneToOne 2.000 2.000 FORMAT "%5.3" EXTENDED_LIMITS 0.00 255.0 /end CHARACTERISTIC
/begin CHARACTERISTIC InjCrv_swtRpOil_C "freigeben der Kennfeldumschaltung in Abhängigkeit der Kraftoffart" VALUE 0x1DD9ED Kw_Wu8 1.000 OneToOne 0.00 1.000 FORMAT "%5.3" EXTENDED_LIMITS 0.00 255.0 /end CHARACTERISTIC
/begin CHARACTERISTIC InjCrv_tClntSOIHysHi_C "Oberer Hysteresewert für Kühlmitteltemperatur" VALUE 0x1DBC04 Kw_Ws16 6553.500 Temp_Cels -3549.940 3003.560 FORMAT "%8.3" /end CHARACTERISTIC
/begin CHARACTERISTIC InjCrv_tClntSOIHysLow_C "Unterer Hysteresewert für Kühlmitteltemperatur" VALUE 0x1DBC06 Kw_Ws16 6553.500 Temp_Cels -3549.940 3003.560 FORMAT "%8.3" /end CHARACTERISTIC
/begin CHARACTERISTIC InjCrv_tClnt_C "Wassertemperatur fuer Spritzbeginn-Sollwert" VALUE 0x1DD7C4 Kw_Ws16 200.0000 Temp_Cels -50.14000 149.8600 FORMAT "%8.4" EXTENDED_LIMITS -3549.940 3003.560 /end CHARACTERISTIC
/begin CHARACTERISTIC InjCrv_tDynClntHigh_C "Aktivierung dyn. Frühverstellung: Oberer Hysteresewert für Kühlmitteltemperatur" VALUE 0x1DBC08 Kw_Ws16 6553.500 Temp_Cels -3549.940 3003.560 FORMAT "%8.3" /end CHARACTERISTIC
/begin CHARACTERISTIC InjCrv_tDynClntLow_C "Aktivierung dyn. Frühverstellung: Unterer Hysteresewert für Kühlmitteltemperatur" VALUE 0x1DBC0A Kw_Ws16 6553.500 Temp_Cels -3549.940 3003.560 FORMAT "%8.3" /end CHARACTERISTIC
/begin CHARACTERISTIC InjCrv_tFBDynMin_C "minimale Temeperatur zur Aktivierung der dynamischen Korrektur des FB" VALUE 0x1DD9EE Kw_Ws16 250.0000 Temp_Cels -50.14000 199.8600 FORMAT "%8.4" EXTENDED_LIMITS -3549.940 3003.560 /end CHARACTERISTIC
/begin CHARACTERISTIC InjCrv_tiPoI2OvRDel_CUR "Einschaltverzögerungszeit der Freigabe der PoI2 im Schub" CURVE 0x1E2776 Kl_Xs16_Ws16 327670.0 Time_ms 0.00 327670.0 FORMAT "%8.1" EXTENDED_LIMITS -327680.0 327670.0
 /begin AXIS_DESCR STD_AXIS Eng_nAvrg EngN 4 0.00 6000.000 FORMAT "%8.3" EXTENDED_LIMITS -32768.00 32767.00 DEPOSIT ABSOLUTE /end AXIS_DESCR
/end CHARACTERISTIC
/begin CHARACTERISTIC InjCrv_tiPoI2OvRMax_C "Maximalzeit für Freigabe der PoI2 im Schub" VALUE 0x1E2788 Kw_Ws16 180000.0 Time_ms 0.00 180000.0 FORMAT "%8.1" EXTENDED_LIMITS -327680.0 327670.0 /end CHARACTERISTIC
/begin CHARACTERISTIC InjCrv_tPiI1Clnt1Low_C "Untere Schwelle der ersten Motortemperatur-Hysterese" VALUE 0x1E0618 Kw_Ws16 200.0000 Temp_Cels -50.14000 149.8600 FORMAT "%8.4" EXTENDED_LIMITS -3549.940 3003.560 /end CHARACTERISTIC
/begin CHARACTERISTIC InjCrv_tPiI1Clnt1Hgh_C "Obere Schwelle der ersten Motortemperatur-Hysterese" VALUE 0x1E061A Kw_Ws16 200.0000 Temp_Cels -50.14000 149.8600 FORMAT "%8.4" EXTENDED_LIMITS -3549.940 3003.560 /end CHARACTERISTIC
/begin CHARACTERISTIC InjCrv_stPiI1Cold1_C "Wert des unteren Abschnittes der ersten Motortemperatur-Hysterese" VALUE 0x1E061C Kw_Ws16 65535.00 OneToOne -32768.00 32767.00 FORMAT "%8.2" READ_ONLY /end CHARACTERISTIC
/begin CHARACTERISTIC InjCrv_stPiI1Warm1_C "Wert des oberen Abschnittes der ersten Motortemperatur-Hysterese" VALUE 0x1E061E Kw_Ws16 65535.00 OneToOne -32768.00 32767.00 FORMAT "%8.2" READ_ONLY /end CHARACTERISTIC
/begin CHARACTERISTIC InjCrv_tPiI1Clnt2Low_C "Untere Schwelle der zweiten Motortemperatur-Hysterese" VALUE 0x1E0620 Kw_Ws16 200.0000 Temp_Cels -50.14000 149.8600 FORMAT "%8.4" EXTENDED_LIMITS -3549.940 3003.560 /end CHARACTERISTIC
/begin CHARACTERISTIC InjCrv_tPiI1Clnt2Hgh_C "Obere Schwelle der zweiten Motortemperatur-Hysterese" VALUE 0x1E0622 Kw_Ws16 200.0000 Temp_Cels -50.14000 149.8600 FORMAT "%8.4" EXTENDED_LIMITS -3549.940 3003.560 /end CHARACTERISTIC
/begin CHARACTERISTIC InjCrv_stPiI1Cold2_C "Wert des unteren Abschnittes der zweiten Motortemperatur-Hysterese" VALUE 0x1E0624 Kw_Ws16 65535.00 OneToOne -32768.00 32767.00 FORMAT "%8.2" READ_ONLY /end CHARACTERISTIC
/begin CHARACTERISTIC InjCrv_stPiI1Warm2_C "Wert des oberen Abschnittes der zweiten Motortemperatur-Hysterese" VALUE 0x1E0626 Kw_Ws16 65535.00 OneToOne -32768.00 32767.00 FORMAT "%8.2" READ_ONLY /end CHARACTERISTIC
/begin CHARACTERISTIC InjCrv_tPoI2HCOxiPreOff_C "obere Hystereseschwelle der Abgastemperatur vor OxiCat für Freigabe PoI2 HC" VALUE 0x1E278A Kw_Ws16 1323.100 Temp_Cels -50.14000 1272.960 FORMAT "%8.3" EXTENDED_LIMITS -3549.940 3003.560 /end CHARACTERISTIC
/begin CHARACTERISTIC InjCrv_tPoI2HCOxiPreOn_C "untere Hystereseschwelle der Abgastemperatur vor OxiCat für Freigabe PoI2 HC" VALUE 0x1E278C Kw_Ws16 1323.100 Temp_Cels -50.14000 1272.960 FORMAT "%8.3" EXTENDED_LIMITS -3549.940 3003.560 /end CHARACTERISTIC
/begin CHARACTERISTIC InjCrv_stPoI2HCOxiPreOff_C "unterer Statuswert der Freigabehysterese über Agbastemperatur vor OxiCat der PoI2HC" VALUE 0x1E278E Kw_Ws16 65535.00 OneToOne -32768.00 32767.00 FORMAT "%8.2" READ_ONLY /end CHARACTERISTIC
/begin CHARACTERISTIC InjCrv_stPoI2HCOxiPreOn_C "oberer Statuswert der Freigabehysterese über Agbastemperatur vor OxiCat der PoI2HC" VALUE 0x1E2790 Kw_Ws16 65535.00 OneToOne -32768.00 32767.00 FORMAT "%8.2" READ_ONLY /end CHARACTERISTIC
/begin CHARACTERISTIC InjCrv_tPoI2HCOxiPstOn_C "obere Hystereseschwelle der Abgastemperatur nach OxiCat für Freigabe PoI2 HC" VALUE 0x1E2792 Kw_Ws16 1323.100 Temp_Cels -50.14000 1272.960 FORMAT "%8.3" EXTENDED_LIMITS -3549.940 3003.560 /end CHARACTERISTIC
/begin CHARACTERISTIC InjCrv_tPoI2HCOxiPstOff_C "untere Hystereseschwelle der Abgastemperatur nach OxiCat für Freigabe PoI2 HC" VALUE 0x1E2794 Kw_Ws16 1323.100 Temp_Cels -50.14000 1272.960 FORMAT "%8.3" EXTENDED_LIMITS -3549.940 3003.560 /end CHARACTERISTIC
/begin CHARACTERISTIC InjCrv_stPoI2HCOxiPstOn_C "oberer Statuswert der Freigabehysterese über Agbastemperatur nach OxiCat der PoI2HC" VALUE 0x1E2796 Kw_Ws16 65535.00 OneToOne -32768.00 32767.00 FORMAT "%8.2" READ_ONLY /end CHARACTERISTIC
/begin CHARACTERISTIC InjCrv_stPoI2HCOxiPstOff_C "unterer Statuswert der Freigabehysterese über Agbastemperatur nach OxiCat der PoI2HC" VALUE 0x1E2798 Kw_Ws16 65535.00 OneToOne -32768.00 32767.00 FORMAT "%8.2" READ_ONLY /end CHARACTERISTIC
/begin CHARACTERISTIC InjCrv_tPoI2HCOxiSurfOff_C "obere Hystereseschwelle der Abgastemperatur im OxiCat für Freigabe PoI2 HC" VALUE 0x1E279A Kw_Ws16 1323.100 Temp_Cels -50.14000 1272.960 FORMAT "%8.3" EXTENDED_LIMITS -3549.940 3003.560 /end CHARACTERISTIC
/begin CHARACTERISTIC InjCrv_tPoI2HCOxiSurfOn_C "untere Hystereseschwelle der Abgastemperatur im OxiCat für Freigabe PoI2 HC" VALUE 0x1E279C Kw_Ws16 1323.100 Temp_Cels -50.14000 1272.960 FORMAT "%8.3" EXTENDED_LIMITS -3549.940 3003.560 /end CHARACTERISTIC
/begin CHARACTERISTIC InjCrv_stPoI2HCOxiSurfOff_C "oberer Statuswert der Freigabehysterese über Agbastemperatur auf OxiCat-Oberfläche der PoI2HC" VALUE 0x1E279E Kw_Ws16 65535.00 OneToOne -32768.00 32767.00 FORMAT "%8.2" READ_ONLY /end CHARACTERISTIC
/begin CHARACTERISTIC InjCrv_stPoI2HCOxiSurfOn_C "unterer Statuswert der Freigabehysterese über Agbastemperatur auf OxiCat-Oberfläche der PoI2HC" VALUE 0x1E27A0 Kw_Ws16 65535.00 OneToOne -32768.00 32767.00 FORMAT "%8.2" READ_ONLY /end CHARACTERISTIC
/begin CHARACTERISTIC InjCrv_tPoI2OvRLo_C "untere Hysteresenschwelle der Abgastemperatur vor Partikelfilter für PoI2 im Schub" VALUE 0x1E27A2 Kw_Ws16 1000.000 Temp_Cels -0.04000000 999.9600 FORMAT "%8.3" EXTENDED_LIMITS -3549.940 3003.560 /end CHARACTERISTIC
/begin CHARACTERISTIC InjCrv_tPoI2OvRHi_C "obere Hysteresenschwelle der Abgastemperatur vor Partikelfilter für PoI2 im Schub" VALUE 0x1E27A4 Kw_Ws16 1000.000 Temp_Cels -0.04000000 999.9600 FORMAT "%8.3" EXTENDED_LIMITS -3549.940 3003.560 /end CHARACTERISTIC
/begin CHARACTERISTIC InjCrv_stPoI2OvRAct_C "internes Label" VALUE 0x1E27A6 Kw_Ws16 65535.00 OneToOne -32768.00 32767.00 FORMAT "%8.2" READ_ONLY /end CHARACTERISTIC
/begin CHARACTERISTIC InjCrv_stPoI2OvRNoAct_C "internes Label" VALUE 0x1E27A8 Kw_Ws16 65535.00 OneToOne -32768.00 32767.00 FORMAT "%8.2" READ_ONLY /end CHARACTERISTIC
/begin CHARACTERISTIC InjCrv_trqDynDesHigh_C "Aktivierung dyn. Frühverstellung: Oberer Hysteresewert für Wunschmoment" VALUE 0x1DBC0C Kw_Ws16 6553.500 Trq -3276.800 3276.700 FORMAT "%8.3" /end CHARACTERISTIC
/begin CHARACTERISTIC InjCrv_trqDynDesLow_C "Aktivierung dyn. Frühverstellung: Unterer Hysteresewert für Wunschmoment" VALUE 0x1DBC0E Kw_Ws16 6553.500 Trq -3276.800 3276.700 FORMAT "%8.3" /end CHARACTERISTIC
/begin CHARACTERISTIC InjCrv_trqDynLimHigh_C "Aktivierung dyn. Frühverstellung: Oberer Hysteresewert für Begrenzungsmoment" VALUE 0x1DBC10 Kw_Ws16 6553.500 Trq -3276.800 3276.700 FORMAT "%8.3" /end CHARACTERISTIC
/begin CHARACTERISTIC InjCrv_trqDynLimLow_C "Aktivierung dyn. Frühverstellung: Unterer Hysteresewert für Begrenzungsmoment" VALUE 0x1DBC12 Kw_Ws16 6553.500 Trq -3276.800 3276.700 FORMAT "%8.3" /end CHARACTERISTIC
/begin CHARACTERISTIC InjCrv_uPoI2OvRHi_C "Maximale Batteriespannung für PoI2 im Schub" VALUE 0x1E27AA Kw_Ws16 995.4233 Volt_Batt 14504.74 15500.16 FORMAT "%8.2" EXTENDED_LIMITS -665674.1 665653.8 /end CHARACTERISTIC
/begin CHARACTERISTIC InjCrv_uPoI2OvRLo_C "Minimale Batteriespannung für PoI2 im Schub" VALUE 0x1E27AC Kw_Ws16 1990.847 Volt_Batt 11010.60 13001.45 FORMAT "%8.2" EXTENDED_LIMITS -665674.1 665653.8 /end CHARACTERISTIC
/begin CHARACTERISTIC InjCrv_vPoI2HCThresOff_C "obere Hystereseschwelle der Fahrzeuggeschwindigkeit für Freigabe PoI2 HC" VALUE 0x1E27AE Kw_Ws16 300.0000 Vel 0.00 300.0000 FORMAT "%8.4" EXTENDED_LIMITS -327.6800 327.6700 /end CHARACTERISTIC
/begin CHARACTERISTIC InjCrv_vPoI2HCThresOn_C "untere Hystereseschwelle der Fahrzeuggeschwindigkeit für Freigabe PoI2 HC" VALUE 0x1E27B0 Kw_Ws16 300.0000 Vel 0.00 300.0000 FORMAT "%8.4" EXTENDED_LIMITS -327.6800 327.6700 /end CHARACTERISTIC
/begin CHARACTERISTIC InjCrv_stPoI2HCSpdOff_C "unterer Statuswert der Freigabehysterese über Geschwindigkeit" VALUE 0x1E27B2 Kw_Ws16 65535.00 OneToOne -32768.00 32767.00 FORMAT "%8.2" READ_ONLY /end CHARACTERISTIC
/begin CHARACTERISTIC InjCrv_stPoI2HCSpdOn_C "oberer Statuswert der Freigabehysterese überGeschwindigkeit" VALUE 0x1E27B4 Kw_Ws16 65535.00 OneToOne -32768.00 32767.00 FORMAT "%8.2" READ_ONLY /end CHARACTERISTIC
/begin CHARACTERISTIC SigTst_GLWLAMPEn_C "Stellertestüberwachung Freigabemaske für Glühanzeige" VALUE 0x1F04A8 Kw_Wu8 7.000 OneToOne 0.00 7.000 FORMAT "%5.3" EXTENDED_LIMITS 0.00 255.0 /end CHARACTERISTIC
/begin CHARACTERISTIC SigTst_GLWRLYEn_C "Stellertestüberwachung Freigabemaske für Glüh Relay" VALUE 0x1F04A9 Kw_Wu8 7.000 OneToOne 0.00 7.000 FORMAT "%5.3" EXTENDED_LIMITS 0.00 255.0 /end CHARACTERISTIC
/begin CHARACTERISTIC SigTst_GLWRLYGSK3En_C "Stellertestüberwachung Freigabemaske für GCU-T" VALUE 0x1F04AA Kw_Wu8 7.000 OneToOne 0.00 7.000 FORMAT "%5.3" EXTENDED_LIMITS 0.00 255.0 /end CHARACTERISTIC
/begin COMPU_METHOD AirMassPerCyl "Luftmasse pro Zylinder" RAT_FUNC "%6.3" "[mg/Hub Luft]" COEFFS 0 10 0 0 0 1 /end COMPU_METHOD
/begin COMPU_METHOD AngleCrS "Winkel Kurbelwelle" RAT_FUNC "%6.4" "[deg CrS]" COEFFS 0 42.6666666666667 0 0 0 1 /end COMPU_METHOD
/begin COMPU_METHOD DtyCyc "Tastverhaeltnis" RAT_FUNC "%6.4" "[%]" COEFFS 0 100 0 0 0 1 /end COMPU_METHOD
/begin COMPU_METHOD EngN "Motordrehzahl" RAT_FUNC "%6.2" "[rpm]" COEFFS 0 1 0 0 0 1 /end COMPU_METHOD
/begin COMPU_METHOD EngTempFldSel "Verbale Umrechnung für Auswahl aus dem Motortemperatur-Feld Eng_tFld" TAB_VERB "%6.3" "" COMPU_TAB_REF EngTempFldSel /end COMPU_METHOD
/begin COMPU_VTAB EngTempFldSel "Verbale Umrechnung für Auswahl aus dem Motortemperatur-Feld Eng_tFld" TAB_VERB 5 0 "Coolant_Temperature" 1 "Oil_Temperature" 2 "Engine_Temperature" 3 "Fuel_Temperature" 4 "Coolant_Temperature_CAN" /end COMPU_VTAB
/begin COMPU_METHOD Fact "Faktor mit Auflösung 1 / 8192, hauptsächlich für einen Faktorenbereich 0...1 verwendet" RAT_FUNC "%6.5" "[-]" COEFFS 0 8192 0 0 0 1 /end COMPU_METHOD
/begin COMPU_METHOD Fact1 "Faktor mit Auflösung 0,01 (100 mal höherer Bereich als Fact)" RAT_FUNC "%6.4" "[-]" COEFFS 0 128 0 0 0 1 /end COMPU_METHOD
/begin COMPU_METHOD Fact1000 "Faktor mit einer Auflösung von 0.001" RAT_FUNC "%6.5" "-" COEFFS 0 1000 0 0 0 1 /end COMPU_METHOD
/begin COMPU_METHOD GlwCtl_Time_ms "zur Zeitumrechnung von um den Faktor 10 größeren Zeiten als Time_ms" RAT_FUNC "%6.0" "[ms]" COEFFS 0 0.01 0 0 0 1 /end COMPU_METHOD
/begin COMPU_METHOD InjMass "Einspritzmenge" RAT_FUNC "%6.4" "[mg/hub]" COEFFS 0 100 0 0 0 1 /end COMPU_METHOD
/begin COMPU_METHOD Length "Länge in Meter" RAT_FUNC "%6.2" "[m]" COEFFS 0 1 0 0 0 1 /end COMPU_METHOD
/begin COMPU_METHOD Map_Select "Umsetzungsfaktor von Kennfeldern fuer vierdimensionale Raeume" RAT_FUNC "%6.4" "[-]" COEFFS 0 256 0 0 0 1 /end COMPU_METHOD
/begin COMPU_METHOD NumPinDia "Verbale Umrechnung für Diagnose Signale" TAB_VERB "%6.3" "" COMPU_TAB_REF NumPinDia /end COMPU_METHOD
/begin COMPU_VTAB NumPinDia "Verbale Umrechnung für Diagnose Signale" TAB_VERB 4 1 "Glow_Relay_DiaSig" 8 "EGR_Actuator_DiaSig" 13 "Throttle_Valve_Actuator_DiaSig" 21 "Glw_Sys_GSK3_DiaSig" /end COMPU_VTAB
/begin COMPU_METHOD NumPinDioOut "Verbale Umrechnung für Digitalausgang Signale" TAB_VERB "%6.3" "" COMPU_TAB_REF NumPinDioOut /end COMPU_METHOD
/begin COMPU_VTAB NumPinDioOut "Verbale Umrechnung für Digitalausgang Signale" TAB_VERB 4 0 "Glow_Relay" 20 "Glow_Lamp" 21 "EGR_Disable_HBridge" 22 "TVA_Disable_HBridge" /end COMPU_VTAB
/begin COMPU_METHOD NumPinPwmOut "Verbale Umrechnung für PWM-Ausgang Signale" TAB_VERB "%6.3" "" COMPU_TAB_REF NumPinPwmOut /end COMPU_METHOD
/begin COMPU_VTAB NumPinPwmOut "Verbale Umrechnung für PWM-Ausgang Signale" TAB_VERB 7 2 "GlwSys_GSK3_Actuator" 3 "Throttle_Valve_Actuator" 5 "EGR_Actuator1" 6 "EGR_Actuator2" 7 "Throttle_Valve_HBridge1" 8 "Throttle_Valve_HBridge2" 13 "EGR_Actuator" /end COMPU_VTAB
/begin COMPU_METHOD OneToOne "eins zu eins (physikalischer Wert ist gleich dem internen Wert)" RAT_FUNC "%6.2" "[-]" COEFFS 0 1 0 0 0 1 /end COMPU_METHOD
/begin COMPU_METHOD Period "Periodendauer" RAT_FUNC "%6.3" "[ms]" COEFFS 0 10 0 0 0 1 /end COMPU_METHOD
/begin COMPU_METHOD Prc "Prozent, gleiche interne Auflösung wie Fact, aber Darstellung in Prozent (0...100%)" RAT_FUNC "%6.4" "[%]" COEFFS 0 100 0 0 0 1 /end COMPU_METHOD
/begin COMPU_METHOD Pres_hPa "Druck (angezeigt in [hPa])" RAT_FUNC "%6.2" "[hPa]" COEFFS 0 1 0 0 0 1 /end COMPU_METHOD
/begin COMPU_METHOD Rmp "einheitenloser Rampengradient (für Library Ramp, etc.)" RAT_FUNC "%6.4" "[1/s]" COEFFS 0 65.536 0 0 0 1 /end COMPU_METHOD
/begin COMPU_METHOD RmpCrsAg_InjCrv "Kurbelwellenwinkel Rampengradient" RAT_FUNC "%6.5" "[deg Crs/s]" COEFFS 0 2796.20266666667 0 0 0 1 /end COMPU_METHOD
/begin COMPU_METHOD RmpPrc "Prozent Rampengradient" RAT_FUNC "%6.5" "[%/s]" COEFFS 0 6553.6 0 0 0 1 /end COMPU_METHOD
/begin COMPU_METHOD RmpSqrVltg1_s "Rampen-Gradient in geringerer Aufloesung als RmpSqrVltg_s" RAT_FUNC "%6.4" "[V^2s/s]" COEFFS 0 65.536 0 0 0 1 /end COMPU_METHOD
/begin COMPU_METHOD RmpTemp "Rampengradient für Temperatur" RAT_FUNC "%6.4" "[deg C/s]" COEFFS 0 655.36 0 0 0 1 /end COMPU_METHOD
/begin COMPU_METHOD SqrVltg_s "Umrechnung für Batterie-Spannungs-Quadrat mehr als eine Sekunde" RAT_FUNC "%6.3" "[V^2s]" COEFFS 0 10 0 0 0 1 /end COMPU_METHOD
/begin COMPU_METHOD TempDiff_Kelv "Offsettemperatur dargestellt in [K]" RAT_FUNC "%6.3" "[ deg C ]" COEFFS 0 10 0 0 0 1 /end COMPU_METHOD
/begin COMPU_METHOD Temp_Cels "Temperatur dargestellt in °C (gleiche interne Darstellung wie Temp_Kelv)" RAT_FUNC "%6.1" "[deg C]" COEFFS 0 10 2731.4 0 0 1 /end COMPU_METHOD
/begin COMPU_METHOD TimeDeb "Entprellzeit in Millisekunden für Libraryfunktion Debounce" RAT_FUNC "%6.1" "[ms]" COEFFS 0 0.1 0 0 0 1 /end COMPU_METHOD
/begin COMPU_METHOD TimeDelay_s "Zeitkonstante T1 (in s) für PT1, DT1, etc." RAT_FUNC "%9.3" "[s]" COEFFS 0 0 1 0 0.00023283064365387 0 /end COMPU_METHOD
/begin COMPU_METHOD Time_ms "Zeit in ms für Fehlerentprellung (DSM) und SW-Timer" RAT_FUNC "%6.1" "[ms]" COEFFS 0 0.1 0 0 0 1 /end COMPU_METHOD
/begin COMPU_METHOD Time_s "Zeit in s für Fehlerentprellung (DSM) und SW-Timer" RAT_FUNC "%6.4" "[s]" COEFFS 0 100 0 0 0 1 /end COMPU_METHOD
/begin COMPU_METHOD Trq "Motormoment" RAT_FUNC "%6.3" "[Nm]" COEFFS 0 10 0 0 0 1 /end COMPU_METHOD
/begin COMPU_METHOD Vel "Fahrzeuggeschwindigkeit, gleiche interne Auflösung wie Vel_SI" RAT_FUNC "%6.4" "[km/h]" COEFFS 0 100 0 0 0 1 /end COMPU_METHOD
/begin COMPU_METHOD Volt "Spannung in V (von ADC)" RAT_FUNC "%6.2" "[mV]" COEFFS 0 0.2046 0 0 0 1 /end COMPU_METHOD
/begin COMPU_METHOD Volt_Batt "Batteriespannung" RAT_FUNC "%6.1" "[mV]" COEFFS 0 0.0492252911173131 0 0 0 1 /end COMPU_METHOD
/begin RECORD_LAYOUT Gkf_Ws16 FNC_VALUES 1 SWORD COLUMN_DIR DIRECT /end RECORD_LAYOUT
/begin RECORD_LAYOUT GSst_Xs16 NO_AXIS_PTS_X 1 SWORD AXIS_PTS_X 2 SWORD INDEX_INCR DIRECT /end RECORD_LAYOUT
/begin RECORD_LAYOUT Kf_Xs16_Ys16_Ws16 NO_AXIS_PTS_X 1 SWORD NO_AXIS_PTS_Y 2 SWORD AXIS_PTS_X 3 SWORD INDEX_INCR DIRECT AXIS_PTS_Y 4 SWORD INDEX_INCR DIRECT FNC_VALUES 5 SWORD COLUMN_DIR DIRECT /end RECORD_LAYOUT
/begin RECORD_LAYOUT Kl_Xs16_Ws16 NO_AXIS_PTS_X 1 SWORD AXIS_PTS_X 2 SWORD INDEX_INCR DIRECT FNC_VALUES 3 SWORD COLUMN_DIR DIRECT /end RECORD_LAYOUT
/begin RECORD_LAYOUT Kwb_Wu32 FNC_VALUES 1 ULONG COLUMN_DIR DIRECT /end RECORD_LAYOUT
/begin RECORD_LAYOUT Kw_Ws16 FNC_VALUES 1 SWORD COLUMN_DIR DIRECT /end RECORD_LAYOUT
/begin RECORD_LAYOUT Kw_Wu16 FNC_VALUES 1 UWORD COLUMN_DIR DIRECT /end RECORD_LAYOUT
/begin RECORD_LAYOUT Kw_Wu32 FNC_VALUES 1 ULONG COLUMN_DIR DIRECT /end RECORD_LAYOUT
/begin RECORD_LAYOUT Kw_Wu8 FNC_VALUES 1 UBYTE COLUMN_DIR DIRECT /end RECORD_LAYOUT
/begin FUNCTION GlwCD_Actr "Glührelais Steller"
 /begin DEF_CHARACTERISTIC GlwCD_DebActrExcTempDef_C GlwCD_DebActrExcTempOk_C GlwCD_DebActrNoLdDef_C GlwCD_DebActrNoLdOk_C GlwCD_DebActrShCirBattDef_C GlwCD_DebActrShCirBattOk_C GlwCD_DebActrShCirGndDef_C GlwCD_DebActrShCirGndOk_C GlwCD_DebNoLdDef_C GlwCD_DebNoLdOk_C GlwCD_DebShCirBattDef_C GlwCD_DebShCirBattOk_C GlwCD_DebShCirGndDef_C GlwCD_DebShCirGndOk_C GlwCD_ctPwrStgOnMax_C GlwCD_numDiaGSK3_C GlwCD_numDiaRly_C GlwCD_numDioOutRly_C GlwCD_numPwmOutGSK3_C GlwCD_rGSKCod_C GlwCD_rGSKMax_C GlwCD_rGSKMin_C GlwCD_stActrOutInv_C GlwCD_stInvOut_C GlwCD_stPwrStgActrActv_C GlwCD_stPwrStgActrDia_C GlwCD_stSPICtl_C GlwCD_swtBattCorEna_C GlwCD_tiBtwTst_C GlwCD_tiPer_C GlwCD_tiPwrStgOn_C GlwCD_uBattLim_C GlwCD_uRef_C SigTst_GLWRLYEn_C SigTst_GLWRLYGSK3En_C /end DEF_CHARACTERISTIC
/end FUNCTION
/begin FUNCTION GlwCD_DigIn "Glühsteuerungseingang"
 /begin DEF_CHARACTERISTIC GlwCD_DebCod2of3PlaDef_C GlwCD_DebCod2of3PlaOk_C GlwCD_DebCod3DiffPlaDef_C GlwCD_DebCod3DiffPlaOk_C GlwCD_DebGSK3DiaPlaDef_C GlwCD_DebGSK3DiaPlaOk_C GlwCD_DebGSK3Err1SigDef_C GlwCD_DebGSK3Err1SigOk_C GlwCD_DebGSK3Err2PlaDef_C GlwCD_DebGSK3Err2PlaOk_C GlwCD_DebGSK3Plug0MinDef_C GlwCD_DebGSK3Plug0MinOk_C GlwCD_DebGSK3Plug0PlaDef_C GlwCD_DebGSK3Plug0PlaOk_C GlwCD_DebGSK3Plug1MinDef_C GlwCD_DebGSK3Plug1MinOk_C GlwCD_DebGSK3Plug1PlaDef_C GlwCD_DebGSK3Plug1PlaOk_C GlwCD_DebGSK3Plug2MinDef_C GlwCD_DebGSK3Plug2MinOk_C GlwCD_DebGSK3Plug2PlaDef_C GlwCD_DebGSK3Plug2PlaOk_C GlwCD_DebGSK3Plug3MinDef_C GlwCD_DebGSK3Plug3MinOk_C GlwCD_DebGSK3Plug3PlaDef_C GlwCD_DebGSK3Plug3PlaOk_C GlwCD_DebGSK3Plug4MinDef_C GlwCD_DebGSK3Plug4MinOk_C GlwCD_DebGSK3Plug4PlaDef_C GlwCD_DebGSK3Plug4PlaOk_C GlwCD_DebGSK3Plug5MinDef_C GlwCD_DebGSK3Plug5MinOk_C GlwCD_DebGSK3Plug5PlaDef_C GlwCD_DebGSK3Plug5PlaOk_C GlwCD_cntEepWr_C GlwCD_ctSyncMin_C GlwCD_ctTOInit_C GlwCD_ctTOReLd_C GlwCD_numStpDef_C GlwCD_numStpOk_C GlwCD_rGSKTst_C GlwCD_stDigInInv_C GlwCD_stGlwUnType_C GlwCD_swtDigInPrsnt_C GlwCD_swtVarSfd_C GlwCD_tEngLim_C GlwCD_tiDigInDebNeg_C GlwCD_tiDigInDebPostv_C GlwCD_tiMaxDef_C GlwCD_tiMaxOk_C GlwCD_tiMinDef_C GlwCD_tiMinOk_C /end DEF_CHARACTERISTIC
/end FUNCTION
/begin FUNCTION GlwCD_GlwUn "Komponententreiber für Glühsteuergerät" /begin DEF_CHARACTERISTIC GlwCD_DebExcTempDef_C GlwCD_DebExcTempOk_C /end DEF_CHARACTERISTIC /end FUNCTION
/begin FUNCTION GlwCD_Lamp "Glühanzeige"
 /begin DEF_CHARACTERISTIC GlwCD_LampCanDebNplDef_C GlwCD_LampCanDebNplOk_C GlwCD_LampDebExcTempDef_C GlwCD_LampDebExcTempOk_C GlwCD_LampDebNoLoadDef_C GlwCD_LampDebNoLoadOk_C GlwCD_LampDebShortCircBatDef_C GlwCD_LampDebShortCircBatOk_C GlwCD_LampDebShortCircGndDef_C GlwCD_LampDebShortCircGndOk_C GlwCD_ctPwrStgLmpOnMax_C GlwCD_stLampInvOut_C GlwCD_stLmpSPICtl_C GlwCD_stPwrStgLampActv_C GlwCD_stPwrStgLampDia_C GlwCD_swtLampCan_C GlwCD_tiBtwTstLmp_C GlwCD_tiGlwLampAckIntr_C GlwCD_tiPwrStgLmpOn_C SigTst_GLWLAMPEn_C /end DEF_CHARACTERISTIC
/end FUNCTION
/begin FUNCTION GlwCtl "Glühzeitsteuerung" /begin SUB_FUNCTION GlwCtl_GlwUn GlwCtl_Logic GlwCtl_Rly /end SUB_FUNCTION /end FUNCTION
/begin FUNCTION GlwCtl_GlwUn "Steuerung für Glühsteuergerät"
 /begin DEF_CHARACTERISTIC GlwCtl_facPst1_C GlwCtl_facPst2_C GlwCtl_tiPst1_C GlwCtl_tiPst2_C /end DEF_CHARACTERISTIC
/end FUNCTION
/begin FUNCTION GlwCtl_Logic "Glühzeitkontrolle"
 /begin DEF_CHARACTERISTIC GlwCtl_dwEnrgSlp_CUR GlwCtl_nPre_C GlwCtl_nPst_C GlwCtl_nRdy_C GlwCtl_nThresGSK3_C GlwCtl_nThresItmGlw_C GlwCtl_nThresNoItmGlw_C GlwCtl_qPst_CUR GlwCtl_qThresFlQnt_C GlwCtl_qThresFl_C GlwCtl_qThresItmGlwHi_C GlwCtl_qThresItmGlwLo_C GlwCtl_qThresNoItmGlwHi_C GlwCtl_qThresNoItmGlwLo_C GlwCtl_rGSKHiPreGlw_C GlwCtl_stEGTRgnGlwEnaMsk_C GlwCtl_swtClgMode_C GlwCtl_swtEnrgPreEnaVal_C GlwCtl_swtGSKModeType_C GlwCtl_swtGSKModeVal_C GlwCtl_swtInjQnt_C GlwCtl_swtRlsPshDisbl_C GlwCtl_swtSpareStrtEna_C GlwCtl_swtTempVal_C GlwCtl_swtVarBatt_C GlwCtl_swtWakeUpPrs_C GlwCtl_tAdjMax_C GlwCtl_tAdjMin_C GlwCtl_tAdjVal_C GlwCtl_tDflEng_C GlwCtl_tStrt_C GlwCtl_tThresSwtTClg_C GlwCtl_tiChk_C GlwCtl_tiClgHi_C GlwCtl_tiClgLo_C GlwCtl_tiDebPre_C GlwCtl_tiDebT50_C GlwCtl_tiDel_C GlwCtl_tiGlwMax_C GlwCtl_tiOut1_CUR GlwCtl_tiPre1_MAP GlwCtl_tiPre2_MAP GlwCtl_tiPst_CUR GlwCtl_tiRdy_CUR GlwCtl_tiSpareStrtDel_C GlwCtl_tiStrt_C GlwCtl_tiThresFl1_CUR GlwCtl_tiThresFl2_C GlwCtl_tiThresFl3_C GlwCtl_wEnrgPre_CUR /end DEF_CHARACTERISTIC
/end FUNCTION
/begin FUNCTION GlwCtl_PwrCtl "Glühstärkeberechnung" /begin DEF_CHARACTERISTIC GlwCtl_tiRdy1_C /end DEF_CHARACTERISTIC /end FUNCTION
/begin FUNCTION GlwCtl_Rly "Steuerung für Glührelais"
 /begin DEF_CHARACTERISTIC GlwCtl_dprcRmpGlwDwn_C GlwCtl_dprcRmpGlwUp_C GlwCtl_facGlwPwrRed_MAP GlwCtl_nRampEna_C GlwCtl_rNomGSK_C GlwCtl_rOut1_C GlwCtl_rOut2_C GlwCtl_rOut3_C GlwCtl_rOut_MAP GlwCtl_rPstCor_MAP GlwCtl_rStrt_C GlwCtl_swtDycStrt_C GlwCtl_swtPreGlwType_C GlwCtl_swtPreGlwVal_C GlwCtl_tiDebPwrRed_C GlwCtl_tiOut2_C GlwCtl_tiPreGlwPsh_CUR GlwCtl_tiPreGlw_CUR GlwCtl_uThresHiOvrVltg_C GlwCtl_uThresHiUndVltg_C GlwCtl_uThresLoOvrVltg_C GlwCtl_uThresLoUndVltg_C /end DEF_CHARACTERISTIC
/end FUNCTION
/begin FUNCTION HDSCD_Co "Heizungsanforderungssensor Komponententreiber"
 /begin DEF_CHARACTERISTIC HDSCD_DebSRCHighDef_C HDSCD_DebSRCHighOk_C HDSCD_DebSRCLowDef_C HDSCD_DebSRCLowOk_C HDSCD_dprcRmpSlpDwn_C HDSCD_dprcRmpSlpUp_C HDSCD_prcAirDfl_C HDSCD_prcLin_CUR HDSCD_stSensIDWord_C HDSCD_uSRCMax_C HDSCD_uSRCMin_C /end DEF_CHARACTERISTIC
/end FUNCTION
/begin FUNCTION HWEMon "Monitoring of Hardware Encapsulation Functions"
 /begin DEF_CHARACTERISTIC HWEMon_DebComDef_C HWEMon_DebComOk_C HWEMon_DebComStepDown_C HWEMon_DebComStepUp_C HWEMon_DebEepDef_C HWEMon_lStoreEEP_C HWEMon_nAvrg_C HWEMon_nThres_C HWEMon_numTrigRecovery_C HWEMon_tiStoreEEP_C /end DEF_CHARACTERISTIC
/end FUNCTION
/begin FUNCTION Hardwaresignaldisplay "Anzeige Hardwarsignale" /begin SUB_FUNCTION ErLpCD GlwCD_Lamp SvLpCD /end SUB_FUNCTION /end FUNCTION
/begin FUNCTION IATSCD_Co "Lufttemperaturfühler Komponententreiber"
 /begin DEF_CHARACTERISTIC IATSCD_DebSRCHighDef_C IATSCD_DebSRCHighOk_C IATSCD_DebSRCLowDef_C IATSCD_DebSRCLowOk_C IATSCD_DebSigDef_C IATSCD_DebSigOk_C IATSCD_dtRmpSlpDwn_C IATSCD_dtRmpSlpUp_C IATSCD_stSensIDWord_C IATSCD_swtSigVal_C IATSCD_tDfl_C IATSCD_tLin_CUR IATSCD_uSRCMax_C IATSCD_uSRCMin_C /end DEF_CHARACTERISTIC
/end FUNCTION
/begin FUNCTION IFCD_Co "Lüftersteuerung für den Ladeluftkühler Komponententrteiber Koordinator"
 /begin DEF_CHARACTERISTIC IFCD_DebExcTempDef_C IFCD_DebExcTempOK_C IFCD_DebNoLoadDef_C IFCD_DebNoLoadOK_C IFCD_DebShortCircBatDef_C IFCD_DebShortCircBatOK_C IFCD_DebShortCircGndDef_C IFCD_DebShortCircGndOK_C IFCD_ctPwrStgOnMax_C IFCD_stInvOut_C IFCD_stPwrStgActv_C IFCD_stPwrStgDia_C IFCD_stSPICtl_C IFCD_tiBtwTst_C IFCD_tiPwrStgOn_C /end DEF_CHARACTERISTIC
/end FUNCTION
/begin FUNCTION IFCtl_Co "Lüftersteuerung für den Ladeluftkühler Koordinator"
 /begin DEF_CHARACTERISTIC IFCtl_stFanOffMsk_C IFCtl_stOff_C IFCtl_tAirHysHi_CUR IFCtl_tAirHysLo_CUR IFCtl_tClntThrHiHysHi_CUR IFCtl_tClntThrHiHysLo_CUR IFCtl_tClntThrLoHysHi_C IFCtl_tClntThrLoHysLo_C /end DEF_CHARACTERISTIC
/end FUNCTION
/begin FUNCTION IO "Signalein-/ausgabe" /begin SUB_FUNCTION Signal_Input /end SUB_FUNCTION /end FUNCTION
/begin FUNCTION IgnLck "Zündschloss" /begin SUB_FUNCTION ImmCtl T15CD T50CD /end SUB_FUNCTION /end FUNCTION
/begin FUNCTION ImmCtl "Steuerung Wegfahrsperre" /begin SUB_FUNCTION ImmCtl_Co ImmCtl_Learn /end SUB_FUNCTION /end FUNCTION
/begin FUNCTION ImmCtl_Co "Wegfahrsperre Freischaltkommunikation"
 /begin DEF_CHARACTERISTIC ImmCtl_Labelkey_C ImmCtl_P_Class_C ImmCtl_stDattest_C ImmCtl_swtStartSKC_C ImmCtl_swtpasswd_ECU_C /end DEF_CHARACTERISTIC
/end FUNCTION
/begin FUNCTION ImmCtl_Learn "Wegfahrsperre Anlernkommunikation"
 /begin DEF_CHARACTERISTIC ImmCtl_cntNegRespMaxAuto_C ImmCtl_cntNegRespMaxMnl_C ImmCtl_stAutoLrnActv_C ImmCtl_stDatChanAcc_C ImmCtl_stDatChan_C ImmCtl_tiDataReq_C ImmCtl_tiLrnReqRep_C ImmCtl_tiP2CANLimit_C ImmCtl_tiP2CANMax_C /end DEF_CHARACTERISTIC
/end FUNCTION
/begin FUNCTION IndSys_CalcSwirl "Drallniveausteuerung"
 /begin DEF_CHARACTERISTIC IndSys_facAPCorRgn_CUR IndSys_facAPCor_CUR IndSys_facWtTempCor_CUR IndSys_qLdDet_CUR IndSys_rAPCorVSARgn_MAP IndSys_rAPCorVSA_MAP IndSys_rEGRLim_C IndSys_rVSAOpen_C IndSys_rVSAOvrRun_MAP IndSys_rVSARgn1_MAP IndSys_rVSARgn2_MAP IndSys_rVSARgn3_MAP IndSys_rVSAThresHi_C IndSys_rVSAThresLo_C IndSys_rVSAYHi_C IndSys_rVSAYLo_C IndSys_rVSA_MAP IndSys_rWtTempCorVSA_MAP IndSys_stRgnMsk_CA IndSys_swtHys_C IndSys_swtNSActv_C IndSys_tiAftLdDet_C /end DEF_CHARACTERISTIC
/end FUNCTION
/begin FUNCTION IndSys_MonIntMnf "Diagnose Abfall Ladedruckschlauch"
 /begin DEF_CHARACTERISTIC IndSys_facTempMonIntMnf_CUR IndSys_nAvrgThrHiPlHi_C IndSys_nAvrgThrLoPlHi_C IndSys_pAirThrLo_C IndSys_pBstThrHiPlHi_C IndSys_pDiffMonIntMnf_MAP IndSys_qRawThrHi_C IndSys_rAirMonIntMnfHi_C IndSys_rAirMonIntMnfLo_C IndSys_rEGRPThrHi_C IndSys_rSwirlThrHi_C IndSys_rTVAPThrHi_C IndSys_tClntThrHi_C IndSys_tClntThrLo_C IndSys_tiDebMonIntMnfDef_C IndSys_tiDebMonIntMnfOk_C IndSys_tiDlyEGR_C IndSys_tiDlyMonIntMnf_C /end DEF_CHARACTERISTIC
/end FUNCTION
/begin FUNCTION IndSys_MonVac "Ansaugluft-Unterdruckerkennung"
 /begin DEF_CHARACTERISTIC IndSys_nAvrg_C IndSys_pDiffHigh_CUR IndSys_pDiffLow_CUR IndSys_rAPP_C IndSys_tiDebNegErrMonVac_C IndSys_tiDebPosErrMonVac_C /end DEF_CHARACTERISTIC
/end FUNCTION
/begin FUNCTION IndSys_pAdj "Ansaugluftdruck-Abgleichwert Berechnung"
 /begin DEF_CHARACTERISTIC IndSys_pAdjDiffMax_C IndSys_pAdjMax_C IndSys_tAirMinAdj_C IndSys_tiDebAdj_C IndSys_tiDelAdjRcy_C IndSys_tiDelAdj_C /end DEF_CHARACTERISTIC
/end FUNCTION
/begin FUNCTION InjCrv_Co "Spritzbeginn Sollwertbildung"
 /begin DEF_CHARACTERISTIC InjCrv_phiCor3_MAP InjCrv_phiTrmDfl_C InjCrv_phiTrmMax_C InjCrv_phiTrmMin_C InjCrv_tClnt_C /end DEF_CHARACTERISTIC
/end FUNCTION
/begin FUNCTION InjCrv_MI1Phi "Einspritzverlauf - Haupteinspritzung winkelsynchron"
 /begin DEF_CHARACTERISTIC InjCrv_dRmpSlpSOI_C InjCrv_pDynAPHigh_C InjCrv_pDynAPLow_C InjCrv_phiBas0_GMAP InjCrv_phiBas1_GMAP InjCrv_phiBas2_GMAP InjCrv_phiBas3_GMAP InjCrv_phiBas4_GMAP InjCrv_phiBas5_GMAP InjCrv_phiBas6_GMAP InjCrv_phiBas7_GMAP InjCrv_phiBas8_GMAP InjCrv_phiBas9_GMAP InjCrv_phiBasGear12_MAP InjCrv_phiBasGear34_MAP InjCrv_phiBasGear56_MAP InjCrv_phiBasX_AXIS InjCrv_phiBasY_AXIS InjCrv_phiBas_CUR InjCrv_phiDyn0_GMAP InjCrv_phiDyn1_GMAP InjCrv_phiDyn2_GMAP InjCrv_phiDyn3_GMAP InjCrv_phiDyn4_GMAP InjCrv_phiDynX_AXIS InjCrv_phiDynY_AXIS InjCrv_phiDyn_CUR InjCrv_phiMIMax_MAP InjCrv_phiStartOn_C InjCrv_phiStrt0_GMAP InjCrv_phiStrt1_GMAP InjCrv_phiStrt2_GMAP InjCrv_phiStrt3_GMAP InjCrv_phiStrtX_AXIS InjCrv_phiStrtY_AXIS InjCrv_phiStrt_CUR InjCrv_swtDyn_C InjCrv_tClntSOIHysHi_C InjCrv_tClntSOIHysLow_C InjCrv_tDynClntHigh_C InjCrv_tDynClntLow_C InjCrv_trqDynDesHigh_C InjCrv_trqDynDesLow_C InjCrv_trqDynLimHigh_C InjCrv_trqDynLimLow_C /end DEF_CHARACTERISTIC
/end FUNCTION
/begin FUNCTION InjCrv_MI1PhiAddCor "Haupteinspritzung - projektspezifische Korrekturen winkelsynchron"
 /begin DEF_CHARACTERISTIC InjCrv_facMI1PCRPhiCor_MAP InjCrv_phiAirCor0_GMAP InjCrv_phiAirCor1_GMAP InjCrv_phiAirCor2_GMAP InjCrv_phiAirCor3_GMAP InjCrv_phiAirCor4_GMAP InjCrv_phiAirCor5_GMAP InjCrv_phiAirCorX_AXIS InjCrv_phiAirCorY_AXIS InjCrv_phiAirCor_CUR InjCrv_phiFBDynAirLck_MAP InjCrv_phiFBDynAirSrPls_MAP InjCrv_phiHghtCor0_GMAP InjCrv_phiHghtCor1_GMAP InjCrv_phiHghtCor2_GMAP InjCrv_phiHghtCor3_GMAP InjCrv_phiHghtCor4_GMAP InjCrv_phiHghtCor5_GMAP InjCrv_phiHghtCorX_AXIS InjCrv_phiHghtCorY_AXIS InjCrv_phiHghtCor_CUR InjCrv_phiMI1PCRCor_MAP InjCrv_swtCTSDfl_C InjCrv_swtDynCor_C InjCrv_tiPT1FBDynCor_C /end DEF_CHARACTERISTIC
/end FUNCTION
/begin FUNCTION InjCrv_MI1PhiAddCorSlow "Haupteinspritzung - projektspezifische Korrekturen zeitsynchron"
 /begin DEF_CHARACTERISTIC InjCrv_ctRevCor3RpOil_MAP InjCrv_ctRevCor3_MAP InjCrv_dphiCor3_C InjCrv_facFBDyn_CUR InjCrv_rFBDynEGRMax_C InjCrv_rFBDynEGRMin_C InjCrv_swtFBDynEnaAll_C InjCrv_swtRpOil_C InjCrv_tFBDynMin_C InjCrv_tiPT1FBDynAir_C /end DEF_CHARACTERISTIC
/end FUNCTION
/begin FUNCTION InjCrv_MI1PhiCor "Förderbeginnberechnung Haupteinspritzung" /begin DEF_CHARACTERISTIC InjCrv_phiStartBackUpAddCor_C /end DEF_CHARACTERISTIC /end FUNCTION
/begin FUNCTION InjCrv_MI1PhiEgt "Förderbeginnberechnung der Haupteinspritzung während Regenerationsbetrieb"
 /begin DEF_CHARACTERISTIC InjCrv_dPhiMI1EGTSlp_C InjCrv_facMI1EGTCor1_MAP InjCrv_facMI1EGTCor2_MAP InjCrv_facMI1EGTCor3_MAP InjCrv_facMI1EGTCor4_MAP InjCrv_phiMI1EGTBas1_MAP InjCrv_phiMI1EGTBas2_MAP InjCrv_phiMI1EGTBas3_MAP InjCrv_phiMI1EGTBas4_MAP InjCrv_phiMI1EGTCor1_MAP InjCrv_phiMI1EGTCor2_MAP InjCrv_phiMI1EGTCor3_MAP InjCrv_phiMI1EGTCor4_MAP /end DEF_CHARACTERISTIC
/end FUNCTION
/begin FUNCTION InjCrv_MI1PiI1Cor "kundenspezifische Haupteinspritzkorrekturen"
 /begin DEF_CHARACTERISTIC InjCrv_dFacPiI1QCorSlp_CA InjCrv_dPhiPiI1CorSlp_CA InjCrv_facPiI1QCor0_MAP InjCrv_facPiI1QCor1_MAP InjCrv_facPiI1QCor2_MAP InjCrv_phiPiI1Cor0_MAP InjCrv_phiPiI1Cor1_MAP InjCrv_phiPiI1Cor2_MAP /end DEF_CHARACTERISTIC
/end FUNCTION
/begin FUNCTION InjCrv_MI1QEGTCor "Einspritzmengenkorrektur Haupteinspritzung durch EGT-Eingriff"
 /begin DEF_CHARACTERISTIC InjCrv_dQEGTCorSlp_C InjCrv_facEGTWghCor_CUR InjCrv_qEGTCor10_MAP InjCrv_qEGTCor11_MAP InjCrv_qEGTCor20_MAP InjCrv_qEGTCor21_MAP InjCrv_qEGTCor30_MAP InjCrv_qEGTCor31_MAP InjCrv_qEGTCor40_MAP InjCrv_qEGTCor41_MAP InjCrv_qEGTCorStd_C /end DEF_CHARACTERISTIC
/end FUNCTION
/begin FUNCTION InjCrv_MI1QPoI2Cor "Einspritzmengenkorrekturfaktor Nacheinspritzung"
 /begin DEF_CHARACTERISTIC InjCrv_dFacPoI2QCorSlp_C InjCrv_facPoI2QCor1_MAP InjCrv_facPoI2QCor2_MAP InjCrv_facPoI2QCor3_MAP InjCrv_facPoI2QCor4_MAP InjCrv_facPoI2QCorStd_C /end DEF_CHARACTERISTIC
/end FUNCTION
/begin FUNCTION InjCrv_PiI "Einspritzverlauf - Voreinspritzung" /begin DEF_CHARACTERISTIC InjCrv_swtQntySelType_C InjCrv_swtQntySelVal_C /end DEF_CHARACTERISTIC /end FUNCTION
/begin FUNCTION InjCrv_PiI1 "Einspritzverlaufsermittlung Voreinspritzung"
 /begin DEF_CHARACTERISTIC InjCrv_dPhiPiI1Slp_CA InjCrv_dQPiI1Slp_CA InjCrv_phiPiI1Rng0_MAP InjCrv_phiPiI1Rng1_MAP InjCrv_phiPiI1Rng2_MAP InjCrv_qPiI1Rng0_MAP InjCrv_qPiI1Rng1_MAP InjCrv_qPiI1Rng2_MAP InjCrv_tPiI1Clnt1Hgh_C InjCrv_tPiI1Clnt1Low_C InjCrv_tPiI1Clnt2Hgh_C InjCrv_tPiI1Clnt2Low_C /end DEF_CHARACTERISTIC
/end FUNCTION
/begin FUNCTION InjCrv_PiI1Rls "Freigabe der Voreinspritzung und Bestimmung des Voreinspritzbereiches"
 /begin DEF_CHARACTERISTIC InjCrv_nPiI1Off_C InjCrv_nPiI1On_C InjCrv_pPiI1Hgh_C InjCrv_pPiI1Low_C InjCrv_stPiI1Act_C InjCrv_stPiI1Cold1_C InjCrv_stPiI1Cold2_C InjCrv_stPiI1HghPres_C InjCrv_stPiI1LowPres_C InjCrv_stPiI1NoAct_C InjCrv_stPiI1RlsEGT_C InjCrv_stPiI1RlsOff0_MAP InjCrv_stPiI1RlsOff1_MAP InjCrv_stPiI1RlsOff2_MAP InjCrv_stPiI1RlsOn0_MAP InjCrv_stPiI1RlsOn1_MAP InjCrv_stPiI1RlsOn2_MAP InjCrv_stPiI1Warm1_C InjCrv_stPiI1Warm2_C /end DEF_CHARACTERISTIC
/end FUNCTION
/begin FUNCTION InjCrv_PoI2 "Einspritzverlauf der Nacheinspritzung"
 /begin DEF_CHARACTERISTIC InjCrv_dPhiPoI2Slp_C InjCrv_dQPoI2Slp_C InjCrv_facPoI2PhiWgh_CUR InjCrv_facPoI2QntWgh_CUR InjCrv_nPoI2Off_C InjCrv_nPoI2On_C InjCrv_nPoI2OvRHi_C InjCrv_nPoI2OvRLo_C InjCrv_numPoI2HC_MAP InjCrv_phiMI1HCDes_MAP InjCrv_phiPoI2HCDes_MAP InjCrv_phiPoI2Rgn10_MAP InjCrv_phiPoI2Rgn11_MAP InjCrv_phiPoI2Rgn20_MAP InjCrv_phiPoI2Rgn21_MAP InjCrv_phiPoI2Rgn30_MAP InjCrv_phiPoI2Rgn31_MAP InjCrv_phiPoI2Rgn40_MAP InjCrv_phiPoI2Rgn41_MAP InjCrv_phiPoI2Std_C InjCrv_qPoI2HCAvrgCor_MAP InjCrv_qPoI2HCFBCCor_MAP InjCrv_qPoI2HCHiOff_CUR InjCrv_qPoI2HCHiOn_CUR InjCrv_qPoI2HCLoOff_CUR InjCrv_qPoI2HCLoOn_CUR InjCrv_qPoI2HCTrqCor_MAP InjCrv_qPoI2Rgn10_MAP InjCrv_qPoI2Rgn11_MAP InjCrv_qPoI2Rgn20_MAP InjCrv_qPoI2Rgn21_MAP InjCrv_qPoI2Rgn30_MAP InjCrv_qPoI2Rgn31_MAP InjCrv_qPoI2Rgn40_MAP InjCrv_qPoI2Rgn41_MAP InjCrv_rPoI2HCHysQnt_C InjCrv_rPoI2HCHysSpd_C InjCrv_stPoI2Act_C InjCrv_stPoI2HCOffMsk_C InjCrv_stPoI2HCOxiPreOff_C InjCrv_stPoI2HCOxiPreOn_C InjCrv_stPoI2HCOxiPstOff_C InjCrv_stPoI2HCOxiPstOn_C InjCrv_stPoI2HCOxiSurfOff_C InjCrv_stPoI2HCOxiSurfOn_C InjCrv_stPoI2HCSpdOff_C InjCrv_stPoI2HCSpdOn_C InjCrv_stPoI2NoAct_C InjCrv_stPoI2OvRAct_C InjCrv_stPoI2OvRNoAct_C InjCrv_swtPoI2HCLmbd_C InjCrv_swtPoI2HCT3_C InjCrv_swtPoI2NSOff_C InjCrv_swtPoI2Op_C InjCrv_tPoI2HCOxiPreOff_C InjCrv_tPoI2HCOxiPreOn_C InjCrv_tPoI2HCOxiPstOff_C InjCrv_tPoI2HCOxiPstOn_C InjCrv_tPoI2HCOxiSurfOff_C InjCrv_tPoI2HCOxiSurfOn_C InjCrv_tPoI2OvRHi_C InjCrv_tPoI2OvRLo_C InjCrv_tiPoI2OvRDel_CUR InjCrv_tiPoI2OvRMax_C InjCrv_uPoI2OvRHi_C InjCrv_uPoI2OvRLo_C InjCrv_vPoI2HCThresOff_C InjCrv_vPoI2HCThresOn_C /end DEF_CHARACTERISTIC
/end FUNCTION
/end MODULE
/end PROJECT
