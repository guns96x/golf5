ASAP2_VERSION 1 3
/begin PROJECT X447 "EDC16U34"
/begin HEADER "" VERSION "VAA1" PROJECT_NO X447 /end HEADER
/begin MODULE DIM ""
/begin MOD_COMMON "" BYTE_ORDER MSB_FIRST ALIGNMENT_BYTE 1 ALIGNMENT_WORD 2 ALIGNMENT_LONG 4 ALIGNMENT_FLOAT32_IEEE 4 /end MOD_COMMON
/begin MEASUREMENT InjCrv_phiPiI1Cor1_mp "Korrekturwinkel 1 der Haupteinspritzung auf Grund der Voreinspritzung" SWORD AngleCrS 1 100 -768.0000 767.9766 FORMAT "%8.4" ECU_ADDRESS 0x9FF55E /end MEASUREMENT
/begin MEASUREMENT InjCrv_phiPiI1Cor2_mp "Korrekturwinkel 2 der Haupteinspritzung auf Grund der Voreinspritzung" SWORD AngleCrS 1 100 -768.0000 767.9766 FORMAT "%8.4" ECU_ADDRESS 0x9FF560 /end MEASUREMENT
/begin MEASUREMENT InjCrv_phiPiI1Des "gewünschter Winkelkomponente Ansteuerbeginn PiI1" SWORD AngleCrS 1 100 -768.0000 767.9766 FORMAT "%8.4" ECU_ADDRESS 0x7F9A74 /end MEASUREMENT
/begin MEASUREMENT InjCrv_phiPiI1DesByp_mp "Bypass-Label, Kopie von InjCrv_phiPiI1Des" SWORD AngleCrS 1 100 -768.0000 767.9766 FORMAT "%8.4" ECU_ADDRESS 0x9FF576 /end MEASUREMENT
/begin MEASUREMENT InjCrv_phiPiI1Rng0_mp "Förderbeginn 0 Voreinspritzung" SWORD AngleCrS 1 100 -768.0000 767.9766 FORMAT "%8.4" ECU_ADDRESS 0x9FF578 /end MEASUREMENT
/begin MEASUREMENT InjCrv_phiPiI1Rng1_mp "Förderbeginn 1 Voreinspritzung" SWORD AngleCrS 1 100 -768.0000 767.9766 FORMAT "%8.4" ECU_ADDRESS 0x9FF57A /end MEASUREMENT
/begin MEASUREMENT InjCrv_phiPiI1Rng2_mp "Förderbeginn 2 Voreinspritzung" SWORD AngleCrS 1 100 -768.0000 767.9766 FORMAT "%8.4" ECU_ADDRESS 0x9FF57C /end MEASUREMENT
/begin MEASUREMENT InjCrv_phiPoI1Des "gewünschter Bezugswinkel für Beginn der PoI1" SWORD AngleCrS 1 100 -768.0000 767.9766 FORMAT "%8.4" ECU_ADDRESS 0x7F9A76 /end MEASUREMENT
/begin MEASUREMENT InjCrv_phiPoI2Des "gewünschter Bezugswinkel für Beginn der PoI2" SWORD AngleCrS 1 100 -768.0000 767.9766 FORMAT "%8.4" ECU_ADDRESS 0x7F9A78 /end MEASUREMENT
/begin MEASUREMENT InjCrv_phiPoI2DesByp_mp "Bypass-Label, Kopie von InjCrv_phiPoI2Des" SWORD AngleCrS 1 100 -768.0000 767.9766 FORMAT "%8.4" ECU_ADDRESS 0x9FF58A /end MEASUREMENT
/begin MEASUREMENT InjCrv_phiPoI2Des_mp "gewünschte Bezugswinkelkomponente für Beginn der PoI2, ausser für PoI2 HC" SWORD AngleCrS 1 100 -768.0000 767.9766 FORMAT "%8.4" ECU_ADDRESS 0x9FF58C /end MEASUREMENT
/begin MEASUREMENT InjCrv_phiPoI2HCDes_mp "gewünschte Bezugswinkelkomponente für Beginn der PoI2HC" SWORD AngleCrS 1 100 -768.0000 767.9766 FORMAT "%8.4" ECU_ADDRESS 0x9FF58E /end MEASUREMENT
/begin MEASUREMENT InjCrv_phiPoI2Rgn0_mp "Grundwert 0 für Förderbeginn Nacheinspritzung" SWORD AngleCrS 1 100 -768.0000 767.9766 FORMAT "%8.4" ECU_ADDRESS 0x9FF590 /end MEASUREMENT
/begin MEASUREMENT InjCrv_phiPoI2Rgn1_mp "Grundwert 1 für Förderbeginn Nacheinspritzung" SWORD AngleCrS 1 100 -768.0000 767.9766 FORMAT "%8.4" ECU_ADDRESS 0x9FF592 /end MEASUREMENT
/begin MEASUREMENT InjCrv_phiPoI2Rgn_mp "Regenerationswert für Förderbeginn Nacheinspritzung" SWORD AngleCrS 1 100 -768.0000 767.9766 FORMAT "%8.4" ECU_ADDRESS 0x9FF594 /end MEASUREMENT
/begin MEASUREMENT InjCrv_phiRun_mp "Spritzbeginnkorrektur nach Startabwurf" SWORD AngleCrS 1 100 -768.0000 767.9766 FORMAT "%8.4" ECU_ADDRESS 0x9FF52A /end MEASUREMENT
/begin MEASUREMENT InjCrv_phiSetPointLimited_mp "Spritzbeginn-Sollwert begrenzter Wert" SWORD AngleCrS 1 100 -768.0000 767.9766 FORMAT "%8.4" ECU_ADDRESS 0x9FF52C /end MEASUREMENT
/begin MEASUREMENT InjCrv_phiSetPointLim_mp "Spritzbeginn-Sollwert Begrenzungswert" SWORD AngleCrS 1 100 -768.0000 767.9766 FORMAT "%8.4" ECU_ADDRESS 0x9FF52E /end MEASUREMENT
/begin MEASUREMENT InjCrv_phiSetPointSwt_mp "Spritzbeginn Sollwert" SWORD AngleCrS 1 100 -768.0000 767.9766 FORMAT "%8.4" ECU_ADDRESS 0x9FF530 /end MEASUREMENT
/begin MEASUREMENT InjCrv_phiSetPointTrimm_mp "Spritzbeginn-Sollwert Trimmwert" SWORD AngleCrS 1 100 -768.0000 767.9766 FORMAT "%8.4" ECU_ADDRESS 0x9FF532 /end MEASUREMENT
/begin MEASUREMENT InjCrv_phiStart_mp "Spritzbeginnkorrektur vor Startabwurf" SWORD AngleCrS 1 100 -768.0000 767.9766 FORMAT "%8.4" ECU_ADDRESS 0x9FF534 /end MEASUREMENT
/begin MEASUREMENT InjCrv_phiTrm "Spritzbeginn-Sollwinkel Abgleichwert" SWORD AngleCrS 1 100 -768.0000 767.9766 FORMAT "%8.4" ECU_ADDRESS 0x7F9A7A /end MEASUREMENT
/begin MEASUREMENT InjCrv_qEGTCor "Mengenkorrektur der Haupteinspritzung durch den EGT" SWORD InjMass 1 100 -327.6800 327.6700 FORMAT "%8.4" ECU_ADDRESS 0x7F9A7C /end MEASUREMENT
/begin MEASUREMENT InjCrv_qEGTCor0_mp "Regenerationswert 0 für Mengenkorrektur Haupteinspritzung" SWORD InjMass 1 100 -327.6800 327.6700 FORMAT "%8.4" ECU_ADDRESS 0x9FF56E /end MEASUREMENT
/begin MEASUREMENT InjCrv_qEGTCor1_mp "Regenerationswert 1  für Mengenkorrektur Haupteinspritzung" SWORD InjMass 1 100 -327.6800 327.6700 FORMAT "%8.4" ECU_ADDRESS 0x9FF570 /end MEASUREMENT
/begin MEASUREMENT InjCrv_qEGTCor_mp "Regenerationswert für Mengenkorrektur Haupteinspritzung" SWORD InjMass 1 100 -327.6800 327.6700 FORMAT "%8.4" ECU_ADDRESS 0x9FF572 /end MEASUREMENT
/begin MEASUREMENT InjCrv_qLmbdCtl "Lambdakontrollmenge" SWORD InjMass 1 100 -327.6800 327.6700 FORMAT "%8.4" ECU_ADDRESS 0x7F9A7E /end MEASUREMENT
/begin MEASUREMENT InjCrv_qMI1Des "Sollmenge Haupteinspritzung" SWORD InjMass 1 100 -327.6800 327.6700 FORMAT "%8.4" ECU_ADDRESS 0x7F9A80 /end MEASUREMENT
/begin MEASUREMENT InjCrv_qMI1DesByp_mp "Bypass-Label, Kopie von InjCrv_qMI1Des" SWORD InjMass 1 100 -327.6800 327.6700 FORMAT "%8.4" ECU_ADDRESS 0x9FF562 /end MEASUREMENT
/begin MEASUREMENT InjCrv_qMI1PiI1Cor_mp "Haupteinspritzmenge nach Korrektur durch Voreinspritzung" SWORD InjMass 1 100 -327.6800 327.6700 FORMAT "%8.4" ECU_ADDRESS 0x9FF564 /end MEASUREMENT
/begin MEASUREMENT InjCrv_qMI1PoI2Cor_mp "Haupteinspritzmenge nach Nacheinspritzkorrektur" SWORD InjMass 1 100 -327.6800 327.6700 FORMAT "%8.4" ECU_ADDRESS 0x9FF566 /end MEASUREMENT
/begin MEASUREMENT InjCrv_qPiI1Cor_mp "Einspritzmengenkorrektur der Haupteinspritzung aufgrund einer Voreinspritzung" SWORD InjMass 1 100 -327.6800 327.6700 FORMAT "%8.4" ECU_ADDRESS 0x9FF568 /end MEASUREMENT
/begin MEASUREMENT InjCrv_qPiI1Des "gewünschte Einspritzmenge PiI 1" SWORD InjMass 1 100 -327.6800 327.6700 FORMAT "%8.4" ECU_ADDRESS 0x7F9A82 /end MEASUREMENT
/begin MEASUREMENT InjCrv_qPiI1DesByp_mp "Bypass-Label, Kopie von InjCrv_qPiI1Des" SWORD InjMass 1 100 -327.6800 327.6700 FORMAT "%8.4" ECU_ADDRESS 0x9FF57E /end MEASUREMENT
/begin MEASUREMENT InjCrv_qPiI1Rng0_mp "Einspritzmenge 0 Voreinspritzung" SWORD InjMass 1 100 -327.6800 327.6700 FORMAT "%8.4" ECU_ADDRESS 0x9FF580 /end MEASUREMENT
/begin MEASUREMENT InjCrv_qPiI1Rng1_mp "Einspritzmenge 1 Voreinspritzung" SWORD InjMass 1 100 -327.6800 327.6700 FORMAT "%8.4" ECU_ADDRESS 0x9FF582 /end MEASUREMENT
/begin MEASUREMENT InjCrv_qPiI1Rng2_mp "Einspritzmenge 2 Voreinspritzung" SWORD InjMass 1 100 -327.6800 327.6700 FORMAT "%8.4" ECU_ADDRESS 0x9FF584 /end MEASUREMENT
/begin MEASUREMENT InjCrv_qPoI1Des "gewünschte Einspritzmenge PoI1" SWORD InjMassInj 1 100 -327.6800 327.6700 FORMAT "%8.4" ARRAY_SIZE 4 ECU_ADDRESS 0x7F9F2C /end MEASUREMENT
/begin MEASUREMENT InjCrv_qPoI2Cor_mp "korrigierter Grundwert der Einspritzmenge PoI2" SWORD InjMass 1 100 -327.6800 327.6700 FORMAT "%8.4" ECU_ADDRESS 0x9FF56A /end MEASUREMENT
/begin MEASUREMENT InjCrv_qPoI2Des "Sollmenge Nacheinspritzung 2" SWORD InjMass 1 100 -327.6800 327.6700 FORMAT "%8.4" ECU_ADDRESS 0x7F9A84 /end MEASUREMENT
/begin MEASUREMENT InjCrv_qPoI2DesByp_mp "Messpunkt für den Bypass" SWORD InjMass 1 100 -327.6800 327.6700 FORMAT "%8.4" ECU_ADDRESS 0x9FF596 /end MEASUREMENT
/begin MEASUREMENT InjCrv_qPoI2Des_mp "Sollmenge Nacheinspritzung 2" SWORD InjMass 1 100 -327.6800 327.6700 FORMAT "%8.4" ECU_ADDRESS 0x9FF598 /end MEASUREMENT
/begin MEASUREMENT InjCrv_qPoI2Eff "wirksame Einspritzmenge PoI2" SWORD InjMass 1 100 -327.6800 327.6700 FORMAT "%8.4" ECU_ADDRESS 0x7F9A86 /end MEASUREMENT
/begin MEASUREMENT InjCrv_qPoI2HCAvrgCor "mittlere Zusatzmenge der HC_Nacheinspritzung" SWORD InjMass 1 100 -327.6800 327.6700 FORMAT "%8.4" ECU_ADDRESS 0x7F9A88 /end MEASUREMENT
/begin MEASUREMENT InjCrv_qPoI2HCCor_mp "Zusatzmenge der HC-Nacheinspritzung" SWORD InjMass 1 100 -327.6800 327.6700 FORMAT "%8.4" ECU_ADDRESS 0x9FF59A /end MEASUREMENT
/begin MEASUREMENT InjCrv_qPoI2HCCylCor "Zylinderspezifische Zusatzmenge der HC-Nacheinspritzung" SWORD InjMass 1 100 -327.6800 327.6700 FORMAT "%8.4" ECU_ADDRESS 0x7F9A8A /end MEASUREMENT
/begin MEASUREMENT InjCrv_qPoI2HCCylCorByp_mp "Messpunkt für Bypass" SWORD InjMass 1 100 -327.6800 327.6700 FORMAT "%8.4" ECU_ADDRESS 0x9FF59C /end MEASUREMENT
/begin MEASUREMENT InjCrv_qPoI2HCFBCCor "Korrekturmenge bei PoI2HC für die Laufruheanpassung" SWORD InjMass 1 100 -327.6800 327.6700 FORMAT "%8.4" ECU_ADDRESS 0x7F9A8C /end MEASUREMENT
/begin MEASUREMENT InjCrv_qPoI2HCFBCCorByp_mp "Messpunkt für Bypass Freischnitt" SWORD InjMass 1 100 -327.6800 327.6700 FORMAT "%8.4" ECU_ADDRESS 0x9FF59E /end MEASUREMENT
/begin MEASUREMENT InjCrv_qPoI2HCTrqCor "Korrekturmenge bei PoI2HC für Momentenkompensation" SWORD InjMass 1 100 -327.6800 327.6700 FORMAT "%8.4" ECU_ADDRESS 0x7F9A8E /end MEASUREMENT
/begin MEASUREMENT InjCrv_qPoI2HCTrqCorByp_mp "Messpunkt für Bypass Freischnitt" SWORD InjMass 1 100 -327.6800 327.6700 FORMAT "%8.4" ECU_ADDRESS 0x9FF5A0 /end MEASUREMENT
/begin MEASUREMENT InjCrv_qPoI2LmbdOfs "Lambda-geregelter Anteil der Nacheinspritzmenge PoI2" SWORD InjMass 1 100 -327.6800 327.6700 FORMAT "%8.4" ECU_ADDRESS 0x7F9A90 /end MEASUREMENT
/begin MEASUREMENT InjCrv_qPoI2LmbdOfsByp_mp "Messpunkt um InjCrv_qPoI2LmbdOfs vor Beipass zu lesen" SWORD InjMass 1 100 -327.6800 327.6700 FORMAT "%8.4" ECU_ADDRESS 0x9FF5BE /end MEASUREMENT
/begin MEASUREMENT InjCrv_qPoI2LmbdOut_mp "Ausgang der Regelstreckenlinearisierung (Lambda-Regler)" SWORD InjMass 1 100 -327.6800 327.6700 FORMAT "%8.4" ECU_ADDRESS 0x9FF5C0 /end MEASUREMENT
/begin MEASUREMENT InjCrv_qPoI2LmbdRgn_mp "Regenerationswert nach Lambda-Regelung Nacheinspritzung" SWORD InjMass 1 100 -327.6800 327.6700 FORMAT "%8.4" ECU_ADDRESS 0x9FF5A2 /end MEASUREMENT
/begin MEASUREMENT InjCrv_qPoI2Ofs_mp "Offset zur Anhebung der Basismenge der PoI2 im Regenerationsbetrieb" SWORD InjMass 1 100 -327.6800 327.6700 FORMAT "%8.4" ECU_ADDRESS 0x9FF5A4 /end MEASUREMENT
/begin MEASUREMENT InjCrv_qPoI2Op "Einspritzmenge für Regenerationsbetriebspunkt" SWORD InjMass 1 100 -327.6800 327.6700 FORMAT "%8.4" ECU_ADDRESS 0x7F9A92 /end MEASUREMENT
/begin MEASUREMENT InjCrv_qPoI2Rgn0_mp "Grundwert 0 für Menge Nacheinspritzung" SWORD InjMass 1 100 -327.6800 327.6700 FORMAT "%8.4" ECU_ADDRESS 0x9FF5A6 /end MEASUREMENT
/begin MEASUREMENT InjCrv_qPoI2Rgn1_mp "Grundwert 1 für Menge Nacheinspritzung" SWORD InjMass 1 100 -327.6800 327.6700 FORMAT "%8.4" ECU_ADDRESS 0x9FF5A8 /end MEASUREMENT
/begin MEASUREMENT InjCrv_qPoI2Rgn_mp "Regenerationswert für Menge Nacheinspritzung" SWORD InjMass 1 100 -327.6800 327.6700 FORMAT "%8.4" ECU_ADDRESS 0x9FF5AA /end MEASUREMENT
/begin MEASUREMENT InjCrv_qPoI2Tot "Gesamteinspritzmasse fuer Regelstrecken-Linearisierungen" SWORD InjMass 1 100 -327.6800 327.6700 FORMAT "%8.4" ECU_ADDRESS 0x7F9A94 /end MEASUREMENT
/begin MEASUREMENT InjCrv_qSmkTrqCor "systemspezifische Rauchbegrenzungskorrekturmenge" SWORD InjMass 1 100 -327.6800 327.6700 FORMAT "%8.4" ECU_ADDRESS 0x7F9A98 /end MEASUREMENT
/begin MEASUREMENT InjCrv_qSOI "Menge fuer Start der Einspritzung" SWORD InjMass 1 100 -327.6800 327.6700 FORMAT "%8.4" ECU_ADDRESS 0x7F9A96 /end MEASUREMENT
/begin MEASUREMENT InjCrv_qTot "Gesamteinspritzmenge" SWORD InjMass 1 100 -327.6800 327.6700 FORMAT "%8.4" ECU_ADDRESS 0x7F9A9E /end MEASUREMENT
/begin MEASUREMENT InjCrv_qTPstOfsMax "Maximale Lambda/T3-Menge im Zugbetrieb" SWORD InjMass 1 100 -327.6800 327.6700 FORMAT "%8.4" ECU_ADDRESS 0x7F9A9A /end MEASUREMENT
/begin MEASUREMENT InjCrv_qTPstOfsOvR "T4' Menge im Schubbetrieb" SWORD InjMass 1 100 -327.6800 327.6700 FORMAT "%8.4" ECU_ADDRESS 0x7F9A9C /end MEASUREMENT
/begin MEASUREMENT InjCrv_qWoDCUnLim_mp "Einspritzmenge ohne Störregler" SWORD InjMass 1 100 -327.6800 327.6700 FORMAT "%8.4" ECU_ADDRESS 0x9FF5AC /end MEASUREMENT
/begin MEASUREMENT InjCrv_qWoDC_mp "Einspritzmenge ohne Störregler (begrenzt)" SWORD InjMass 1 100 -327.6800 327.6700 FORMAT "%8.4" ECU_ADDRESS 0x9FF5AE /end MEASUREMENT
/begin MEASUREMENT InjCrv_rPoI2LmbdDes_mp "Sollwert für Lambda-Regelung bei Regeneration" SWORD lambda 1 100 -32.76800 32.76700 FORMAT "%8.5" ECU_ADDRESS 0x9FF5C2 /end MEASUREMENT
/begin MEASUREMENT InjCrv_rPoI2LmbdDev_mp "Regelabweichung für Lambda-Regelung bei Regeneration" SWORD lambda 1 100 -32.76800 32.76700 FORMAT "%8.5" ECU_ADDRESS 0x9FF5C4 /end MEASUREMENT
/begin MEASUREMENT InjCrv_rPoI2LmbdGovMin_mp "momentane dynamische Min.-Grenze (Lambda-Regler)" SWORD lambda 1 100 -32.76800 32.76700 FORMAT "%8.5" ECU_ADDRESS 0x9FF5C6 /end MEASUREMENT
/begin MEASUREMENT InjCrv_rPoI2LmbdMin_mp "Ausgangswert der Lambda-Limitierung" SWORD lambda 1 100 -32.76800 32.76700 FORMAT "%8.5" ECU_ADDRESS 0x9FF5C8 /end MEASUREMENT
/begin MEASUREMENT InjCrv_rPoI2LmbdNom "Sollwert fuer Lambda-Regelung im Nacheinspritzbetrieb" SWORD lambda 1 100 -32.76800 32.76700 FORMAT "%8.5" ECU_ADDRESS 0x7F9AA0 /end MEASUREMENT
/begin MEASUREMENT InjCrv_rPoI2LmbdNomByp_mp "Messpunkt um InjCrv_rPoI2LmbdNom ueber ASCET vor Bypass auszulesen" SWORD lambda 1 100 -32.76800 32.76700 FORMAT "%8.5" ECU_ADDRESS 0x9FF5CA /end MEASUREMENT
/begin MEASUREMENT InjCrv_rPoI2LmbdOutI_mp "Integralanteil des Lambda-Regler-Ausgangssignals" SLONG lambda 1 100 -2147483.64800 2147483.64700 FORMAT "%13.5" ECU_ADDRESS 0x9FE5F8 /end MEASUREMENT
/begin MEASUREMENT InjCrv_rPoI2LmbdOutP_mp "Proportionalanteil des Lambda-Regler-Ausgangssignals" SWORD lambda 1 100 -32.76800 32.76700 FORMAT "%8.5" ECU_ADDRESS 0x9FF5CC /end MEASUREMENT
/begin MEASUREMENT InjCrv_rPoI2LmbdOut_mp "Ausgangssignal des Lambda-Reglers" SWORD lambda 1 100 -32.76800 32.76700 FORMAT "%8.5" ECU_ADDRESS 0x9FF5CE /end MEASUREMENT
/begin MEASUREMENT InjCrv_rPoI2LmbdRgn0_mp "Vorgabewertwert 0 für Lambda-Regelung bei Regeneration" SWORD lambda 1 100 -32.76800 32.76700 FORMAT "%8.5" ECU_ADDRESS 0x9FF5D0 /end MEASUREMENT
/begin MEASUREMENT InjCrv_rPoI2LmbdRgn1_mp "Vorgabewertwert 1 für Lambda-Regelung bei Regeneration" SWORD lambda 1 100 -32.76800 32.76700 FORMAT "%8.5" ECU_ADDRESS 0x9FF5D2 /end MEASUREMENT
/begin MEASUREMENT InjCrv_rPoI2LmbdT3I_mp "Integralanteil der T3-Regelung" SLONG lambda 1 100 -2147483.64800 2147483.64700 FORMAT "%13.5" ECU_ADDRESS 0x9FE5FC /end MEASUREMENT
/begin MEASUREMENT InjCrv_rPoI2LmbdT3Min_mp "momentane dynamische Min.-Grenze (T3-Regler)" SWORD lambda 1 100 -32.76800 32.76700 FORMAT "%8.5" ECU_ADDRESS 0x9FF5DE /end MEASUREMENT
/begin MEASUREMENT InjCrv_rPoI2LmbdT3Ofs "Lambdaoffset aufgrund der T3-Regelung" SWORD lambda 1 100 -32.76800 32.76700 FORMAT "%8.5" ECU_ADDRESS 0x7F9AA2 /end MEASUREMENT
/begin MEASUREMENT InjCrv_rPoI2LmbdT3P_mp "Proportionalanteil der T3-Regelung" SWORD lambda 1 100 -32.76800 32.76700 FORMAT "%8.5" ECU_ADDRESS 0x9FF5E0 /end MEASUREMENT
/begin MEASUREMENT InjCrv_rPoI2Rmp_mp "Interner Rampenwert des Umschalters für die Nacheinspritzmenge" ULONG OneToOne 1 100 0.00 4294967295.00 FORMAT "%13.2" ECU_ADDRESS 0x9FE5F4 /end MEASUREMENT
/begin MEASUREMENT InjCrv_rPreTrbnDev_mp "auf Lambda-Wert umgesetzte Abgastemperatur-Abweichung" SWORD lambda 1 100 -32.76800 32.76700 FORMAT "%8.5" ECU_ADDRESS 0x9FF5E2 /end MEASUREMENT
/begin MEASUREMENT InjCrv_stDyn "Status der dynamischen FB-Frühverstellung" UBYTE OneToOne 1 100 0.00 255.0 FORMAT "%5.1" ECU_ADDRESS 0x7F94BB /end MEASUREMENT
/begin MEASUREMENT InjCrv_stFBDynCorOff "Status der dynamischen Korrektur des FB" UBYTE OneToOne 1 100 0.00 255.0 FORMAT "%5.1" ECU_ADDRESS 0x7F94BC /end MEASUREMENT
/begin MEASUREMENT InjCrv_stGearSOI_mp "Status Gangbereich für FB-Berechnung" UBYTE OneToOne 1 100 0.00 255.0 FORMAT "%5.1" ECU_ADDRESS 0x9FFF10 /end MEASUREMENT
/begin MEASUREMENT InjCrv_stInjCharActVal "Einspritzverlauf aktueller Wert" UBYTE OneToOne 1 100 0.00 255.0 FORMAT "%5.1" ECU_ADDRESS 0x7F94BD /end MEASUREMENT
/begin MEASUREMENT InjCrv_stLmbdCtl "Freigabestatus Lambdakontrollmenge" UBYTE OneToOne 1 100 0.00 255.0 FORMAT "%5.1" ECU_ADDRESS 0x7F94BE /end MEASUREMENT
/begin MEASUREMENT InjCrv_stPiI1 "Freigabestatus der Voreinspritzung" UBYTE OneToOne 1 100 0.00 255.0 FORMAT "%5.1" ECU_ADDRESS 0x7F94BF /end MEASUREMENT
/begin MEASUREMENT InjCrv_stPoI2 "Freigabestatus PoI2" UBYTE OneToOne 1 100 0.00 255.0 FORMAT "%5.1" ECU_ADDRESS 0x7F94C0 /end MEASUREMENT
/begin MEASUREMENT InjCrv_stPoI2Ctl "Zustand PoI2-Regelung (Ein/Aus)" UBYTE OneToOne 1 100 0.00 255.0 FORMAT "%5.1" ECU_ADDRESS 0x7F94C1 /end MEASUREMENT
/begin MEASUREMENT InjCrv_stPoI2HCCylOn "Zylinderauswahlstatus für den verlängerten Zylinder bei PoI2 HC" UBYTE OneToOne 1 100 0.00 255.0 FORMAT "%5.1" ECU_ADDRESS 0x7F94C2 /end MEASUREMENT
/begin MEASUREMENT InjCrv_stPoI2HCOff "Abschaltstatus der PoI2HC" UWORD OneToOne 1 100 0.00 65535.00 FORMAT "%8.2" ECU_ADDRESS 0x7F9AA4 /end MEASUREMENT
/begin MEASUREMENT InjCrv_stPoI2HCOffByp_mp "Messpunkt für Bypass Freischnitt" SWORD OneToOne 1 100 -32768.00 32767.00 FORMAT "%8.2" ECU_ADDRESS 0x9FF5B0 /end MEASUREMENT
/begin MEASUREMENT InjCrv_stPoI2Int_mp "Status Regenerationsanforderung (intern)" UBYTE OneToOne 1 100 0.00 255.0 FORMAT "%5.1" ECU_ADDRESS 0x9FFF14 /end MEASUREMENT
/begin MEASUREMENT InjCrv_stPoI2LmbdCtl "Status Lambda-Regelung bei Regenerationsbetrieb" UBYTE OneToOne 1 100 0.00 255.0 FORMAT "%5.1" ECU_ADDRESS 0x7F94C3 /end MEASUREMENT
/begin MEASUREMENT InjCrv_stPoI2LmbdRelax "Ausschaltrampe des Lambda-Reglers ist aktiv" UBYTE OneToOne 1 100 0.00 255.0 FORMAT "%5.1" ECU_ADDRESS 0x7F94C4 /end MEASUREMENT
/begin MEASUREMENT InjCrv_stPoI2LmbdSC "Ueberbrueckungsbedingung des Lambda-Reglers" UBYTE OneToOne 1 100 0.00 255.0 FORMAT "%5.1" ECU_ADDRESS 0x7F94C5 /end MEASUREMENT
/begin MEASUREMENT InjCrv_stPoI2LmbdT3Ctl "Zustand T3-Regelung (Ein/Aus)" UBYTE OneToOne 1 100 0.00 255.0 FORMAT "%5.1" ECU_ADDRESS 0x7F94C6 /end MEASUREMENT
/begin MEASUREMENT InjCrv_stPoI2LmbdT3Relax "Ausschaltrampe des T3-Reglers ist aktiv" UBYTE OneToOne 1 100 0.00 255.0 FORMAT "%5.1" ECU_ADDRESS 0x7F94C7 /end MEASUREMENT
/begin MEASUREMENT InjCrv_stPoI2noSwt "kennzeichnet: PoI2 ist aktiv, Einschaltrampen sind nicht aktiv" UBYTE OneToOne 1 100 0.00 255.0 FORMAT "%5.1" ECU_ADDRESS 0x7F94C8 /end MEASUREMENT
/begin MEASUREMENT InjCrv_stPoI2OvROff "Abschaltstatus der PoI2 im Schub" UWORD OneToOne 1 100 0.00 65535.00 FORMAT "%8.2" ECU_ADDRESS 0x7F9AA6 /end MEASUREMENT
/begin MEASUREMENT InjCrv_stPreTrbnT3Rls1_mp "Freigabebedingung 1 des Abgastemperatur-Reglers" UBYTE OneToOne 1 100 0.00 255.0 FORMAT "%5.1" ECU_ADDRESS 0x9FFF15 /end MEASUREMENT
/begin MEASUREMENT InjCrv_stPreTrbnT3Rls2_mp "Freigabebedingung 2 des Abgastemperatur-Reglers" SWORD OneToOne 1 100 -32768.00 32767.00 FORMAT "%8.2" ECU_ADDRESS 0x9FF5E4 /end MEASUREMENT
/begin MEASUREMENT InjCrv_stPreTrbnT3Rls3_mp "Freigabebedingung 3 des Abgastemperatur-Reglers" UBYTE OneToOne 1 100 0.00 255.0 FORMAT "%5.1" ECU_ADDRESS 0x9FFF16 /end MEASUREMENT
/begin MEASUREMENT InjCrv_stT3DiaMaxErr_mp "Status Temperaturvergleich auf Überschreitung max. Grenze" UBYTE OneToOne 1 100 0.00 255.0 FORMAT "%5.1" ECU_ADDRESS 0x9FFF17 /end MEASUREMENT
/begin MEASUREMENT InjCrv_stT3DiaMinErr_mp "Status Temperaturvergleich auf Unterschreitung min. Grenze" UBYTE OneToOne 1 100 0.00 255.0 FORMAT "%5.1" ECU_ADDRESS 0x9FFF18 /end MEASUREMENT
/begin MEASUREMENT InjCrv_stT3Dia_mp "Statuswort der T3-Diagnose" UWORD OneToOne 1 100 0.00 65535.00 FORMAT "%8.2" ECU_ADDRESS 0x7FDDFE /end MEASUREMENT
/begin MEASUREMENT InjCrv_swtPoI2LmbdSC "Steuersignal des Ueberbrueckungsschalters des Lambda-Reglers" UBYTE OneToOne 1 100 0.00 255.0 FORMAT "%5.1" ECU_ADDRESS 0x7F94C9 /end MEASUREMENT
/begin MEASUREMENT InjCrv_swtQntySel "Schalter fuer Mengenauswahl (0:InjCtl_qRaw/1:InjCtl_qAct)" UBYTE OneToOne 1 100 0.00 255.0 FORMAT "%5.1" ECU_ADDRESS 0x7F94CA /end MEASUREMENT
/begin MEASUREMENT InjCrv_tClnt "Ersatzwert Wassertemperatur fuer Spritzbeginn-Sollwert" SWORD Temp_Cels 1 100 -3549.940 3003.560 FORMAT "%8.3" ECU_ADDRESS 0x7F9AA8 /end MEASUREMENT
/begin MEASUREMENT InjCrv_tiPoI2OvRTmr_mp "Zeit, die seit Beginn des Schubes verstrichen ist" UWORD Time_ms 1 100 0.00 655350.0 FORMAT "%8.1" ECU_ADDRESS 0x9FF5B2 /end MEASUREMENT
/begin MEASUREMENT InjCrv_tiT3DiaBit3Rls_mp "Timerwert für aktuelle Regenerationsstufe Bit3" UWORD Time_ms 1 100 0.00 655350.0 FORMAT "%8.1" ECU_ADDRESS 0x9FF5EE /end MEASUREMENT
/begin MEASUREMENT InjCrv_tiT3DiaBit8Rls_mp "Verzögerungszeit für Gesamtfreigabe Bit" UWORD Time_ms 1 100 0.00 655350.0 FORMAT "%8.1" ECU_ADDRESS 0x9FF5F0 /end MEASUREMENT
/begin MEASUREMENT InjCrv_tiT3DiaCTDel_mp "Zeitverzögerung bis T3-Diagnosefreigabe, aus Kühlmitteltemperatur" UWORD Time_ms 1 100 0.00 655350.0 FORMAT "%8.1" ECU_ADDRESS 0x9FF5F2 /end MEASUREMENT
/begin MEASUREMENT InjCrv_tiT3DiaEGPCT_mp "Gesamtzeit bis T3-Diagnosefreigabe, aus CT + EGP" UWORD Time_ms 1 100 0.00 655350.0 FORMAT "%8.1" ECU_ADDRESS 0x9FF5F4 /end MEASUREMENT
/begin MEASUREMENT InjCrv_tiT3DiaEGPDel_mp "Zeit bis Diagnosefreigabe, aus Abgastemperatur vor Turbolader" UWORD Time_ms 1 100 0.00 655350.0 FORMAT "%8.1" ECU_ADDRESS 0x9FF5F6 /end MEASUREMENT
/begin MEASUREMENT InjCrv_tPreTrbnDev_mp "Regelabweichung der T3-Regelung" SWORD TempDiff_Kelv 1 100 -3276.800 3276.700 FORMAT "%8.3" ECU_ADDRESS 0x9FF5E6 /end MEASUREMENT
/begin MEASUREMENT InjCrv_tPreTrbnNom "Sollwert fuer T3-Regelung im Nacheinspritzbetrieb" SWORD Temp_Cels 1 100 -3549.940 3003.560 FORMAT "%8.3" ECU_ADDRESS 0x7F9AAA /end MEASUREMENT
/begin MEASUREMENT InjCrv_tPreTrbnNomByp_mp "Messpunkt um InjCrv_tPreTrbnNom ueber ASCET vor Bypass auszulesen" SWORD Temp_Cels 1 100 -3549.940 3003.560 FORMAT "%8.3" ECU_ADDRESS 0x9FF5E8 /end MEASUREMENT
/begin MEASUREMENT InjCrv_tPstDelta_mp "Differenz zwischen tOxiPst und entsprechendem Limit" SWORD TempDiff_Kelv 1 100 -3276.800 3276.700 FORMAT "%8.3" ECU_ADDRESS 0x9FF600 /end MEASUREMENT
/begin MEASUREMENT InjCrv_tT3DiaAirSel_mp "selektierte Lufttemperatur für die T3-Diagnose" SWORD Temp_Cels 1 100 -3549.940 3003.560 FORMAT "%8.3" ECU_ADDRESS 0x9FF5F8 /end MEASUREMENT
/begin MEASUREMENT InjCrv_tT3DiaDevMax_mp "zulässige Temperaturüberschreitung" SWORD TempDiff_Kelv 1 100 -3276.800 3276.700 FORMAT "%8.3" ECU_ADDRESS 0x9FF5FA /end MEASUREMENT
/begin MEASUREMENT InjCrv_tT3DiaDevMin_mp "zulässige Temperaturunterschreitung" SWORD TempDiff_Kelv 1 100 -3276.800 3276.700 FORMAT "%8.3" ECU_ADDRESS 0x9FF5FC /end MEASUREMENT
/begin MEASUREMENT InjCrv_tT3DiaMax_mp "zulässige Maximaltemperatur der T3-Diagnose" SWORD Temp_Cels 1 100 -3549.940 3003.560 FORMAT "%8.3" ECU_ADDRESS 0x9FF5FE /end MEASUREMENT
/begin MEASUREMENT InjCrv_tT3DiaMin_mp "zulässige Minimaltemperatur der T3-Diagnose" SWORD Temp_Cels 1 100 -3549.940 3003.560 FORMAT "%8.3" ECU_ADDRESS 0x7FDE00 /end MEASUREMENT
/begin MEASUREMENT InjCrv_tT3DiaPreNomFlt_mp "gefilterte Solltemperatur der T3-Diagnose" SWORD Temp_Cels 1 100 -3549.940 3003.560 FORMAT "%8.3" ECU_ADDRESS 0x7FDE02 /end MEASUREMENT
/begin MEASUREMENT InjCtl_qAct "Fahrerwunschmenge inklusive Leerlaufregler ohne Ruckeldämpfer" SWORD InjMass 1 100 -327.6800 327.6700 FORMAT "%8.4" ECU_ADDRESS 0x7F9AAC /end MEASUREMENT
/begin MEASUREMENT InjCtl_qCurr "Einspritzmenge aktueller Wert" SWORD InjMass 1 100 -327.6800 327.6700 FORMAT "%8.4" ECU_ADDRESS 0x7F9AAE /end MEASUREMENT
/begin MEASUREMENT InjCtl_qCurrUnCor "aktuelle Menge ohne Korrektur durch Mengenmittelwertadaption (FMA)" SWORD InjMass 1 100 -327.6800 327.6700 FORMAT "%8.4" ECU_ADDRESS 0x7F9AB0 /end MEASUREMENT
/begin MEASUREMENT InjCtl_qDes "Einspritzmenge Wunschwert" SWORD InjMass 1 100 -327.6800 327.6700 FORMAT "%8.4" ECU_ADDRESS 0x7F9AB2 /end MEASUREMENT
/begin MEASUREMENT InjCtl_qLim "Begrenzungsmenge" SWORD InjMass 1 100 -327.6800 327.6700 FORMAT "%8.4" ECU_ADDRESS 0x7F9AB4 /end MEASUREMENT
/begin MEASUREMENT InjCtl_qLimErr "Begrenzungsmenge im Falle eines Systemfehlers" SWORD InjMass 1 100 -327.6800 327.6700 FORMAT "%8.4" ECU_ADDRESS 0x7F9AB6 /end MEASUREMENT
/begin MEASUREMENT InjCtl_qLimNorm_mp "Begrenzungsmenge im Normalbetrieb (kein Systemfehler)" SWORD InjMass 1 100 -327.6800 327.6700 FORMAT "%8.4" ECU_ADDRESS 0x9FF602 /end MEASUREMENT
/begin MEASUREMENT InjCtl_qLimSwt "Ausgang RampSwitch-Block für Begrenzungsmenge im Systemfehlerfall" SWORD InjMass 1 100 -327.6800 327.6700 FORMAT "%8.4" ECU_ADDRESS 0x7F9AB8 /end MEASUREMENT
/begin MEASUREMENT InjCtl_qRaw "Einspritzmenge Rohwert" SWORD InjMass 1 100 -327.6800 327.6700 FORMAT "%8.4" ECU_ADDRESS 0x7F9ABA /end MEASUREMENT
/begin MEASUREMENT InjCtl_qSetUnBal "Einspritzmenge Sollwert ohne Mengenausgleichsregelung" SWORD InjMass 1 100 -327.6800 327.6700 FORMAT "%8.4" ECU_ADDRESS 0x7F9ABC /end MEASUREMENT
/begin MEASUREMENT InjCtl_stNoInj "Status für keine Einspritzung (0 -> Einspritzung, 1 -> InjCtl_qSetUnBal == 0)" UBYTE OneToOne 1 100 0.00 255.0 FORMAT "%5.1" ECU_ADDRESS 0x7F94CB /end MEASUREMENT
/begin MEASUREMENT InjCtl_stQLimErr "Status Begrenzungsmenge im Falle eines Systemfehlers (soll verwendet werden)" UBYTE OneToOne 1 100 0.00 255.0 FORMAT "%5.1" ECU_ADDRESS 0x7F94CC /end MEASUREMENT
/begin MEASUREMENT InjCtl_trqInrLim "Begrenzungsmoment (als inneres Moment) resultierend aus der Begrenzungsmenge InjCtl_qLim" SWORD Trq 1 100 -3276.800 3276.700 FORMAT "%8.3" ECU_ADDRESS 0x7F9ABE /end MEASUREMENT
/begin MEASUREMENT InjUn_ctFBC_qArr_FTC_mp "Index des Feldes der FBC Mengen" UBYTE OneToOne 1 100 0.00 255.0 FORMAT "%5.1" ECU_ADDRESS 0x9FFF19 /end MEASUREMENT
/begin MEASUREMENT InjUn_facFlTempCor_mp "Korrekturfaktor für die Einspritzmengen" UWORD Fact 1 100 0.00 7.999878 FORMAT "%8.6" ECU_ADDRESS 0x9FF604 /end MEASUREMENT
/begin MEASUREMENT InjUn_qFBC_FTC_mp "Zylinderspezifische Menge der FBC" SWORD InjMass 1 100 -327.6800 327.6700 FORMAT "%8.4" ECU_ADDRESS 0x9FF606 /end MEASUREMENT
/begin MEASUREMENT InjUn_qMI1DesCorr "kraftstofftemperaturkorrigierte Einspritzmenge für die Haupteinspritzung" SWORD InjMass 1 100 -327.6800 327.6700 FORMAT "%8.4" ECU_ADDRESS 0x7F9AC0 /end MEASUREMENT
/begin MEASUREMENT InjUn_qMI1DesCorrByp_mp "Messpunkt um InjUn_qMI1DesCorr ueber ASCET vor Bypass auszulesen" SWORD InjMass 1 100 -327.6800 327.6700 FORMAT "%8.4" ECU_ADDRESS 0x9FF608 /end MEASUREMENT
/begin MEASUREMENT InjUn_qPiI1DesCorr "kraftstofftemperaturkorrigierte Einspritzmenge für die Voreinspritzung" SWORD InjMass 1 100 -327.6800 327.6700 FORMAT "%8.4" ECU_ADDRESS 0x7F9AC2 /end MEASUREMENT
/begin MEASUREMENT InjUn_qPiI1DesCorrByp_mp "Messpunkt um InjUn_qPiI1DesCorr ueber ASCET vor Bypass auszulesen" SWORD InjMass 1 100 -327.6800 327.6700 FORMAT "%8.4" ECU_ADDRESS 0x9FF60A /end MEASUREMENT
/begin MEASUREMENT InjUn_qPoI2DesCorr "kraftstofftemperaturkorrigierte Einspritzmenge für die 2 Nacheinspritzung" SWORD InjMass 1 100 -327.6800 327.6700 FORMAT "%8.4" ECU_ADDRESS 0x7F9AC4 /end MEASUREMENT
/begin MEASUREMENT InjUn_qPoI2DesCorrByp_mp "Messpunkt um InjUn_qPoI2DesCorr ueber ASCET vor Bypass auszulesen" SWORD InjMass 1 100 -327.6800 327.6700 FORMAT "%8.4" ECU_ADDRESS 0x9FF60C /end MEASUREMENT
/begin MEASUREMENT InjUn_qTotIDes_mp "Gesamteinspritzmenge" SWORD InjMass 1 100 -327.6800 327.6700 FORMAT "%8.4" ECU_ADDRESS 0x9FF60E /end MEASUREMENT
/begin MEASUREMENT InjUn_qTotInj "Gesamteinspritzmenge für die Schubüberwachung" SWORD InjMass 1 100 -327.6800 327.6700 FORMAT "%8.4" ECU_ADDRESS 0x7F9AC6 /end MEASUREMENT
/begin MEASUREMENT InjUn_ShOffTstCyl_mp "Zylinder mit dem der Test der redundanten Abschaltpfade durchgeführt wurde" UBYTE OneToOne 1 100 0.00 255.0 FORMAT "%5.1" ECU_ADDRESS 0x9FFF1A /end MEASUREMENT
/begin MEASUREMENT InjUn_stInjValve "Abschaltanforderungen für Injektor" UBYTE OneToOne 1 100 0.00 255.0 FORMAT "%5.1" ECU_ADDRESS 0x7F94CD /end MEASUREMENT
/begin MEASUREMENT InjUn_stShOffTst_mp "Status der Einspritzung während eines Abschaltpfadtests" UBYTE OneToOne 1 100 0.00 255.0 FORMAT "%5.1" ECU_ADDRESS 0x9FFF1B /end MEASUREMENT
/begin MEASUREMENT InjUn_stSysErr "systemspezifische Fehler" UWORD OneToOne 1 100 0.00 65535.00 FORMAT "%8.2" ECU_ADDRESS 0x7F9AC8 /end MEASUREMENT
/begin MEASUREMENT InjUn_stTst "allgemeiner Status der Tests, die im Einspritzsystem durchgeführt werden" UWORD OneToOne 1 100 0.00 65535.00 FORMAT "%8.2" ECU_ADDRESS 0x7F9ACA /end MEASUREMENT
/begin MEASUREMENT InjUn_tFlDiffCorr_mp "korrigierte Kraftstofftemperaturabweichung" SWORD TempDiff_Kelv 1 100 -3276.800 3276.700 FORMAT "%8.3" ECU_ADDRESS 0x9FF610 /end MEASUREMENT
/begin MEASUREMENT InjUn_tFlDiff_mp "Kraftstofftemperaturabweichung" SWORD TempDiff_Kelv 1 100 -3276.800 3276.700 FORMAT "%8.3" ECU_ADDRESS 0x9FF612 /end MEASUREMENT
/begin MEASUREMENT InjUn_tFlRef_mp "Kraftstoffbezugstemperatur" SWORD Temp_Cels 1 100 -3549.940 3003.560 FORMAT "%8.3" ECU_ADDRESS 0x9FF614 /end MEASUREMENT
/begin MEASUREMENT InjVCD_nActITACMI1_mp "Drehzahl, die im ITAC-Modus für die Umwandlung der SV-Schließzeit in einen Winkel bei Haupteinspritzung verwendet wird" SWORD EngN 1 100 -32768.00 32767.00 FORMAT "%8.2" ECU_ADDRESS 0x9FF622 /end MEASUREMENT
/begin MEASUREMENT InjVCD_nActITACPiI1_mp "Drehzahl, die im ITAC-Modus für die Umwandlung der SV-Schließzeit in einen Winkel bei Voreinspritzung verwendet wird" SWORD EngN 1 100 -32768.00 32767.00 FORMAT "%8.2" ECU_ADDRESS 0x9FF632 /end MEASUREMENT
/begin MEASUREMENT InjVCD_nActITACPoI2_mp "Drehzahl, die im ITAC-Modus für die Umwandlung der SV-Schließzeit in einen Winkel bei Nacheinspritzung verwendet wird" SWORD EngN 1 100 -32768.00 32767.00 FORMAT "%8.2" ECU_ADDRESS 0x9FF63C /end MEASUREMENT
/begin MEASUREMENT InjVCD_numIncr_mp "Anzahl der Inkremente, die benutzt werden, um die Inkrementzeit des ""virtual dynamic WUP"" vorherzusagen" SBYTE OneToOne 1 100 -128.0 127.0 FORMAT "%5.1" ECU_ADDRESS 0x9FFF1C /end MEASUREMENT
/begin MEASUREMENT InjVCD_numInj "Einspritzzähler" UBYTE OneToOne 1 100 0.00 255.0 FORMAT "%5.1" ECU_ADDRESS 0x7F94D0 /end MEASUREMENT
/begin MEASUREMENT InjVCD_phiMI1EOD_mp "Förderende MI1" SWORD AngleCrS 1 100 -768.0000 767.9766 FORMAT "%8.4" ECU_ADDRESS 0x9FF628 /end MEASUREMENT
/begin MEASUREMENT InjVCD_phiMI1SOE_mp "Ansteuerbeginn MI1" SWORD AngleCrS 1 100 -768.0000 767.9766 FORMAT "%8.4" ECU_ADDRESS 0x9FF62A /end MEASUREMENT
/begin MEASUREMENT InjVCD_phiPiI1EOD_mp "Förderende PiI1" SWORD AngleCrS 1 100 -768.0000 767.9766 FORMAT "%8.4" ECU_ADDRESS 0x9FF634 /end MEASUREMENT
/begin MEASUREMENT InjVCD_phiPiI1SOE_mp "Ansteuerbeginn PiI1" SWORD AngleCrS 1 100 -768.0000 767.9766 FORMAT "%8.4" ECU_ADDRESS 0x9FF636 /end MEASUREMENT
/begin MEASUREMENT InjVCD_phiPoI2EODLatest_mp "Grenze für Förderende der Nacheinspritzung" SWORD AngleCrS 1 100 -768.0000 767.9766 FORMAT "%8.4" ECU_ADDRESS 0x9FF63E /end MEASUREMENT
/begin MEASUREMENT InjVCD_phiPoI2EOD_mp "Förderende PoI2" SWORD AngleCrS 1 100 -768.0000 767.9766 FORMAT "%8.4" ECU_ADDRESS 0x9FF640 /end MEASUREMENT
/begin MEASUREMENT InjVCD_phiPoI2SOE_mp "Ansteuerbeginn PoI2" SWORD AngleCrS 1 100 -768.0000 767.9766 FORMAT "%8.4" ECU_ADDRESS 0x9FF642 /end MEASUREMENT
/begin MEASUREMENT InjVCD_phiWUP_mp "Winkel des alten dynamischen WUPs vor der Korrektur" SWORD AngleCrS 1 100 -768.0000 767.9766 FORMAT "%8.4" ECU_ADDRESS 0x9FF616 /end MEASUREMENT
/begin MEASUREMENT InjVCD_stBIPWinVio "Status der BIP-Fensterverletzung" UBYTE OneToOne 1 100 0.00 255.0 FORMAT "%5.1" ARRAY_SIZE 5 ECU_ADDRESS 0x7F9EEC /end MEASUREMENT
/begin MEASUREMENT InjVCD_stInjVlv "Abschaltanforderung für Magnetventil" UWORD OneToOne 1 100 0.00 65535.00 FORMAT "%8.2" ECU_ADDRESS 0x7F9ACC /end MEASUREMENT
/begin MEASUREMENT InjVCD_stInjVlv_mp "LowByte von InjVCD_stInjVlv für Signals" UBYTE OneToOne 1 100 0.00 255.0 FORMAT "%5.1" ECU_ADDRESS 0x7FDE04 /end MEASUREMENT
/begin MEASUREMENT InjVCD_stITAC_mp "Status des ITAC-Modus" UWORD OneToOne 1 100 0.00 65535.00 FORMAT "%8.2" ECU_ADDRESS 0x9FF618 /end MEASUREMENT
/begin MEASUREMENT InjVCD_stPoI2Corr_mp "Status Verschiebung und Kürzung Nacheinspritzung" UBYTE OneToOne 1 100 0.00 255.0 FORMAT "%5.1" ECU_ADDRESS 0x9FFF24 /end MEASUREMENT
/begin MEASUREMENT InjVCD_stWUP_mp "Zustand der ""Extrapolation des virtuellen dynamischen WUPs""" UWORD OneToOne 1 100 0.00 65535.00 FORMAT "%8.2" ECU_ADDRESS 0x9FF61A /end MEASUREMENT
/begin MEASUREMENT InjVCD_tiIncrMain_mp "Increment Periodendauer zum Zeitpunkt des aktuellen Main Interrupts" SWORD InjTime_us 1 100 -32768.00 32767.00 FORMAT "%8.2" ECU_ADDRESS 0x9FF61C /end MEASUREMENT
/begin MEASUREMENT InjVCD_tiIncrWUPMI1PoI2 "Periodendauer des Inkrements vor dem virtuellen dynamischen WUP für die Haupt- und Nacheinspritzung" SWORD InjTime_us 1 100 -32768.00 32767.00 FORMAT "%8.2" ECU_ADDRESS 0x7F9ACE /end MEASUREMENT
/begin MEASUREMENT InjVCD_tiIncrWUPPiI1_mp "Periodendauer des Inkrements vor dem aktuellen Interrupt für die Voreinspritzung" SWORD InjTime_us 1 100 -32768.00 32767.00 FORMAT "%8.2" ECU_ADDRESS 0x9FF63A /end MEASUREMENT
/begin MEASUREMENT InjVCD_tiMainOld_mp "Periodendauer des Inkrements vor dem letzten Main Interrupt" SWORD InjTime_us 1 100 -32768.00 32767.00 FORMAT "%8.2" ECU_ADDRESS 0x9FF61E /end MEASUREMENT
/begin MEASUREMENT InjVCD_tiWUPOld_mp "Periodendauer des Inkrements 1 oder 2 Zylindersegmente vor dem virtuellen dynamischen WUP" SWORD InjTime_us 1 100 -32768.00 32767.00 FORMAT "%8.2" ECU_ADDRESS 0x9FF620 /end MEASUREMENT
/begin MEASUREMENT InjVlv_nCyl1 "Zylinderspezifische Drehzahl für Zylinder 1" SWORD EngN 1 100 -32768.00 32767.00 FORMAT "%8.2" ECU_ADDRESS 0x7F9AD0 /end MEASUREMENT
/begin MEASUREMENT InjVlv_nCyl2 "Zylinderspezifische Drehzahl für Zylinder 2" SWORD EngN 1 100 -32768.00 32767.00 FORMAT "%8.2" ECU_ADDRESS 0x7F9AD2 /end MEASUREMENT
/begin MEASUREMENT InjVlv_nCyl3 "Zylinderspezifische Drehzahl für Zylinder 3" SWORD EngN 1 100 -32768.00 32767.00 FORMAT "%8.2" ECU_ADDRESS 0x7F9AD4 /end MEASUREMENT
/begin MEASUREMENT InjVlv_nCyl4 "Zylinderspezifische Drehzahl für Zylinder 4" SWORD EngN 1 100 -32768.00 32767.00 FORMAT "%8.2" ECU_ADDRESS 0x7F9AD6 /end MEASUREMENT
/begin MEASUREMENT InjVlv_nCyl5 "Zylinderspezifische Drehzahl für Zylinder 5" SWORD EngN 1 100 -32768.00 32767.00 FORMAT "%8.2" ECU_ADDRESS 0x7F9AD8 /end MEASUREMENT
/begin MEASUREMENT InjVlv_nCyl6 "Zylinderspezifische Drehzahl für Zylinder 6" SWORD EngN 1 100 -32768.00 32767.00 FORMAT "%8.2" ECU_ADDRESS 0x7F9ADA /end MEASUREMENT
/begin MEASUREMENT InjVlv_numMI1_mp "Auswahl d. Förderdauerkennfelder InjVCD_phiInjMI1_MAPk" UWORD Map_Select 1 100 0.00 255.9961 FORMAT "%8.4" ECU_ADDRESS 0x9FF646 /end MEASUREMENT
/begin MEASUREMENT InjVlv_numPiI1_mp "Auswahl d. Förderdauerkennfelder InjVCD_phiInjPiI1_MAPk" UWORD Map_Select 1 100 0.00 255.9961 FORMAT "%8.4" ECU_ADDRESS 0x9FF64C /end MEASUREMENT
/begin MEASUREMENT InjVlv_numPoI2_mp "Auswahl der Förderdauerkennfelder Nacheinspritzung" UWORD Map_Select 1 100 0.00 255.9961 FORMAT "%8.4" ECU_ADDRESS 0x9FF652 /end MEASUREMENT
/begin MEASUREMENT InjVlv_phiMI11k "Förderbeginn Haupteinspritzung vom Pumpemkennfeld [k-1]" SWORD AngleCrS 1 100 -768.0000 767.9766 FORMAT "%8.4" ECU_ADDRESS 0x7F9ADC /end MEASUREMENT
/begin MEASUREMENT InjVlv_phiMI1BreMin_mp "min. Ansteuerpause nach der Haupteinspritzung in Winkel" SWORD AngleCrS 1 100 -768.0000 767.9766 FORMAT "%8.4" ECU_ADDRESS 0x9FF65A /end MEASUREMENT
/begin MEASUREMENT InjVlv_phiMI1Bre_mp "Ansteuerpause nach der Haupteinspritzung in Winkel" SWORD AngleCrS 1 100 -768.0000 767.9766 FORMAT "%8.4" ECU_ADDRESS 0x9FF65C /end MEASUREMENT
/begin MEASUREMENT InjVlv_phiMI1CaSCorr_mp "gewünschter korrigierter Ansteuerbeginn der Haupteinspritzung" SWORD AngleCrS 1 100 -768.0000 767.9766 FORMAT "%8.4" ECU_ADDRESS 0x9FF648 /end MEASUREMENT
/begin MEASUREMENT InjVlv_phiMI1DesCorr "verschobener Förderbeginn Haupteinspritzung" SWORD AngleCrS 1 100 -768.0000 767.9766 FORMAT "%8.4" ECU_ADDRESS 0x7F9ADE /end MEASUREMENT
/begin MEASUREMENT InjVlv_phiMI1Dur "Dauer der Haupteinspritzung" SWORD AngleCrS 1 100 -768.0000 767.9766 FORMAT "%8.4" ECU_ADDRESS 0x7F9AE0 /end MEASUREMENT
/begin MEASUREMENT InjVlv_phiMI1Dur1k "Förderdauer Haupteinspritzung des Pumpenkennfeldes [k-1]" SWORD AngleCrS 1 100 -768.0000 767.9766 FORMAT "%8.4" ECU_ADDRESS 0x7F9AE2 /end MEASUREMENT
/begin MEASUREMENT InjVlv_phiMI1DurByp_mp "Messpunkt um InjVlv_phiMI1Dur ueber ASCET vor Bypass auszulesen" SWORD AngleCrS 1 100 -768.0000 767.9766 FORMAT "%8.4" ECU_ADDRESS 0x9FF64A /end MEASUREMENT
/begin MEASUREMENT InjVlv_phiMI1DurCorr "korrigierte Dauer der Haupteinspritzung" SWORD AngleCrS 1 100 -768.0000 767.9766 FORMAT "%8.4" ECU_ADDRESS 0x7F9AE4 /end MEASUREMENT
/begin MEASUREMENT InjVlv_phiMI1Durk "Förderdauer Haupteinspritzung des Pumpenkennfeldes [k]" SWORD AngleCrS 1 100 -768.0000 767.9766 FORMAT "%8.4" ECU_ADDRESS 0x7F9AE6 /end MEASUREMENT
/begin MEASUREMENT InjVlv_phiMI1End_mp "spätestes Förderende der Haupteinspritzung" SWORD AngleCrS 1 100 -768.0000 767.9766 FORMAT "%8.4" ECU_ADDRESS 0x9FF65E /end MEASUREMENT
/begin MEASUREMENT InjVlv_phiMI1InjBre_mp "Förderpause nach der Haupteinspritzung in Winkel" SWORD AngleCrS 1 100 -768.0000 767.9766 FORMAT "%8.4" ECU_ADDRESS 0x9FF660 /end MEASUREMENT
/begin MEASUREMENT InjVlv_phiMI1k "Förderbeginn Haupteinspritzung vom Pumpenkennfeld [k]" SWORD AngleCrS 1 100 -768.0000 767.9766 FORMAT "%8.4" ECU_ADDRESS 0x7F9AE8 /end MEASUREMENT
/begin MEASUREMENT InjVlv_phiPiI1BreMin_mp "minimale Ansteuerpause zwischen Vor- und Haupteinspritzung in °KW" SWORD AngleCrS 1 100 -768.0000 767.9766 FORMAT "%8.4" ECU_ADDRESS 0x9FF664 /end MEASUREMENT
/begin MEASUREMENT InjVlv_phiPiI1Bre_mp "Ansteuerpause nach Voreinspritzung" SWORD AngleCrS 1 100 -768.0000 767.9766 FORMAT "%8.4" ECU_ADDRESS 0x9FF666 /end MEASUREMENT
/begin MEASUREMENT InjVlv_phiPiI1CaSCorr_mp "gewünschter korrigierter Ansteuerbeginn der Voreinspritzung" SWORD AngleCrS 1 100 -768.0000 767.9766 FORMAT "%8.4" ECU_ADDRESS 0x9FF64E /end MEASUREMENT
/begin MEASUREMENT InjVlv_phiPiI1DesCorr "gewünschter korrigierter Förderbeginn der Voreinspritzung" SWORD AngleCrS 1 100 -768.0000 767.9766 FORMAT "%8.4" ECU_ADDRESS 0x7F9AEA /end MEASUREMENT
/begin MEASUREMENT InjVlv_phiPiI1Desk "gewünschter Förderbeginn Voreinspritzung Kennfeld (k-1)" SWORD AngleCrS 1 100 -768.0000 767.9766 FORMAT "%8.4" ECU_ADDRESS 0x7F9AEC /end MEASUREMENT
/begin MEASUREMENT InjVlv_phiPiI1Dur "Dauer der Voreinspritzung" SWORD AngleCrS 1 100 -768.0000 767.9766 FORMAT "%8.4" ECU_ADDRESS 0x7F9AEE /end MEASUREMENT
/begin MEASUREMENT InjVlv_phiPiI1DurByp_mp "Messpunkt um InjVlv_phiPiI1Dur ueber ASCET vor Bypass auszulesen" SWORD AngleCrS 1 100 -768.0000 767.9766 FORMAT "%8.4" ECU_ADDRESS 0x9FF650 /end MEASUREMENT
/begin MEASUREMENT InjVlv_phiPiI1DurCorr "korrigierte Ansteuerdauer Voreinspritzung nach Kürzung Voreinspritzung" SWORD AngleCrS 1 100 -768.0000 767.9766 FORMAT "%8.4" ECU_ADDRESS 0x7F9AF0 /end MEASUREMENT
/begin MEASUREMENT InjVlv_phiPiI1Durk "Förderdauer Voreinspritzung Kennfeld [k]" SWORD AngleCrS 1 100 -768.0000 767.9766 FORMAT "%8.4" ECU_ADDRESS 0x7F9AF2 /end MEASUREMENT
/begin MEASUREMENT InjVlv_phiPiI1End_mp "Ansteuerende Voreinspritzung" SWORD AngleCrS 1 100 -768.0000 767.9766 FORMAT "%8.4" ECU_ADDRESS 0x9FF668 /end MEASUREMENT
/begin MEASUREMENT InjVlv_phiPiI1InjBre_mp "Förderpause nach Voreinspritzung in Winkel" SWORD AngleCrS 1 100 -768.0000 767.9766 FORMAT "%8.4" ECU_ADDRESS 0x9FF66A /end MEASUREMENT
/begin MEASUREMENT InjVlv_phiPoI2CaSCorr_mp "gewünschter korrigierter Ansteuerbeginn der Nacheinspritzung" SWORD AngleCrS 1 100 -768.0000 767.9766 FORMAT "%8.4" ECU_ADDRESS 0x9FF654 /end MEASUREMENT
/begin MEASUREMENT InjVlv_phiPoI2Dur "Dauer der Nacheinspritzung" SWORD AngleCrS 1 100 -768.0000 767.9766 FORMAT "%8.4" ECU_ADDRESS 0x7F9AF4 /end MEASUREMENT
/begin MEASUREMENT InjVlv_phiPoI2DurByp_mp "Messpunkt um InjVlv_phiPoI2Dur ueber ASCET vor Bypass auszulesen" SWORD AngleCrS 1 100 -768.0000 767.9766 FORMAT "%8.4" ECU_ADDRESS 0x9FF656 /end MEASUREMENT
/begin MEASUREMENT InjVlv_qFBCCyl1 "Zylinderselektive FBC-Mengenkorrektur für Zylinder 1" SWORD InjMass 1 100 -327.6800 327.6700 FORMAT "%8.4" ECU_ADDRESS 0x7F9AF6 /end MEASUREMENT
/begin MEASUREMENT InjVlv_qFBCCyl2 "Zylinderselektive FBC-Mengenkorrektur für Zylinder 2" SWORD InjMass 1 100 -327.6800 327.6700 FORMAT "%8.4" ECU_ADDRESS 0x7F9AF8 /end MEASUREMENT
/begin MEASUREMENT InjVlv_qFBCCyl3 "Zylinderselektive FBC-Mengenkorrektur für Zylinder 3" SWORD InjMass 1 100 -327.6800 327.6700 FORMAT "%8.4" ECU_ADDRESS 0x7F9AFA /end MEASUREMENT
/begin MEASUREMENT InjVlv_qFBCCyl4 "Zylinderselektive FBC-Mengenkorrektur für Zylinder 4" SWORD InjMass 1 100 -327.6800 327.6700 FORMAT "%8.4" ECU_ADDRESS 0x7F9AFC /end MEASUREMENT
/begin MEASUREMENT InjVlv_qFBCCyl5 "Zylinderselektive FBC-Mengenkorrektur für Zylinder 5" SWORD InjMass 1 100 -327.6800 327.6700 FORMAT "%8.4" ECU_ADDRESS 0x7F9AFE /end MEASUREMENT
/begin MEASUREMENT InjVlv_qFBCCyl6 "Zylinderselektive FBC-Mengenkorrektur für Zylinder 6" SWORD InjMass 1 100 -327.6800 327.6700 FORMAT "%8.4" ECU_ADDRESS 0x7F9B00 /end MEASUREMENT
/begin MEASUREMENT InjVlv_stMI1Corr_mp "Status der Haupteinspritzverschiebung" UBYTE OneToOne 1 100 0.00 255.0 FORMAT "%5.1" ECU_ADDRESS 0x9FFF2C /end MEASUREMENT
/begin MEASUREMENT InjVlv_stPiI1Corr_mp "Status Verschiebung und Kürzung Voreinspritzung" UBYTE OneToOne 1 100 0.00 255.0 FORMAT "%5.1" ECU_ADDRESS 0x9FFF2D /end MEASUREMENT
/begin MEASUREMENT InjVlv_tiMI1BreAct_mp "Ansteuerpause zwischen Haupt- und Nacheinspritzung in Zeit" SWORD InjTime_us 1 100 -32768.00 32767.00 FORMAT "%8.2" ECU_ADDRESS 0x9FF662 /end MEASUREMENT
/begin MEASUREMENT InjVlv_tiMI1BreMin "min. Ansteuerpause nach der Haupteinspritzung in Zeit" SWORD InjTime_us 1 100 -32768.00 32767.00 FORMAT "%8.2" ECU_ADDRESS 0x7F9B02 /end MEASUREMENT
/begin MEASUREMENT InjVlv_tiPiI1BreAct_mp "Ansteuerpause zwischen Vor- und Haupteinspritzung in Zeit" SWORD InjTime_us 1 100 -32768.00 32767.00 FORMAT "%8.2" ECU_ADDRESS 0x9FF66C /end MEASUREMENT
/begin MEASUREMENT InjVlv_tiPiI1BreMin "minimale Ansteuerpause zwischen Vor- und Haupteinspritzung" SWORD InjTime_us 1 100 -32768.00 32767.00 FORMAT "%8.2" ECU_ADDRESS 0x7F9B04 /end MEASUREMENT
/begin MEASUREMENT LASCD_aLinPT1OP_mp "Ausgang des ersten PT1-Filters" SWORD Acc 1 100 -32.76800 32.76700 FORMAT "%8.5" ECU_ADDRESS 0x9FF66E /end MEASUREMENT
/begin MEASUREMENT LASCD_aLong "gefilterte Längsbeschleunigung" SWORD Acc 1 100 -32.76800 32.76700 FORMAT "%8.5" ECU_ADDRESS 0x7F9B06 /end MEASUREMENT
/begin MEASUREMENT LASCD_aLongUnFlt_mp "ungefilterter Beschleunigungswert" SWORD Acc 1 100 -32.76800 32.76700 FORMAT "%8.5" ECU_ADDRESS 0x9FF670 /end MEASUREMENT
/begin MEASUREMENT LASCD_swtAccSens "Schalter zur Aktivierung des LASCD-Moduls" UBYTE OneToOne 1 100 0.00 255.0 FORMAT "%5.1" ECU_ADDRESS 0x7F94D4 /end MEASUREMENT
/begin MEASUREMENT Layer_nGearDispAct "aktueller Gang für Hochschaltanzeige" UBYTE OneToOne 1 100 0.00 255.0 FORMAT "%5.1" ECU_ADDRESS 0x7F9500 /end MEASUREMENT
/begin MEASUREMENT Layer_nGearDispReq "angeforderter Zielgang für Hochschaltanzeige" UBYTE OneToOne 1 100 0.00 255.0 FORMAT "%5.1" ECU_ADDRESS 0x7F9501 /end MEASUREMENT
/begin MEASUREMENT LIGov_DKd "aktueller D Glied Parameter Kd" SWORD KD_RPM2NM_3 1 100 -1.600000 1.599951 FORMAT "%8.6" ECU_ADDRESS 0x7F9B08 /end MEASUREMENT
/begin MEASUREMENT LIGov_IKi "aktueller I Anteil Kleinsignalparameter Ki" UWORD KI_RPM2NM_2 1 100 0.00 24.41369 FORMAT "%8.5" ECU_ADDRESS 0x7F9B0A /end MEASUREMENT
/begin MEASUREMENT LIGov_IKiNeg "aktueller I Parameter negative Großsignale KiNeg" UWORD KI_RPM2NM_2 1 100 0.00 24.41369 FORMAT "%8.5" ECU_ADDRESS 0x7F9B0C /end MEASUREMENT
/begin MEASUREMENT LIGov_IKiPos "aktueller positiver I Großsignalparameter" UWORD KI_RPM2NM_2 1 100 0.00 24.41369 FORMAT "%8.5" ECU_ADDRESS 0x7F9B0E /end MEASUREMENT
/begin MEASUREMENT LIGov_InitIZero_mp "Status Init I Anteil mit Null" UBYTE OneToOne 1 100 0.00 255.0 FORMAT "%5.1" ECU_ADDRESS 0x9FFF2E /end MEASUREMENT
/begin MEASUREMENT LIGov_IWinNeg "aktuelles negatives Kleinsignalfenster für I Parameter" SWORD EngN 1 100 -32768.00 32767.00 FORMAT "%8.2" ECU_ADDRESS 0x7F9B10 /end MEASUREMENT
/begin MEASUREMENT LIGov_IWinPos "aktuelles positives Kleinsignalfenster für I Parameter" SWORD EngN 1 100 -32768.00 32767.00 FORMAT "%8.2" ECU_ADDRESS 0x7F9B12 /end MEASUREMENT
/begin MEASUREMENT LIGov_nAvrg_mp "OLDA-Größe für Eng_nAvrg" SWORD EngN 1 100 -32768.00 32767.00 FORMAT "%8.2" ECU_ADDRESS 0x9FF676 /end MEASUREMENT
/begin MEASUREMENT LIGov_nDHypDenom "aktueller Denominator für D Anteil Gewichtungsfaktor" SWORD EngN 1 100 -32768.00 32767.00 FORMAT "%8.2" ECU_ADDRESS 0x7F9B20 /end MEASUREMENT
/begin MEASUREMENT LIGov_nDHypNum "aktueller Numinator für D Anteil Gewichtungsfaktor" SWORD EngN 1 100 -32768.00 32767.00 FORMAT "%8.2" ECU_ADDRESS 0x7F9B22 /end MEASUREMENT
/begin MEASUREMENT LIGov_nDiff_mp "n Regelabweichung" SWORD EngN 1 100 -32768.00 32767.00 FORMAT "%8.2" ECU_ADDRESS 0x9FF678 /end MEASUREMENT
/begin MEASUREMENT LIGov_nFrznShift_mp "eingefrorene Drehzahl vor Schaltung" SWORD EngN 1 100 -32768.00 32767.00 FORMAT "%8.2" ECU_ADDRESS 0x9FF67A /end MEASUREMENT
/begin MEASUREMENT LIGov_nLim "erhöhte Leerlauf-Solldrehzahl" SWORD EngN 1 100 -32768.00 32767.00 FORMAT "%8.2" ECU_ADDRESS 0x7F9B24 /end MEASUREMENT
/begin MEASUREMENT LIGov_nRgn_mp "Meßpunkt für die LL-Drehzahlanhebung je nach Regenerationsstufe" SWORD EngN 1 100 -32768.00 32767.00 FORMAT "%8.2" ECU_ADDRESS 0x9FF67C /end MEASUREMENT
/begin MEASUREMENT LIGov_nSetpoint "Leerlaufsolldrehzahl" SWORD EngN 1 100 -32768.00 32767.00 FORMAT "%8.2" ECU_ADDRESS 0x7F9B26 /end MEASUREMENT
/begin MEASUREMENT LIGov_nSetPointRmpInit_mp "Initialisierungswert für LIGov-Solldrehzahl Rampen" SWORD EngN 1 100 -32768.00 32767.00 FORMAT "%8.2" ECU_ADDRESS 0x9FF672 /end MEASUREMENT
/begin MEASUREMENT LIGov_nSetpointTemp "Sollwert Leerlaufregler temperaturabhängig" SWORD EngN 1 100 -32768.00 32767.00 FORMAT "%8.2" ECU_ADDRESS 0x7F9B28 /end MEASUREMENT
/begin MEASUREMENT LIGov_nSetpointTrmEEP_mp "Limitierter EEPROM Abgleichwert von LIGOV_SETDIA" SWORD EngN 1 100 -32768.00 32767.00 FORMAT "%8.2" ECU_ADDRESS 0x9FF674 /end MEASUREMENT
/begin MEASUREMENT LIGov_nSetRmp2_mp "Meßpunkt vor zweiter Rampe" SWORD EngN 1 100 -32768.00 32767.00 FORMAT "%8.2" ECU_ADDRESS 0x9FF67E /end MEASUREMENT
/begin MEASUREMENT LIGov_nSetShift_mp "berechnete Drehzahl nach Schaltung" SWORD EngN 1 100 -32768.00 32767.00 FORMAT "%8.2" ECU_ADDRESS 0x9FF680 /end MEASUREMENT
/begin MEASUREMENT LIGov_nShiftDiff_mp "Drehzahldifferenz durch Schaltung" SWORD EngN 1 100 -32768.00 32767.00 FORMAT "%8.2" ECU_ADDRESS 0x9FF682 /end MEASUREMENT
/begin MEASUREMENT LIGov_PKp "aktueller Kleinsignalparameter Kp" UWORD KP_RPM2NM_2 1 100 0.00 3.199951 FORMAT "%8.6" ECU_ADDRESS 0x7F9B14 /end MEASUREMENT
/begin MEASUREMENT LIGov_PKpNeg "aktueller negativer Großsignalparameter KpNeg" UWORD KP_RPM2NM_2 1 100 0.00 3.199951 FORMAT "%8.6" ECU_ADDRESS 0x7F9B16 /end MEASUREMENT
/begin MEASUREMENT LIGov_PKpPos "aktueller positiver Großsignalparameter KpPos" UWORD KP_RPM2NM_2 1 100 0.00 3.199951 FORMAT "%8.6" ECU_ADDRESS 0x7F9B18 /end MEASUREMENT
/begin MEASUREMENT LIGov_Predef "aktuelles Einschrittmoment" SWORD Trq 1 100 -3276.800 3276.700 FORMAT "%8.3" ECU_ADDRESS 0x7F9B1E /end MEASUREMENT
/begin MEASUREMENT LIGov_PWinNeg "aktuelle negatives Kleinsignalfenster für P parameter" SWORD EngN 1 100 -32768.00 32767.00 FORMAT "%8.2" ECU_ADDRESS 0x7F9B1A /end MEASUREMENT
/begin MEASUREMENT LIGov_PWinPos "aktuelles positives Kleinsignalfenster für P Parameter" SWORD EngN 1 100 -32768.00 32767.00 FORMAT "%8.2" ECU_ADDRESS 0x7F9B1C /end MEASUREMENT
/begin MEASUREMENT LIGov_rShiftDiff_mp "Uebersetzungsdifferenz durch Schaltung" SWORD TransR 1 100 -327.6800 327.6700 FORMAT "%8.4" ECU_ADDRESS 0x9FF684 /end MEASUREMENT
/begin MEASUREMENT LIGov_rTransFrzn_mp "eingefrorene Uebersetzung vor Schaltung" SWORD TransR 1 100 -327.6800 327.6700 FORMAT "%8.4" ECU_ADDRESS 0x9FF686 /end MEASUREMENT
/begin MEASUREMENT LIGov_rTransSet_mp "berechnete Uebersetzung nach Schaltung" SWORD TransR 1 100 -327.6800 327.6700 FORMAT "%8.4" ECU_ADDRESS 0x9FF688 /end MEASUREMENT
/begin MEASUREMENT LIGov_rTransShift_mp "aktuelles Uebersetzungsverhaeltnis" SWORD TransR 1 100 -327.6800 327.6700 FORMAT "%8.4" ECU_ADDRESS 0x9FF68A /end MEASUREMENT
/begin MEASUREMENT LIGov_st "Zustand des Leerlaufreglers" UWORD OneToOne 1 100 0.00 65535.00 FORMAT "%8.2" ECU_ADDRESS 0x7F9B2A /end MEASUREMENT
/begin MEASUREMENT LIGov_stBasAdjActive "Freigabe des I-Anteils angefordert" UBYTE OneToOne 1 100 0.00 255.0 FORMAT "%5.1" ECU_ADDRESS 0x7F94D5 /end MEASUREMENT
/begin MEASUREMENT LIGov_stCalcRgnMsk_mp "Statusbyte des Regenerationseingriffs" UBYTE OneToOne 1 100 0.00 255.0 FORMAT "%5.1" ECU_ADDRESS 0x9FFF2F /end MEASUREMENT
/begin MEASUREMENT LIGov_stFFCalcRgnMsk_mp "Statusbyte nach dem Flip Flop des Regenerationseingriffs" UBYTE OneToOne 1 100 0.00 255.0 FORMAT "%5.1" ECU_ADDRESS 0x9FFF30 /end MEASUREMENT
/begin MEASUREMENT LIGov_stGear "Ganginformation für Parameterauswahl" SBYTE OneToOne 1 100 -128.0 127.0 FORMAT "%5.1" ECU_ADDRESS 0x7F94D6 /end MEASUREMENT
/begin MEASUREMENT LIGov_swtParDriveoff "SW-Schalter für die Verwendung eines Parametersatzes DriveOff (Anfahren)" UBYTE OneToOne 1 100 0.00 255.0 FORMAT "%5.1" ECU_ADDRESS 0x7F94D7 /end MEASUREMENT
/begin MEASUREMENT LIGov_tEngHys "aktuelle entjitterte Motortemperatur" SWORD Temp_Cels 1 100 -3549.940 3003.560 FORMAT "%8.3" ECU_ADDRESS 0x7F9B2C /end MEASUREMENT
/begin MEASUREMENT LIGov_tEngTrqInit_mp "Temperaturwert von dem Array Eng_tFld" SWORD Temp_Cels 1 100 -3549.940 3003.560 FORMAT "%8.3" ECU_ADDRESS 0x9FF68C /end MEASUREMENT
/begin MEASUREMENT LIGov_tiDT1 "aktuelle Zeitkonstante für D Anteil" SWORD TimeDelay_s_Lin_16_3 1 100 -250.0076 250.0000 FORMAT "%8.4" ECU_ADDRESS 0x7F9B2E /end MEASUREMENT
/begin MEASUREMENT LIGov_tiPT1_mp "aktuelle PT1 Zeitkonstante für PT1 filtern des LLR Ausgangs" SWORD TimeDelay_s_Lin_16 1 100 -5.000153 5.000000 FORMAT "%8.6" ECU_ADDRESS 0x9FF68E /end MEASUREMENT
/begin MEASUREMENT LIGov_trq "Leerlaufreglermoment" SWORD Trq 1 100 -3276.800 3276.700 FORMAT "%8.3" ECU_ADDRESS 0x7F9B30 /end MEASUREMENT
/begin MEASUREMENT LIGov_trqD_mp "Messpunkt für den Wert des D-Anteils des LLR" SWORD Trq 1 100 -3276.800 3276.700 FORMAT "%8.3" ECU_ADDRESS 0x9FF690 /end MEASUREMENT
/begin MEASUREMENT LIGov_trqFlt "Leerlaufreglermoment PT1 gefiltert" SWORD Trq 1 100 -3276.800 3276.700 FORMAT "%8.3" ECU_ADDRESS 0x7F9B32 /end MEASUREMENT
/begin MEASUREMENT LIGov_trqFrzn_mp "eingefrorenes LLR Moment vor Schaltung" SWORD Trq 1 100 -3276.800 3276.700 FORMAT "%8.3" ECU_ADDRESS 0x9FF692 /end MEASUREMENT
/begin MEASUREMENT LIGov_trqI "Wert des I-Anteils des LLR" SWORD Trq 1 100 -3276.800 3276.700 FORMAT "%8.3" ECU_ADDRESS 0x7F9B34 /end MEASUREMENT
/begin MEASUREMENT LIGov_trqInitI "Initialisierungsmoment für I-Anteil nach Start" SWORD Trq 1 100 -3276.800 3276.700 FORMAT "%8.3" ECU_ADDRESS 0x7F9B36 /end MEASUREMENT
/begin MEASUREMENT LIGov_trqInitIShift_mp "neuer I Anteil" SWORD Trq 1 100 -3276.800 3276.700 FORMAT "%8.3" ECU_ADDRESS 0x9FF694 /end MEASUREMENT
/begin MEASUREMENT LIGov_trqIState "LIGov Status des I-Anteils" SLONG Trq 1 100 -214748364.800 214748364.700 FORMAT "%13.3" ECU_ADDRESS 0x7F9E80 /end MEASUREMENT
/begin MEASUREMENT LIGov_trqI_mp "Messpunkt für den Wert des I-Anteils des LLR" SWORD Trq 1 100 -3276.800 3276.700 FORMAT "%8.3" ECU_ADDRESS 0x9FF696 /end MEASUREMENT
/begin MEASUREMENT LIGov_trqMax_mp "aktueller LLR Begrenzungswert" SWORD Trq 1 100 -3276.800 3276.700 FORMAT "%8.3" ECU_ADDRESS 0x9FF698 /end MEASUREMENT
/begin MEASUREMENT LIGov_trqP "Wert des P-Anteils des LLR" SWORD Trq 1 100 -3276.800 3276.700 FORMAT "%8.3" ECU_ADDRESS 0x7F9B38 /end MEASUREMENT
/begin MEASUREMENT LIGov_trqP_mp "Messpunkt für den Wert des P-Anteils des LLR" SWORD Trq 1 100 -3276.800 3276.700 FORMAT "%8.3" ECU_ADDRESS 0x9FF69A /end MEASUREMENT
/begin MEASUREMENT LIGov_trqShift_mp "neues LLR Moment" SWORD Trq 1 100 -3276.800 3276.700 FORMAT "%8.3" ECU_ADDRESS 0x9FF69C /end MEASUREMENT
/begin MEASUREMENT LockCnt_tiLock "Zeit in Minuten die das ECU gesperrt bleibt." UBYTE OneToOne 1 100 0.00 255.0 FORMAT "%5.1" ECU_ADDRESS 0x7F9502 /end MEASUREMENT
/begin MEASUREMENT LSUCD_ctHtCoup "Zähler für LSU Diagnose Heizerkopplung" UWORD OneToOne 1 100 0.00 65535.00 FORMAT "%8.2" ARRAY_SIZE 1 ECU_ADDRESS 0x7F9B3A /end MEASUREMENT
/begin MEASUREMENT LSUCD_d2rO2Eval_mp "Bewertungsgröße für Lernfortschritt" SWORD O2 1 100 -0.3276800 0.3276700 FORMAT "%9.7" ARRAY_SIZE 1 ECU_ADDRESS 0x9FF6B4 /end MEASUREMENT
/begin MEASUREMENT LSUCD_d2rO2_mp "Eingangsgröße des Bewertungsfilters" SWORD O2 1 100 -0.3276800 0.3276700 FORMAT "%9.7" ARRAY_SIZE 1 ECU_ADDRESS 0x9FF6B6 /end MEASUREMENT
/begin MEASUREMENT LSUCD_dcycHtCor "Tastverhältnis Heizer Endstufe nach Batteriespannungs Korrektur" SWORD DtyCyc 1 100 -327.6800 327.6700 FORMAT "%8.4" ARRAY_SIZE 1 ECU_ADDRESS 0x7F9B3C /end MEASUREMENT
/begin MEASUREMENT LSUCD_dcycHtCoupStep1 "Heizungs-Aufgabe fährt im ersten Signalerwerbungs-Zyklus rad" SWORD DtyCyc 1 100 -327.6800 327.6700 FORMAT "%8.4" ARRAY_SIZE 1 ECU_ADDRESS 0x7F9B3E /end MEASUREMENT
/begin MEASUREMENT LSUCD_dcycHtCoupStep2 "Heizungs-Aufgabe fährt im zweiten Signalerwerbungs-Zyklus rad" SWORD DtyCyc 1 100 -327.6800 327.6700 FORMAT "%8.4" ARRAY_SIZE 1 ECU_ADDRESS 0x7F9B40 /end MEASUREMENT
/begin MEASUREMENT LSUCD_dcycHtCoupStep3 "Heizungs-Aufgabe fährt im dritten Signalerwerbungs-Zyklus rad" SWORD DtyCyc 1 100 -327.6800 327.6700 FORMAT "%8.4" ARRAY_SIZE 1 ECU_ADDRESS 0x7F9B42 /end MEASUREMENT
/begin MEASUREMENT LSUCD_dcycLimActHt "Aktuelle Tastverhältnisgrenze Heizeransteuerung für nominales Tastverhältnis (vor Korrektur)" SWORD DtyCyc 1 100 -327.6800 327.6700 FORMAT "%8.4" ARRAY_SIZE 1 ECU_ADDRESS 0x7F9B44 /end MEASUREMENT
/begin MEASUREMENT LSUCD_dcycRippel_mp "Änderung des Heizungs-Tastverhältnisses bei Diagnose der Heizungskopplung" SWORD DtyCyc 1 100 -327.6800 327.6700 FORMAT "%8.4" ARRAY_SIZE 1 ECU_ADDRESS 0x9FF6D0 /end MEASUREMENT
/begin MEASUREMENT LSUCD_dHtCoupStep "Schieberegister für die Aufzeichnung der Werte" UBYTE OneToOne 1 100 0.00 255.0 FORMAT "%5.1" ECU_ADDRESS 0x7F94D8 /end MEASUREMENT
/begin MEASUREMENT LSUCD_dHtCoupStepLast "Letzter Wert des Schieberegisters" UBYTE OneToOne 1 100 0.00 255.0 FORMAT "%5.1" ECU_ADDRESS 0x7F94D9 /end MEASUREMENT
/begin MEASUREMENT LSUCD_drO2Adpt "Eingelernter absoluter Messfehler der Sauerstoffkonzentration" SWORD O2 1 100 -0.3276800 0.3276700 FORMAT "%9.7" ARRAY_SIZE 1 ECU_ADDRESS 0x7F9B46 /end MEASUREMENT
/begin MEASUREMENT LSUCD_drO2Flt_mp "Ausgangsgröße des Adaptionsfilters" SWORD O2 1 100 -0.3276800 0.3276700 FORMAT "%9.7" ARRAY_SIZE 1 ECU_ADDRESS 0x9FF6B8 /end MEASUREMENT
/begin MEASUREMENT LSUCD_facO2Corr_mp "Aktueller Korrekturfaktor der Adaption" SWORD Fact 1 100 -4.000000 3.999878 FORMAT "%8.6" ARRAY_SIZE 1 ECU_ADDRESS 0x9FF6BA /end MEASUREMENT
/begin MEASUREMENT LSUCD_facPresComp_mp "Druckkorrekturfaktor" SWORD Fact 1 100 -4.000000 3.999878 FORMAT "%8.6" ARRAY_SIZE 1 ECU_ADDRESS 0x9FF6C4 /end MEASUREMENT
/begin MEASUREMENT LSUCD_facUCor_mp "Korrektur Faktor für Heizeranforderung" SWORD Fact 1 100 -4.000000 3.999878 FORMAT "%8.6" ECU_ADDRESS 0x9FF6BC /end MEASUREMENT
/begin MEASUREMENT LSUCD_mAirAftOvrrun "Integral über Luftmassenstrom seit Beginn der Schubphase" SWORD AirMass_2 1 100 -3276.800 3276.700 FORMAT "%8.3" ECU_ADDRESS 0x7F9B48 /end MEASUREMENT
/begin MEASUREMENT LSUCD_pExhGasLstVal_mp "Abgas-Wert des letzten geschätzten Sensors" SWORD Pres_hPa 1 100 -32768.00 32767.00 FORMAT "%8.2" ECU_ADDRESS 0x9FF6C6 /end MEASUREMENT
/begin MEASUREMENT LSUCD_resRi "Ri Meßwert (gefiltert und korrigiert)" SWORD Resist 1 100 -3276.800 3276.700 FORMAT "%8.3" ARRAY_SIZE 1 ECU_ADDRESS 0x7F9B52 /end MEASUREMENT
/begin MEASUREMENT LSUCD_resRiChange_mp "Betrag der Ri-Änderung mit dem letzten gefilterten Wert" SWORD Resist 1 100 -3276.800 3276.700 FORMAT "%8.3" ARRAY_SIZE 1 ECU_ADDRESS 0x9FF6CA /end MEASUREMENT
/begin MEASUREMENT LSUCD_resRiClb "Korrekturwert Ri Offset" SWORD Resist 1 100 -3276.800 3276.700 FORMAT "%8.3" ARRAY_SIZE 1 ECU_ADDRESS 0x7F9B54 /end MEASUREMENT
/begin MEASUREMENT LSUCD_resRiClbRaw_mp "Rohwert Ri Korrektur ohne Filterung" SWORD Resist 1 100 -3276.800 3276.700 FORMAT "%8.3" ARRAY_SIZE 1 ECU_ADDRESS 0x9FF6CC /end MEASUREMENT
/begin MEASUREMENT LSUCD_resRiHtCoupStep1 "Innerer Wiederstand im ersten Datenakquisitionszyklus" SWORD Resist 1 100 -3276.800 3276.700 FORMAT "%8.3" ARRAY_SIZE 1 ECU_ADDRESS 0x7F9B56 /end MEASUREMENT
/begin MEASUREMENT LSUCD_resRiHtCoupStep2 "Innerer Wiederstand im zweiten Datenakquisitionszyklus" SWORD Resist 1 100 -3276.800 3276.700 FORMAT "%8.3" ARRAY_SIZE 1 ECU_ADDRESS 0x7F9B58 /end MEASUREMENT
/begin MEASUREMENT LSUCD_resRiHtCoupStep3 "Innerer Wiederstand im dritten Datenakquisitionszyklus" SWORD Resist 1 100 -3276.800 3276.700 FORMAT "%8.3" ARRAY_SIZE 1 ECU_ADDRESS 0x7F9B5A /end MEASUREMENT
/begin MEASUREMENT LSUCD_resRiRaw "Ri Meßwert ohne Korrektur" SWORD Resist 1 100 -3276.800 3276.700 FORMAT "%8.3" ARRAY_SIZE 1 ECU_ADDRESS 0x7F9B5C /end MEASUREMENT
/begin MEASUREMENT LSUCD_resRiRippel_mp "Änderung des Innenwiderstands bei Freigabe der Heizung" SWORD Resist 1 100 -3276.800 3276.700 FORMAT "%8.3" ARRAY_SIZE 1 ECU_ADDRESS 0x9FF6D2 /end MEASUREMENT
/begin MEASUREMENT LSUCD_resRi_mp "Ri-Messwert gefiltert und korrigiert" SWORD Resist 1 100 -3276.800 3276.700 FORMAT "%8.3" ECU_ADDRESS 0x9FF6CE /end MEASUREMENT
/begin MEASUREMENT LSUCD_rO2Act "Aktueller O2 Meßwert ohne Ausblendung Abgleichvorgang" SWORD O2 1 100 -0.3276800 0.3276700 FORMAT "%9.7" ARRAY_SIZE 1 ECU_ADDRESS 0x7F9B4A /end MEASUREMENT
/begin MEASUREMENT LSUCD_rO2Adpt "Adaptierte Sauerstoffkonzentration" SWORD O2 1 100 -0.3276800 0.3276700 FORMAT "%9.7" ARRAY_SIZE 1 ECU_ADDRESS 0x7F9B4C /end MEASUREMENT
/begin MEASUREMENT LSUCD_rO2PresComp "Druckkompensierte Sauerstoffkonzentration" SWORD O2 1 100 -0.3276800 0.3276700 FORMAT "%9.7" ARRAY_SIZE 1 ECU_ADDRESS 0x7F9B4E /end MEASUREMENT
/begin MEASUREMENT LSUCD_rO2Raw "O2 Wert ohne Druck- und Empfindlichkeitskorrektur" SWORD O2 1 100 -0.3276800 0.3276700 FORMAT "%9.7" ARRAY_SIZE 1 ECU_ADDRESS 0x7F9B50 /end MEASUREMENT
/begin MEASUREMENT LSUCD_rOutHWE_mp "Tastverhältnis Heizerendstufe nach Stellertest Anforderung und Endstufen Diagnose." SWORD DtyCyc 1 100 -327.6800 327.6700 FORMAT "%8.4" ARRAY_SIZE 1 ECU_ADDRESS 0x9FF6BE /end MEASUREMENT
/begin MEASUREMENT LSUCD_stAdpt "Zustandsgröße der Adaption (adaptiert / nicht adaptiert)" UBYTE OneToOne 1 100 0.00 255.0 FORMAT "%5.1" ARRAY_SIZE 1 ECU_ADDRESS 0x7F94DA /end MEASUREMENT
/begin MEASUREMENT LSUCD_stAdptActv_mp "Zustand der Lernphase (aktiv / nicht aktiv)" UBYTE OneToOne 1 100 0.00 255.0 FORMAT "%5.1" ARRAY_SIZE 1 ECU_ADDRESS 0x9FFF3B /end MEASUREMENT
/begin MEASUREMENT LSUCD_stChange_mp "Neues Lernergebnis im aktuellen Fahrzyklus" UBYTE OneToOne 1 100 0.00 255.0 FORMAT "%5.1" ARRAY_SIZE 1 ECU_ADDRESS 0x9FFF3C /end MEASUREMENT
/begin MEASUREMENT LSUCD_stCircModeNew "Aktueller Wert des Auswerteschaltungs Modes (CJ 120 Konfiguration)" UWORD OneToOne 1 100 0.00 65535.00 FORMAT "%8.2" ARRAY_SIZE 1 ECU_ADDRESS 0x7F9B5E /end MEASUREMENT
/begin MEASUREMENT LSUCD_stCircModeNewLow "LowByte von LSUCD_stCircModeNew" UBYTE OneToOne 1 100 0.00 255.0 FORMAT "%5.1" ECU_ADDRESS 0x7F94DB /end MEASUREMENT
/begin MEASUREMENT LSUCD_stDiaIAEna "Message um die Erkennung von IA oder IP Kurzschluss nach Masse freizugeben" UBYTE OneToOne 1 100 0.00 255.0 FORMAT "%5.1" ARRAY_SIZE 1 ECU_ADDRESS 0x7F94DC /end MEASUREMENT
/begin MEASUREMENT LSUCD_stHold_mp "Zustandsgröße der Adaption (gestört / nicht gestört)" UBYTE OneToOne 1 100 0.00 255.0 FORMAT "%5.1" ARRAY_SIZE 1 ECU_ADDRESS 0x9FFF3D /end MEASUREMENT
/begin MEASUREMENT LSUCD_stHtCoupActv "Statusbotschaft für Heizungskopplung aktiv" UBYTE OneToOne 1 100 0.00 255.0 FORMAT "%5.1" ECU_ADDRESS 0x7F94DD /end MEASUREMENT
/begin MEASUREMENT LSUCD_stHtDis "Zustand Heizerabschaltung wegen Batteriespannung oder Betriebsmodus" UBYTE OneToOne 1 100 0.00 255.0 FORMAT "%5.1" ECU_ADDRESS 0x7F94DE /end MEASUREMENT
/begin MEASUREMENT LSUCD_stInitClb "Erste CJ120-Kalibrierung wurde angefordert" UBYTE OneToOne 1 100 0.00 255.0 FORMAT "%5.1" ECU_ADDRESS 0x7F94DF /end MEASUREMENT
/begin MEASUREMENT LSUCD_stIpHighCurEna "Status-Message für hohen (0 bis 150ua) Referenzpumpstrom für CJ125" UBYTE OneToOne 1 100 0.00 255.0 FORMAT "%5.1" ARRAY_SIZE 1 ECU_ADDRESS 0x7F94E0 /end MEASUREMENT
/begin MEASUREMENT LSUCD_stIpNormCurEna "Status-Message für normalen (0 bis 150ua) Referenzpumpstrom für CJ125" UBYTE OneToOne 1 100 0.00 255.0 FORMAT "%5.1" ARRAY_SIZE 1 ECU_ADDRESS 0x7F94E1 /end MEASUREMENT
/begin MEASUREMENT LSUCD_stIsolChkActv "Nebenschlußerkennung ist momentan aktiv" UBYTE OneToOne 1 100 0.00 255.0 FORMAT "%5.1" ARRAY_SIZE 1 ECU_ADDRESS 0x7F94E2 /end MEASUREMENT
/begin MEASUREMENT LSUCD_stIsolChkO2Last "Status ob die O2 Konzentration im letzten Zyklus innerhalb des vorgegebenen Fensters war" UBYTE OneToOne 1 100 0.00 255.0 FORMAT "%5.1" ARRAY_SIZE 1 ECU_ADDRESS 0x7F94E3 /end MEASUREMENT
/begin MEASUREMENT LSUCD_stIsolChkStrt "Statusmessage zum Starten der Nebenschlusserkennung" UBYTE OneToOne 1 100 0.00 255.0 FORMAT "%5.1" ARRAY_SIZE 1 ECU_ADDRESS 0x7F94E4 /end MEASUREMENT
/begin MEASUREMENT LSUCD_stO2Act "Gültigkeitsstatus des aktuellen O2 Signals (0 = ungültig, 1 = gültig)" UBYTE OneToOne 1 100 0.00 255.0 FORMAT "%5.1" ARRAY_SIZE 1 ECU_ADDRESS 0x7F94E5 /end MEASUREMENT
/begin MEASUREMENT LSUCD_stO2ClbEna "Auslösesignal für O2 Offsetspannung Kalibriersequenz" UBYTE OneToOne 1 100 0.00 255.0 FORMAT "%5.1" ECU_ADDRESS 0x7F94E6 /end MEASUREMENT
/begin MEASUREMENT LSUCD_stO2Clb_mp "Zusatands Bits der O2 Offset Abgleich Sequenz" UBYTE OneToOne 1 100 0.00 255.0 FORMAT "%5.1" ECU_ADDRESS 0x9FFF3F /end MEASUREMENT
/begin MEASUREMENT LSUCD_stO2IntValid "Status des internen O2-Rohsignals (gültig/ungültig)" UBYTE OneToOne 1 100 0.00 255.0 FORMAT "%5.1" ARRAY_SIZE 1 ECU_ADDRESS 0x7F94E7 /end MEASUREMENT
/begin MEASUREMENT LSUCD_stO2SPICalDem "SPI Status-Message um die Schaltung in den Kalibriermodus zu versetzen" UBYTE OneToOne 1 100 0.00 255.0 FORMAT "%5.1" ECU_ADDRESS 0x7F94E8 /end MEASUREMENT
/begin MEASUREMENT LSUCD_stO2SPISens "Modus-Bits zum Setzen der Empfindlichkeit der O2-Auswertung" UWORD OneToOne 1 100 0.00 65535.00 FORMAT "%8.2" ARRAY_SIZE 1 ECU_ADDRESS 0x7F9B60 /end MEASUREMENT
/begin MEASUREMENT LSUCD_stO2Valid "Zustand O2 Signal (0 = ungültig, 1 = gültig)" UBYTE OneToOne 1 100 0.00 255.0 FORMAT "%5.1" ARRAY_SIZE 1 ECU_ADDRESS 0x7F94E9 /end MEASUREMENT
/begin MEASUREMENT LSUCD_stOpnErrIP "Status Leerlauf-Fehler Pumpstrom Pin (IP)" UBYTE OneToOne 1 100 0.00 255.0 FORMAT "%5.1" ARRAY_SIZE 1 ECU_ADDRESS 0x7F94EA /end MEASUREMENT
/begin MEASUREMENT LSUCD_stOpnLdTstActv "Message von LSU_WireDiagnosis, die anzeigt, ob die Kabelunterbrechungsdiagnose für Nernst-Zelle und virtuelle Masse aktiv ist" UBYTE OneToOne 1 100 0.00 255.0 FORMAT "%5.1" ARRAY_SIZE 1 ECU_ADDRESS 0x7F94EB /end MEASUREMENT
/begin MEASUREMENT LSUCD_stPumpCtl "Status der Pumpensteuerung (ein/aus)" UBYTE OneToOne 1 100 0.00 255.0 FORMAT "%5.1" ARRAY_SIZE 1 ECU_ADDRESS 0x7F94EC /end MEASUREMENT
/begin MEASUREMENT LSUCD_stPumpDemRef "externe Anforderung Referenzpumpströme" UBYTE OneToOne 1 100 0.00 255.0 FORMAT "%5.1" ARRAY_SIZE 1 ECU_ADDRESS 0x7F94ED /end MEASUREMENT
/begin MEASUREMENT LSUCD_stPumpEna "Zustand der CJ 120 Pumpstromregelung (0 = abgeschaltet, 1 = aktiv = Strom angeschaltet)" UBYTE OneToOne 1 100 0.00 255.0 FORMAT "%5.1" ARRAY_SIZE 1 ECU_ADDRESS 0x7F94EE /end MEASUREMENT
/begin MEASUREMENT LSUCD_stRecValEval_mp "Messpunkt für den Status der Auswertung erfasster Werte in der Heizungskopplung" UBYTE OneToOne 1 100 0.00 255.0 FORMAT "%5.1" ARRAY_SIZE 1 ECU_ADDRESS 0x9FFF43 /end MEASUREMENT
/begin MEASUREMENT LSUCD_stRefCurTrans_mp "Status des Übergangs von hohem zu niedrigem Strom" UBYTE OneToOne 1 100 0.00 255.0 FORMAT "%5.1" ARRAY_SIZE 1 ECU_ADDRESS 0x9FFF3E /end MEASUREMENT
/begin MEASUREMENT LSUCD_stRefPump "Status der Referenz Pumpströme (0 = off, 1 = 20 uA, 2 = 40 uA, 3 = 60 uA)" UBYTE OneToOne 1 100 0.00 255.0 FORMAT "%5.1" ARRAY_SIZE 1 ECU_ADDRESS 0x7F94EF /end MEASUREMENT
/begin MEASUREMENT LSUCD_stRgnEna "Nachricht, um Regeneration zu befähigen" UBYTE OneToOne 1 100 0.00 255.0 FORMAT "%5.1" ECU_ADDRESS 0x7F94F0 /end MEASUREMENT
/begin MEASUREMENT LSUCD_stRgnIpSettle "Status des Pumpe-Stromes, der nach Regeneration setzt" UBYTE OneToOne 1 100 0.00 255.0 FORMAT "%5.1" ECU_ADDRESS 0x7F94F1 /end MEASUREMENT
/begin MEASUREMENT LSUCD_stRiClb "Status der Ri-Kalibrierungssequenz" UBYTE OneToOne 1 100 0.00 255.0 FORMAT "%5.1" ECU_ADDRESS 0x7F94F2 /end MEASUREMENT
/begin MEASUREMENT LSUCD_stRiClbEna "Auslöser für Ri Abgleichsequenz" UBYTE OneToOne 1 100 0.00 255.0 FORMAT "%5.1" ECU_ADDRESS 0x7F94F3 /end MEASUREMENT
/begin MEASUREMENT LSUCD_stRiFltAct_mp "Messpunkt für den Status der Filteraktivierung" UBYTE OneToOne 1 100 0.00 255.0 FORMAT "%5.1" ARRAY_SIZE 1 ECU_ADDRESS 0x9FFF41 /end MEASUREMENT
/begin MEASUREMENT LSUCD_stRiLimSlp_mp "Zustand der Ri Störungsunterdrückung" UBYTE OneToOne 1 100 0.00 255.0 FORMAT "%5.1" ARRAY_SIZE 1 ECU_ADDRESS 0x9FFF42 /end MEASUREMENT
/begin MEASUREMENT LSUCD_stRiSPICalDem "Anforderung der Ri-Regelung Einschaltung des Lern- oder Messmodus" UBYTE OneToOne 1 100 0.00 255.0 FORMAT "%5.1" ECU_ADDRESS 0x7F94F4 /end MEASUREMENT
/begin MEASUREMENT LSUCD_stRiValid "Zustand Ri Signals (0 = ungültig, 1 = gültig)" UBYTE OneToOne 1 100 0.00 255.0 FORMAT "%5.1" ARRAY_SIZE 1 ECU_ADDRESS 0x7F94F5 /end MEASUREMENT
/begin MEASUREMENT LSUCD_stSPIDiaInfo "Status der SPI Chip Diagnose" UWORD OneToOne 1 100 0.00 65535.00 FORMAT "%8.2" ARRAY_SIZE 1 ECU_ADDRESS 0x7F9B62 /end MEASUREMENT
/begin MEASUREMENT LSUCD_stSPIInitVal "Wert des CJ12x Initialisierungsregisters" UWORD OneToOne 1 100 0.00 65535.00 FORMAT "%8.2" ARRAY_SIZE 1 ECU_ADDRESS 0x7F9B64 /end MEASUREMENT
/begin MEASUREMENT LSUCD_stSRCState_mp "Status der SRC Überwachung des O2 Rohsignales" UBYTE OneToOne 1 100 0.00 255.0 FORMAT "%5.1" ARRAY_SIZE 1 ECU_ADDRESS 0x9FFF40 /end MEASUREMENT
/begin MEASUREMENT LSUCD_stSrvTstDemOld "Status LSUCD-Diasgnose mit Servicetester" UWORD OneToOne 1 100 0.00 65535.00 FORMAT "%8.2" ECU_ADDRESS 0x7F9B66 /end MEASUREMENT
/begin MEASUREMENT LSUCD_stTstTrigger_mp "Messpunkt für den Status zur Auslösung des Tests der Nebenschlusserkennung" UBYTE OneToOne 1 100 0.00 255.0 FORMAT "%5.1" ARRAY_SIZE 1 ECU_ADDRESS 0x9FFF44 /end MEASUREMENT
/begin MEASUREMENT LSUCD_stWireDiaChk_mp "Bitfeld: Unterdiagnosen ausgeführt" UBYTE OneToOne 1 100 0.00 255.0 FORMAT "%5.1" ARRAY_SIZE 1 ECU_ADDRESS 0x9FFF45 /end MEASUREMENT
/begin MEASUREMENT LSUCD_stWireDiaErr_mp "Status des Fehlers Nebenschlusserkennung" UBYTE OneToOne 1 100 0.00 255.0 FORMAT "%5.1" ARRAY_SIZE 1 ECU_ADDRESS 0x9FFF46 /end MEASUREMENT
/begin MEASUREMENT LSUCD_swtAdpt "Schalter für Adaption der Lambda-Sonde" UBYTE OneToOne 1 100 0.00 255.0 FORMAT "%5.1" ECU_ADDRESS 0x7F94F6 /end MEASUREMENT
/begin MEASUREMENT LSUCD_tRi "Äquivalenztemperatur des gemessenen Ri-Werts" SWORD Temp_Cels 1 100 -3549.940 3003.560 FORMAT "%8.3" ARRAY_SIZE 1 ECU_ADDRESS 0x7F9B68 /end MEASUREMENT
/begin MEASUREMENT LSUCD_uO2Clb "Offsetspannungs Korrekturwert für Lambda Spannungswert" SWORD Volt 1 100 -160156.4 160151.5 FORMAT "%8.1" ARRAY_SIZE 1 ECU_ADDRESS 0x7F9B6A /end MEASUREMENT
/begin MEASUREMENT LSUCD_uO2FltRippel_mp "Gefilterte, überlagerte Sauerstoff-Wechselspannung bei Diagnose der Heizungskopplung" SWORD Volt 1 100 -160156.4 160151.5 FORMAT "%8.1" ARRAY_SIZE 1 ECU_ADDRESS 0x9FF6D4 /end MEASUREMENT
/begin MEASUREMENT LSUCD_uO2Grad_mp "Gradient der Sauerstoff-Spannung bei Diagnose der Heizungskopplung" SWORD Volt 1 100 -160156.4 160151.5 FORMAT "%8.1" ARRAY_SIZE 1 ECU_ADDRESS 0x9FF6D6 /end MEASUREMENT
/begin MEASUREMENT LSUCD_uO2HtCoupStep1 "O2 Konzentration im ersten Datenakquisitionszyklus" SWORD Volt 1 100 -160156.4 160151.5 FORMAT "%8.1" ARRAY_SIZE 1 ECU_ADDRESS 0x7F9B6C /end MEASUREMENT
/begin MEASUREMENT LSUCD_uO2HtCoupStep2 "O2 Konzentration im zweiten Datenakquisitionszyklus" SWORD Volt 1 100 -160156.4 160151.5 FORMAT "%8.1" ARRAY_SIZE 1 ECU_ADDRESS 0x7F9B6E /end MEASUREMENT
/begin MEASUREMENT LSUCD_uO2HtCoupStep3 "O2 Konzentration im dritten Datenakquisitionszyklus" SWORD Volt 1 100 -160156.4 160151.5 FORMAT "%8.1" ARRAY_SIZE 1 ECU_ADDRESS 0x7F9B70 /end MEASUREMENT
/begin MEASUREMENT LSUCD_uO2OfsCor_mp "O2 Spannungswert nach Offset Kompensation" SWORD Volt 1 100 -160156.4 160151.5 FORMAT "%8.1" ECU_ADDRESS 0x9FF6C0 /end MEASUREMENT
/begin MEASUREMENT LSUCD_uO2Raw "Spannungsrohwert Lambdasignal nach Mittelung und Subtraktion Referenzwert" SWORD Volt 1 100 -160156.4 160151.5 FORMAT "%8.1" ARRAY_SIZE 1 ECU_ADDRESS 0x7F9B72 /end MEASUREMENT
/begin MEASUREMENT LSUCD_uO2RawOfsCor "O2 Spannungssignal um Offsetspannung korrigiert" SWORD Volt 1 100 -160156.4 160151.5 FORMAT "%8.1" ARRAY_SIZE 1 ECU_ADDRESS 0x7F9B74 /end MEASUREMENT
/begin MEASUREMENT LSUCD_uO2Raw_mp "O2 Spannung nach Mittelwertbildung" SWORD Volt 1 100 -160156.4 160151.5 FORMAT "%8.1" ARRAY_SIZE 1 ECU_ADDRESS 0x9FF6C2 /end MEASUREMENT
/begin MEASUREMENT LSUCD_uO2Rippel_mp "Sauerstoff-Wechselspannung bei Diagnose der Heizungskopplung" SWORD Volt 1 100 -160156.4 160151.5 FORMAT "%8.1" ARRAY_SIZE 1 ECU_ADDRESS 0x9FF6D8 /end MEASUREMENT
/begin MEASUREMENT LSUCD_uRiRaw "Spannungsrohwert Ri nach Mittelung" SWORD Volt 1 100 -160156.4 160151.5 FORMAT "%8.1" ARRAY_SIZE 1 ECU_ADDRESS 0x7F9B76 /end MEASUREMENT
/begin MEASUREMENT LSUCD_uRiRawOfsCor "Ri-Spannung nach Offset-Korrektur" SWORD Volt 1 100 -160156.4 160151.5 FORMAT "%8.1" ARRAY_SIZE 1 ECU_ADDRESS 0x7F9B78 /end MEASUREMENT
/begin MEASUREMENT LSUCtl_dcycDT1_mp "DT1 Anteil der Heizungsregler Tastverhältnisanforderung" SWORD DtyCyc 1 100 -327.6800 327.6700 FORMAT "%8.4" ARRAY_SIZE 1 ECU_ADDRESS 0x9FF6DA /end MEASUREMENT
/begin MEASUREMENT LSUCtl_dcycHt "Heizertastverhältnis Anforderung durch Ri Regelung" SWORD DtyCyc 1 100 -327.6800 327.6700 FORMAT "%8.4" ARRAY_SIZE 1 ECU_ADDRESS 0x7F9B7A /end MEASUREMENT
/begin MEASUREMENT LSUCtl_dcycHtIniRamp "Startwert für Aufheizkurven Rampe" SWORD DtyCyc 1 100 -327.6800 327.6700 FORMAT "%8.4" ECU_ADDRESS 0x7F9B7C /end MEASUREMENT
/begin MEASUREMENT LSUCtl_dcycHtStrt "Tastverhältnisvorgabe Heizung durch Aufheizstrategie" SWORD DtyCyc 1 100 -327.6800 327.6700 FORMAT "%8.4" ARRAY_SIZE 1 ECU_ADDRESS 0x7F9B7E /end MEASUREMENT
/begin MEASUREMENT LSUCtl_dcycPI_mp "Tastverhältnisforderung aus dem P I Regelglied" SWORD DtyCyc 1 100 -327.6800 327.6700 FORMAT "%8.4" ARRAY_SIZE 1 ECU_ADDRESS 0x9FF6DC /end MEASUREMENT
/begin MEASUREMENT LSUCtl_stHtCtl "Statusbits Zustand Heizungsregelung" UBYTE OneToOne 1 100 0.00 255.0 FORMAT "%5.1" ARRAY_SIZE 1 ECU_ADDRESS 0x7F94F7 /end MEASUREMENT
/begin MEASUREMENT LSUCtl_stHtDisable "High level Diagnose Anforderung Heizungsregelungsabschaltung (0 = nicht abgeschaltet, >0 Ausgang = 0 %)" UBYTE OneToOne 1 100 0.00 255.0 FORMAT "%5.1" ARRAY_SIZE 1 ECU_ADDRESS 0x7F94F8 /end MEASUREMENT
/begin MEASUREMENT LSUCtl_stRmp_mp "Ansteuerstatus für geschaltete Rampe" UBYTE OneToOne 1 100 0.00 255.0 FORMAT "%5.1" ARRAY_SIZE 1 ECU_ADDRESS 0x9FFF47 /end MEASUREMENT
/begin MEASUREMENT LSUCtl_stSCUNEna "Message um Test für Erkennung von Kurzschluss nach Vbat bei UNI freizugeben" UBYTE OneToOne 1 100 0.00 255.0 FORMAT "%5.1" ARRAY_SIZE 1 ECU_ADDRESS 0x7F94F9 /end MEASUREMENT
/begin MEASUREMENT LSUCtl_tAirStrt_mp "Ansauglufttemperatur nach Zündung an (mit Verzögerung erfasst!)" SWORD Temp_Cels 1 100 -3549.940 3003.560 FORMAT "%8.3" ECU_ADDRESS 0x9FF6DE /end MEASUREMENT
/begin MEASUREMENT LSUCtl_tDvt "Regelabweichung Sensortemperatur" SWORD TempDiff_Kelv 1 100 -3276.800 3276.700 FORMAT "%8.3" ARRAY_SIZE 1 ECU_ADDRESS 0x7F9B80 /end MEASUREMENT
/begin MEASUREMENT LSUCtl_tDvt_mp "Regelabweichung Sensortemperatur" SWORD TempDiff_Kelv 1 100 -3276.800 3276.700 FORMAT "%8.3" ECU_ADDRESS 0x9FF6C8 /end MEASUREMENT
/begin MEASUREMENT LSUCtl_tLowLim_mp "Untere Widerstandsgrenze für eingeregelten Zustand" SWORD Temp_Cels 1 100 -3549.940 3003.560 FORMAT "%8.3" ECU_ADDRESS 0x9FF6E0 /end MEASUREMENT
/begin MEASUREMENT LSUCtl_tUpLim_mp "Obere Widerstandsgrenze für eingeregelten Zustand" SWORD Temp_Cels 1 100 -3549.940 3003.560 FORMAT "%8.3" ECU_ADDRESS 0x9FF6E2 /end MEASUREMENT
/begin MEASUREMENT LSU_bpPlausSetPoint_mp "Bitposition für Zugriff auf LSU_stO2Err(_mp)" UBYTE OneToOne 1 100 0.00 255.0 FORMAT "%5.1" ECU_ADDRESS 0x9FFF37 /end MEASUREMENT
/begin MEASUREMENT LSU_mAirPlausTst_mp "Integrierter Luftmassenwert" SWORD AirMass_2 1 100 -3276.800 3276.700 FORMAT "%8.3" ARRAY_SIZE 1 ECU_ADDRESS 0x9FF6A0 /end MEASUREMENT
/begin MEASUREMENT LSU_qStrt_mp "anfängliche Kraftstoffmenge in Dynamik-Überwachung" SWORD InjMass 1 100 -327.6800 327.6700 FORMAT "%8.4" ECU_ADDRESS 0x9FF6AC /end MEASUREMENT
/begin MEASUREMENT LSU_rLmbd "Lambda" SWORD lambda 1 100 -32.76800 32.76700 FORMAT "%8.5" ARRAY_SIZE 1 ECU_ADDRESS 0x7F9B82 /end MEASUREMENT
/begin MEASUREMENT LSU_rLmbdRec "Kehrwert von Lambda" SWORD lambdaRecVal 1 100 -32.76800 32.76700 FORMAT "%8.5" ARRAY_SIZE 1 ECU_ADDRESS 0x7F9B84 /end MEASUREMENT
/begin MEASUREMENT LSU_rO2ActVal "Aktuell von Plausibilisierung verwendete O2-Konzentration" SWORD O2 1 100 -0.3276800 0.3276700 FORMAT "%9.7" ARRAY_SIZE 1 ECU_ADDRESS 0x7F9B86 /end MEASUREMENT
/begin MEASUREMENT LSU_rO2Adpt "Adaptierte Sauerstoffkonzentration die an externe Module übertragen wird" SWORD O2 1 100 -0.3276800 0.3276700 FORMAT "%9.7" ARRAY_SIZE 1 ECU_ADDRESS 0x7F9B88 /end MEASUREMENT
/begin MEASUREMENT LSU_rO2AdptLastLSU_mp "Adaptierte Sauerstoffkonzentration des Sensors mit der höchsten Nummer" SWORD O2 1 100 -0.3276800 0.3276700 FORMAT "%9.7" ECU_ADDRESS 0x9FF69E /end MEASUREMENT
/begin MEASUREMENT LSU_rO2Calc_mp "aktuelle O2-Konzentration aus Luftmasse und Einspritzmenge" SWORD O2 1 100 -0.3276800 0.3276700 FORMAT "%9.7" ECU_ADDRESS 0x9FF6AE /end MEASUREMENT
/begin MEASUREMENT LSU_rO2DiffCmpChk "O2-Unterscheid eines Sondenpaars" SWORD O2 1 100 -0.3276800 0.3276700 FORMAT "%9.7" ECU_ADDRESS 0x7FF3F6 /end MEASUREMENT
/begin MEASUREMENT LSU_rO2DvtNeg_mp "Minustoleranz für Plausibilisierung O2-Signal LSU" SWORD O2 1 100 -0.3276800 0.3276700 FORMAT "%9.7" ECU_ADDRESS 0x9FF6B0 /end MEASUREMENT
/begin MEASUREMENT LSU_rO2DvtPos_mp "Plustoleranz für Plausibilisierung O2-Signal LSU" SWORD O2 1 100 -0.3276800 0.3276700 FORMAT "%9.7" ECU_ADDRESS 0x9FF6B2 /end MEASUREMENT
/begin MEASUREMENT LSU_rO2Lmbd1Thres "Message: Toleranzband für Lambda-1-Erkennung" SWORD O2 1 100 -0.3276800 0.3276700 FORMAT "%9.7" ECU_ADDRESS 0x7F9B8A /end MEASUREMENT
/begin MEASUREMENT LSU_rO2MaxDiff "Maximale O2 Differenz zwischen ausgewählten Lambdasonden" SWORD O2 1 100 -0.3276800 0.3276700 FORMAT "%9.7" ECU_ADDRESS 0x7FF3F6 /end MEASUREMENT
/begin MEASUREMENT LSU_rO2MaxVal "Oberer Grenzwert der Plausibilisierung" SWORD O2 1 100 -0.3276800 0.3276700 FORMAT "%9.7" ARRAY_SIZE 1 ECU_ADDRESS 0x7F9B8C /end MEASUREMENT
/begin MEASUREMENT LSU_rO2MinVal "Unterer Grenzwert der Plausibilisierung" SWORD O2 1 100 -0.3276800 0.3276700 FORMAT "%9.7" ARRAY_SIZE 1 ECU_ADDRESS 0x7F9B8E /end MEASUREMENT
/begin MEASUREMENT LSU_rO2RawFlt "Gefilterte O2Raw-Sauerstoffkonzentration in Lambda-1-Erkennung" SWORD O2 1 100 -0.3276800 0.3276700 FORMAT "%9.7" ARRAY_SIZE 1 ECU_ADDRESS 0x7F9B90 /end MEASUREMENT
/begin MEASUREMENT LSU_rO2Stat_mp "gefilterte O2-Konzentration aus Luftmasse und Einspritzmenge" SWORD O2 1 100 -0.3276800 0.3276700 FORMAT "%9.7" ARRAY_SIZE 1 ECU_ADDRESS 0x9FF6A2 /end MEASUREMENT
/begin MEASUREMENT LSU_rO2Thres1_mp "untere O2-Schwelle für Messung der Anstiegszeit" SWORD O2 1 100 -0.3276800 0.3276700 FORMAT "%9.7" ARRAY_SIZE 1 ECU_ADDRESS 0x9FF6A4 /end MEASUREMENT
/begin MEASUREMENT LSU_rO2Thres2_mp "obere O2-Schwelle für Messung der Anstiegszeit" SWORD O2 1 100 -0.3276800 0.3276700 FORMAT "%9.7" ARRAY_SIZE 1 ECU_ADDRESS 0x9FF6A6 /end MEASUREMENT
/begin MEASUREMENT LSU_stChkDyn_mp "Nummer der zuletzt erreichten O2-Schwelle" UBYTE OneToOne 1 100 0.00 255.0 FORMAT "%5.1" ARRAY_SIZE 1 ECU_ADDRESS 0x9FFF35 /end MEASUREMENT
/begin MEASUREMENT LSU_stClbDisable "Disable-Signal für CJ120-Kalibrierung" UBYTE OneToOne 1 100 0.00 255.0 FORMAT "%5.1" ECU_ADDRESS 0x7F94FA /end MEASUREMENT
/begin MEASUREMENT LSU_stClbTrg_mp "CJ125-Kalibrierung bzw. Pumpstromumkehr ist freigegeben" UBYTE OneToOne 1 100 0.00 255.0 FORMAT "%5.1" ECU_ADDRESS 0x9FFF31 /end MEASUREMENT
/begin MEASUREMENT LSU_stConstPOp "Statusmessage konstanter Betriebspunkt" UBYTE OneToOne 1 100 0.00 255.0 FORMAT "%5.1" ECU_ADDRESS 0x7F94FB /end MEASUREMENT
/begin MEASUREMENT LSU_stEnaPlausChk_mp "Freigabestatus der Plausibilisierung" UBYTE OneToOne 1 100 0.00 255.0 FORMAT "%5.1" ECU_ADDRESS 0x9FFF38 /end MEASUREMENT
/begin MEASUREMENT LSU_stLSUClbSchedTstDem_mp "Anzeige Umschaltung LSU-Diagnose in Servicetest-Modus" UBYTE OneToOne 1 100 0.00 255.0 FORMAT "%5.1" ECU_ADDRESS 0x9FFF32 /end MEASUREMENT
/begin MEASUREMENT LSU_stLSUMonTstDem_mp "Anzeige Umschaltung LSU-Diagnose in Servicetest-Modus" UBYTE OneToOne 1 100 0.00 255.0 FORMAT "%5.1" ECU_ADDRESS 0x9FFF39 /end MEASUREMENT
/begin MEASUREMENT LSU_stNotOpPoint1_mp "Messen des Punktes für Status des Betriebsgebiets 1" UBYTE OneToOne 1 100 0.00 255.0 FORMAT "%5.1" ECU_ADDRESS 0x9FFF33 /end MEASUREMENT
/begin MEASUREMENT LSU_stNotOpPoint2_mp "Messen des Punktes für Status des Betriebsgebiets 2" UBYTE OneToOne 1 100 0.00 255.0 FORMAT "%5.1" ECU_ADDRESS 0x9FFF34 /end MEASUREMENT
/begin MEASUREMENT LSU_stO2Chk_mp "Bitfeld :: Teildiagnosen durchgeführt" UWORD OneToOne 1 100 0.00 65535.00 FORMAT "%8.2" ARRAY_SIZE 1 ECU_ADDRESS 0x9FF6A8 /end MEASUREMENT
/begin MEASUREMENT LSU_stO2Err "Statuswort Diagnoseergebnisse" UWORD OneToOne 1 100 0.00 65535.00 FORMAT "%8.2" ARRAY_SIZE 1 ECU_ADDRESS 0x7F9B92 /end MEASUREMENT
/begin MEASUREMENT LSU_stPlausChk "Statuswort Zustand Plausibilitäts-Check" UBYTE OneToOne 1 100 0.00 255.0 FORMAT "%5.1" ARRAY_SIZE 1 ECU_ADDRESS 0x7F94FC /end MEASUREMENT
/begin MEASUREMENT LSU_stPlausChkCon_mp "Statuswort Zustand der Voraussetzungen für Plausibilitätscheck" UBYTE OneToOne 1 100 0.00 255.0 FORMAT "%5.1" ECU_ADDRESS 0x9FFF36 /end MEASUREMENT
/begin MEASUREMENT LSU_stPlausChkRls_mp "Freigabebedingungen der Plausibilisierung" UBYTE OneToOne 1 100 0.00 255.0 FORMAT "%5.1" ECU_ADDRESS 0x9FFF3A /end MEASUREMENT
/begin MEASUREMENT LSU_stStrtClb "Hilfsvariable für Kalibrierungs-Scheduler" UBYTE OneToOne 1 100 0.00 255.0 FORMAT "%5.1" ECU_ADDRESS 0x7F94FD /end MEASUREMENT
/begin MEASUREMENT LSU_stTmrClbPerRun "Status des Kalibrier-Timers" UBYTE OneToOne 1 100 0.00 255.0 FORMAT "%5.1" ECU_ADDRESS 0x7F94FE /end MEASUREMENT
/begin MEASUREMENT LSU_swtEna "Status-Message zu Freigabe oder Sperren der gesamten LSU-Funktionen" UBYTE OneToOne 1 100 0.00 255.0 FORMAT "%5.1" ECU_ADDRESS 0x7F94FF /end MEASUREMENT
/begin MEASUREMENT LSU_tiState1_mp "Timervariable: Kraftstoffmenge liegt innerhalb Toleranzband" UWORD Time_s 1 100 0.00 655.3500 FORMAT "%8.4" ARRAY_SIZE 1 ECU_ADDRESS 0x9FF6AA /end MEASUREMENT
/begin MEASUREMENT LSU_tiState2 "Message: Anstiegszeit O2-Signal beim Übergang Last-Schub (Dynamiküberwachung)" UWORD Time_s 1 100 0.00 655.3500 FORMAT "%8.4" ARRAY_SIZE 1 ECU_ADDRESS 0x7F9B94 /end MEASUREMENT
/begin MEASUREMENT LSU_tiState3 "Message: Zeitdauer bis zum Erreichen des Schubs (Kraftstoffmenge kleiner als Schwellwert)" UWORD Time_s 1 100 0.00 655.3500 FORMAT "%8.4" ARRAY_SIZE 1 ECU_ADDRESS 0x7F9B96 /end MEASUREMENT
/begin MEASUREMENT LSU_tiSwitch "Message: Maximal zulässiger Wert für O2-Flankenzeit Last -> Schub" UWORD Time_s 1 100 0.00 655.3500 FORMAT "%8.4" ARRAY_SIZE 1 ECU_ADDRESS 0x7F9B98 /end MEASUREMENT
/begin MEASUREMENT LSU_tiWait3 "Message: maximale Zeitdauer zum erreichen der oberen O2-Schwelle in Dynamiküberwachung" UWORD Time_s 1 100 0.00 655.3500 FORMAT "%8.4" ARRAY_SIZE 1 ECU_ADDRESS 0x7F9B9A /end MEASUREMENT
/begin MEASUREMENT Lub_nMin "Drehzahlforderung Minimalwert für Schmierung" SWORD EngN 1 100 -32768.00 32767.00 FORMAT "%8.2" ECU_ADDRESS 0x7F9B9C /end MEASUREMENT
/begin MEASUREMENT MemMon_ctErrChkRam "Fehlerzähler für Doppelablage und zyklischen RAM-Test" UBYTE OneToOne 1 100 0.00 255.0 FORMAT "%5.1" ECU_ADDRESS 0x7FA7C1 /end MEASUREMENT
/begin MEASUREMENT MemMon_ctErrChkRom "Fehlerzähler für zyklischen ROM-Test" UBYTE OneToOne 1 100 0.00 255.0 FORMAT "%5.1" ECU_ADDRESS 0x7FA7C2 /end MEASUREMENT
/begin MEASUREMENT MemMon_ctHealChkRam "Heilungszähler für Doppelablage und zyklischen RAM-Test" UBYTE Time_ms_40ms 1 100 0.00 10200. FORMAT "%5.0" ECU_ADDRESS 0x7FA7C3 /end MEASUREMENT
/begin MEASUREMENT MemMon_ctHealChkRom "Heilungszähler für zyklischen ROM-Test" UBYTE Time_ms_40ms 1 100 0.00 10200. FORMAT "%5.0" ECU_ADDRESS 0x7FA7C4 /end MEASUREMENT
/begin MEASUREMENT MemMon_st "Status der Speicherüberwachung" UBYTE OneToOne 1 100 0.00 255.0 FORMAT "%5.1" ECU_ADDRESS 0x7FA7C0 /end MEASUREMENT
/begin MEASUREMENT MRlyCD_ctTooEarly_mp "Fehlerzähler für ""Hauptrelais öffnet zu früh"" Fehler" UBYTE OneToOne 1 100 0.00 255.0 FORMAT "%5.1" ECU_ADDRESS 0x9FFF48 /end MEASUREMENT
/begin MEASUREMENT MRlyCD_stFanShutOff "Anforderung zum Anfang des Lüfterabschaltvorgangs" UBYTE OneToOne 1 100 0.00 255.0 FORMAT "%5.1" ECU_ADDRESS 0x7F9503 /end MEASUREMENT
/begin MEASUREMENT MRlyCD_stMon "aktueller Zustand der Hauptrelaisüberwachung" UBYTE OneToOne 1 100 0.00 255.0 FORMAT "%5.1" ECU_ADDRESS 0x7F9504 /end MEASUREMENT
/begin MEASUREMENT MRlyCD_stPrevOpening "Bedingung / Grund für das Öffnen des Hauptrelais während letztem Steuergerätelauf" UBYTE OneToOne 1 100 0.00 255.0 FORMAT "%5.1" ECU_ADDRESS 0x7F9505 /end MEASUREMENT
/begin MEASUREMENT MSidCD_numECUS "Anzahl der ECU in diesem system: 1 - 4 (Master/Slave)" UBYTE OneToOne 1 100 0.00 255.0 FORMAT "%5.1" ECU_ADDRESS 0x7F9506 /end MEASUREMENT
/begin MEASUREMENT MSidCD_swtMAIN "Typ der ECU: Single ECU=0xFF, Master Slave - Master: 0, Master Slave - Slave: 1,2,3 or 4" UBYTE OneToOne 1 100 0.00 255.0 FORMAT "%5.1" ECU_ADDRESS 0x7F9507 /end MEASUREMENT
/begin MEASUREMENT NetMng_ctRecoveryA_mp "Meßpunkt der die Anzahl der Neuinitialisierungen des CAN-Controller A bei BusOff wiedergibt" UBYTE OneToOne 1 100 0.00 255.0 FORMAT "%5.1" ECU_ADDRESS 0x9FFF49 /end MEASUREMENT
/begin MEASUREMENT NetMng_ctRecoveryB_mp "Meßpunkt der die Anzahl der Neuinitialisierungen des CAN-Controller B bei BusOff wiedergibt" UBYTE OneToOne 1 100 0.00 255.0 FORMAT "%5.1" ECU_ADDRESS 0x9FFF4A /end MEASUREMENT
/begin MEASUREMENT NetMng_ctRecoveryC_mp "Meßpunkt der die Anzahl der Neuinitialisierungen des CAN-Controller C bei BusOff wiedergibt" UBYTE OneToOne 1 100 0.00 255.0 FORMAT "%5.1" ECU_ADDRESS 0x9FFF4B /end MEASUREMENT
/begin MEASUREMENT NetMng_stCAN "Status der CAN-Controller" ULONG OneToOne 1 100 0.00 4294967295.00 FORMAT "%13.2" ECU_ADDRESS 0x7F9E88 /end MEASUREMENT
/begin MEASUREMENT NetMng_stCanBusNoCom_mp "Bus- und Controller-bezogene Information über Kommunikationsausfall am CAN" UWORD OneToOne 1 100 0.00 65535.00 FORMAT "%8.2" ECU_ADDRESS 0x9FF6E4 /end MEASUREMENT
/begin MEASUREMENT NetMng_stCanBusOffAct "Unentprellter Busoff Zustand aller Controller und aller Busse" UWORD OneToOne 1 100 0.00 65535.00 FORMAT "%8.2" ECU_ADDRESS 0x7F9BA0 /end MEASUREMENT
/begin MEASUREMENT NetMng_stCanBusOffDeb "Entprellter Busoff Zustand aller Controller und aller Busse" UWORD OneToOne 1 100 0.00 65535.00 FORMAT "%8.2" ECU_ADDRESS 0x7F9BA2 /end MEASUREMENT
/begin MEASUREMENT NetMng_stCANModeA_mp "Zustand in dem sich State-Machine für CAN A befindet" UBYTE OneToOne 1 100 0.00 255.0 FORMAT "%5.1" ECU_ADDRESS 0x9FFF4C /end MEASUREMENT
/begin MEASUREMENT NetMng_stCANModeB_mp "Zustand in dem sich State-Machine für CAN B befindet" UBYTE OneToOne 1 100 0.00 255.0 FORMAT "%5.1" ECU_ADDRESS 0x9FFF4D /end MEASUREMENT
/begin MEASUREMENT NetMng_stCANModeC_mp "Zustand in dem sich State-Machine für CAN C befindet" UBYTE OneToOne 1 100 0.00 255.0 FORMAT "%5.1" ECU_ADDRESS 0x9FFF4E /end MEASUREMENT
/begin MEASUREMENT NetMng_stDebValBusOffCanA_mp "aktueller BusOff-Entprellstatus von CAN A" UBYTE OneToOne 1 100 0.00 255.0 FORMAT "%5.1" ECU_ADDRESS 0x9FFF4F /end MEASUREMENT
/begin MEASUREMENT NetMng_stDebValBusOffCanB_mp "aktueller BusOff-Entprellstatus von CAN B" UBYTE OneToOne 1 100 0.00 255.0 FORMAT "%5.1" ECU_ADDRESS 0x9FFF50 /end MEASUREMENT
/begin MEASUREMENT NetMng_stDebValBusOffCanC_mp "aktueller BusOff-Entprellstatus von CAN C" UBYTE OneToOne 1 100 0.00 255.0 FORMAT "%5.1" ECU_ADDRESS 0x9FFF51 /end MEASUREMENT
/begin MEASUREMENT NetMng_stErrCANDevA_mp "Fehlerstatus (BusOff, ErrorPassive) der HWK für CAN A" UBYTE OneToOne 1 100 0.00 255.0 FORMAT "%5.1" ECU_ADDRESS 0x9FFF52 /end MEASUREMENT
/begin MEASUREMENT NetMng_stErrCANDevB_mp "Fehlerstatus (BusOff, ErrorPassive) der HWK für CAN B" UBYTE OneToOne 1 100 0.00 255.0 FORMAT "%5.1" ECU_ADDRESS 0x9FFF53 /end MEASUREMENT
/begin MEASUREMENT NetMng_stErrCANDevC_mp "Fehlerstatus (BusOff, ErrorPassive) der HWK für CAN C" UBYTE OneToOne 1 100 0.00 255.0 FORMAT "%5.1" ECU_ADDRESS 0x9FFF54 /end MEASUREMENT
/begin MEASUREMENT NetMng_stFadeOut "Status der CAN Ausblendung" UBYTE OneToOne 1 100 0.00 255.0 FORMAT "%5.1" ECU_ADDRESS 0x7F9508 /end MEASUREMENT
/begin MEASUREMENT NetMng_stGWCanShOff "Status Triebstrang Controller Abschaltung" UBYTE OneToOne 1 100 0.00 255.0 FORMAT "%5.1" ECU_ADDRESS 0x7F9509 /end MEASUREMENT
/begin MEASUREMENT NetMng_stTP20CANMute "Status: sperren der CAN- Sende- Botschaften durch TP20 Mute Anforderung" UBYTE OneToOne 1 100 0.00 255.0 FORMAT "%5.1" ECU_ADDRESS 0x7F950A /end MEASUREMENT
/begin MEASUREMENT NetMng_stTxMsgDisbl "Status welche Sendebotschaften durch den auftretenden BusOff gesperrt werden" UWORD OneToOne 1 100 0.00 65535.00 FORMAT "%8.2" ECU_ADDRESS 0x7F9BA4 /end MEASUREMENT
/begin MEASUREMENT NetMng_stUsrMsgDisbl "Status welche Sendebotschaften durch den auftretenden BusOff gesperrt sind bzw. wurden" UWORD OneToOne 1 100 0.00 65535.00 FORMAT "%8.2" ECU_ADDRESS 0x7F9BA6 /end MEASUREMENT
/begin MEASUREMENT NSC_numPrio "Prioritätszahl des Regenerationsanforderungslevel des NOx-Specherkat" UWORD OneToOne 1 100 0.00 65535.00 FORMAT "%8.2" ECU_ADDRESS 0x7F9B9E /end MEASUREMENT
/begin MEASUREMENT NSC_st "von NOx-Speicherkatalysator angeforderter Regenerationsstatus" ULONG OneToOne 1 100 0.00 4294967295.00 FORMAT "%13.2" ECU_ADDRESS 0x7F9E84 /end MEASUREMENT
/begin MEASUREMENT OTSCD_dtDynTst_mp "Differenz zwischen dem ersten Meßwert der Öltemperatur und dem aktuellen Meßwert" SWORD TempDiff_Kelv 1 100 -3276.800 3276.700 FORMAT "%8.3" ECU_ADDRESS 0x9FF6E6 /end MEASUREMENT
/begin MEASUREMENT OTSCD_stCanSndTemp "Status Öltemperatur  für CAN" UBYTE OneToOne 1 100 0.00 255.0 FORMAT "%5.1" ECU_ADDRESS 0x7F950B /end MEASUREMENT
/begin MEASUREMENT OTSCD_stClntThres_mp "Status der Kühlmitteltemperatur, bei welchem die Öltemperatur auf den aus dem Modell berechneten Ersatzwet schaltet" UBYTE OneToOne 1 100 0.00 255.0 FORMAT "%5.1" ECU_ADDRESS 0x9FFF55 /end MEASUREMENT
/begin MEASUREMENT OTSCD_stOilTErr "Zustand des Öltemperatur - Errors" UBYTE OneToOne 1 100 0.00 255.0 FORMAT "%5.1" ECU_ADDRESS 0x7F950C /end MEASUREMENT
/begin MEASUREMENT OTSCD_stPlausWIV "Status Plausibilitätstimers ( 0: gestopp t ,1: läuft)" UBYTE OneToOne 1 100 0.00 255.0 FORMAT "%5.1" ECU_ADDRESS 0x7F950D /end MEASUREMENT
/begin MEASUREMENT OTSCD_swtSig "Signalquelle Schalter ADC/CAN" UBYTE OneToOne 1 100 0.00 255.0 FORMAT "%5.1" ECU_ADDRESS 0x7F950E /end MEASUREMENT
/begin MEASUREMENT OTSCD_tEngOil "Motoröltemperatur" SWORD Temp_Cels 1 100 -3549.940 3003.560 FORMAT "%8.3" ECU_ADDRESS 0x7F9BA8 /end MEASUREMENT
/begin MEASUREMENT OTSCD_tEngOilCur_mp "Die Öltemperatur wird über eine Kennlinie berechnet, wenn das Empfangen der Information über CAN appliziert ist." SWORD Temp_Cels 1 100 -3549.940 3003.560 FORMAT "%8.3" ECU_ADDRESS 0x9FF6E8 /end MEASUREMENT
/begin MEASUREMENT OTSCD_tEngOilLin "linearisierter Wert aus HWK vorm Aufruf der Übergangsfunktion" SWORD Temp_Cels 1 100 -3549.940 3003.560 FORMAT "%8.3" ECU_ADDRESS 0x7F9BAA /end MEASUREMENT
/begin MEASUREMENT OTSCD_tEngOilWIV "Motoröltemperatur für WIV3" SWORD Temp_Cels 1 100 -3549.940 3003.560 FORMAT "%8.3" ECU_ADDRESS 0x7F9BAC /end MEASUREMENT
/begin MEASUREMENT OTSCD_tiDynTst_mp "Aktuelle Zeit des dynamischen Tests" UWORD Time_DynTst 1 100 0.00 167769.6 FORMAT "%8.1" ECU_ADDRESS 0x9FF6EA /end MEASUREMENT
/begin MEASUREMENT OTSCD_tiMaxDynTst_mp "Maximale Zeit für dynamische Plausibilisierung" UWORD Time_DynTst 1 100 0.00 167769.6 FORMAT "%8.1" ECU_ADDRESS 0x9FF6EC /end MEASUREMENT
/begin MEASUREMENT OTSCD_tOilModel_mp "Öltemperatur - Ersatzwert aus dem Modell" SWORD Temp_Cels 1 100 -3549.940 3003.560 FORMAT "%8.3" ECU_ADDRESS 0x9FF6EE /end MEASUREMENT
/begin MEASUREMENT OTSCD_tOTSStrtVal_mp "Öltemperatur zu Beginn des dynamischen Plausibilitätstest" SWORD Temp_Cels 1 100 -3549.940 3003.560 FORMAT "%8.3" ECU_ADDRESS 0x9FF6F0 /end MEASUREMENT
/begin MEASUREMENT OTSCD_uRaw "Rohwert des OTF-Sensors" SWORD Volt 1 100 -160156.4 160151.5 FORMAT "%8.1" ECU_ADDRESS 0x7F9BAE /end MEASUREMENT
/begin MEASUREMENT OvRMon_ct10MS "In der 10ms Scheibe inkrementierter Zähler, welcher zur Zeitlichen Steuerung von OvRMon_Co verwendet wird." UWORD OneToOne 1 100 0.00 65535.00 FORMAT "%8.2" ECU_ADDRESS 0x7FA848 /end MEASUREMENT
/begin MEASUREMENT OvRMon_ctCrCtlPDef_mp "Entprellzählerwert für die Cruise Control Plus" UWORD OneToOne 1 100 0.00 65535.00 FORMAT "%8.2" ECU_ADDRESS 0x9FF6FA /end MEASUREMENT
/begin MEASUREMENT OvRMon_ctQInjDef_mp "Zählerstand für die Fehlerentprellung der red. Schubübrwachung" UWORD OneToOne 1 100 0.00 65535.00 FORMAT "%8.2" ECU_ADDRESS 0x9FF70C /end MEASUREMENT
/begin MEASUREMENT OvRMon_facBattCor_mp "Redundant eingelesener Battieriespannungskorrekturfaktor" SWORD Fact 1 100 -4.000000 3.999878 FORMAT "%8.6" ECU_ADDRESS 0x9FF70E /end MEASUREMENT
/begin MEASUREMENT OvRMon_nAvrg "Redundante mittlere Drehzahl in der Schubüberwachung" SWORD EngN 1 100 -32768.00 32767.00 FORMAT "%8.2" ECU_ADDRESS 0x7FA84A /end MEASUREMENT
/begin MEASUREMENT OvRMon_nSeg_mp "Mittlere Segmentdrehzahl in der Schubüberwachung" SWORD EngN 1 100 -32768.00 32767.00 FORMAT "%8.2" ECU_ADDRESS 0x9FF700 /end MEASUREMENT
/begin MEASUREMENT OvRMon_phiActMI_mp "(Start-) Winkel der letzten Haupteinspritzung für UI (SOE)" SWORD AngleCrS 1 100 -768.0000 767.9766 FORMAT "%8.4" ECU_ADDRESS 0x9FF702 /end MEASUREMENT
/begin MEASUREMENT OvRMon_phiActPiI_mp "(Start-) Winkel der letzten Voreinspritzung für UI (SOE)" SWORD AngleCrS 1 100 -768.0000 767.9766 FORMAT "%8.4" ECU_ADDRESS 0x9FF704 /end MEASUREMENT
/begin MEASUREMENT OvRMon_phiActPoI_mp "(Start-) Winkel der letzten Nacheinspritzung für UI (SOE)" SWORD AngleCrS 1 100 -768.0000 767.9766 FORMAT "%8.4" ECU_ADDRESS 0x9FF706 /end MEASUREMENT
/begin MEASUREMENT OvRMon_qLimEnh_mp "erweiterter Schubkennlinienausgang für OvR-Überwachung (mengenbasiert)" SWORD InjMass 1 100 -327.6800 327.6700 FORMAT "%8.4" ECU_ADDRESS 0x9FF6F2 /end MEASUREMENT
/begin MEASUREMENT OvRMon_stAccPed_mp "Status der Fahrpedal - Schubüberwachung" UBYTE OneToOne 1 100 0.00 255.0 FORMAT "%5.1" ECU_ADDRESS 0x9FFF58 /end MEASUREMENT
/begin MEASUREMENT OvRMon_stACCP_mp "Freigabebedingung für ACCa" UBYTE OneToOne 1 100 0.00 255.0 FORMAT "%5.1" ECU_ADDRESS 0x9FFF56 /end MEASUREMENT
/begin MEASUREMENT OvRMon_stACC_mp "Meßpunkt des OvRMon ACC Überwachungsstatus" UBYTE OneToOne 1 100 0.00 255.0 FORMAT "%5.1" ECU_ADDRESS 0x9FFF57 /end MEASUREMENT
/begin MEASUREMENT OvRMon_stAPPDiff_mp "Status der Fahrpedalüberwachung" UBYTE OneToOne 1 100 0.00 255.0 FORMAT "%5.1" ECU_ADDRESS 0x9FFF59 /end MEASUREMENT
/begin MEASUREMENT OvRMon_stAstAccs_mp "Status der Überwachung bei AST Eingriff" UBYTE OneToOne 1 100 0.00 255.0 FORMAT "%5.1" ECU_ADDRESS 0x9FFF5B /end MEASUREMENT
/begin MEASUREMENT OvRMon_stBattSRCErr_mp "Status der SRC-Überprüfung der redundant eingelesenen Batteriespannung" UBYTE OneToOne 1 100 0.00 255.0 FORMAT "%5.1" ECU_ADDRESS 0x9FFF63 /end MEASUREMENT
/begin MEASUREMENT OvRMon_stBRK8Err_mp "Fehler-Information Bremse 8 Botschaft über CAN" UBYTE OneToOne 1 100 0.00 255.0 FORMAT "%5.1" ECU_ADDRESS 0x9FFF64 /end MEASUREMENT
/begin MEASUREMENT OvRMon_stBrkActvBstr_mp "Status für Überwachung des AUDI-ACC mit aktivem Bremsverstärker" UBYTE OneToOne 1 100 0.00 255.0 FORMAT "%5.1" ECU_ADDRESS 0x9FFF65 /end MEASUREMENT
/begin MEASUREMENT OvRMon_stBrkMnRed_mp "Status des redundant eingelesenen Hauptbremsschalters und redundanten Bremsschalters" UBYTE OneToOne 1 100 0.00 255.0 FORMAT "%5.1" ECU_ADDRESS 0x9FFF66 /end MEASUREMENT
/begin MEASUREMENT OvRMon_stBrkPressed "Bremszustand, berechnet durch die Schubüberwachung" UBYTE OneToOne 1 100 0.00 255.0 FORMAT "%5.1" ECU_ADDRESS 0x7F950F /end MEASUREMENT
/begin MEASUREMENT OvRMon_stBrkPressed_mp "Meldung Bremse betätigt in der Schubüberwachung" UBYTE OneToOne 1 100 0.00 255.0 FORMAT "%5.1" ECU_ADDRESS 0x9FFF67 /end MEASUREMENT
/begin MEASUREMENT OvRMon_stBrkSRCErr_mp "Status der SRC-Überprüfung des redundant eingelesenen Hauptbremsschalters" UBYTE OneToOne 1 100 0.00 255.0 FORMAT "%5.1" ECU_ADDRESS 0x9FFF68 /end MEASUREMENT
/begin MEASUREMENT OvRMon_stConvDebVal_mp "entprelltes Kupplungssignal in der Schubüberwachung" UBYTE OneToOne 1 100 0.00 255.0 FORMAT "%5.1" ECU_ADDRESS 0x9FFF69 /end MEASUREMENT
/begin MEASUREMENT OvRMon_stCrCtlACCsel_mp "Auswahl der Cruise Control bzw. ACC Version" UBYTE OneToOne 1 100 0.00 255.0 FORMAT "%5.1" ECU_ADDRESS 0x9FFF6A /end MEASUREMENT
/begin MEASUREMENT OvRMon_stCrCtla_mp "Freigabebedingung für CrCtla" UBYTE OneToOne 1 100 0.00 255.0 FORMAT "%5.1" ECU_ADDRESS 0x9FFF5D /end MEASUREMENT
/begin MEASUREMENT OvRMon_stCrCtlplus3_mp "Status der Überwachung für ACCa" UWORD OneToOne 1 100 0.00 65535.00 FORMAT "%8.2" ECU_ADDRESS 0x9FF6FC /end MEASUREMENT
/begin MEASUREMENT OvRMon_stCrCtlplus4_mp "Status der Überwachung für CrCtla" UWORD OneToOne 1 100 0.00 65535.00 FORMAT "%8.2" ECU_ADDRESS 0x9FF6FE /end MEASUREMENT
/begin MEASUREMENT OvRMon_stCrCtlP_mp "Staus der Cruise Control Plus Monitoring Funktion" UBYTE OneToOne 1 100 0.00 255.0 FORMAT "%5.1" ECU_ADDRESS 0x9FFF5F /end MEASUREMENT
/begin MEASUREMENT OvRMon_stCrCtl_mp "Status der Fahrgeschwindigkeitsregelung - Schubüberwachung" UBYTE OneToOne 1 100 0.00 255.0 FORMAT "%5.1" ECU_ADDRESS 0x9FFF5E /end MEASUREMENT
/begin MEASUREMENT OvRMon_stEnhOvRMode "Status der erweiterten Schubkennlinie" UBYTE OneToOne 1 100 0.00 255.0 FORMAT "%5.1" ECU_ADDRESS 0x7FA7E6 /end MEASUREMENT
/begin MEASUREMENT OvRMon_stIntr "Interrupt-Status der operativen Ebene" UBYTE OneToOne 1 100 0.00 255.0 FORMAT "%5.1" ECU_ADDRESS 0x7FC934 /end MEASUREMENT
/begin MEASUREMENT OvRMon_stIntrInactv_mp "Status der Interruptkennung" UBYTE OneToOne 1 100 0.00 255.0 FORMAT "%5.1" ECU_ADDRESS 0x9FFF60 /end MEASUREMENT
/begin MEASUREMENT OvRMon_stLowIdlValflt "Status des Leergasschalters - über OvRMon eingelesen" UBYTE OneToOne 1 100 0.00 255.0 FORMAT "%5.1" ECU_ADDRESS 0x7FA7EC /end MEASUREMENT
/begin MEASUREMENT OvRMon_stLowIdlValRaw_mp "Redundant eingelesener Rohwert des Leergasschalters" UBYTE OneToOne 1 100 0.00 255.0 FORMAT "%5.1" ECU_ADDRESS 0x9FFF5A /end MEASUREMENT
/begin MEASUREMENT OvRMon_stOvR "Freigabestatus der Schubüberwachung zur Übertragung vom Master zum Slave" UBYTE OneToOne 1 100 0.00 255.0 FORMAT "%5.1" ECU_ADDRESS 0x7FA7E7 /end MEASUREMENT
/begin MEASUREMENT OvRMon_stOvRCpl "Komplement des Freigabestatus der Schubüberwachung zur Übertragung vom Master zum Slave" UBYTE OneToOne 1 100 0.00 255.0 FORMAT "%5.1" ECU_ADDRESS 0x7FC8BF /end MEASUREMENT
/begin MEASUREMENT OvRMon_stPreCond "Unentprellte Schubinformation in Ebene 2" UBYTE OneToOne 1 100 0.00 255.0 FORMAT "%5.1" ECU_ADDRESS 0x7FA7E8 /end MEASUREMENT
/begin MEASUREMENT OvRMon_stPwrStg "Status ob die Endstufen wegen Recovery RcyOvRMonTiLimET abgeschaltet sind (0...Endstufen abgeschalten)" UBYTE OneToOne 1 100 0.00 255.0 FORMAT "%5.1" ECU_ADDRESS 0x7FA7F7 /end MEASUREMENT
/begin MEASUREMENT OvRMon_stRls_mp "Status aller Freigabe Bits für die Schubüberwachung" UWORD OneToOne 1 100 0.00 65535.00 FORMAT "%8.2" ECU_ADDRESS 0x9FF710 /end MEASUREMENT
/begin MEASUREMENT OvRMon_stShtrp_mp "Meßpunkt des OvRMon ShortTrip Überwachungstatus" UBYTE OneToOne 1 100 0.00 255.0 FORMAT "%5.1" ECU_ADDRESS 0x9FFF61 /end MEASUREMENT
/begin MEASUREMENT OvRMon_stStCtl_mp "Status der Stabilitätskontrolle (Fahrdynamikregelung) - Schubüberwachung" UBYTE OneToOne 1 100 0.00 255.0 FORMAT "%5.1" ECU_ADDRESS 0x9FFF62 /end MEASUREMENT
/begin MEASUREMENT OvRMon_stTIIAccs_mp "Status der Überwachung bei TII Eingriff" UBYTE OneToOne 1 100 0.00 255.0 FORMAT "%5.1" ECU_ADDRESS 0x9FFF5C /end MEASUREMENT
/begin MEASUREMENT OvRMon_swtActvBrkBstr_mp "Schalter zur Auswahl von ACC mit oder ohne aktiven Bremsverstärker" UBYTE OneToOne 1 100 0.00 255.0 FORMAT "%5.1" ECU_ADDRESS 0x9FFF6B /end MEASUREMENT
/begin MEASUREMENT OvRMon_tiActMIEff_mp "Ansteuerzeit der letzten Haupteinspritzung" SLONG InjTime_us 1 100 -2147483648.00 2147483647.00 FORMAT "%13.2" ECU_ADDRESS 0x9FE600 /end MEASUREMENT
/begin MEASUREMENT OvRMon_tiActPiIEff_mp "Ansteuerzeit der letzten Voreinspritzung" SLONG InjTime_us 1 100 -2147483648.00 2147483647.00 FORMAT "%13.2" ECU_ADDRESS 0x9FE604 /end MEASUREMENT
/begin MEASUREMENT OvRMon_tiActPoIEff_mp "Ansteuerzeit der letzten Nacheinspritzung" SLONG InjTime_us 1 100 -2147483648.00 2147483647.00 FORMAT "%13.2" ECU_ADDRESS 0x9FE608 /end MEASUREMENT
/begin MEASUREMENT OvRMon_tiIntrSysAct "Systemzeit vom aktuellen Main-Interrupt" ULONG OneToOne 1 100 0.00 4294967295.00 FORMAT "%13.2" ECU_ADDRESS 0x7FC92C /end MEASUREMENT
/begin MEASUREMENT OvRMon_tiIntrSysLst "Systemzeit vom vorhergehenden Main-Interrupt" ULONG OneToOne 1 100 0.00 4294967295.00 FORMAT "%13.2" ECU_ADDRESS 0x7FC930 /end MEASUREMENT
/begin MEASUREMENT OvRMon_tiLimET_mp "Obergrenze der Ansteuerdauer der Schubüberwachung" UWORD InjTime_us 1 100 0.00 65535.00 FORMAT "%8.2" ECU_ADDRESS 0x9FF708 /end MEASUREMENT
/begin MEASUREMENT OvRMon_tiOvRMonActive_mp "Zeit nach Aktivierung der Schubüberwachung" SWORD Time_ms 1 100 -327680.0 327670.0 FORMAT "%8.1" ECU_ADDRESS 0x9FF70A /end MEASUREMENT
/begin MEASUREMENT OvRMon_tiTDCAvrg "Mittlere momentwirksame Ansteuerdauer pro Zylinder in der Schubüberwachung" ULONG InjTime_us 1 100 0.00 4294967295.00 FORMAT "%13.2" ECU_ADDRESS 0x7FC938 /end MEASUREMENT
/begin MEASUREMENT OvRMon_tiTDCAvrgCpl "Komplement der mittleren momentwirksamen Ansteuerdauer pro Zylinder in der Schubüberwachung" ULONG InjTime_us 1 100 0.00 4294967295.00 FORMAT "%13.2" ECU_ADDRESS 0x7FC93C /end MEASUREMENT
/begin MEASUREMENT OvRMon_tiTDCSumET_mp "Summe der momentwirksamen Ansteuerdauern eines Zylinders" SLONG InjTime_us 1 100 -2147483648.00 2147483647.00 FORMAT "%13.2" ECU_ADDRESS 0x9FE60C /end MEASUREMENT
/begin MEASUREMENT OvRMon_uBatt_mp "Geglätterter Wert der redundant eingelesenen Batteriespannung" SWORD Volt_Batt 1 100 -665674.1 665653.8 FORMAT "%8.1" ECU_ADDRESS 0x9FF712 /end MEASUREMENT
/begin MEASUREMENT OvRMon_uBrkMnSwtCor_mp "Batteriespannungskorrigierter Wert des redundant eingelesenen Hauptbremsschalters" SWORD Volt 1 100 -160156.4 160151.5 FORMAT "%8.1" ECU_ADDRESS 0x9FF714 /end MEASUREMENT
/begin MEASUREMENT OvRMon_uBrkMnSwtRaw_mp "Redundant eingelesener Spannungsrohwert des Hauptbremsschalters vom ADC" SWORD Volt 1 100 -160156.4 160151.5 FORMAT "%8.1" ECU_ADDRESS 0x9FF716 /end MEASUREMENT
/begin MEASUREMENT OvRMon_uBrkMnSwt_mp "Geglätterter Spannungswert des redundant eingelesenen Hauptbremsschalters" SWORD Volt 1 100 -160156.4 160151.5 FORMAT "%8.1" ECU_ADDRESS 0x9FF718 /end MEASUREMENT
/begin MEASUREMENT OvRMon_uRawAPP1 "Spannungswert (Fahrervorgabe - PWG) aus Ebene2 für die Cruise Control Plus Monitoring Funktion" SWORD Volt 1 100 -160156.4 160151.5 FORMAT "%8.1" ECU_ADDRESS 0x7FA7EA /end MEASUREMENT
/begin MEASUREMENT OvRMon_uRawBatt_mp "redundant eingelesener Batteriespannungsrohwert" SWORD Volt_Batt 1 100 -665674.1 665653.8 FORMAT "%8.1" ECU_ADDRESS 0x9FF71A /end MEASUREMENT
/begin MEASUREMENT OvRMon_uRawLowIdle_mp "Spannungsrohwert des redundant eingelesenen Leergasschalters" SWORD Volt 1 100 -160156.4 160151.5 FORMAT "%8.1" ECU_ADDRESS 0x9FF6F4 /end MEASUREMENT
/begin MEASUREMENT OvRMon_uRegAPP1_mp "ADC-Registerwert der Position von Fahrpedal 1" SWORD Volt 1 100 -160156.4 160151.5 FORMAT "%8.1" ECU_ADDRESS 0x9FF6F6 /end MEASUREMENT
/begin MEASUREMENT OvRMon_uRegAPP2_mp "ADC-Registerwert der Position von Fahrpedal 2" SWORD Volt 1 100 -160156.4 160151.5 FORMAT "%8.1" ECU_ADDRESS 0x9FF6F8 /end MEASUREMENT
/begin MEASUREMENT OxiCCD_tLinPre "linearisierter Wert Abgastemperatur vor Oxidationskatalysator" SWORD Temp_Cels 1 100 -3549.940 3003.560 FORMAT "%8.3" ECU_ADDRESS 0x7F9BB0 /end MEASUREMENT
/begin MEASUREMENT OxiCCD_tPre "Abgastemperatur vor Oxidationskatalysator" SWORD Temp_Cels 1 100 -3549.940 3003.560 FORMAT "%8.3" ECU_ADDRESS 0x7F9BB2 /end MEASUREMENT
/begin MEASUREMENT OxiCCD_uRawTempPre "Abgastemperatur vor Oxidationskatalysator Rohwert" SWORD Volt 1 100 0.00 5000.000 FORMAT "%8.3" ECU_ADDRESS 0x7F9BB4 /end MEASUREMENT
/begin MEASUREMENT PCR_dmAirAltCorr2_mp "Korrigierte Luftmasse in großer Höhe, zweites Luftsystem" SWORD AirMassPerTime 1 100 -3276.800 3276.700 FORMAT "%8.3" ECU_ADDRESS 0x9FF71E /end MEASUREMENT
/begin MEASUREMENT PCR_dmAirAltCorrFl2_mp "Korrigierte Luftmasse in großer Höhe, erstes Luftsystem" FLOAT32_IEEE AirmassPerTime_float 1 100 0.00 1400.00000 FORMAT "%10.5" ECU_ADDRESS 0x9FE610 /end MEASUREMENT
/begin MEASUREMENT PCR_dmAirAltCorrFl_mp "Korrigierte Luftmasse in großer Höhe, erstes Luftsystem" FLOAT32_IEEE AirmassPerTime_float 1 100 0.00 1400.00000 FORMAT "%10.5" ECU_ADDRESS 0x9FE614 /end MEASUREMENT
/begin MEASUREMENT PCR_dmAirAltCorr_mp "Korrigierte Luftmasse in großer Höhe, erstes Luftsystem" SWORD AirMassPerTime 1 100 -3276.800 3276.700 FORMAT "%8.3" ECU_ADDRESS 0x9FF720 /end MEASUREMENT
/begin MEASUREMENT PCR_dnAvrg "Drehzahlgradient Basis für Korrekturfaktor D-Verstärkung" SWORD dEngSpd_s 1 100 -32768.00 32767.00 FORMAT "%8.2" ECU_ADDRESS 0x7F9BB6 /end MEASUREMENT
/begin MEASUREMENT PCR_dpBPDesStat_mp "Zeitliche Ableitung des Ladedrucksollwertes" SWORD Pres_hPaPerSec_20ms 1 100 -1638400. 1638350. FORMAT "%8.0" ECU_ADDRESS 0x9FF786 /end MEASUREMENT
/begin MEASUREMENT PCR_dqDes "Abgeleitete gefilterte Einspritzwunschmenge" SWORD dInjQnt_s 1 100 -32768.00 32767.00 FORMAT "%8.2" ECU_ADDRESS 0x7F9BB8 /end MEASUREMENT
/begin MEASUREMENT PCR_DT1_mp "Zeitkonstante für DT1-Glied" ULONG TimeDelay_s 1 100 0.0000010000000 4294.9673 FORMAT "%9.4" ECU_ADDRESS 0x9FE648 /end MEASUREMENT
/begin MEASUREMENT PCR_facAT_mp "Lufttemperaturabhängiger Faktor für Sollwertberechnung" SWORD Fact 1 100 -4.000000 3.999878 FORMAT "%8.6" ECU_ADDRESS 0x9FF768 /end MEASUREMENT
/begin MEASUREMENT PCR_facBPAltCorr2_mp "Umrechnungsfaktor für Ladedruck in großer Höhe, zweites Luftsystem" FLOAT32_IEEE OneToOne 1 100 0.00 6.55000000 FORMAT "%10.8" ECU_ADDRESS 0x9FE618 /end MEASUREMENT
/begin MEASUREMENT PCR_facBPAltCorr_mp "Umrechnungsfaktor für Ladedruck in großer Höhe, erstes Luftsystem" FLOAT32_IEEE OneToOne 1 100 0.00 6.55000000 FORMAT "%10.8" ECU_ADDRESS 0x9FE61C /end MEASUREMENT
/begin MEASUREMENT PCR_facBPAltDesMax2_mp "Vorgesteuertes Ladedruckverhältnis für große Höhen rechtes System" SWORD Fact1000 1 100 -32.76800 32.76700 FORMAT "%8.5" ECU_ADDRESS 0x9FF722 /end MEASUREMENT
/begin MEASUREMENT PCR_facBPAltDesMax_mp "Vorgesteuertes Ladedruckverhältnis für große Höhen linkes System" SWORD Fact1000 1 100 -32.76800 32.76700 FORMAT "%8.5" ECU_ADDRESS 0x9FF724 /end MEASUREMENT
/begin MEASUREMENT PCR_facBPAltDyn2_mp "Ladedruckverhältnis des Vorfilters in großen Höhen rechtes System" SWORD Fact1000 1 100 -32.76800 32.76700 FORMAT "%8.5" ECU_ADDRESS 0x9FF726 /end MEASUREMENT
/begin MEASUREMENT PCR_facBPAltDynLim2_mp "Limitiertes Ladedruckverhältnis des Vorfilter in großen Höhen rechtes System" SWORD Fact1000 1 100 -32.76800 32.76700 FORMAT "%8.5" ECU_ADDRESS 0x9FF728 /end MEASUREMENT
/begin MEASUREMENT PCR_facBPAltDynLim_mp "Limitiertes Ladedruckverhältnis des Vorfilter in großen Höhen linkes System" SWORD Fact1000 1 100 -32.76800 32.76700 FORMAT "%8.5" ECU_ADDRESS 0x9FF72A /end MEASUREMENT
/begin MEASUREMENT PCR_facBPAltDyn_mp "Ladedruckverhältnis des Vorfilters in großen Höhen linkes System" SWORD Fact1000 1 100 -32.76800 32.76700 FORMAT "%8.5" ECU_ADDRESS 0x9FF72C /end MEASUREMENT
/begin MEASUREMENT PCR_facBPAltMax2Corr2_mp "korrigiertes Ladedruckverhältnis im zweiten Luftsystem in Abhängigkeit des aktuellen Motorbetriebspunktes" SWORD Fact1000 1 100 -32.76800 32.76700 FORMAT "%8.5" ECU_ADDRESS 0x9FF72E /end MEASUREMENT
/begin MEASUREMENT PCR_facBPAltMax2Corr_mp "korrigiertes Ladedruckverhältnis im zweiten Luftsystem auf Grund Hochschaltung" SWORD Fact1000 1 100 -32.76800 32.76700 FORMAT "%8.5" ECU_ADDRESS 0x9FF730 /end MEASUREMENT
/begin MEASUREMENT PCR_facBPAltMax2_mp "Ladedruckverhältnis ohne Vorfilter in großen Höhen rechtes System" SWORD Fact1000 1 100 -32.76800 32.76700 FORMAT "%8.5" ECU_ADDRESS 0x9FF732 /end MEASUREMENT
/begin MEASUREMENT PCR_facBPAltMaxCorr2_mp "korrigiertes Ladedruckverhältnis in Abhängigkeit des aktuellen Motorbetriebspunktes" SWORD Fact1000 1 100 -32.76800 32.76700 FORMAT "%8.5" ECU_ADDRESS 0x9FF734 /end MEASUREMENT
/begin MEASUREMENT PCR_facBPAltMaxCorr_mp "korrigiertes Ladedruckverhältnis auf Grund Hochschaltung" SWORD Fact1000 1 100 -32.76800 32.76700 FORMAT "%8.5" ECU_ADDRESS 0x9FF736 /end MEASUREMENT
/begin MEASUREMENT PCR_facBPAltMax_mp "Ladedruckverhältnis ohne Vorfilter in großen Höhen linkes System" SWORD Fact1000 1 100 -32.76800 32.76700 FORMAT "%8.5" ECU_ADDRESS 0x9FF738 /end MEASUREMENT
/begin MEASUREMENT PCR_facBPMaxCorAdd_mp "Additiver Korrekturwert in Abhängigkeit des aktuellen Motorbetriebspunktes" SWORD Fact1000 1 100 -32.76800 32.76700 FORMAT "%8.5" ECU_ADDRESS 0x9FF71C /end MEASUREMENT
/begin MEASUREMENT PCR_facCtlAT_mp "lufttemperaturabhängiger Korrekturfaktor für Ladedrucksteuerung" SWORD Fact 1 100 -4.000000 3.999878 FORMAT "%8.6" ECU_ADDRESS 0x9FF750 /end MEASUREMENT
/begin MEASUREMENT PCR_facCtQ_mp "Kühltemperaturabhängiger Faktor für Sollwertberechnung" SWORD Fact 1 100 -4.000000 3.999878 FORMAT "%8.6" ECU_ADDRESS 0x9FF76A /end MEASUREMENT
/begin MEASUREMENT PCR_facD_mp "Adaptionsfaktor für Regler-D-Verstärkung" SWORD Fact 1 100 -4.000000 3.999878 FORMAT "%8.6" ECU_ADDRESS 0x9FF788 /end MEASUREMENT
/begin MEASUREMENT PCR_facEAT_mp "Umgebungslufttemperaturabhängiger Korrekturfaktor für Sollwertbildung" SWORD Fact 1 100 -4.000000 3.999878 FORMAT "%8.6" ECU_ADDRESS 0x9FF76C /end MEASUREMENT
/begin MEASUREMENT PCR_facI_mp "Adaptionsfaktor für Regler-I-Verstärkung" SWORD Fact 1 100 -4.000000 3.999878 FORMAT "%8.6" ECU_ADDRESS 0x9FF78A /end MEASUREMENT
/begin MEASUREMENT PCR_facP_mp "Adaptionsfaktor für Regler-P-Verstärkung" SWORD Fact 1 100 -4.000000 3.999878 FORMAT "%8.6" ECU_ADDRESS 0x9FF78C /end MEASUREMENT
/begin MEASUREMENT PCR_facShftUpCor_mp "Korrekturwert des Ladedruckverhältnis auf Grund Hochschaltung" SWORD Fact1000 1 100 -32.76800 32.76700 FORMAT "%8.5" ECU_ADDRESS 0x9FF73A /end MEASUREMENT
/begin MEASUREMENT PCR_facTrbnRed_mp "Korrekturfaktor für aktuelle Laderdrehzahl" SWORD Fact 1 100 -4.000000 3.999878 FORMAT "%8.6" ECU_ADDRESS 0x9FF73C /end MEASUREMENT
/begin MEASUREMENT PCR_nAvrgFrz "Eingefrorene Drehzahl für die Anti-Kaudern-Maßnahme" SWORD EngN 1 100 -32768.00 32767.00 FORMAT "%8.2" ECU_ADDRESS 0x7F9BBA /end MEASUREMENT
/begin MEASUREMENT PCR_nTrbn "Laderdrehzahl linkes System" SWORD TurboN 1 100 -327680.0 327670.0 FORMAT "%8.1" ECU_ADDRESS 0x7F9BBC /end MEASUREMENT
/begin MEASUREMENT PCR_nTrbn2 "Laderdrehzahl rechtes Sytem" SWORD TurboN 1 100 -327680.0 327670.0 FORMAT "%8.1" ECU_ADDRESS 0x7F9BBE /end MEASUREMENT
/begin MEASUREMENT PCR_nTrbnFlt2_mp "gefilterte Laderdrehzahl Luftsystem 2" SWORD TurboN 1 100 -327680.0 327670.0 FORMAT "%8.1" ECU_ADDRESS 0x9FF73E /end MEASUREMENT
/begin MEASUREMENT PCR_nTrbnFlt_mp "gefilterte Laderdrehzahl" SWORD TurboN 1 100 -327680.0 327670.0 FORMAT "%8.1" ECU_ADDRESS 0x9FF740 /end MEASUREMENT
/begin MEASUREMENT PCR_nTrbnMax_mp "maximale Laderdrehzahl" SWORD TurboN 1 100 -327680.0 327670.0 FORMAT "%8.1" ECU_ADDRESS 0x9FF742 /end MEASUREMENT
/begin MEASUREMENT PCR_nTrbnRed2_mp "reduzierte Laderdrehzahl Luftsystem 2" FLOAT32_IEEE TrbChN_float 1 100 0.00 300000.000 FORMAT "%10.3" ECU_ADDRESS 0x9FE620 /end MEASUREMENT
/begin MEASUREMENT PCR_nTrbnRedMax_mp "maximale reduzierte Laderdrehzahl" SWORD TurboN 1 100 -327680.0 327670.0 FORMAT "%8.1" ECU_ADDRESS 0x9FF744 /end MEASUREMENT
/begin MEASUREMENT PCR_nTrbnRed_mp "reduzierte Laderdrehzahl" FLOAT32_IEEE TrbChN_float 1 100 0.00 300000.000 FORMAT "%10.3" ECU_ADDRESS 0x9FE624 /end MEASUREMENT
/begin MEASUREMENT PCR_pAirAltCorr2_mp "Druck vor Verdichter, zweites Luftsystem" FLOAT32_IEEE Pres_hPa_float 1 100 0.00 4000.00000 FORMAT "%10.5" ECU_ADDRESS 0x9FE628 /end MEASUREMENT
/begin MEASUREMENT PCR_pAirAltCorr_mp "Druck vor Verdichter, erstes Luftsystem" FLOAT32_IEEE Pres_hPa_float 1 100 0.00 4000.00000 FORMAT "%10.5" ECU_ADDRESS 0x9FE62C /end MEASUREMENT
/begin MEASUREMENT PCR_pAPQCmpn_mp "luftdruckabhängige Kompensation für Sollwertbildung" SWORD Pres_hPa 1 100 -32768.00 32767.00 FORMAT "%8.2" ECU_ADDRESS 0x9FF76E /end MEASUREMENT
/begin MEASUREMENT PCR_pBDes "Ladedrucksollwert" SWORD Pres_hPa 1 100 -32768.00 32767.00 FORMAT "%8.2" ECU_ADDRESS 0x7F9BC0 /end MEASUREMENT
/begin MEASUREMENT PCR_pBDes1_mp "stationärer Ladedruck für Partikelfilter Regeneration 1 vor Korrektur" SWORD Pres_hPa 1 100 -32768.00 32767.00 FORMAT "%8.2" ECU_ADDRESS 0x9FF770 /end MEASUREMENT
/begin MEASUREMENT PCR_pBDes2_mp "stationärer Ladedruck für Partikelfilter Regeneration 2 vor Korrektur" SWORD Pres_hPa 1 100 -32768.00 32767.00 FORMAT "%8.2" ECU_ADDRESS 0x9FF772 /end MEASUREMENT
/begin MEASUREMENT PCR_pBDes3_mp "Ladedrucksollwert im Regenerationsbetrieb 3 vor Abgasdruckkorrektur" SWORD Pres_hPa 1 100 -32768.00 32767.00 FORMAT "%8.2" ECU_ADDRESS 0x9FF774 /end MEASUREMENT
/begin MEASUREMENT PCR_pBDesBas_mp "Grundwert des Ladedrucksollwertes" SWORD Pres_hPa 1 100 -32768.00 32767.00 FORMAT "%8.2" ECU_ADDRESS 0x9FF776 /end MEASUREMENT
/begin MEASUREMENT PCR_pBDesByp_mp "Bypass-Label, Kopie von PCR_pBDes" SWORD Pres_hPa 1 100 -32768.00 32767.00 FORMAT "%8.2" ECU_ADDRESS 0x9FF778 /end MEASUREMENT
/begin MEASUREMENT PCR_pBDesCorr_mp "korrigierter Ladedrucksollwert" SWORD Pres_hPa 1 100 -32768.00 32767.00 FORMAT "%8.2" ECU_ADDRESS 0x9FF77A /end MEASUREMENT
/begin MEASUREMENT PCR_pBDesCtCorr_mp "Kühltemperaturkorrigierter Wert des Ladedrucksollwerts" SWORD Pres_hPa 1 100 -32768.00 32767.00 FORMAT "%8.2" ECU_ADDRESS 0x9FF77C /end MEASUREMENT
/begin MEASUREMENT PCR_pBDesDyn_mp "Dynamischer Teil des Ladedrucksollwerts" SWORD Pres_hPa 1 100 -32768.00 32767.00 FORMAT "%8.2" ECU_ADDRESS 0x9FF77E /end MEASUREMENT
/begin MEASUREMENT PCR_pBDesMaxAP_mp "Größter erlaubter Ladedrucksollwert in Abhängigkeit vom Luftdruck" SWORD Pres_hPa 1 100 -32768.00 32767.00 FORMAT "%8.2" ECU_ADDRESS 0x9FF780 /end MEASUREMENT
/begin MEASUREMENT PCR_pBDesRgn_mp "Ladedrucksollwert im Regenerationsbetrieb" SWORD Pres_hPa 1 100 -32768.00 32767.00 FORMAT "%8.2" ARRAY_SIZE 3 ECU_ADDRESS 0x9FF762 /end MEASUREMENT
/begin MEASUREMENT PCR_pBDesVal_mp "Ladedrucksollwert vor Korrektur" SWORD Pres_hPa 1 100 -32768.00 32767.00 FORMAT "%8.2" ECU_ADDRESS 0x9FF782 /end MEASUREMENT
/begin MEASUREMENT PCR_pBGDev "Regelabweichung" SWORD Pres_hPa 1 100 -32768.00 32767.00 FORMAT "%8.2" ECU_ADDRESS 0x7F9BC2 /end MEASUREMENT
/begin MEASUREMENT PCR_pBGDevI_mp "Regelabweichung für I-Anteil" SWORD Pres_hPa 1 100 -32768.00 32767.00 FORMAT "%8.2" ECU_ADDRESS 0x9FF78E /end MEASUREMENT
/begin MEASUREMENT PCR_pBGDevMax_mp "Maximale Reglerabweichung" SWORD Pres_hPa 1 100 -32768.00 32767.00 FORMAT "%8.2" ECU_ADDRESS 0x9FF7B8 /end MEASUREMENT
/begin MEASUREMENT PCR_pBPAltCorr2_mp "Quadrat  des Druckes bei der Berechnung des erlaubten Ladedrucks Luftsystem 2" FLOAT32_IEEE OneToOne 1 100 0.00 300000.000 FORMAT "%10.3" ECU_ADDRESS 0x9FE630 /end MEASUREMENT
/begin MEASUREMENT PCR_pBPAltCorr_mp "Quadrat  des Druckes bei der Berechnung des erlaubten Ladedrucks Luftsystem 1" FLOAT32_IEEE OneToOne 1 100 0.00 300000.000 FORMAT "%10.3" ECU_ADDRESS 0x9FE634 /end MEASUREMENT
/begin MEASUREMENT PCR_pBPAltDesMax2_mp "Laderdrehzahllimit in großer Höhe ohne Luftmassenkorrektur rechtes System" SWORD Pres_hPa 1 100 -32768.00 32767.00 FORMAT "%8.2" ECU_ADDRESS 0x9FF746 /end MEASUREMENT
/begin MEASUREMENT PCR_pBPAltDesMaxCorr "korrigierter erlaubter Ladedruck" SWORD Pres_hPa 1 100 -32768.00 32767.00 FORMAT "%8.2" ECU_ADDRESS 0x7F9BC4 /end MEASUREMENT
/begin MEASUREMENT PCR_pBPAltDesMaxCorr2 "korrigierter erlaubter Ladedruck Luftsytem 2" SWORD Pres_hPa 1 100 -32768.00 32767.00 FORMAT "%8.2" ECU_ADDRESS 0x7F9BC6 /end MEASUREMENT
/begin MEASUREMENT PCR_pBPAltDesMax_mp "Laderdrehzahllimit in großer Höhe ohne Luftmassenkorrektur linkes System" SWORD Pres_hPa 1 100 -32768.00 32767.00 FORMAT "%8.2" ECU_ADDRESS 0x9FF748 /end MEASUREMENT
/begin MEASUREMENT PCR_pBPDesStat "stationärer Anteil des Ladedrucksollwertes" SWORD Pres_hPa 1 100 -32768.00 32767.00 FORMAT "%8.2" ECU_ADDRESS 0x7F9BC8 /end MEASUREMENT
/begin MEASUREMENT PCR_pBPIntValCorr2_mp "s" FLOAT32_IEEE Pres_hPa_float 1 100 0.00 4000.00000 FORMAT "%10.5" ECU_ADDRESS 0x9FE638 /end MEASUREMENT
/begin MEASUREMENT PCR_pBPIntValCorr_mp "Druck nach Verdichter (vor Ladeluftkühler 1" FLOAT32_IEEE Pres_hPa_float 1 100 0.00 4000.00000 FORMAT "%10.5" ECU_ADDRESS 0x9FE63C /end MEASUREMENT
/begin MEASUREMENT PCR_pNQCtCmpn_mp "Korrekturwert für Kühlwassertemperaturkorrektur für Sollwertberechnung" SWORD Pres_hPa 1 100 -32768.00 32767.00 FORMAT "%8.2" ECU_ADDRESS 0x9FF784 /end MEASUREMENT
/begin MEASUREMENT PCR_qCtl "für die Steuerung benutztes Einspritzmengensignal" SWORD InjMass 1 100 -327.6800 327.6700 FORMAT "%8.4" ECU_ADDRESS 0x7F9BCA /end MEASUREMENT
/begin MEASUREMENT PCR_qCtlByp_mp "Bypass message für PCR_qCtl" SWORD InjMass 1 100 -327.6800 327.6700 FORMAT "%8.4" ECU_ADDRESS 0x9FF752 /end MEASUREMENT
/begin MEASUREMENT PCR_qDes "Einspritzmenge für Sollwertbildung" SWORD InjMass 1 100 -327.6800 327.6700 FORMAT "%8.4" ECU_ADDRESS 0x7F9BCC /end MEASUREMENT
/begin MEASUREMENT PCR_qMinBPGovFlt_mp "Minimale Einspritzmenge zur Aktivierung der Ladergeräuschunterdrückung" SWORD InjMass 1 100 -327.6800 327.6700 FORMAT "%8.4" ECU_ADDRESS 0x9FF790 /end MEASUREMENT
/begin MEASUREMENT PCR_qMonOff_mp "untere Schwelle der Abschalthysterese" SWORD InjMass 1 100 -327.6800 327.6700 FORMAT "%8.4" ECU_ADDRESS 0x9FF792 /end MEASUREMENT
/begin MEASUREMENT PCR_qMonOn_mp "obere Schwelle der Abschalthysterese" SWORD InjMass 1 100 -327.6800 327.6700 FORMAT "%8.4" ECU_ADDRESS 0x9FF794 /end MEASUREMENT
/begin MEASUREMENT PCR_rBalGvnrDiff "Tastverhältnis Gleichstellungsregler" SWORD Prc 1 100 -327.6800 327.6700 FORMAT "%8.4" ECU_ADDRESS 0x7F9BDA /end MEASUREMENT
/begin MEASUREMENT PCR_rBPACD "Stellgröße für den Ladedrucksteller" SWORD Prc 1 100 -327.6800 327.6700 FORMAT "%8.4" ECU_ADDRESS 0x7F9BCE /end MEASUREMENT
/begin MEASUREMENT PCR_rBPACD2 "Stellgröße für den zweiten Ladedrucksteller" SWORD Prc 1 100 -327.6800 327.6700 FORMAT "%8.4" ECU_ADDRESS 0x7F9BD0 /end MEASUREMENT
/begin MEASUREMENT PCR_rBPACDByp_mp "Bypass-Label, Kopie von PCR_rBPACD" SWORD Prc 1 100 -327.6800 327.6700 FORMAT "%8.4" ECU_ADDRESS 0x9FF7BA /end MEASUREMENT
/begin MEASUREMENT PCR_rBPAPRatFrz "Eingefrorener Ladedruckwert für die Anti-Kaudern-Maßnahme" SWORD Fact 1 100 -4.000000 3.999878 FORMAT "%8.6" ECU_ADDRESS 0x7F9BD2 /end MEASUREMENT
/begin MEASUREMENT PCR_rBPAPRatMin_mp "Ladedruckvergleichswert für die Schuberkennung der Anti-Kaudern-Maßnahme" SWORD Fact 1 100 -4.000000 3.999878 FORMAT "%8.6" ECU_ADDRESS 0x9FF796 /end MEASUREMENT
/begin MEASUREMENT PCR_rBPAPRat_mp "Ladedruckverhältnis für die Anti-Kaudern-Maßnahme" SWORD Fact 1 100 -4.000000 3.999878 FORMAT "%8.6" ECU_ADDRESS 0x9FF798 /end MEASUREMENT
/begin MEASUREMENT PCR_rBPCtl "Ladedruck Steueranteil der Stellgrösse" SWORD Prc 1 100 -327.6800 327.6700 FORMAT "%8.4" ECU_ADDRESS 0x7F9BD4 /end MEASUREMENT
/begin MEASUREMENT PCR_rBPCtl1_mp "gesteuerter Ladedruck für Partikelfilter Regeneration 1 vor Korrektur" SWORD Prc 1 100 -327.6800 327.6700 FORMAT "%8.4" ECU_ADDRESS 0x9FF754 /end MEASUREMENT
/begin MEASUREMENT PCR_rBPCtl2_mp "gesteuerter Ladedruck für Partikelfilter Regeneration 2 vor Korrektur" SWORD Prc 1 100 -327.6800 327.6700 FORMAT "%8.4" ECU_ADDRESS 0x9FF756 /end MEASUREMENT
/begin MEASUREMENT PCR_rBPCtl3_mp "Steuerwert im Regenerationsbetrieb 3 vor Abgasdruckkorrektur" SWORD Prc 1 100 -327.6800 327.6700 FORMAT "%8.4" ECU_ADDRESS 0x9FF758 /end MEASUREMENT
/begin MEASUREMENT PCR_rBPCtlAPCorr_mp "in Abhängigkeit des Atmosphärendrucks korrigierter Steuerwert" SWORD Prc 1 100 -327.6800 327.6700 FORMAT "%8.4" ECU_ADDRESS 0x9FF75A /end MEASUREMENT
/begin MEASUREMENT PCR_rBPCtlBas_mp "Basissteuerwert für Ladedruck" SWORD Prc 1 100 -327.6800 327.6700 FORMAT "%8.4" ECU_ADDRESS 0x9FF75C /end MEASUREMENT
/begin MEASUREMENT PCR_rBPCtlByp_mp "Bypass message für PCR_rBPCtl" SWORD Prc 1 100 -327.6800 327.6700 FORMAT "%8.4" ECU_ADDRESS 0x9FF75E /end MEASUREMENT
/begin MEASUREMENT PCR_rBPCtlCorr_mp "korrigierter Steuerwert für Ladedruck" SWORD Prc 1 100 -327.6800 327.6700 FORMAT "%8.4" ECU_ADDRESS 0x9FF760 /end MEASUREMENT
/begin MEASUREMENT PCR_rBPCtlRgn_mp "Steuerwert im Regenerationsbetrieb" SWORD Prc 1 100 -327.6800 327.6700 FORMAT "%8.4" ARRAY_SIZE 3 ECU_ADDRESS 0x9FF74A /end MEASUREMENT
/begin MEASUREMENT PCR_rBPGov "Reglerstellgröße für den Ladedruck" SWORD Prc 1 100 -327.6800 327.6700 FORMAT "%8.4" ECU_ADDRESS 0x7F9BD6 /end MEASUREMENT
/begin MEASUREMENT PCR_rBPGov2 "Reglerstellgröße für den Ladedruck 2" SWORD Prc 1 100 -327.6800 327.6700 FORMAT "%8.4" ECU_ADDRESS 0x7F9BD8 /end MEASUREMENT
/begin MEASUREMENT PCR_rBPGovByp_mp "Meßpunkt für Bypass Freischnitt" SWORD Prc 1 100 -327.6800 327.6700 FORMAT "%8.4" ECU_ADDRESS 0x9FF79A /end MEASUREMENT
/begin MEASUREMENT PCR_rBPGovFlt_mp "PT1 gefilterter Reglerausgang im Falle einer aktiven Ladergeräuschunterdrückung" SWORD Prc 1 100 -327.6800 327.6700 FORMAT "%8.4" ECU_ADDRESS 0x9FF79C /end MEASUREMENT
/begin MEASUREMENT PCR_rBPGovMax_mp "Maximal zulässige Reglerstellgröße" SWORD Prc 1 100 -327.6800 327.6700 FORMAT "%8.4" ECU_ADDRESS 0x9FF79E /end MEASUREMENT
/begin MEASUREMENT PCR_rBPGovMin_mp "Minimal zulässige Reglerstellgröße" SWORD Prc 1 100 -327.6800 327.6700 FORMAT "%8.4" ECU_ADDRESS 0x9FF7A0 /end MEASUREMENT
/begin MEASUREMENT PCR_rBPGovUnLin2_mp "Rohwert Tastverhätnis für Ladedruckregler2" SWORD Prc 1 100 -327.6800 327.6700 FORMAT "%8.4" ECU_ADDRESS 0x9FF7A2 /end MEASUREMENT
/begin MEASUREMENT PCR_rBPGovUnLin_mp "Rohwert Tastverhätnis für Ladedruckregler" SWORD Prc 1 100 -327.6800 327.6700 FORMAT "%8.4" ECU_ADDRESS 0x9FF7A4 /end MEASUREMENT
/begin MEASUREMENT PCR_rBPNS_mp "Ladedruck nach der Anti-Kaudern-Maßnahme" SWORD Prc 1 100 -327.6800 327.6700 FORMAT "%8.4" ECU_ADDRESS 0x9FF7A6 /end MEASUREMENT
/begin MEASUREMENT PCR_rBPPT1NS_mp "gefilterter PCR_rPIDCtl" SWORD Prc 1 100 -327.6800 327.6700 FORMAT "%8.4" ECU_ADDRESS 0x9FF7A8 /end MEASUREMENT
/begin MEASUREMENT PCR_rOutDT1_mp "DT1-Anteil des PIDT1 Reglers" SWORD Prc 1 100 -327.6800 327.6700 FORMAT "%8.4" ECU_ADDRESS 0x9FF7AA /end MEASUREMENT
/begin MEASUREMENT PCR_rOutI_mp "I-Anteil des PIDT1 Reglers" SWORD Prc 1 100 -327.6800 327.6700 FORMAT "%8.4" ECU_ADDRESS 0x9FF7AC /end MEASUREMENT
/begin MEASUREMENT PCR_rOutP_mp "P-Anteil des PIDT1 Reglers" SWORD Prc 1 100 -327.6800 327.6700 FORMAT "%8.4" ECU_ADDRESS 0x9FF7AE /end MEASUREMENT
/begin MEASUREMENT PCR_rPICtl_mp "P+I+Steueranteil der Stellgröße (vor ARW)" SWORD Prc 1 100 -327.6800 327.6700 FORMAT "%8.4" ECU_ADDRESS 0x9FF7B0 /end MEASUREMENT
/begin MEASUREMENT PCR_rPIDCtl_mp "Regel- und Steueranteil der Stellgrösse des Ladedruckreglers" SWORD Prc 1 100 -327.6800 327.6700 FORMAT "%8.4" ECU_ADDRESS 0x9FF7B2 /end MEASUREMENT
/begin MEASUREMENT PCR_rstI_mp "Integratorzustand in Basisvariante" SWORD Prc 1 100 -327.6800 327.6700 FORMAT "%8.4" ECU_ADDRESS 0x9FF7B4 /end MEASUREMENT
/begin MEASUREMENT PCR_stActvNS "Statusbitfeld der Anti-Kaudern-Eingriffe" UWORD OneToOne 1 100 0.00 65535.00 FORMAT "%8.2" ECU_ADDRESS 0x7F9BDC /end MEASUREMENT
/begin MEASUREMENT PCR_stBPGovFlt_mp "Status der Ladergeräuschunterdrückung" UBYTE OneToOne 1 100 0.00 255.0 FORMAT "%5.1" ECU_ADDRESS 0x9FFF6C /end MEASUREMENT
/begin MEASUREMENT PCR_stMonitor "Statusangabe bei Abschaltung der Regelung" UBYTE OneToOne 1 100 0.00 255.0 FORMAT "%5.1" ECU_ADDRESS 0x7F9510 /end MEASUREMENT
/begin MEASUREMENT PCR_stNSInt1 "Bitleiste der internen Stati der Anti-Kaudern-Erkennung zur Entprellung des Kupplung-Rohsignales" UBYTE OneToOne 1 100 0.00 255.0 FORMAT "%5.1" ECU_ADDRESS 0x7F9511 /end MEASUREMENT
/begin MEASUREMENT PCR_stNSint_mp "Anti-Kaudern interne Stati" UWORD OneToOne 1 100 0.00 65535.00 FORMAT "%8.2" ECU_ADDRESS 0x9FF7B6 /end MEASUREMENT
/begin MEASUREMENT PCR_stPCR "Status der Ladedruckregelung" UWORD OneToOne 1 100 0.00 65535.00 FORMAT "%8.2" ECU_ADDRESS 0x7F9BDE /end MEASUREMENT
/begin MEASUREMENT PCR_stPCR_mp "Status der Ladedruckregelung" UWORD OneToOne 1 100 0.00 65535.00 FORMAT "%8.2" ECU_ADDRESS 0x7FDE06 /end MEASUREMENT
/begin MEASUREMENT PCR_stRgtOffMsk_mp "Zustand EGT-Status gleich Maske Ausschalten" UBYTE OneToOne 1 100 0.00 255.0 FORMAT "%5.1" ECU_ADDRESS 0x9FFF6D /end MEASUREMENT
/begin MEASUREMENT PCR_stRgtOnMsk_mp "Zustand EGT-Status gleich Maske Einschalten" UBYTE OneToOne 1 100 0.00 255.0 FORMAT "%5.1" ECU_ADDRESS 0x9FFF6E /end MEASUREMENT
/begin MEASUREMENT PCR_stRmpCtl_mp "Codierung des gewählten Rampenschalterausgangs" ULONG OneToOne 1 100 0.00 4294967295.00 FORMAT "%13.2" ECU_ADDRESS 0x9FE640 /end MEASUREMENT
/begin MEASUREMENT PCR_stRmpDes_mp "Codierung des gewählten Rampenschalterausgangs" ULONG OneToOne 1 100 0.00 4294967295.00 FORMAT "%13.2" ECU_ADDRESS 0x9FE644 /end MEASUREMENT
/begin MEASUREMENT PCR_stWorkSph "present working sphere" UBYTE OneToOne 1 100 0.00 255.0 FORMAT "%5.1" ECU_ADDRESS 0x7F9512 /end MEASUREMENT
/begin MEASUREMENT PCR_swtLimMpCr "Schalter zur Auswahl der Größen, aus denen der zulässige Stellgrößenbereich bestimmt wird" UBYTE OneToOne 1 100 0.00 255.0 FORMAT "%5.1" ECU_ADDRESS 0x7F9513 /end MEASUREMENT
/begin MEASUREMENT PCR_swtNoDeb_mp "Schalter Regler ein/aus ohne Zeitverzögerung" UBYTE OneToOne 1 100 0.00 255.0 FORMAT "%5.1" ECU_ADDRESS 0x9FFF6F /end MEASUREMENT
/begin MEASUREMENT PCR_swtQCtl "Schalterwertmessage zur Auswahl der für Steuerung verwendeten Einspritzmenge" UBYTE OneToOne 1 100 0.00 255.0 FORMAT "%5.1" ECU_ADDRESS 0x7F9514 /end MEASUREMENT
/begin MEASUREMENT PCR_swtQDes "Schalter für Mengeneingangswunsch bei der Sollwertberechnung" UBYTE OneToOne 1 100 0.00 255.0 FORMAT "%5.1" ECU_ADDRESS 0x7F9515 /end MEASUREMENT
/begin MEASUREMENT PCR_swtRelAbs "Schalter zur Auswahl zwischen Absolut- und Relativdruckregelung" UBYTE OneToOne 1 100 0.00 255.0 FORMAT "%5.1" ECU_ADDRESS 0x7F9516 /end MEASUREMENT
/begin MEASUREMENT PCR_swtRgt "Schalter: Regler ein/aus" UBYTE OneToOne 1 100 0.00 255.0 FORMAT "%5.1" ECU_ADDRESS 0x7F9517 /end MEASUREMENT
/begin MEASUREMENT PCR_tGDevMax_mp "Temperatur für Berechnung der maximalen Regelabweichung" SWORD Temp_Cels 1 100 -3549.940 3003.560 FORMAT "%8.3" ECU_ADDRESS 0x9FF7BC /end MEASUREMENT
/begin MEASUREMENT PCR_tiStrtDelay_mp "Zeit, in der die Regelung nach Startabwurf abgeschaltet bleibt" UWORD Time_ms 1 100 0.00 655350.0 FORMAT "%8.1" ECU_ADDRESS 0x9FF7BE /end MEASUREMENT
/begin MEASUREMENT PFltCD_pDiff "Differenzdruck über Partikelfilter" SWORD Pres_hPa 1 100 -32768.00 32767.00 FORMAT "%8.2" ECU_ADDRESS 0x7F9BE0 /end MEASUREMENT
/begin MEASUREMENT PFltCD_pDiff_mp "Ungefilterter Differenzdrucksensor Wert [ hpa ]" SWORD Pres_hPa 1 100 -32768.00 32767.00 FORMAT "%8.2" ECU_ADDRESS 0x9FF8CA /end MEASUREMENT
/begin MEASUREMENT PFltCD_pLinDiff "Linearisierter Wert des Differenzdrucks über Partikelfilter" SWORD Pres_hPa 1 100 -32768.00 32767.00 FORMAT "%8.2" ECU_ADDRESS 0x7F9BE2 /end MEASUREMENT
/begin MEASUREMENT PFltCD_pPre "Abgastemp. vor Partikelfilter [kPa]" SWORD Pres_hPa 1 100 -32768.00 32767.00 FORMAT "%8.2" ECU_ADDRESS 0x7F9BE4 /end MEASUREMENT
/begin MEASUREMENT PFltCD_stActrDSMTst_mp "Endstufenstatus" UBYTE OneToOne 1 100 0.00 255.0 FORMAT "%5.1" ECU_ADDRESS 0x9FFF92 /end MEASUREMENT
/begin MEASUREMENT PFltCD_stOutHtg_mp "Ausgangszustand der Partikelfilterheizung" UBYTE OneToOne 1 100 0.00 255.0 FORMAT "%5.1" ECU_ADDRESS 0x9FFF93 /end MEASUREMENT
/begin MEASUREMENT PFltCD_swtSigPDiff "Schalterwert ob ADC oder CAN" UBYTE OneToOne 1 100 0.00 255.0 FORMAT "%5.1" ECU_ADDRESS 0x7F9518 /end MEASUREMENT
/begin MEASUREMENT PFltCD_tLinPre "Linearisierter Wert der Abgastemperatur vor dem Partikelfilter" SWORD Temp_Cels 1 100 -3549.940 3003.560 FORMAT "%8.3" ECU_ADDRESS 0x7F9BE6 /end MEASUREMENT
/begin MEASUREMENT PFltCD_tLinPst "Linearisierter Wert der Temperatur nach Partikelfilter" SWORD Temp_Cels 1 100 -3549.940 3003.560 FORMAT "%8.3" ECU_ADDRESS 0x7F9BE8 /end MEASUREMENT
/begin MEASUREMENT PFltCD_tPre "Abgastemp. vor Partikelfilter erster Sensor" SWORD Temp_Cels 1 100 -3549.940 3003.560 FORMAT "%8.3" ECU_ADDRESS 0x7F9BEA /end MEASUREMENT
/begin MEASUREMENT PFltCD_tPst "Abgastemperatur hinter dem Partikelfilter" SWORD Temp_Cels 1 100 -3549.940 3003.560 FORMAT "%8.3" ECU_ADDRESS 0x7F9BEC /end MEASUREMENT
/begin MEASUREMENT PFltCD_uRawPresDiff "Spannungsrohwert des Differenzdrucksensors" SWORD Volt 1 100 -160156.4 160151.5 FORMAT "%8.1" ECU_ADDRESS 0x7F9BEE /end MEASUREMENT
/begin MEASUREMENT PFltCD_uRawPresDiffBnk_mp "Meßpunkt zur Anpassung des Eingangs zur Linearisierungskennlinie" SWORD Volt 1 100 -160156.4 160151.5 FORMAT "%8.1" ECU_ADDRESS 0x9FF8CC /end MEASUREMENT
/begin MEASUREMENT PFltCD_uRawTempPre "Spannungsrohwert der Abgastemperatur vor dem Partikelfilter" SWORD Volt 1 100 -160156.4 160151.5 FORMAT "%8.1" ECU_ADDRESS 0x7F9BF0 /end MEASUREMENT
/begin MEASUREMENT PFltCD_uRawTempPst "Rohwert der Abgastemperatur hinter dem Partikelfilter" SWORD Volt 1 100 -160156.4 160151.5 FORMAT "%8.1" ECU_ADDRESS 0x7F9BF2 /end MEASUREMENT
/begin MEASUREMENT PFltCD_uRawTempPstBnk_mp "Meßpunkt zur Anpassung des Eingangs zur Linearisierungskennlinie" SWORD Volt 1 100 -160156.4 160151.5 FORMAT "%8.1" ECU_ADDRESS 0x9FF8CE /end MEASUREMENT
/begin MEASUREMENT PFlt_cpEGOxi_mp "Spezifische Wärmekapazität Abgas im DOC" SWORD SpecificHeat 1 100 -3.276800 3.276700 FORMAT "%8.6" ECU_ADDRESS 0x9FF7E2 /end MEASUREMENT
/begin MEASUREMENT PFlt_cpEG_mp "Spezifische Wärmekapazität Abgas im DPF" SWORD SpecificHeat 1 100 -3.276800 3.276700 FORMAT "%8.6" ECU_ADDRESS 0x9FF7E4 /end MEASUREMENT
/begin MEASUREMENT PFlt_ctRgnLck "Zähler für nicht erfolgreiche Regenerationen [-]" UBYTE OneToOne 1 100 0.00 255.0 FORMAT "%5.1" ECU_ADDRESS 0x7F9519 /end MEASUREMENT
/begin MEASUREMENT PFlt_dCpEG "Wärmekapazitätsstrom durch DPF" SWORD SpecHeatFlow 1 100 -327.6800 327.6700 FORMAT "%8.4" ECU_ADDRESS 0x7F9BF4 /end MEASUREMENT
/begin MEASUREMENT PFlt_dCpEGOxi "Wärmekapazitätsstrom durch DOC" SWORD SpecHeatFlow 1 100 -327.6800 327.6700 FORMAT "%8.4" ECU_ADDRESS 0x7F9BF6 /end MEASUREMENT
/begin MEASUREMENT PFlt_ddvolFlt_mp "Änderung Abgasvolumenstrom" SWORD CubMtrPerHrPerSec 1 100 -3276.800 3276.700 FORMAT "%8.3" ECU_ADDRESS 0x9FF858 /end MEASUREMENT
/begin MEASUREMENT PFlt_dmEG "Abgasmassenstrom [kg/h]" SWORD AirMassPerTime 1 100 -3276.800 3276.700 FORMAT "%8.3" ECU_ADDRESS 0x7F9BF8 /end MEASUREMENT
/begin MEASUREMENT PFlt_dmHCOxiCat_mp "Einspritzmenge HC" SWORD InjMassPerTime 1 100 -327.6800 327.6700 FORMAT "%8.4" ECU_ADDRESS 0x9FF898 /end MEASUREMENT
/begin MEASUREMENT PFlt_dmNO2TotCor_mp "Corrigierter, gesamter NO2 Massenstrom" SLONG dmSoot_mg_p_s 1 100 -21474836.4800 21474836.4700 FORMAT "%13.4" ECU_ADDRESS 0x9FE688 /end MEASUREMENT
/begin MEASUREMENT PFlt_dmNO2Tot_mp "insgesamt zur Verfügung stehender NO2-Massenstrom" SLONG dmSoot_mg_p_s 1 100 -21474836.4800 21474836.4700 FORMAT "%13.4" ECU_ADDRESS 0x9FE68C /end MEASUREMENT
/begin MEASUREMENT PFlt_dmNOxRaw_mp "simulierte NOx-Basisemission" SWORD dmSoot_mg_p_s 1 100 -327.6800 327.6700 FORMAT "%8.4" ECU_ADDRESS 0x9FF812 /end MEASUREMENT
/begin MEASUREMENT PFlt_dmO2Cor_mp "korrigierter O2-Massenstrom" SWORD AirMassPerTime_gps 1 100 -327.6800 327.6700 FORMAT "%8.4" ECU_ADDRESS 0x9FF814 /end MEASUREMENT
/begin MEASUREMENT PFlt_dmO2_mp "Sauerstoffmassendurchsatz im Abgasstrom" SWORD AirMassPerTime_gps 1 100 -327.6800 327.6700 FORMAT "%8.4" ECU_ADDRESS 0x9FF816 /end MEASUREMENT
/begin MEASUREMENT PFlt_dmSotCldStrt_mp "Rußemission während Kaltstart" SLONG SootMassPerSec_fine 1 100 -2147.48364800 2147.48364700 FORMAT "%13.8" ECU_ADDRESS 0x9FE690 /end MEASUREMENT
/begin MEASUREMENT PFlt_dmSotDegThm_mp "Abbaurate der Russmasse durch thermische Regeneration" SLONG SootMassPerSec_fine 1 100 -2147.48364800 2147.48364700 FORMAT "%13.8" ECU_ADDRESS 0x9FE694 /end MEASUREMENT
/begin MEASUREMENT PFlt_dmSotEmClntCorrRgn_mp "Rohrussemissionen nach Korrektur durch Kuehlwassertemperatur bei Warmlauf (low soot - Modus)" SLONG SootMassPerHour 1 100 -21474836.4800 21474836.4700 FORMAT "%13.4" ECU_ADDRESS 0x9FE698 /end MEASUREMENT
/begin MEASUREMENT PFlt_dmSotEmClntCorr_mp "Rohrussemissionen nach Korrektur durch Kuehlwassertemperatur bei Warmlauf" SLONG SootMassPerHour 1 100 -21474836.4800 21474836.4700 FORMAT "%13.4" ECU_ADDRESS 0x9FE69C /end MEASUREMENT
/begin MEASUREMENT PFlt_dmSotEmEngRaw_mp "Rohrussemissionen ohne Kaltstartkorrektur" SLONG SootMassPerSec_fine 1 100 -2147.48364800 2147.48364700 FORMAT "%13.8" ECU_ADDRESS 0x9FE6A0 /end MEASUREMENT
/begin MEASUREMENT PFlt_dmSotEmEng_mp "Rohrussemissionen aus Basiskennfeld" SLONG SootMassPerSec_fine 1 100 -2147.48364800 2147.48364700 FORMAT "%13.8" ECU_ADDRESS 0x9FE6A4 /end MEASUREMENT
/begin MEASUREMENT PFlt_dmSotEmRgn_mp "gesamt russmassenstrom aus motor" SWORD SootMassPerHour 1 100 -327.6800 327.6700 FORMAT "%8.4" ECU_ADDRESS 0x9FF818 /end MEASUREMENT
/begin MEASUREMENT PFlt_dmSotEm_mp "Gesamt Russmassenstrom aus Motor" SWORD SootMassPerHour 1 100 -327.6800 327.6700 FORMAT "%8.4" ECU_ADDRESS 0x9FF81A /end MEASUREMENT
/begin MEASUREMENT PFlt_dmSotNrm_mp "gesamt Russmassenstrom aus Motor (normaler Modus)" SLONG SootMassPerHour 1 100 -21474836.4800 21474836.4700 FORMAT "%13.4" ECU_ADDRESS 0x9FE6A8 /end MEASUREMENT
/begin MEASUREMENT PFlt_dmSotRgn_mp "beladungserhöhender Massenstrom im low soot - mode [g/h]" SLONG SootMassPerHour 1 100 -21474836.4800 21474836.4700 FORMAT "%13.4" ECU_ADDRESS 0x9FE6AC /end MEASUREMENT
/begin MEASUREMENT PFlt_dmSotSimDynLmbdRgn_mp "simulierter Rußmassenstrom aus Lambda [mg/s]" SWORD dmSoot_mg_p_s 1 100 -327.6800 327.6700 FORMAT "%8.4" ECU_ADDRESS 0x9FF81C /end MEASUREMENT
/begin MEASUREMENT PFlt_dmSotSimDynLmbd_mp "simulierter Rußmassenstrom aus Lambda" SWORD dmSoot_mg_p_s 1 100 -327.6800 327.6700 FORMAT "%8.4" ECU_ADDRESS 0x9FF81E /end MEASUREMENT
/begin MEASUREMENT PFlt_dmSotSimDynRgn_mp "Dynamischer Anteil für produzierte Rußmasse = f(dq) (low soot modus)" SWORD dmSoot_mg_p_s 1 100 -327.6800 327.6700 FORMAT "%8.4" ECU_ADDRESS 0x9FF820 /end MEASUREMENT
/begin MEASUREMENT PFlt_dmSotSimDyn_mp "Dynamischer Anteil für produzierte Rußmasse = f(dq)" SWORD dmSoot_mg_p_s 1 100 -327.6800 327.6700 FORMAT "%8.4" ECU_ADDRESS 0x9FF822 /end MEASUREMENT
/begin MEASUREMENT PFlt_dmSotSimRgnNO2Raw_mp "durch NO2-Effekt regenerierter Rußmassenstrom ohne Berücksichtigung der Verzugszeit" SWORD dmSoot_mg_p_s 1 100 -327.6800 327.6700 FORMAT "%8.4" ECU_ADDRESS 0x9FF824 /end MEASUREMENT
/begin MEASUREMENT PFlt_dmSotSimRgnNO2_mp "durch NO2-Effekt regenerierter Rußmassenstrom" SWORD dmSoot_mg_p_s 1 100 -327.6800 327.6700 FORMAT "%8.4" ECU_ADDRESS 0x9FF826 /end MEASUREMENT
/begin MEASUREMENT PFlt_dmSotSimTempEep "Abgelegte Russmasse im EEPROM [g/s]" SLONG SootMassPerSec_fine 1 100 -2147.48364800 2147.48364700 FORMAT "%13.8" ECU_ADDRESS 0x7F9E8C /end MEASUREMENT
/begin MEASUREMENT PFlt_dmSotSimTempInitVal_mp "Russmasse bei Initialisierung des Russmassenintegrators" SLONG SootMassPerSec_fine 1 100 -2147.48364800 2147.48364700 FORMAT "%13.8" ECU_ADDRESS 0x9FE6B0 /end MEASUREMENT
/begin MEASUREMENT PFlt_dmSotSimTemp_mp "Russmassenaenderungsrate als Summe aller Eintraege in den Filter" SLONG SootMassPerSec_fine 1 100 -2147.48364800 2147.48364700 FORMAT "%13.8" ECU_ADDRESS 0x9FE6B4 /end MEASUREMENT
/begin MEASUREMENT PFlt_dpDiffFlt_mp "Änderung Druckdifferenz" SWORD hPaPerSec 1 100 -3276.800 3276.700 FORMAT "%8.3" ECU_ADDRESS 0x9FF85A /end MEASUREMENT
/begin MEASUREMENT PFlt_dpDiffNegDef_mp "Untere Schwelle Änderung Differenzdrucksignal" SWORD hPaPerSec 1 100 -3276.800 3276.700 FORMAT "%8.3" ECU_ADDRESS 0x9FF85C /end MEASUREMENT
/begin MEASUREMENT PFlt_dpDiffPosDef_mp "Obere Schwelle Änderung Differenzdrucksignal" SWORD hPaPerSec 1 100 -3276.800 3276.700 FORMAT "%8.3" ECU_ADDRESS 0x9FF85E /end MEASUREMENT
/begin MEASUREMENT PFlt_dqPoI2Op_mp "DT1 gefilterte Einspritzquantität im Betriebspunkt PoI2" SWORD InjMass 1 100 -327.6800 327.6700 FORMAT "%8.4" ECU_ADDRESS 0x9FF828 /end MEASUREMENT
/begin MEASUREMENT PFlt_drSotFltCorrMax_mp "maximaler Gradient des Russbeladungs-PT1-Filters" SLONG PrcPerTime 1 100 -214748.364800 214748.364700 FORMAT "%13.6" ECU_ADDRESS 0x9FE66C /end MEASUREMENT
/begin MEASUREMENT PFlt_drSotFltCorrMin_mp "minimaler Gradient des Russbeladungs-PT1-Filters" SLONG PrcPerTime 1 100 -214748.364800 214748.364700 FORMAT "%13.6" ECU_ADDRESS 0x9FE670 /end MEASUREMENT
/begin MEASUREMENT PFlt_dvol "berechneter Abgasvolumenstrom im Partikelfilter" SWORD CubMtrPerHr 1 100 -3276.800 3276.700 FORMAT "%8.3" ECU_ADDRESS 0x7F9BFA /end MEASUREMENT
/begin MEASUREMENT PFlt_dvolFlt_mp "gefilterter Abgasvolumenstrom" SWORD CubMtrPerHr 1 100 -3276.800 3276.700 FORMAT "%8.3" ECU_ADDRESS 0x9FF860 /end MEASUREMENT
/begin MEASUREMENT PFlt_facArrhThm_mp "Nicht lineare Zunahme des Russabbrandes ueber Temperatur (Arrhenius Faktor)" SWORD Fact_10m 1 100 -327.6800 327.6700 FORMAT "%8.4" ECU_ADDRESS 0x9FF82A /end MEASUREMENT
/begin MEASUREMENT PFlt_facAshLdLrn "Korrekturfaktor für die Aschebeladung aufgrund der Ascheverteilung" SWORD Fact 1 100 -4.000000 3.999878 FORMAT "%8.6" ECU_ADDRESS 0x7F9BFC /end MEASUREMENT
/begin MEASUREMENT PFlt_facAshMs2Ld_mp "korrekturfaktor für nichtlinear Aschenverteilung[ ]" SWORD Fact 1 100 -4.000000 3.999878 FORMAT "%8.6" ECU_ADDRESS 0x9FF7E6 /end MEASUREMENT
/begin MEASUREMENT PFlt_facCnvCatNO2Cor_mp "Faktor für den Einfluß der Katalysatoralterung auf den NO2 Effekt" SWORD Fact1000 1 100 -32.76800 32.76700 FORMAT "%8.5" ECU_ADDRESS 0x9FF82C /end MEASUREMENT
/begin MEASUREMENT PFlt_facCnvCatNO2_mp "Temperaturabhängigkeitsfaktor von der Umwandlung NO2 zu NO2 bei der Oxidationskatalysator" SWORD Fact 1 100 -4.000000 3.999878 FORMAT "%8.6" ECU_ADDRESS 0x9FF82E /end MEASUREMENT
/begin MEASUREMENT PFlt_facDvolNO2_mp "Korrekturfaktor der NOx/NO2-Umwandlung in Abhängigkeit der Verweildauer des Abgases im Oxidationskatalysator" SWORD Fact 1 100 -4.000000 3.999878 FORMAT "%8.6" ECU_ADDRESS 0x9FF830 /end MEASUREMENT
/begin MEASUREMENT PFlt_facOxiCritDrivCyc_mp "Alter des Oxidationskatalysators im laufenden Fahrzyklus" ULONG Fact1000 1 100 0.00 4294967.29500 FORMAT "%13.5" ECU_ADDRESS 0x9FE6B8 /end MEASUREMENT
/begin MEASUREMENT PFlt_facOxiCritEEPROM_mp "Alter des Oxidationskatalysators gespeichert im EEPROM" ULONG Fact1000 1 100 0.00 4294967.29500 FORMAT "%13.5" ECU_ADDRESS 0x9FE6BC /end MEASUREMENT
/begin MEASUREMENT PFlt_facOxiCrit_mp "Faktor für den Einfluß der Temperatur auf die Oxidationskatalysatoralterung" SWORD OneToOne 1 100 -32768.00 32767.00 FORMAT "%8.2" ECU_ADDRESS 0x9FF832 /end MEASUREMENT
/begin MEASUREMENT PFlt_facReacSpdInHiRes_mp "Faktor fuer Reaktionsgeschwindigkeit vor Korrektur ueber Arrheniusfaktor (HiRes Curve)" SWORD Fact1000 1 100 -32.76800 32.76700 FORMAT "%8.5" ECU_ADDRESS 0x9FF834 /end MEASUREMENT
/begin MEASUREMENT PFlt_facReacSpdInLoRes_mp "Faktor fuer Reaktionsgeschwindigkeit vor Korrektur ueber Arrheniusfaktor (LoRes Curve)" SWORD Fact_0_5 1 100 -65536.00 65534.00 FORMAT "%8.2" ECU_ADDRESS 0x9FF836 /end MEASUREMENT
/begin MEASUREMENT PFlt_facReacSpdIn_mp "Faktor fuer Reaktionsgeschwindigkeit vor Korrektur ueber Arrheniusfaktor" SLONG Fact1000 1 100 -2147483.64800 2147483.64700 FORMAT "%13.5" ECU_ADDRESS 0x9FE6C0 /end MEASUREMENT
/begin MEASUREMENT PFlt_facReacSpdThmO2_mp "Gewichtung fuer Reaktionsumsatz O2 in abbrennbaren Russ" SWORD Fact_100u 1 100 -3.276800 3.276700 FORMAT "%8.6" ECU_ADDRESS 0x9FF838 /end MEASUREMENT
/begin MEASUREMENT PFlt_facSotSimDynInjMsRgn_mp "Simulierter Partikelstromfaktor basierend auf die abgeleitete Einspritzmenge (low soot modus)" SWORD Fact1000 1 100 -32.76800 32.76700 FORMAT "%8.5" ECU_ADDRESS 0x9FF83A /end MEASUREMENT
/begin MEASUREMENT PFlt_facSotSimDynInjMs_mp "Simulierter Partikelstromfaktor basierend auf die abgeleitete Einspritzmenge" SWORD Fact1000 1 100 -32.76800 32.76700 FORMAT "%8.5" ECU_ADDRESS 0x9FF83C /end MEASUREMENT
/begin MEASUREMENT PFlt_facSotSimRgnNO2_mp "Faktor für Beladungsabhängigkeit des NO2-Effektes" SWORD Fact 1 100 -4.000000 3.999878 FORMAT "%8.6" ECU_ADDRESS 0x9FF83E /end MEASUREMENT
/begin MEASUREMENT PFlt_facTempNO2_mp "Faktor für Temperaturabhängigkeit des NO2-Effektes" SWORD Fact 1 100 -4.000000 3.999878 FORMAT "%8.6" ECU_ADDRESS 0x9FF840 /end MEASUREMENT
/begin MEASUREMENT PFlt_lSnceRgn_mp "gefahrene Strecke seit letzter erfolgreicher Regeneration" ULONG Length 1 100 0.00 4294967295.00 FORMAT "%13.2" ECU_ADDRESS 0x7FDE08 /end MEASUREMENT
/begin MEASUREMENT PFlt_lSumMax_mp "gefahrene Strecke Schwelle für Regeneration" ULONG Length 1 100 0.00 4294967295.00 FORMAT "%13.2" ECU_ADDRESS 0x9FE64C /end MEASUREMENT
/begin MEASUREMENT PFlt_lSum_mp "ges. gefahrene Strecke bei der letzten erfolgr. Regeneration" ULONG Length 1 100 0.00 4294967295.00 FORMAT "%13.2" ECU_ADDRESS 0x7FDE0C /end MEASUREMENT
/begin MEASUREMENT PFlt_mAshAdd_mp "Aschebeladung aus aktuellem Fahrzyklus durch Additiv [g]" ULONG mAsh_g 1 100 0.00 655.359999847 FORMAT "%13.9" ECU_ADDRESS 0x9FE674 /end MEASUREMENT
/begin MEASUREMENT PFlt_mAshFl_mp "Aschebeladung aus aktuellem Fahrzyklus durch Treibstoff [g]" ULONG mAsh_g 1 100 0.00 655.359999847 FORMAT "%13.9" ECU_ADDRESS 0x9FE678 /end MEASUREMENT
/begin MEASUREMENT PFlt_mAshTrmTot "Aschebeladung [g]" SWORD mAsh 1 100 -3276.800 3276.700 FORMAT "%8.3" ECU_ADDRESS 0x7F9BFE /end MEASUREMENT
/begin MEASUREMENT PFlt_mAshTrm_mp "Aschebeladung Merkwert im EEPROM [g]" ULONG mAsh_g 1 100 0.00 655.359999847 FORMAT "%13.9" ECU_ADDRESS 0x9FE67C /end MEASUREMENT
/begin MEASUREMENT PFlt_mSotSimPres "Absolute Russmasse im Filter aus Differenzdruckmessung ueber Volumenstrom" SWORD mSoot_g 1 100 -327.6800 327.6700 FORMAT "%8.4" ECU_ADDRESS 0x7F9C00 /end MEASUREMENT
/begin MEASUREMENT PFlt_mSotSimTemp "Absolute Russmasse im Filter aus Russmassenintegration" SWORD mSoot_g 1 100 -327.6800 327.6700 FORMAT "%8.4" ECU_ADDRESS 0x7F9C02 /end MEASUREMENT
/begin MEASUREMENT PFlt_mSotSimTempDfl_mp "Absolute Russmasse im Filter fuer Fehler im Russmassenbeladungsmodell" SWORD mSoot_g 1 100 -327.6800 327.6700 FORMAT "%8.4" ECU_ADDRESS 0x9FF842 /end MEASUREMENT
/begin MEASUREMENT PFlt_mSotSimTempEep "Im EEPROM abgespeicherte absolute Russmasse aus Russmassenintegration [g]" SWORD mSoot_g 1 100 -327.6800 327.6700 FORMAT "%8.4" ECU_ADDRESS 0x7F9C04 /end MEASUREMENT
/begin MEASUREMENT PFlt_mSotSimTempLst_mp "Initialisierungswert fuer Russmassenintegrator bei Regenerationsanforderung ueber Weg, Zeit oder Kraftstoffmenge" SWORD mSoot_g 1 100 -327.6800 327.6700 FORMAT "%8.4" ECU_ADDRESS 0x9FF844 /end MEASUREMENT
/begin MEASUREMENT PFlt_mSotSimTempSpec "Spezifische Russmasse aus Russmassenbeladungsmodell" SWORD Soot_gPerLtr 1 100 -327.6800 327.6700 FORMAT "%8.4" ECU_ADDRESS 0x7F9C06 /end MEASUREMENT
/begin MEASUREMENT PFlt_mSotSimTempTrm_mp "Initialisierungswert fuer simulierte Russmasse bei Testerlogin" SWORD mSoot_g 1 100 -327.6800 327.6700 FORMAT "%8.4" ECU_ADDRESS 0x9FF846 /end MEASUREMENT
/begin MEASUREMENT PFlt_nMin "Leerlaufdrehzahl im Regenerationszustand [rpm]" SWORD EngN 1 100 -32768.00 32767.00 FORMAT "%8.2" ECU_ADDRESS 0x7F9C08 /end MEASUREMENT
/begin MEASUREMENT PFlt_numEngPOp_mp "Regeneationsmaßnahme nach Berücksichtigung des Motorbetriebspunktes" UBYTE OneToOne 1 100 0.00 255.0 FORMAT "%5.1" ECU_ADDRESS 0x7FDE10 /end MEASUREMENT
/begin MEASUREMENT PFlt_numFltEmpEu_mp "Eulerzahl für leeres Filter [-]" SWORD EulerNum 1 100 -3276.800 3276.700 FORMAT "%8.3" ECU_ADDRESS 0x9FF7E8 /end MEASUREMENT
/begin MEASUREMENT PFlt_numFltEmpRe_mp "Reynoldszahl für leeres Filter [-]" SWORD ReynoldsNum 1 100 -3276800. 3276700. FORMAT "%8.0" ECU_ADDRESS 0x9FF7EA /end MEASUREMENT
/begin MEASUREMENT PFlt_numFltFulEu_mp "Eulerzahl für volles Filter" SWORD EulerNum 1 100 -3276.800 3276.700 FORMAT "%8.3" ECU_ADDRESS 0x9FF7EC /end MEASUREMENT
/begin MEASUREMENT PFlt_numFltFulRe_mp "Reynoldszahl für volles Filter [-]" SWORD ReynoldsNum 1 100 -3276800. 3276700. FORMAT "%8.0" ECU_ADDRESS 0x9FF7EE /end MEASUREMENT
/begin MEASUREMENT PFlt_numLst "Regenerationsanforderung aufgrund von gefahrener Strecke, Betriebszeit oder Verbrauch" UBYTE OneToOne 1 100 0.00 255.0 FORMAT "%5.1" ECU_ADDRESS 0x7F951A /end MEASUREMENT
/begin MEASUREMENT PFlt_numLvlRgnDur_mp "Regenerationsanforderung" UBYTE OneToOne 1 100 0.00 255.0 FORMAT "%5.1" ECU_ADDRESS 0x9FFF70 /end MEASUREMENT
/begin MEASUREMENT PFlt_numPrio "Priorität für angeforderten Regenerationszustand" UWORD OneToOne 1 100 0.00 65535.00 FORMAT "%8.2" ECU_ADDRESS 0x7F9C0A /end MEASUREMENT
/begin MEASUREMENT PFlt_numPrt_mp "Regenerationsanforderung aufgrund Motorschutz" UBYTE OneToOne 1 100 0.00 255.0 FORMAT "%5.1" ECU_ADDRESS 0x9FFF71 /end MEASUREMENT
/begin MEASUREMENT PFlt_numRgn "Regenerationsanforderungszahl" UBYTE OneToOne 1 100 0.00 255.0 FORMAT "%5.1" ECU_ADDRESS 0x7F951B /end MEASUREMENT
/begin MEASUREMENT PFlt_numRgn_mpByp_mp "Meßpunkt für Bypass" UBYTE OneToOne 1 100 0.00 255.0 FORMAT "%5.1" ECU_ADDRESS 0x9FFF72 /end MEASUREMENT
/begin MEASUREMENT PFlt_numSot "Partikelfilterstatus" UBYTE OneToOne 1 100 0.00 255.0 FORMAT "%5.1" ECU_ADDRESS 0x7F951C /end MEASUREMENT
/begin MEASUREMENT PFlt_numSotSimPres "Regenerationspriorität abgeleitet aus dem Druckdifferenz-Aschemassenpfad" UBYTE OneToOne 1 100 0.00 255.0 FORMAT "%5.1" ECU_ADDRESS 0x7F951D /end MEASUREMENT
/begin MEASUREMENT PFlt_numSotSimTemp "Regenerationspriorität abgeleitet aus dem simuliertem Aschemassenpfad" UBYTE OneToOne 1 100 0.00 255.0 FORMAT "%5.1" ECU_ADDRESS 0x7F951E /end MEASUREMENT
/begin MEASUREMENT PFlt_pDiff "Differenzdruck über Partikelfilter [kPa]" SWORD Pres_hPa 1 100 -32768.00 32767.00 FORMAT "%8.2" ECU_ADDRESS 0x7F9C0C /end MEASUREMENT
/begin MEASUREMENT PFlt_pDiffCharMonMin_mp "Differenzdruckschwelle für Überwachung der DPF Charakteristik" SWORD Pres_hPa 1 100 -32768.00 32767.00 FORMAT "%8.2" ECU_ADDRESS 0x9FF862 /end MEASUREMENT
/begin MEASUREMENT PFlt_pDiffFlt_mp "gefilterte Druckdifferenz über Partikelfilter" SWORD Pres_hPa 1 100 -32768.00 32767.00 FORMAT "%8.2" ECU_ADDRESS 0x9FF864 /end MEASUREMENT
/begin MEASUREMENT PFlt_pDiffInt "Modulinterner Differenzdruck am Partikelfilter nach Plausibilitätstest" SWORD Pres_hPa 1 100 -32768.00 32767.00 FORMAT "%8.2" ECU_ADDRESS 0x7F9C0E /end MEASUREMENT
/begin MEASUREMENT PFlt_pDiffIntFlt_mp "gefilterte Druckdifferenz" SWORD Pres_hPa 1 100 -32768.00 32767.00 FORMAT "%8.2" ECU_ADDRESS 0x9FF7F0 /end MEASUREMENT
/begin MEASUREMENT PFlt_pDiffMinSty_mp "Minimaler Differenzdruck stationär gemessen" SWORD Pres_hPa 1 100 -32768.00 32767.00 FORMAT "%8.2" ECU_ADDRESS 0x7FDE20 /end MEASUREMENT
/begin MEASUREMENT PFlt_pDiffOfsValActMidRaw_mp "Im Nachlauf gemittelter nicht limitierter Offset des Differenzdruck" SWORD Pres_hPa 1 100 -32768.00 32767.00 FORMAT "%8.2" ECU_ADDRESS 0x9FF866 /end MEASUREMENT
/begin MEASUREMENT PFlt_pDiffOfsValActMid_mp "Im Nachlauf gemittelter offset des Differenzdrucks[hpa]" SWORD Pres_hPa 1 100 -32768.00 32767.00 FORMAT "%8.2" ECU_ADDRESS 0x9FF868 /end MEASUREMENT
/begin MEASUREMENT PFlt_pDiffOfsValAct_mp "Aktueller Offset des Differenzdrucks über Partikelfilter" SWORD Pres_hPa 1 100 -32768.00 32767.00 FORMAT "%8.2" ECU_ADDRESS 0x7FDE22 /end MEASUREMENT
/begin MEASUREMENT PFlt_pDiffOfsValOld_mp "Bisheriger Offset des Differenzdrucks über Partikelfilter" SWORD Pres_hPa 1 100 -32768.00 32767.00 FORMAT "%8.2" ECU_ADDRESS 0x7FDE24 /end MEASUREMENT
/begin MEASUREMENT PFlt_pDiffRaw "Unkorrigierter Differenzdruck über Partikelfilter [hpa]" SWORD Pres_hPa 1 100 -32768.00 32767.00 FORMAT "%8.2" ECU_ADDRESS 0x7F9C10 /end MEASUREMENT
/begin MEASUREMENT PFlt_pEngPrtMax_mp "Maximaldruck Motorschutz" SWORD Pres_hPa 1 100 -32768.00 32767.00 FORMAT "%8.2" ECU_ADDRESS 0x9FF7C0 /end MEASUREMENT
/begin MEASUREMENT PFlt_pEngPrtMin_mp "Minimaldruck Motorschutz" SWORD Pres_hPa 1 100 -32768.00 32767.00 FORMAT "%8.2" ECU_ADDRESS 0x9FF7C2 /end MEASUREMENT
/begin MEASUREMENT PFlt_pMid "Absolutdruck im Partikelfilter" SWORD Pres_hPa 1 100 -32768.00 32767.00 FORMAT "%8.2" ECU_ADDRESS 0x7F9C12 /end MEASUREMENT
/begin MEASUREMENT PFlt_pPre "Druck vor Partikelfilter" SWORD Pres_hPa 1 100 -32768.00 32767.00 FORMAT "%8.2" ECU_ADDRESS 0x7F9C14 /end MEASUREMENT
/begin MEASUREMENT PFlt_pPreInt "Modulinterner Druck vor Partikelfilter nach Plausibilitätstest" SWORD Pres_hPa 1 100 -32768.00 32767.00 FORMAT "%8.2" ECU_ADDRESS 0x7F9C16 /end MEASUREMENT
/begin MEASUREMENT PFlt_pSotDiffEmpFul_mp "Unterschied im Differenzdruck zwischen leerem und vollem Filter [hPa]" SWORD Pres_hPa 1 100 -32768.00 32767.00 FORMAT "%8.2" ECU_ADDRESS 0x9FF7F2 /end MEASUREMENT
/begin MEASUREMENT PFlt_pSotEmp_mp "simulierter Differenzdruck für ein leeres Filter [hPa]" SWORD Pres_hPa 1 100 -32768.00 32767.00 FORMAT "%8.2" ECU_ADDRESS 0x9FF7F4 /end MEASUREMENT
/begin MEASUREMENT PFlt_pSotFul_mp "simulierter Differenzdruck für ein volles Filter [hPa]" SWORD Pres_hPa 1 100 -32768.00 32767.00 FORMAT "%8.2" ECU_ADDRESS 0x9FF7F6 /end MEASUREMENT
/begin MEASUREMENT PFlt_qFl_mp "verbrauchter Treibstoff seit der letzten erfolgreichen Regeneration" SWORD Fl_L 1 100 -327.6800 327.6700 FORMAT "%8.4" ECU_ADDRESS 0x7FDE12 /end MEASUREMENT
/begin MEASUREMENT PFlt_qPoI1DesAct_mp "Einspritzmenge der letzten Nacheinspritzung des aktuellen Zylinders" SWORD InjMass 1 100 -327.6800 327.6700 FORMAT "%8.4" ECU_ADDRESS 0x9FF89A /end MEASUREMENT
/begin MEASUREMENT PFlt_qPoI2NonEff_mp "nicht wirksame Einspritzmenge der PoI2 mg/zycl" SWORD InjMass 1 100 -327.6800 327.6700 FORMAT "%8.4" ECU_ADDRESS 0x9FF89C /end MEASUREMENT
/begin MEASUREMENT PFlt_rAshLdBst_mp "Aschebeladung aus Aschemasse für beste Verteilung" SWORD Prc 1 100 -327.6800 327.6700 FORMAT "%8.4" ECU_ADDRESS 0x9FF7F8 /end MEASUREMENT
/begin MEASUREMENT PFlt_rAshLdDiff_mp "Differenz der Aschebeladungsmodelle" SWORD Prc 1 100 -327.6800 327.6700 FORMAT "%8.4" ECU_ADDRESS 0x9FF7FA /end MEASUREMENT
/begin MEASUREMENT PFlt_rAshLdLrnNew_mp "Neuer gelernter Korrekturwert für die Ascheverteilung" SWORD Prc 1 100 -327.6800 327.6700 FORMAT "%8.4" ECU_ADDRESS 0x9FF7FC /end MEASUREMENT
/begin MEASUREMENT PFlt_rAshLdLrnOld_mp "Gelernter Korrekturwert für die Ascheverteilung aus dem letzten Taskdurchlauf" SWORD Prc 1 100 -327.6800 327.6700 FORMAT "%8.4" ECU_ADDRESS 0x9FF7FE /end MEASUREMENT
/begin MEASUREMENT PFlt_rAshLdLrn_mp "Gelernter korrekturwert für die Ascheverteilung" SWORD Prc 1 100 -327.6800 327.6700 FORMAT "%8.4" ECU_ADDRESS 0x7FDE1C /end MEASUREMENT
/begin MEASUREMENT PFlt_rAshLdTot_mp "Aschebeladung [%]" SWORD Prc 1 100 -327.6800 327.6700 FORMAT "%8.4" ECU_ADDRESS 0x9FF800 /end MEASUREMENT
/begin MEASUREMENT PFlt_rAshLdWrst_mp "Aschebeladung aus Aschemasse für die schlechteste Verteilung" SWORD Prc 1 100 -327.6800 327.6700 FORMAT "%8.4" ECU_ADDRESS 0x9FF802 /end MEASUREMENT
/begin MEASUREMENT PFlt_resFlowFlt "gefilterter Strömungswiderstand" SWORD Res_hPaHrPerCM 1 100 -32.76800 32.76700 FORMAT "%8.5" ECU_ADDRESS 0x7F9C24 /end MEASUREMENT
/begin MEASUREMENT PFlt_resFlowOfs "Strömungswiderstandoffset" SWORD Res_hPaHrPerCM 1 100 -32.76800 32.76700 FORMAT "%8.5" ECU_ADDRESS 0x7F9C26 /end MEASUREMENT
/begin MEASUREMENT PFlt_rLmbd "Lambdawert" SWORD lambda 1 100 -32.76800 32.76700 FORMAT "%8.5" ECU_ADDRESS 0x7F9C18 /end MEASUREMENT
/begin MEASUREMENT PFlt_rLmbdAprx "Lambda berechnet aus q_inj und dm_air" SWORD lambda 1 100 -32.76800 32.76700 FORMAT "%8.5" ECU_ADDRESS 0x7F9C1A /end MEASUREMENT
/begin MEASUREMENT PFlt_rLmbdDegThm_mp "Lambda-Wert mit HCI Berücksichtigung" SWORD lambda 1 100 -32.76800 32.76700 FORMAT "%8.5" ECU_ADDRESS 0x9FF848 /end MEASUREMENT
/begin MEASUREMENT PFlt_rLmbdDynRgn_mp "Dynamische Komponente des Lambda-Wertes [-]" SWORD lambda 1 100 -32.76800 32.76700 FORMAT "%8.5" ECU_ADDRESS 0x9FF84A /end MEASUREMENT
/begin MEASUREMENT PFlt_rLmbdDyn_mp "Dynamische Komponente des Lambda-Wertes" SWORD lambda 1 100 -32.76800 32.76700 FORMAT "%8.5" ECU_ADDRESS 0x9FF84C /end MEASUREMENT
/begin MEASUREMENT PFlt_rO2mass_mp "Verhältnis Sauerstoff zu Gesamtabgas berechnet aus Lambda" SWORD Prc_100u 1 100 -3.276800 3.276700 FORMAT "%8.6" ECU_ADDRESS 0x9FF84E /end MEASUREMENT
/begin MEASUREMENT PFlt_rOutHtg "Ansteurung der Partikelfilterheizung [%]" SWORD Prc 1 100 -327.6800 327.6700 FORMAT "%8.4" ECU_ADDRESS 0x7F9C1C /end MEASUREMENT
/begin MEASUREMENT PFlt_rSotFltCorrOld_mp "korrigierter Russbeladungswert des vorigen Taskzyklus" SWORD Prc 1 100 -327.6800 327.6700 FORMAT "%8.4" ECU_ADDRESS 0x9FF804 /end MEASUREMENT
/begin MEASUREMENT PFlt_rSotFltCorr_mp "Korrigierter  Russbeladungskoefficient(%)" SWORD Prc 1 100 -327.6800 327.6700 FORMAT "%8.4" ECU_ADDRESS 0x9FF806 /end MEASUREMENT
/begin MEASUREMENT PFlt_rSotFltOfs_mp "Gefilterter Russbeladungskoeffizient mit Ascheoffsetkorrektur" SWORD Prc 1 100 -327.6800 327.6700 FORMAT "%8.4" ECU_ADDRESS 0x9FF808 /end MEASUREMENT
/begin MEASUREMENT PFlt_rSotRatFlt_mp "aktuelles Filterbeladungsverhältnis gefiltert" SWORD Prc 1 100 -327.6800 327.6700 FORMAT "%8.4" ECU_ADDRESS 0x7FDE1E /end MEASUREMENT
/begin MEASUREMENT PFlt_rSotRat_mp "aktuelle Filterbeladung [%]" SWORD Prc 1 100 -327.6800 327.6700 FORMAT "%8.4" ECU_ADDRESS 0x9FF80A /end MEASUREMENT
/begin MEASUREMENT PFlt_rSotSimHigh1_mp "oberer Hysteresenschwellwert der Hysterese 1 des PFlt Regenerationsanforderungs-Status" SWORD Prc 1 100 -327.6800 327.6700 FORMAT "%8.4" ECU_ADDRESS 0x9FF7C4 /end MEASUREMENT
/begin MEASUREMENT PFlt_rSotSimHigh2_mp "oberer Hysteresenschwellwert der Hysterese 2 des PFlt Regenerationsanforderungs-Status" SWORD Prc 1 100 -327.6800 327.6700 FORMAT "%8.4" ECU_ADDRESS 0x9FF7C6 /end MEASUREMENT
/begin MEASUREMENT PFlt_rSotSimHigh3_mp "oberer Hysteresenschwellwert der Hysterese 3 des PFlt Regenerationsanforderungs-Status" SWORD Prc 1 100 -327.6800 327.6700 FORMAT "%8.4" ECU_ADDRESS 0x9FF7C8 /end MEASUREMENT
/begin MEASUREMENT PFlt_rSotSimHigh4_mp "oberer Hysteresenschwellwert der Hysterese 4 des PFlt Regenerationsanforderungs-Status" SWORD Prc 1 100 -327.6800 327.6700 FORMAT "%8.4" ECU_ADDRESS 0x9FF7CA /end MEASUREMENT
/begin MEASUREMENT PFlt_rSotSimMax "Resultierender Beladungskoeffizent aus Differenzdruckmessung und Russmassenintegration" SWORD Prc 1 100 -327.6800 327.6700 FORMAT "%8.4" ECU_ADDRESS 0x7F9C1E /end MEASUREMENT
/begin MEASUREMENT PFlt_rSotSimPres "Partikelfilterbeladungskoeffizient aus Differenzdruckmessung über Volumenstrom" SWORD Prc 1 100 -327.6800 327.6700 FORMAT "%8.4" ECU_ADDRESS 0x7F9C20 /end MEASUREMENT
/begin MEASUREMENT PFlt_rSotSimPres1_mp "Partikelfilterbeladungskoeffizient nach Begrenzung [%]" SWORD Prc 1 100 -327.6800 327.6700 FORMAT "%8.4" ECU_ADDRESS 0x9FF80C /end MEASUREMENT
/begin MEASUREMENT PFlt_rSotSimPres2_mp "Partikelfilterbeladungskoeffizient mit Offset [%]" SWORD Prc 1 100 -327.6800 327.6700 FORMAT "%8.4" ECU_ADDRESS 0x9FF80E /end MEASUREMENT
/begin MEASUREMENT PFlt_rSotSimPresByp_mp "Meßpunkt für Bypass" SWORD Prc 1 100 -327.6800 327.6700 FORMAT "%8.4" ECU_ADDRESS 0x9FF810 /end MEASUREMENT
/begin MEASUREMENT PFlt_rSotSimTemp "Partikelfilterbeladungszähler aus Temperaturmessung" SWORD Prc 1 100 -327.6800 327.6700 FORMAT "%8.4" ECU_ADDRESS 0x7F9C22 /end MEASUREMENT
/begin MEASUREMENT PFlt_st "von Partikelfilter angeforderter Regenerationsstatus [-]" ULONG OneToOne 1 100 0.00 4294967295.00 FORMAT "%13.2" ECU_ADDRESS 0x7F9E90 /end MEASUREMENT
/begin MEASUREMENT PFlt_stAddRequAct "bedarfsgesteuerte Additivierung aktiviert" UBYTE OneToOne 1 100 0.00 255.0 FORMAT "%5.1" ECU_ADDRESS 0x7F951F /end MEASUREMENT
/begin MEASUREMENT PFlt_stAftRunDelDem "Nachlaufverzögerung für Partikelfiltermonitor" UBYTE OneToOne 1 100 0.00 255.0 FORMAT "%5.1" ECU_ADDRESS 0x7F9520 /end MEASUREMENT
/begin MEASUREMENT PFlt_stAshLdLrn_mp "Status Aschelernen" UBYTE OneToOne 1 100 0.00 255.0 FORMAT "%5.1" ECU_ADDRESS 0x9FFF82 /end MEASUREMENT
/begin MEASUREMENT PFlt_stAshTrm "Status fuer Aschemasseanpassung ueber externe Kommunikation" UBYTE OneToOne 1 100 0.00 255.0 FORMAT "%5.1" ECU_ADDRESS 0x7F9521 /end MEASUREMENT
/begin MEASUREMENT PFlt_stCldStrt "Kaltstarterkennung" UBYTE OneToOne 1 100 0.00 255.0 FORMAT "%5.1" ECU_ADDRESS 0x7F9522 /end MEASUREMENT
/begin MEASUREMENT PFlt_stCntRes "Statuswort erfolgreiche Regeneration" UBYTE OneToOne 1 100 0.00 255.0 FORMAT "%5.1" ECU_ADDRESS 0x7F9523 /end MEASUREMENT
/begin MEASUREMENT PFlt_stCnt_mp "Statuswort für  Regnerationsanf. nach Kraftstoffverbrauch, Betriebsstunden oder gefahrener Strecke" UBYTE OneToOne 1 100 0.00 255.0 FORMAT "%5.1" ECU_ADDRESS 0x9FFF73 /end MEASUREMENT
/begin MEASUREMENT PFlt_stDisRstLck "Status fuer Ausblenden des Lck Status zum Erkennen einer erfolgreichen Regeneration bei Anforderung ueber Lst Regeneration" UBYTE OneToOne 1 100 0.00 255.0 FORMAT "%5.1" ECU_ADDRESS 0x7F9524 /end MEASUREMENT
/begin MEASUREMENT PFlt_stEngPOp "Motorbetriebspunkt" UBYTE OneToOne 1 100 0.00 255.0 FORMAT "%5.1" ECU_ADDRESS 0x7F9525 /end MEASUREMENT
/begin MEASUREMENT PFlt_stEngPOpByp_mp "Meßpunkt für Bypass" UBYTE OneToOne 1 100 0.00 255.0 FORMAT "%5.1" ECU_ADDRESS 0x9FFF7F /end MEASUREMENT
/begin MEASUREMENT PFlt_stEngPOpCalc_mp "Motorstatus für Partikelfilterregeneration" UBYTE OneToOne 1 100 0.00 255.0 FORMAT "%5.1" ECU_ADDRESS 0x9FFF80 /end MEASUREMENT
/begin MEASUREMENT PFlt_stEngPrtActv "Status Motorschutz aktiv" UBYTE OneToOne 1 100 0.00 255.0 FORMAT "%5.1" ECU_ADDRESS 0x7F9526 /end MEASUREMENT
/begin MEASUREMENT PFlt_stFastIntr "Schnelle Regenerations-Unterbrechung" UBYTE OneToOne 1 100 0.00 255.0 FORMAT "%5.1" ECU_ADDRESS 0x7F9527 /end MEASUREMENT
/begin MEASUREMENT PFlt_stFreezePT1_mp "Bedingungen zum Einfrieren der Rußbeladungsberechnung" UBYTE OneToOne 1 100 0.00 255.0 FORMAT "%5.1" ECU_ADDRESS 0x9FFF83 /end MEASUREMENT
/begin MEASUREMENT PFlt_stHalt "Partikelfilterregeneration Aktiv" UBYTE OneToOne 1 100 0.00 255.0 FORMAT "%5.1" ECU_ADDRESS 0x7F9528 /end MEASUREMENT
/begin MEASUREMENT PFlt_stHtgActv_mp "Bitwort mit Schalterzuständen" UBYTE OneToOne 1 100 0.00 255.0 FORMAT "%5.1" ECU_ADDRESS 0x9FFF81 /end MEASUREMENT
/begin MEASUREMENT PFlt_stInrDes_mp "Zustand des geforderten Drehmomentes für die Regenerations-Unterbrechung" UBYTE OneToOne 1 100 0.00 255.0 FORMAT "%5.1" ECU_ADDRESS 0x9FFF74 /end MEASUREMENT
/begin MEASUREMENT PFlt_stIntr_mp "Statuswort Regeneration unterbrochen" UBYTE OneToOne 1 100 0.00 255.0 FORMAT "%5.1" ECU_ADDRESS 0x9FFF75 /end MEASUREMENT
/begin MEASUREMENT PFlt_stLck "Statusbit Lock Partikelfilterregeneration" UBYTE OneToOne 1 100 0.00 255.0 FORMAT "%5.1" ECU_ADDRESS 0x7F9529 /end MEASUREMENT
/begin MEASUREMENT PFlt_stLckTempPlausTmr_mp "Timerbasierter Verriegelungsstatus Plausibilisierung Temperature" UBYTE OneToOne 1 100 0.00 255.0 FORMAT "%5.1" ECU_ADDRESS 0x9FFF87 /end MEASUREMENT
/begin MEASUREMENT PFlt_stLckTempPlaus_mp "Verriegelungsstatus Plausibilisierung Temperatursensoren" UBYTE OneToOne 1 100 0.00 255.0 FORMAT "%5.1" ECU_ADDRESS 0x9FFF88 /end MEASUREMENT
/begin MEASUREMENT PFlt_stLckTmr_mp "Verriegelung Timer Temperaturplausibilisierung" UBYTE OneToOne 1 100 0.00 255.0 FORMAT "%5.1" ECU_ADDRESS 0x9FFF89 /end MEASUREMENT
/begin MEASUREMENT PFlt_stLoginReq "Regeneration über VAG-Tester aktiv" UBYTE OneToOne 1 100 0.00 255.0 FORMAT "%5.1" ECU_ADDRESS 0x7F952A /end MEASUREMENT
/begin MEASUREMENT PFlt_stLogReqOfsAdapt_mp "Status Tester-Login request für direkte Adaption des Offsetwertes für den Differenzdrucksensor" UBYTE OneToOne 1 100 0.00 255.0 FORMAT "%5.1" ECU_ADDRESS 0x9FFF8A /end MEASUREMENT
/begin MEASUREMENT PFlt_stLrnOfs_mp "Ergebnis der Verknüpfungen der Bedingungen für das Offsetwert lernen" UBYTE OneToOne 1 100 0.00 255.0 FORMAT "%5.1" ECU_ADDRESS 0x9FFF8B /end MEASUREMENT
/begin MEASUREMENT PFlt_stLstActv_mp "Status Lst Regenerationsanforderung (Weg, Zeit, Kraftsoffmenge) aktiv" UBYTE OneToOne 1 100 0.00 255.0 FORMAT "%5.1" ECU_ADDRESS 0x9FFF76 /end MEASUREMENT
/begin MEASUREMENT PFlt_stMonRgnActv_mp "Regeneration aktiv [-]" UBYTE OneToOne 1 100 0.00 255.0 FORMAT "%5.1" ECU_ADDRESS 0x9FFF77 /end MEASUREMENT
/begin MEASUREMENT PFlt_stNO2Actv_mp "Status NO2-Effekt aktiv" UBYTE OneToOne 1 100 0.00 255.0 FORMAT "%5.1" ECU_ADDRESS 0x9FFF84 /end MEASUREMENT
/begin MEASUREMENT PFlt_stPDiffSty_mp "Statusbit Differenzdrucksignal stationär" UBYTE OneToOne 1 100 0.00 255.0 FORMAT "%5.1" ECU_ADDRESS 0x9FFF8C /end MEASUREMENT
/begin MEASUREMENT PFlt_stPresDiffPlaus_mp "Zustand Plausibilisierung Differenzdrucksignal" UBYTE OneToOne 1 100 0.00 255.0 FORMAT "%5.1" ECU_ADDRESS 0x9FFF8D /end MEASUREMENT
/begin MEASUREMENT PFlt_stRelDiaPresSens_mp "Temperaturabhängiger Freigabestatus für die Differenzdrucksensordiagnose" UBYTE OneToOne 1 100 0.00 255.0 FORMAT "%5.1" ECU_ADDRESS 0x9FFF8E /end MEASUREMENT
/begin MEASUREMENT PFlt_stResFlowHi_mp "Obere Schwelle Resflow-SRC überschritten" UBYTE OneToOne 1 100 0.00 255.0 FORMAT "%5.1" ECU_ADDRESS 0x9FFF8F /end MEASUREMENT
/begin MEASUREMENT PFlt_stResFlowLo_mp "Untere Schwelle ResFlow-SRC unterschritten" UBYTE OneToOne 1 100 0.00 255.0 FORMAT "%5.1" ECU_ADDRESS 0x9FFF90 /end MEASUREMENT
/begin MEASUREMENT PFlt_stRgnStg_mp "Maßnahmenbitwort Regeneration" ULONG OneToOne 1 100 0.00 4294967295.00 FORMAT "%13.2" ECU_ADDRESS 0x9FE650 /end MEASUREMENT
/begin MEASUREMENT PFlt_stRgnTStM_mp "Zustand der Zustandsmaschine der Regenerationszeitbegrenzung" UBYTE OneToOne 1 100 0.00 255.0 FORMAT "%5.1" ECU_ADDRESS 0x9FFF78 /end MEASUREMENT
/begin MEASUREMENT PFlt_stRlsPlausTemp "Message für Release Condition der Temperatur Sensorplausibilisierung" UBYTE OneToOne 1 100 0.00 255.0 FORMAT "%5.1" ECU_ADDRESS 0x7F952B /end MEASUREMENT
/begin MEASUREMENT PFlt_stRlsPlausTempPreOxiC "Message für Release Condition der Temperatur Sensorplausibilisierung" UBYTE OneToOne 1 100 0.00 255.0 FORMAT "%5.1" ECU_ADDRESS 0x7F952C /end MEASUREMENT
/begin MEASUREMENT PFlt_stRlsPlausTempPrePFlt "Message für Release Condition der Temperatur Sensorplausibilisierung" UBYTE OneToOne 1 100 0.00 255.0 FORMAT "%5.1" ECU_ADDRESS 0x7F952D /end MEASUREMENT
/begin MEASUREMENT PFlt_stRlsPlausTempPreTrbn "Message für Release Condition der Temperatur Sensorplausibilisierung" UBYTE OneToOne 1 100 0.00 255.0 FORMAT "%5.1" ECU_ADDRESS 0x7F952E /end MEASUREMENT
/begin MEASUREMENT PFlt_stRlsPlausTempPstPFlt "Message für Release Condition der Temperatur Sensorplausibilisierung" UBYTE OneToOne 1 100 0.00 255.0 FORMAT "%5.1" ECU_ADDRESS 0x7F952F /end MEASUREMENT
/begin MEASUREMENT PFlt_stSimOn "Statusbit Simulation aktiv" UBYTE OneToOne 1 100 0.00 255.0 FORMAT "%5.1" ECU_ADDRESS 0x7F9530 /end MEASUREMENT
/begin MEASUREMENT PFlt_stSotMode_mp "Status ""low soot""-Modus bei Beladungssimulation" UBYTE OneToOne 1 100 0.00 255.0 FORMAT "%5.1" ECU_ADDRESS 0x9FFF85 /end MEASUREMENT
/begin MEASUREMENT PFlt_stSotSimDef_mp "Kombinierter Validitätsstatus des Differenzdruckpfades und des Aschemassensimulationspfades" UBYTE OneToOne 1 100 0.00 255.0 FORMAT "%5.1" ECU_ADDRESS 0x9FFF79 /end MEASUREMENT
/begin MEASUREMENT PFlt_stSotSimEmp_mp "Status Partikelfilter leer" UBYTE OneToOne 1 100 0.00 255.0 FORMAT "%5.1" ECU_ADDRESS 0x9FFF7A /end MEASUREMENT
/begin MEASUREMENT PFlt_stSotSimPresOn "Status für Beladungsberechung aus dem Differenzdrucksignal gültig." UBYTE OneToOne 1 100 0.00 255.0 FORMAT "%5.1" ECU_ADDRESS 0x7F9531 /end MEASUREMENT
/begin MEASUREMENT PFlt_stSotSimPresVld "Validitätszustand des rußsimulierten Drucksignals ohne Verzögerung." UBYTE OneToOne 1 100 0.00 255.0 FORMAT "%5.1" ECU_ADDRESS 0x7F9532 /end MEASUREMENT
/begin MEASUREMENT PFlt_stSotSimTempInitCond_mp "Status fuer Initialisierung des Russmassenintegrators" UBYTE OneToOne 1 100 0.00 255.0 FORMAT "%5.1" ECU_ADDRESS 0x9FFF86 /end MEASUREMENT
/begin MEASUREMENT PFlt_stSotSimTempVld "Status fuer Beladungsberechnung aus der Russmassenintegration gueltig" UBYTE OneToOne 1 100 0.00 255.0 FORMAT "%5.1" ECU_ADDRESS 0x7F9533 /end MEASUREMENT
/begin MEASUREMENT PFlt_stSumRgnMaxTmr_mp "Übergangsbedingungen für die akkumulative Regenerationszeitüberwachung" UBYTE OneToOne 1 100 0.00 255.0 FORMAT "%5.1" ECU_ADDRESS 0x9FFF7B /end MEASUREMENT
/begin MEASUREMENT PFlt_stSumTimState_mp "Zustand der akkumulativen Regenerationszeitüberwachung" UBYTE OneToOne 1 100 0.00 255.0 FORMAT "%5.1" ECU_ADDRESS 0x9FFF7C /end MEASUREMENT
/begin MEASUREMENT PFlt_stSysFail "allgemine Systemfehler" UBYTE OneToOne 1 100 0.00 255.0 FORMAT "%5.1" ECU_ADDRESS 0x7F9534 /end MEASUREMENT
/begin MEASUREMENT PFlt_stTempPlausDone_mp "Statusbit Plausibilisierung Temperatursensoren durchgeführt" UBYTE OneToOne 1 100 0.00 255.0 FORMAT "%5.1" ECU_ADDRESS 0x9FFF91 /end MEASUREMENT
/begin MEASUREMENT PFlt_stTstrRgnShOff_mp "Zustand Sperre der Regeneration über Tester-Login" UBYTE OneToOne 1 100 0.00 255.0 FORMAT "%5.1" ECU_ADDRESS 0x9FFF7D /end MEASUREMENT
/begin MEASUREMENT PFlt_stTxtMsg "Status-Text-Message für Partikel Filter" UBYTE OneToOne 1 100 0.00 255.0 FORMAT "%5.1" ECU_ADDRESS 0x7F9535 /end MEASUREMENT
/begin MEASUREMENT PFlt_swtSotSimRst_mp "Umschalter auf Nachlaufsersatzwert für PFlt_rSotSimPresLowx_CUR" UBYTE OneToOne 1 100 0.00 255.0 FORMAT "%5.1" ECU_ADDRESS 0x9FFF7E /end MEASUREMENT
/begin MEASUREMENT PFlt_tAddPoI1_mp "Korrektur der Stationärtemperaturen durch PoI1" SWORD TempDiff_Kelv 1 100 -3276.800 3276.700 FORMAT "%8.3" ECU_ADDRESS 0x9FF89E /end MEASUREMENT
/begin MEASUREMENT PFlt_tAddPoI2_mp "Korrektur der Stationärtemperaturen durch PoI2" SWORD TempDiff_Kelv 1 100 -3276.800 3276.700 FORMAT "%8.3" ECU_ADDRESS 0x9FF8A0 /end MEASUREMENT
/begin MEASUREMENT PFlt_tArrh "Partikelfilteroberflachentemperatur" SWORD Temp_Cels 1 100 -3549.940 3003.560 FORMAT "%8.3" ECU_ADDRESS 0x7F9C28 /end MEASUREMENT
/begin MEASUREMENT PFlt_tDiffCorr_mp "Temperaturabweichung durch instationären Betrieb" SWORD TempDiff_Kelv 1 100 -3276.800 3276.700 FORMAT "%8.3" ECU_ADDRESS 0x9FF8A2 /end MEASUREMENT
/begin MEASUREMENT PFlt_tDiffPlausPreOxiC_mp "Abweichung der simulierten von der aktuellen Temperatur nach dem Oxidationskatalysator" SWORD TempDiff_Kelv 1 100 -3276.800 3276.700 FORMAT "%8.3" ECU_ADDRESS 0x9FF86A /end MEASUREMENT
/begin MEASUREMENT PFlt_tDiffPlausPrePFlt_mp "Temperatursensor des ersten DPF-Abgassensors für die modell-basierte Plausibilitätsprüfung" SWORD TempDiff_Kelv 1 100 -3276.800 3276.700 FORMAT "%8.3" ECU_ADDRESS 0x9FF86C /end MEASUREMENT
/begin MEASUREMENT PFlt_tDiffPlausPreTrbn_mp "Temperatursensor des ersten Turbolader-Abgassensors für die modell-basierte Plausibilitätsprüfung" SWORD TempDiff_Kelv 1 100 -3276.800 3276.700 FORMAT "%8.3" ECU_ADDRESS 0x9FF86E /end MEASUREMENT
/begin MEASUREMENT PFlt_tDiffPlausPstPFlt_mp "Abweichung der simulierten von der aktuellen Temperatur nach dem Partikelfilter" SWORD TempDiff_Kelv 1 100 -3276.800 3276.700 FORMAT "%8.3" ECU_ADDRESS 0x9FF870 /end MEASUREMENT
/begin MEASUREMENT PFlt_tDiffPreOxiCNeg_mp "Maximal erlaubte negative Temperaturabweichung vor OxiCat" SWORD TempDiff_Kelv 1 100 -3276.800 3276.700 FORMAT "%8.3" ECU_ADDRESS 0x9FF872 /end MEASUREMENT
/begin MEASUREMENT PFlt_tDiffPreOxiCPos_mp "Maximal erlaubte positive Temperaturabweichung vor OxiCat" SWORD TempDiff_Kelv 1 100 -3276.800 3276.700 FORMAT "%8.3" ECU_ADDRESS 0x9FF874 /end MEASUREMENT
/begin MEASUREMENT PFlt_tDiffPrePFltNeg_mp "Maximal erlaubte negative Temperaturabweichung vor DPF" SWORD TempDiff_Kelv 1 100 -3276.800 3276.700 FORMAT "%8.3" ECU_ADDRESS 0x9FF876 /end MEASUREMENT
/begin MEASUREMENT PFlt_tDiffPrePFltPos_mp "Maximal erlaubte positive Temperaturabweichung vor DPF" SWORD TempDiff_Kelv 1 100 -3276.800 3276.700 FORMAT "%8.3" ECU_ADDRESS 0x9FF878 /end MEASUREMENT
/begin MEASUREMENT PFlt_tDiffPreTrbnNeg_mp "Maximal erlaubte negative Temperaturabweichung vor Turbine" SWORD TempDiff_Kelv 1 100 -3276.800 3276.700 FORMAT "%8.3" ECU_ADDRESS 0x9FF87A /end MEASUREMENT
/begin MEASUREMENT PFlt_tDiffPreTrbnPos_mp "Maximal erlaubte positive Temperaturabweichung vor Turbine" SWORD TempDiff_Kelv 1 100 -3276.800 3276.700 FORMAT "%8.3" ECU_ADDRESS 0x9FF87C /end MEASUREMENT
/begin MEASUREMENT PFlt_tDiffPstPFltNeg_mp "Maximal erlaubte negative Abweichung der simulierten von der aktuellen Temperatur nach Partikelfilter" SWORD TempDiff_Kelv 1 100 -3276.800 3276.700 FORMAT "%8.3" ECU_ADDRESS 0x9FF87E /end MEASUREMENT
/begin MEASUREMENT PFlt_tDiffPstPFltPos_mp "Maximal erlaubte positve Abweichung der simulierten von der aktuellen Temperatur nach Partikelfilter" SWORD TempDiff_Kelv 1 100 -3276.800 3276.700 FORMAT "%8.3" ECU_ADDRESS 0x9FF880 /end MEASUREMENT
/begin MEASUREMENT PFlt_tDwnStrm_mp "Zweite Abgastemperatur zur Überwachung" SWORD Temp_Cels 1 100 -3549.940 3003.560 FORMAT "%8.3" ECU_ADDRESS 0x9FF882 /end MEASUREMENT
/begin MEASUREMENT PFlt_tEngNorm_mp "Temperaturwert von dem Array Eng_tFld" SWORD Temp_Cels 1 100 -3549.940 3003.560 FORMAT "%8.3" ECU_ADDRESS 0x9FF7D0 /end MEASUREMENT
/begin MEASUREMENT PFlt_tExoIncr_mp "Temperaturhub über Filter bei aktiver externer Nacheinspritzung" SWORD Temp_Cels 1 100 -3549.940 3003.560 FORMAT "%8.3" ECU_ADDRESS 0x9FF8A4 /end MEASUREMENT
/begin MEASUREMENT PFlt_tFlt "Temperatur im Partikelfilter" SWORD Temp_Cels 1 100 -3549.940 3003.560 FORMAT "%8.3" ECU_ADDRESS 0x7F9C2A /end MEASUREMENT
/begin MEASUREMENT PFlt_tFltPreModArrh_mp "DPF Temperatur modelliert mit der Temperatur vor dem DPF" SWORD Temp_Cels 1 100 -3549.940 3003.560 FORMAT "%8.3" ECU_ADDRESS 0x9FF8A6 /end MEASUREMENT
/begin MEASUREMENT PFlt_tFltPreMod_mp "DPF Temperatur modelliert mit der Temperatur vor dem DPF" SWORD Temp_Cels 1 100 -3549.940 3003.560 FORMAT "%8.3" ECU_ADDRESS 0x9FF8A8 /end MEASUREMENT
/begin MEASUREMENT PFlt_tFltPstModArrh_mp "DPF Temperatur modelliert mit der Temperatur nach dem DPF" SWORD Temp_Cels 1 100 -3549.940 3003.560 FORMAT "%8.3" ECU_ADDRESS 0x9FF8AA /end MEASUREMENT
/begin MEASUREMENT PFlt_tFltPstMod_mp "DPF Temperatur modelliert mit der Temperatur nach dem DPF" SWORD Temp_Cels 1 100 -3549.940 3003.560 FORMAT "%8.3" ECU_ADDRESS 0x9FF8AC /end MEASUREMENT
/begin MEASUREMENT PFlt_tHtTransCor_mp "Temperaturkorrekturwert Wärmeübergang" SWORD TempDiff_Kelv 1 100 -3276.800 3276.700 FORMAT "%8.3" ECU_ADDRESS 0x9FF8AE /end MEASUREMENT
/begin MEASUREMENT PFlt_tIATLoLvl_mp "niedrigster Wert der Ansauglufttemperatur" SWORD Temp_Cels 1 100 -3549.940 3003.560 FORMAT "%8.3" ECU_ADDRESS 0x9FF884 /end MEASUREMENT
/begin MEASUREMENT PFlt_tiEngOff "Motorstillstandszeit" UWORD Time_min_One2One 1 100 0.00 65535.00 FORMAT "%8.2" ECU_ADDRESS 0x7F9C48 /end MEASUREMENT
/begin MEASUREMENT PFlt_tiEngOff_mp "Motorstillstandszeit" UWORD Time_min_One2One 1 100 0.00 65535.00 FORMAT "%8.2" ECU_ADDRESS 0x9FF886 /end MEASUREMENT
/begin MEASUREMENT PFlt_tiEngOnAct_mp "Motorlaufzeit im aktuellen DC" SLONG TimeEngOn 1 100 -2147483648.00 2147483647.00 FORMAT "%13.2" ECU_ADDRESS 0x9FE6C4 /end MEASUREMENT
/begin MEASUREMENT PFlt_tiEngOnInit_mp "gesamte Motorlaufzeit ohne aktuellem DC" SLONG TimeEngOn 1 100 -2147483648.00 2147483647.00 FORMAT "%13.2" ECU_ADDRESS 0x9FE6C8 /end MEASUREMENT
/begin MEASUREMENT PFlt_tiEnvDefMaxTmr_mp "Entprelltimer für den permanenten PFlt-Sensorfehler" SLONG TimeEngSpdFlt_s 1 100 -214748364.800 214748364.700 FORMAT "%13.3" ECU_ADDRESS 0x9FE680 /end MEASUREMENT
/begin MEASUREMENT PFlt_tiExhGsDel_mp "Verzögerungszeit Abgas" SWORD Time_s 1 100 -327.6800 327.6700 FORMAT "%8.4" ECU_ADDRESS 0x9FF8B0 /end MEASUREMENT
/begin MEASUREMENT PFlt_tiFltSimRgn5PT1_mp "Zeitkonstante des PT1-Gliedes bei der Betriebszustandsberechnung Stufe 5" ULONG TimeOneToOne 1 100 0.00 4294967295.00 FORMAT "%13.2" ECU_ADDRESS 0x9FE664 /end MEASUREMENT
/begin MEASUREMENT PFlt_tiFltSimRgn7PT1_mp "Zeitkonstante des PT1-Gliedes bei der Betriebszustandsberechnung Stufe 7" ULONG TimeOneToOne 1 100 0.00 4294967295.00 FORMAT "%13.2" ECU_ADDRESS 0x9FE668 /end MEASUREMENT
/begin MEASUREMENT PFlt_tiHtTransDT1_mp "Wärmeübergangszeit" SWORD Time_s 1 100 -327.6800 327.6700 FORMAT "%8.4" ECU_ADDRESS 0x9FF8B2 /end MEASUREMENT
/begin MEASUREMENT PFlt_tiLckChkTempPlaus_mp "Aktuelle Verriegelungszeit Temperatursensorplausibilisierung nach kurzem Motorlauf" UWORD Time_s 1 100 0.00 655.3500 FORMAT "%8.4" ECU_ADDRESS 0x9FF888 /end MEASUREMENT
/begin MEASUREMENT PFlt_tiNO2RgnDel_mp "Verzugszeit des Beginns der NO2-Regeneration" SWORD Time_s 1 100 -327.6800 327.6700 FORMAT "%8.4" ECU_ADDRESS 0x9FF850 /end MEASUREMENT
/begin MEASUREMENT PFlt_tiOp_mp "Motorbetriebszeit bei der letzten erfolgr. Regeneration" ULONG TimeEngOn 1 100 0.00 4294967295.00 FORMAT "%13.2" ECU_ADDRESS 0x7FDE14 /end MEASUREMENT
/begin MEASUREMENT PFlt_tiReacSpd_mp "Verweilzeit des Abgasstroms im Filter" SWORD Time_s_100us 1 100 -3.276800 3.276700 FORMAT "%8.6" ECU_ADDRESS 0x9FF852 /end MEASUREMENT
/begin MEASUREMENT PFlt_tiRgnLckMaxTmr_mp "Timer für Messung der Sperrungzeit [s]" ULONG Time_s 1 100 0.00 42949672.9500 FORMAT "%13.4" ECU_ADDRESS 0x9FE654 /end MEASUREMENT
/begin MEASUREMENT PFlt_tiRgnLckMax_mp "Maximaldauer der Regeneration Sperrung [s]" ULONG Time_s 1 100 0.00 42949672.9500 FORMAT "%13.4" ECU_ADDRESS 0x9FE658 /end MEASUREMENT
/begin MEASUREMENT PFlt_tiRgnMaxTmr_mp "Verbesserter Timer für die Regenerationszeitüberwachung" ULONG Time_s 1 100 0.00 42949672.9500 FORMAT "%13.4" ECU_ADDRESS 0x9FE65C /end MEASUREMENT
/begin MEASUREMENT PFlt_tiRgnMax_mp "Wert für die maximale Regenerierungsdauer" ULONG Time_s 1 100 0.00 42949672.9500 FORMAT "%13.4" ECU_ADDRESS 0x9FE660 /end MEASUREMENT
/begin MEASUREMENT PFlt_tiSnceRgn_mp "Motorbetriebszeit seit der letzten erfolgreichen Regeneration" ULONG TimeEngOn 1 100 0.00 4294967295.00 FORMAT "%13.2" ECU_ADDRESS 0x7FDE18 /end MEASUREMENT
/begin MEASUREMENT PFlt_tiSumRgnMaxTmr "Akkumulative Regenerationszeit" ULONG Time_s 1 100 0.00 42949672.9500 FORMAT "%13.4" ECU_ADDRESS 0x7F9E94 /end MEASUREMENT
/begin MEASUREMENT PFlt_tiSumRgnMaxTmr_mp "Akkumulative Regenerationszeit (Auflösung 5s)" SWORD Time_5s 1 100 -163840.0 163835.0 FORMAT "%8.1" ECU_ADDRESS 0x9FF7CC /end MEASUREMENT
/begin MEASUREMENT PFlt_tiThresPFltNorm_mp "Schwellwert für Zeit seit Erreichen Zustand NORMAL" SWORD Time_ms 1 100 -327680.0 327670.0 FORMAT "%8.1" ECU_ADDRESS 0x9FF7D2 /end MEASUREMENT
/begin MEASUREMENT PFlt_tiTstrRgnShOff_mp "Abgelaufene Regenerationssperrzeit seit Sperre über Tester-Login" SWORD Time_5s 1 100 -163840.0 163835.0 FORMAT "%8.1" ECU_ADDRESS 0x9FF7CE /end MEASUREMENT
/begin MEASUREMENT PFlt_tiVelVeh_mp "Abgelaufene Zeit seit Überschreiten der Fahrzeuggeschwindigkeitsschwelle" UWORD TimeDeb 1 100 0.00 655350.0 FORMAT "%8.1" ECU_ADDRESS 0x9FF7D4 /end MEASUREMENT
/begin MEASUREMENT PFlt_tOxiCat_mp "OxidationskatalysatorTemperatur" SWORD Temp_Cels 1 100 -3549.940 3003.560 FORMAT "%8.3" ECU_ADDRESS 0x9FF7D6 /end MEASUREMENT
/begin MEASUREMENT PFlt_tOxiExoIncr_mp "Exotherme Erhöhung der Oxidationskatalysatortemperatur" SWORD TempDiff_Kelv 1 100 -3276.800 3276.700 FORMAT "%8.3" ECU_ADDRESS 0x9FF8B4 /end MEASUREMENT
/begin MEASUREMENT PFlt_tOxiPre "Temperatur vor Oxidationskatalysator" SWORD Temp_Cels 1 100 -3549.940 3003.560 FORMAT "%8.3" ECU_ADDRESS 0x7F9C2C /end MEASUREMENT
/begin MEASUREMENT PFlt_tOxiPreDeb "PT1 gefilterte Temperatur vor DOC" SWORD Temp_Cels 1 100 -3549.940 3003.560 FORMAT "%8.3" ECU_ADDRESS 0x7F9C2E /end MEASUREMENT
/begin MEASUREMENT PFlt_tOxiPreMod_mp "Oxikat Oberflächentemperatur modelliert mit der Temperatur vor dem Oxikat" SWORD Temp_Cels 1 100 -3549.940 3003.560 FORMAT "%8.3" ECU_ADDRESS 0x9FF8B6 /end MEASUREMENT
/begin MEASUREMENT PFlt_tOxiPreSim "Simulierte Temperatur vor Oxidationskatalysator" SWORD Temp_Cels 1 100 -3549.940 3003.560 FORMAT "%8.3" ECU_ADDRESS 0x7F9C30 /end MEASUREMENT
/begin MEASUREMENT PFlt_tOxiPreSty "Stationäre Temperatur vor Oxidationskatalysator" SWORD Temp_Cels 1 100 -3549.940 3003.560 FORMAT "%8.3" ECU_ADDRESS 0x7F9C32 /end MEASUREMENT
/begin MEASUREMENT PFlt_tOxiPreSum_mp "Summe der Temperatur vor Oxidationskatalysator und exo-therme" SWORD Temp_Cels 1 100 -3549.940 3003.560 FORMAT "%8.3" ECU_ADDRESS 0x9FF8B8 /end MEASUREMENT
/begin MEASUREMENT PFlt_tOxiPreUnCorr_mp "Unkorrigierte Temperatur vor Oxidationskatalysator" SWORD Temp_Cels 1 100 -3549.940 3003.560 FORMAT "%8.3" ECU_ADDRESS 0x9FF890 /end MEASUREMENT
/begin MEASUREMENT PFlt_tOxiPst "Temperatur nach dem Oxidations Katalysator [°C]" SWORD Temp_Cels 1 100 -3549.940 3003.560 FORMAT "%8.3" ECU_ADDRESS 0x7F9C34 /end MEASUREMENT
/begin MEASUREMENT PFlt_tOxiPstMod_mp "Oxikat Oberflächentemperatur modelliert mit der Temperatur nach dem Oxikat" SWORD Temp_Cels 1 100 -3549.940 3003.560 FORMAT "%8.3" ECU_ADDRESS 0x9FF8BA /end MEASUREMENT
/begin MEASUREMENT PFlt_tOxiPstSim "Simulierte Temperatur nach Oxidationskatalysator" SWORD Temp_Cels 1 100 -3549.940 3003.560 FORMAT "%8.3" ECU_ADDRESS 0x7F9C36 /end MEASUREMENT
/begin MEASUREMENT PFlt_tOxiPstUnCorr_mp "Unkorrigierte Temperatur nach Oxidationskatalysator" SWORD Temp_Cels 1 100 -3549.940 3003.560 FORMAT "%8.3" ECU_ADDRESS 0x9FF892 /end MEASUREMENT
/begin MEASUREMENT PFlt_tOxiSurf "Oberflächentemperatur des DPF-OxiKat" SWORD Temp_Cels 1 100 -3549.940 3003.560 FORMAT "%8.3" ECU_ADDRESS 0x7F9C38 /end MEASUREMENT
/begin MEASUREMENT PFlt_tPFltMon_mp "Motortemperatur aus Kennfeld" SWORD Temp_Cels 1 100 -3549.940 3003.560 FORMAT "%8.3" ECU_ADDRESS 0x9FF88A /end MEASUREMENT
/begin MEASUREMENT PFlt_tPOpCalc_mp "Temperaturwert von dem Array Eng_tFld" SWORD Temp_Cels 1 100 -3549.940 3003.560 FORMAT "%8.3" ECU_ADDRESS 0x9FF7D8 /end MEASUREMENT
/begin MEASUREMENT PFlt_tPre "Abgastemp. vor Partikelfilter" SWORD Temp_Cels 1 100 -3549.940 3003.560 FORMAT "%8.3" ECU_ADDRESS 0x7F9C3A /end MEASUREMENT
/begin MEASUREMENT PFlt_tPreCorr_mp "Korrigiertes Temperatursignal vor Partikelfilter" SWORD Temp_Cels 1 100 -3549.940 3003.560 FORMAT "%8.3" ECU_ADDRESS 0x9FF8BC /end MEASUREMENT
/begin MEASUREMENT PFlt_tPreDeb "PT1 gefilterte Temperatur vor DPF" SWORD Temp_Cels 1 100 -3549.940 3003.560 FORMAT "%8.3" ECU_ADDRESS 0x7F9C3C /end MEASUREMENT
/begin MEASUREMENT PFlt_tPreInt_mp "Modulinterne Temperatur vor Partikelfilter nach Plausibilitätstest" SWORD Temp_Cels 1 100 -3549.940 3003.560 FORMAT "%8.3" ECU_ADDRESS 0x9FF8BE /end MEASUREMENT
/begin MEASUREMENT PFlt_tPreSim "Simulierte Temperatur vor Partikelfilter" SWORD Temp_Cels 1 100 -3549.940 3003.560 FORMAT "%8.3" ECU_ADDRESS 0x7F9C3E /end MEASUREMENT
/begin MEASUREMENT PFlt_tPreSty "Stationäre Temperatur vor Partikelfilter" SWORD Temp_Cels 1 100 -3549.940 3003.560 FORMAT "%8.3" ECU_ADDRESS 0x7F9C40 /end MEASUREMENT
/begin MEASUREMENT PFlt_tPreSumArrh_mp "Summe der Temperatur vor und dem durch die externe Nacheinspritzung verursachten Temperaturhub" SWORD Temp_Cels 1 100 -3549.940 3003.560 FORMAT "%8.3" ECU_ADDRESS 0x9FF8C0 /end MEASUREMENT
/begin MEASUREMENT PFlt_tPreSum_mp "Summe der Temperatur vor und dem durch die externe Nacheinspritzung verursachten Temperaturhub" SWORD Temp_Cels 1 100 -3549.940 3003.560 FORMAT "%8.3" ECU_ADDRESS 0x9FF8C2 /end MEASUREMENT
/begin MEASUREMENT PFlt_tPreUnCorr_mp "Unkorrigierte Temperatur vor Partikelfilter" SWORD Temp_Cels 1 100 -3549.940 3003.560 FORMAT "%8.3" ECU_ADDRESS 0x9FF894 /end MEASUREMENT
/begin MEASUREMENT PFlt_tPst "Abgastemperatur nach Partikel" SWORD Temp_Cels 1 100 -3549.940 3003.560 FORMAT "%8.3" ECU_ADDRESS 0x7F9C42 /end MEASUREMENT
/begin MEASUREMENT PFlt_tPstSim "Simulierte Temperatur nach Partikelfilter" SWORD Temp_Cels 1 100 -3549.940 3003.560 FORMAT "%8.3" ECU_ADDRESS 0x7F9C44 /end MEASUREMENT
/begin MEASUREMENT PFlt_tPstSimRgn5_mp "Modellierter Abgastemperaturwert bei der Betriebszustandsberechnung Stufe 5" SWORD Temp_Cels 1 100 -3549.940 3003.560 FORMAT "%8.3" ECU_ADDRESS 0x9FF7DA /end MEASUREMENT
/begin MEASUREMENT PFlt_tPstSimRgn7_mp "Modellierter Abgastemperaturwert bei der Betriebszustandsberechnung Stufe 7" SWORD Temp_Cels 1 100 -3549.940 3003.560 FORMAT "%8.3" ECU_ADDRESS 0x9FF7DC /end MEASUREMENT
/begin MEASUREMENT PFlt_tPstSim_mp "Simulierte Temperatur nach Partikelfilter" SWORD Temp_Cels 1 100 -3549.940 3003.560 FORMAT "%8.3" ECU_ADDRESS 0x9FF8C4 /end MEASUREMENT
/begin MEASUREMENT PFlt_tPstUnCorr_mp "Unkorrigierte Temperatur nach Partikelfilter" SWORD Temp_Cels 1 100 -3549.940 3003.560 FORMAT "%8.3" ECU_ADDRESS 0x9FF896 /end MEASUREMENT
/begin MEASUREMENT PFlt_tReac_mp "Differenz zu Abbrandtemperatur für thermischen Abbrand im Filter" SWORD Temp_Kelv 1 100 -3276.800 3276.700 FORMAT "%8.3" ECU_ADDRESS 0x9FF854 /end MEASUREMENT
/begin MEASUREMENT PFlt_tSimPreOxiC_mp "Simulierte Temperatur des ersten Oxidationskatalysator-Abgassensors" SWORD Temp_Cels 1 100 -3549.940 3003.560 FORMAT "%8.3" ECU_ADDRESS 0x9FF88C /end MEASUREMENT
/begin MEASUREMENT PFlt_tSimPrePFlt_mp "Simulierte Temperatur des ersten Partikelfilter-Abgassensors" SWORD Temp_Cels 1 100 -3549.940 3003.560 FORMAT "%8.3" ECU_ADDRESS 0x7FDE26 /end MEASUREMENT
/begin MEASUREMENT PFlt_tSimPreTrbn_mp "Simulierte Temperatur des ersten Turbolader-Abgassensors" SWORD Temp_Cels 1 100 -3549.940 3003.560 FORMAT "%8.3" ECU_ADDRESS 0x7FDE28 /end MEASUREMENT
/begin MEASUREMENT PFlt_tSimPstPFlt_mp "Temperatur nach Partikelfilter aus dem simulierten Abgas-Temperaturarray" SWORD Temp_Cels 1 100 -3549.940 3003.560 FORMAT "%8.3" ECU_ADDRESS 0x7FDE2A /end MEASUREMENT
/begin MEASUREMENT PFlt_tSurf "Oberflächen Temperatur vom Partikel Filter" SWORD Temp_Cels 1 100 -3549.940 3003.560 FORMAT "%8.3" ECU_ADDRESS 0x7F9C46 /end MEASUREMENT
/begin MEASUREMENT PFlt_tSurfSim_mp "modellierte Partikelfilteroberflächentemperatur" SWORD Temp_Cels 1 100 -3549.940 3003.560 FORMAT "%8.3" ECU_ADDRESS 0x9FF8C6 /end MEASUREMENT
/begin MEASUREMENT PFlt_tThresPFltPre3_mp "Schwellwert 3 für Temperatur im Filter" SWORD Temp_Cels 1 100 -3549.940 3003.560 FORMAT "%8.3" ECU_ADDRESS 0x9FF7DE /end MEASUREMENT
/begin MEASUREMENT PFlt_tThresPFltPre4_mp "Schwellwert 4 für Temperatur im Filter" SWORD Temp_Cels 1 100 -3549.940 3003.560 FORMAT "%8.3" ECU_ADDRESS 0x9FF7E0 /end MEASUREMENT
/begin MEASUREMENT PFlt_tTotCor_mp "Additiver Temperaturkorrekturwert" SWORD TempDiff_Kelv 1 100 -3276.800 3276.700 FORMAT "%8.3" ECU_ADDRESS 0x9FF8C8 /end MEASUREMENT
/begin MEASUREMENT PFlt_tUpStrm_mp "Erste Abgastemperatur zur Überwachung" SWORD Temp_Cels 1 100 -3549.940 3003.560 FORMAT "%8.3" ECU_ADDRESS 0x9FF88E /end MEASUREMENT
/begin MEASUREMENT PFlt_volAdd_mp "Additivmenge aus aktuellem Fahrzyklus [ml]" SLONG volAdd_ml_fine 1 100 -2147483.64800 2147483.64700 FORMAT "%13.5" ECU_ADDRESS 0x9FE684 /end MEASUREMENT
/begin MEASUREMENT PFlt_volFltActv_mp "Nutzbares, nicht durch Asche belegtes Filtervolumen" SWORD AshVol 1 100 -32.76800 32.76700 FORMAT "%8.5" ECU_ADDRESS 0x9FF856 /end MEASUREMENT
/begin MEASUREMENT PrpBrk_trqDes "Vortriebsmomentwunsch der Längsbewegung" SLONG TrqPrpHigh 1 100 -214748364.800 214748364.700 FORMAT "%13.3" ECU_ADDRESS 0x7F9E98 /end MEASUREMENT
/begin MEASUREMENT PrpBrk_trqDesInr "Fahrerwunschmotormoment" SWORD Trq 1 100 -3276.800 3276.700 FORMAT "%8.3" ECU_ADDRESS 0x7F9C4A /end MEASUREMENT
/begin MEASUREMENT PrpBrk_trqLead "Vorhaltmoment der Längsbewegung" SLONG TrqPrpHigh 1 100 -214748364.800 214748364.700 FORMAT "%13.3" ECU_ADDRESS 0x7F9E9C /end MEASUREMENT
/begin MEASUREMENT PrpCtl_aDemSpdLim "Die hochgeschwindigkeitsbegrenzte Beschleunigung" SWORD Acc 1 100 -32.76800 32.76700 FORMAT "%8.5" ECU_ADDRESS 0x7F9C4C /end MEASUREMENT
/begin MEASUREMENT PrpCtl_facGovInit_mp "Messpunkt für den Faktor, um den der Reglerinitlialisierungswert für den I-Anteil zu reduzieren ist" SWORD Fact 1 100 -4.000000 3.999878 FORMAT "%8.6" ECU_ADDRESS 0x9FF8E4 /end MEASUREMENT
/begin MEASUREMENT PrpCtl_MaxSpdLimEEP1_mp "Limitierter EEPROM Abgleichwert1 von MAXSPEED" SWORD Vel 1 100 -327.6800 327.6700 FORMAT "%8.4" ECU_ADDRESS 0x9FF8E6 /end MEASUREMENT
/begin MEASUREMENT PrpCtl_MaxSpdLimEEP2_mp "Limitierter EEPROM Abgleichwert2 von MAXSPEED" SWORD Vel 1 100 -327.6800 327.6700 FORMAT "%8.4" ECU_ADDRESS 0x9FF8E8 /end MEASUREMENT
/begin MEASUREMENT PrpCtl_MaxSpdLimEEPByp_mp "Bypass für PrpCtl_MaxSpdLimEEP" SWORD Vel 1 100 -327.6800 327.6700 FORMAT "%8.4" ECU_ADDRESS 0x9FF8EA /end MEASUREMENT
/begin MEASUREMENT PrpCtl_MaxSpdLimEEP_mp "Limitierter EEPROM Abgleichwert von MAXSPEED" SWORD Vel 1 100 -327.6800 327.6700 FORMAT "%8.4" ECU_ADDRESS 0x9FF8EC /end MEASUREMENT
/begin MEASUREMENT PrpCtl_stAPPFFSet_mp "Zustand FlipFlop für Fahrpedalstellung" UBYTE OneToOne 1 100 0.00 255.0 FORMAT "%5.1" ECU_ADDRESS 0x9FFF97 /end MEASUREMENT
/begin MEASUREMENT PrpCtl_stAWDFFRes_mp "Zustand FlipFlop (Reset-Eingang) für Aktivierung HGB über Allrad1" UBYTE OneToOne 1 100 0.00 255.0 FORMAT "%5.1" ECU_ADDRESS 0x9FFF98 /end MEASUREMENT
/begin MEASUREMENT PrpCtl_stAWDFFSet_mp "Zustand FlipFlop (Set-Eingang) für Aktivierung HGB über Allrad1" UBYTE OneToOne 1 100 0.00 255.0 FORMAT "%5.1" ECU_ADDRESS 0x9FFF99 /end MEASUREMENT
/begin MEASUREMENT PrpCtl_stAWDFid_mp "Meßpunkt für CAN-Fehler der Botschaft AWD1 oder fehlerhafte Fahrgeschwindigkeit" UBYTE OneToOne 1 100 0.00 255.0 FORMAT "%5.1" ECU_ADDRESS 0x9FFF9A /end MEASUREMENT
/begin MEASUREMENT PrpCtl_stMaxActvAWD "Status Höchstgeschwindigkeitsbegrenzung über Allrad1" UBYTE OneToOne 1 100 0.00 255.0 FORMAT "%5.1" ECU_ADDRESS 0x7F9537 /end MEASUREMENT
/begin MEASUREMENT PrpCtl_stMaxActvNiveau "Status Höchstgeschwindigkeitsbegrenzung über Niveau1" UBYTE OneToOne 1 100 0.00 255.0 FORMAT "%5.1" ECU_ADDRESS 0x7F9538 /end MEASUREMENT
/begin MEASUREMENT PrpCtl_stNiveauFFRes_mp "Zustand FlipFlop (Reset-Eingang) für Aktivierung HGB über Niveau1" UBYTE OneToOne 1 100 0.00 255.0 FORMAT "%5.1" ECU_ADDRESS 0x9FFF9B /end MEASUREMENT
/begin MEASUREMENT PrpCtl_stNiveauFFSet_mp "Zustand FlipFlop (Set-Eingang) für Aktivierung HGB über Niveau1" UBYTE OneToOne 1 100 0.00 255.0 FORMAT "%5.1" ECU_ADDRESS 0x9FFF9C /end MEASUREMENT
/begin MEASUREMENT PrpCtl_stNoAPPLim_mp "Status Fahrpedalbegrenzung inaktiv" UBYTE OneToOne 1 100 0.00 255.0 FORMAT "%5.1" ECU_ADDRESS 0x9FFF9D /end MEASUREMENT
/begin MEASUREMENT PrpCtl_stSPTrackByp_mp "Bypass für PrpCtl_stSPTrack" SBYTE OneToOne 1 100 -128.0 127.0 FORMAT "%5.1" ECU_ADDRESS 0x9FFF9E /end MEASUREMENT
/begin MEASUREMENT PrpCtl_stSPTrack_mp "Messpunkt Status Sollwertnachführung" UBYTE OneToOne 1 100 0.00 255.0 FORMAT "%5.1" ECU_ADDRESS 0x7FDE2C /end MEASUREMENT
/begin MEASUREMENT PrpCtl_sttrqLim "Status Zustand Momentenbegrenzung" UBYTE OneToOne 1 100 0.00 255.0 FORMAT "%5.1" ECU_ADDRESS 0x7F9539 /end MEASUREMENT
/begin MEASUREMENT PrpCtl_trqGovInit_mp "Messpunkt des Reglerinitlialisierungswerts für den I-Anteil" SLONG TrqPrpHigh 1 100 -214748364.800 214748364.700 FORMAT "%13.3" ECU_ADDRESS 0x9FE6CC /end MEASUREMENT
/begin MEASUREMENT PrpCtl_trqGovLimByp_mp "Bypass für PrpCtl_trqGovLim" SLONG TrqPrpHigh 1 100 -214748364.800 214748364.700 FORMAT "%13.3" ECU_ADDRESS 0x9FE6D0 /end MEASUREMENT
/begin MEASUREMENT PrpCtl_trqGovLim_mp "Maximale Begrenzungmoment für dem Reglers" SLONG TrqPrpHigh 1 100 -214748364.800 214748364.700 FORMAT "%13.3" ECU_ADDRESS 0x9FE6D4 /end MEASUREMENT
/begin MEASUREMENT PrpCtl_trqIOld_mp "Meßpunkt I-Anteil (alt) des Reglers" SLONG TrqPrpHigh 1 100 -214748364.800 214748364.700 FORMAT "%13.3" ECU_ADDRESS 0x9FE6D8 /end MEASUREMENT
/begin MEASUREMENT PrpCtl_trqI_mp "Status I-Anteil" SLONG TrqPrpHigh 1 100 -214748364.800 214748364.700 FORMAT "%13.3" ECU_ADDRESS 0x9FE6DC /end MEASUREMENT
/begin MEASUREMENT PrpCtl_trqPOld_mp "Meßpunkt I-Anteil (alt) des Reglers" SLONG TrqPrpHigh 1 100 -214748364.800 214748364.700 FORMAT "%13.3" ECU_ADDRESS 0x9FE6E0 /end MEASUREMENT
/begin MEASUREMENT PrpCtl_trqP_mp "Status PI-Anteil" SLONG TrqPrpHigh 1 100 -214748364.800 214748364.700 FORMAT "%13.3" ECU_ADDRESS 0x9FE6E4 /end MEASUREMENT
/begin MEASUREMENT PrpCtl_trqSpdLim "begrenztes Moment für Höchstgeschwindigkeitsbegrenzung" SLONG TrqPrpHigh 1 100 -214748364.800 214748364.700 FORMAT "%13.3" ECU_ADDRESS 0x7F9EA0 /end MEASUREMENT
/begin MEASUREMENT PrpCtl_trqSpdLimByp_mp "Bypass für PrpCtl_trqSpdLim" SLONG TrqPrpHigh 1 100 -214748364.800 214748364.700 FORMAT "%13.3" ECU_ADDRESS 0x9FE6E8 /end MEASUREMENT
/begin MEASUREMENT PrpCtl_vCurrTrackByp_mp "Bypass für PrpCtl_vCurrTrack" SWORD Vel 1 100 -327.6800 327.6700 FORMAT "%8.4" ECU_ADDRESS 0x9FE6EC /end MEASUREMENT
/begin MEASUREMENT PrpCtl_vCurrTrack_mp "Messpunkt des nachgeführten Geschwindigkeitssollwertes" SWORD Vel 1 100 -327.6800 327.6700 FORMAT "%8.4" ECU_ADDRESS 0x7FDE2E /end MEASUREMENT
/begin MEASUREMENT PrpCtl_vMaxAWD "Höchstgeschwindigkeit durch Allrad1" SWORD Vel 1 100 -327.6800 327.6700 FORMAT "%8.4" ECU_ADDRESS 0x7F9C4E /end MEASUREMENT
/begin MEASUREMENT PrpCtl_vMaxAWDByp_mp "Bypass für PrpCtl_vMaxAWD" SWORD Vel 1 100 -327.6800 327.6700 FORMAT "%8.4" ECU_ADDRESS 0x9FF8EE /end MEASUREMENT
/begin MEASUREMENT PrpCtl_vMaxNiveau "Höchstgeschwindigkeit durch Niveau1" SWORD Vel 1 100 -327.6800 327.6700 FORMAT "%8.4" ECU_ADDRESS 0x7F9C50 /end MEASUREMENT
/begin MEASUREMENT PrpCtl_vMaxNiveauByp_mp "Bypass für PrpCtl_vMaxNiveau" SWORD Vel 1 100 -327.6800 327.6700 FORMAT "%8.4" ECU_ADDRESS 0x9FF8F0 /end MEASUREMENT
/begin MEASUREMENT Prp_factIpol_mp "" SWORD FactLow 1 100 -32.00000 31.99902 FORMAT "%8.5" ECU_ADDRESS 0x9FF8D0 /end MEASUREMENT
/begin MEASUREMENT Prp_rAPP "verknüpfte Fahrpedalstellung PWG und virtuelles PWG" SWORD Prc 1 100 -327.6800 327.6700 FORMAT "%8.4" ECU_ADDRESS 0x7F9C52 /end MEASUREMENT
/begin MEASUREMENT Prp_rAPPByp_mp "Meßpunkt für Bypass" SWORD Prc 1 100 -327.6800 327.6700 FORMAT "%8.4" ECU_ADDRESS 0x9FF8D2 /end MEASUREMENT
/begin MEASUREMENT Prp_rtrqEng_mp "relative Motorauslastung bezogen auf Prp_trqLimNoSmkMax_mp" SWORD Prc 1 100 -327.6800 327.6700 FORMAT "%8.4" ECU_ADDRESS 0x9FF8D4 /end MEASUREMENT
/begin MEASUREMENT Prp_rTrqLimIpol "" SWORD Prc 1 100 -327.6800 327.6700 FORMAT "%8.4" ECU_ADDRESS 0x7F9C54 /end MEASUREMENT
/begin MEASUREMENT Prp_rTrqLim_mp "Anteil der unbegrenzten CrCtl_Forderung" SWORD Prc 1 100 -327.6800 327.6700 FORMAT "%8.4" ECU_ADDRESS 0x9FF8D6 /end MEASUREMENT
/begin MEASUREMENT Prp_rVirtAPP "virtuelle Fahrpedalstellung bei FGR oder HGB" SWORD Prc 1 100 -327.6800 327.6700 FORMAT "%8.4" ECU_ADDRESS 0x7F9C56 /end MEASUREMENT
/begin MEASUREMENT Prp_rVirtAPPByp_mp "Meßpunkt für Bypass" SWORD Prc 1 100 -327.6800 327.6700 FORMAT "%8.4" ECU_ADDRESS 0x9FF8D8 /end MEASUREMENT
/begin MEASUREMENT Prp_rVirtEngPrp_mp "Virtuelle Fahrpedalstellung aus inversem Fahrverhaltenkennfeld" SWORD Prc 1 100 -327.6800 327.6700 FORMAT "%8.4" ECU_ADDRESS 0x9FF8DA /end MEASUREMENT
/begin MEASUREMENT Prp_rVirtOvrRun_mp "Virtuelle Fahrpedalstellung aus der inversen Schubkennlinie" SWORD Prc 1 100 -327.6800 327.6700 FORMAT "%8.4" ECU_ADDRESS 0x9FF8DC /end MEASUREMENT
/begin COMPU_METHOD Acc "Fahrzeugbeschleunigung" RAT_FUNC "%6.5" "[m/s^2]" COEFFS 0 1000 0 0 0 1 /end COMPU_METHOD
/begin COMPU_METHOD AirMassPerTime "Luftmasse pro Zeit" RAT_FUNC "%6.3" "[Kg/h Luft]" COEFFS 0 10 0 0 0 1 /end COMPU_METHOD
/begin COMPU_METHOD AirmassPerTime_float "Umrechnungsformel für Luftmasse pro Zeit" RAT_FUNC "%6.2" "[kg/h]" COEFFS 0 1 0 0 0 1 /end COMPU_METHOD
/begin COMPU_METHOD AirMassPerTime_gps "Luftmasse pro Zeit [g/s], Aufloesung 0.01" RAT_FUNC "%6.4" "[g/s Luft]" COEFFS 0 100 0 0 0 1 /end COMPU_METHOD
/begin COMPU_METHOD AirMass_2 "Luftmasse (geringere Auflösung)" RAT_FUNC "%6.3" "[g]" COEFFS 0 10 0 0 0 1 /end COMPU_METHOD
/begin COMPU_METHOD AngleCrS "Winkel Kurbelwelle" RAT_FUNC "%6.4" "[deg CrS]" COEFFS 0 42.6666666666667 0 0 0 1 /end COMPU_METHOD
/begin COMPU_METHOD AshVol "Aschevolumen [l], Auflösung 0.001" RAT_FUNC "%6.5" "[l]" COEFFS 0 1000 0 0 0 1 /end COMPU_METHOD
/begin COMPU_METHOD CubMtrPerHr "Volumsstrom in m^3/h" RAT_FUNC "%6.3" "[m^3/h]" COEFFS 0 10 0 0 0 1 /end COMPU_METHOD
/begin COMPU_METHOD CubMtrPerHrPerSec "Volumenstromdifferenz pro Sekunde" RAT_FUNC "%6.3" "[m^3/h/s]" COEFFS 0 10 0 0 0 1 /end COMPU_METHOD
/begin COMPU_METHOD dEngSpd_s "Einspritzmengenanstieg/s" RAT_FUNC "%6.2" "[rpm/s]" COEFFS 0 1 0 0 0 1 /end COMPU_METHOD
/begin COMPU_METHOD dInjQnt_s "Einspritzmengenanstieg/s" RAT_FUNC "%6.2" "[(mg/stroke)/s]" COEFFS 0 1 0 0 0 1 /end COMPU_METHOD
/begin COMPU_METHOD dmSoot_mg_p_s "differenzielle Rußmasse mg/s" RAT_FUNC "%6.4" "mg/s" COEFFS 0 100 0 0 0 1 /end COMPU_METHOD
/begin COMPU_METHOD DtyCyc "Tastverhaeltnis" RAT_FUNC "%6.4" "[%]" COEFFS 0 100 0 0 0 1 /end COMPU_METHOD
/begin COMPU_METHOD EngN "Motordrehzahl" RAT_FUNC "%6.2" "[rpm]" COEFFS 0 1 0 0 0 1 /end COMPU_METHOD
/begin COMPU_METHOD EulerNum "Euler number" RAT_FUNC "%6.3" "[-]" COEFFS 0 10 0 0 0 1 /end COMPU_METHOD
/begin COMPU_METHOD Fact "Faktor mit Auflösung 1 / 8192, hauptsächlich für einen Faktorenbereich 0...1 verwendet" RAT_FUNC "%6.5" "[-]" COEFFS 0 8192 0 0 0 1 /end COMPU_METHOD
/begin COMPU_METHOD Fact1000 "Faktor mit einer Auflösung von 0.001" RAT_FUNC "%6.5" "-" COEFFS 0 1000 0 0 0 1 /end COMPU_METHOD
/begin COMPU_METHOD FactLow "Faktor mit Auflösung 1/1024, hauptsächlich für einen Faktorenbereich 1...50 verwendet" RAT_FUNC "%6.5" "[-]" COEFFS 0 1024 0 0 0 1 /end COMPU_METHOD
/begin COMPU_METHOD Fact_0_5 "Faktor mit Auflösung 2" RAT_FUNC "%6.2" "[-]" COEFFS 0 0.5 0 0 0 1 /end COMPU_METHOD
/begin COMPU_METHOD Fact_100u "Faktor mit Auflösung 0.0001" RAT_FUNC "%7.6" "[-]" COEFFS 0 10000 0 0 0 1 /end COMPU_METHOD
/begin COMPU_METHOD Fact_10m "Faktor mit Auflösung 0.01" RAT_FUNC "%6.4" "[-]" COEFFS 0 100 0 0 0 1 /end COMPU_METHOD
/begin COMPU_METHOD Fl_L "Treibstoffmenge [l]" RAT_FUNC "%6.4" "[l]" COEFFS 0 100 0 0 0 1 /end COMPU_METHOD
/begin COMPU_METHOD hPaPerSec "Differenzdruck pro Sekunde" RAT_FUNC "%6.3" "[hPa/s]" COEFFS 0 10 0 0 0 1 /end COMPU_METHOD
/begin COMPU_METHOD InjMass "Einspritzmenge" RAT_FUNC "%6.4" "[mg/hub]" COEFFS 0 100 0 0 0 1 /end COMPU_METHOD
/begin COMPU_METHOD InjMassInj "Einspritzmenge pro Einspritzung (mg/Einspritzung)" RAT_FUNC "%6.4" "[mg/inj]" COEFFS 0 100 0 0 0 1 /end COMPU_METHOD
/begin COMPU_METHOD InjMassPerTime "Kraftstoffmassenstrom" RAT_FUNC "%6.4" "[kg/h]" COEFFS 0 100 0 0 0 1 /end COMPU_METHOD
/begin COMPU_METHOD InjTime_us "Zeit in Microsekunden für das Einspritztiming" RAT_FUNC "%6.2" "[us]" COEFFS 0 1 0 0 0 1 /end COMPU_METHOD
/begin COMPU_METHOD KD_RPM2NM_3 "Verstärkungsfaktor zur Anpassung von 16 Bit an 32 Bit Werte (mit KD_RPM2NM_2_NRM+1 schieben)" RAT_FUNC "%7.6" "[Nm/(rpm*s)]" COEFFS 0 20480 0 0 0 1 /end COMPU_METHOD
/begin COMPU_METHOD KI_RPM2NM_2 "Verstärkungsfaktor zur Anpassung von 16 Bit an 32 Bit Werte (mit KI_RPM2NM_2_NRM schieben)" RAT_FUNC "%6.5" "[Nm/rpm]" COEFFS 0 2684.35456 0 0 0 1 /end COMPU_METHOD
/begin COMPU_METHOD KP_RPM2NM_2 "Verstärkungsfaktor zur Anpassung von 16 Bit an 32 Bit Werte (mit KP_RPM2NM_2_NRM schieben)" RAT_FUNC "%7.6" "[Nm/rpm]" COEFFS 0 20480 0 0 0 1 /end COMPU_METHOD
/begin COMPU_METHOD lambda "Lambda" RAT_FUNC "%6.5" "[-]" COEFFS 0 1000 0 0 0 1 /end COMPU_METHOD
/begin COMPU_METHOD lambdaRecVal "Reziproker Lambda Wert" RAT_FUNC "%6.5" "[-]" COEFFS 0 1000 0 0 0 1 /end COMPU_METHOD
/begin COMPU_METHOD Length "Länge in Meter" RAT_FUNC "%6.2" "[m]" COEFFS 0 1 0 0 0 1 /end COMPU_METHOD
/begin COMPU_METHOD Map_Select "Umsetzungsfaktor von Kennfeldern fuer vierdimensionale Raeume" RAT_FUNC "%6.4" "[-]" COEFFS 0 256 0 0 0 1 /end COMPU_METHOD
/begin COMPU_METHOD mAsh "Umrechnung für Aschemasse in niedrigere Auflösung (s32 auf s16)" RAT_FUNC "%6.3" "[g]" COEFFS 0 10 0 0 0 1 /end COMPU_METHOD
/begin COMPU_METHOD mAsh_g "Asche Masse" RAT_FUNC "%9.8" "[g]" COEFFS 0 6553600 0 0 0 1 /end COMPU_METHOD
/begin COMPU_METHOD mSoot_g "Rußmasse [g]" RAT_FUNC "%6.4" "g" COEFFS 0 100 0 0 0 1 /end COMPU_METHOD
/begin COMPU_METHOD O2 "Sauerstoffkonzentration" RAT_FUNC "%8.7" "[-]" COEFFS 0 100000 0 0 0 1 /end COMPU_METHOD
/begin COMPU_METHOD OneToOne "eins zu eins (physikalischer Wert ist gleich dem internen Wert)" RAT_FUNC "%6.2" "[-]" COEFFS 0 1 0 0 0 1 /end COMPU_METHOD
/begin COMPU_METHOD Prc "Prozent, gleiche interne Auflösung wie Fact, aber Darstellung in Prozent (0...100%)" RAT_FUNC "%6.4" "[%]" COEFFS 0 100 0 0 0 1 /end COMPU_METHOD
/begin COMPU_METHOD PrcPerTime "Rampengradient für PT1-Filter" RAT_FUNC "%7.6" "[%/s]" COEFFS 0 10000 0 0 0 1 /end COMPU_METHOD
/begin COMPU_METHOD Prc_100u "Prozent mit Aufloesung 0.0001" RAT_FUNC "%7.6" "[%]" COEFFS 0 10000 0 0 0 1 /end COMPU_METHOD
/begin COMPU_METHOD Pres_hPa "Druck (angezeigt in [hPa])" RAT_FUNC "%6.2" "[hPa]" COEFFS 0 1 0 0 0 1 /end COMPU_METHOD
/begin COMPU_METHOD Pres_hPaPerSec_20ms "Druck pro Sekunde [hPa/s]" RAT_FUNC "%6.1" "[hPa/s]" COEFFS 0 0.02 0 0 0 1 /end COMPU_METHOD
/begin COMPU_METHOD Pres_hPa_float "Druck (angezeigt in [hPa])" RAT_FUNC "%6.2" "[hPa]" COEFFS 0 1 0 0 0 1 /end COMPU_METHOD
/begin COMPU_METHOD Resist "Widerstand" RAT_FUNC "%6.3" "[Ohm]" COEFFS 0 10 0 0 0 1 /end COMPU_METHOD
/begin COMPU_METHOD Res_hPaHrPerCM "Strömungswiderstand [hPa h/m3]" RAT_FUNC "%6.5" "[hPa/(m^3/h)]" COEFFS 0 1000 0 0 0 1 /end COMPU_METHOD
/begin COMPU_METHOD ReynoldsNum "Reynolds Nummer um den thermischen Koeffizienten zu bestimmen" RAT_FUNC "%6.0" "[-]" COEFFS 0 0.01 0 0 0 1 /end COMPU_METHOD
/begin COMPU_METHOD RmpEngNLow "Motordrehzahl Rampensteigung" RAT_FUNC "%6.2" "[rpm/s]" COEFFS 0 1 0 0 0 1 /end COMPU_METHOD
/begin COMPU_METHOD RmpInjMassLow "Einspritzmenge Rampensteigung" RAT_FUNC "%6.3" "[(mg/stroke)/s]" COEFFS 0 10 0 0 0 1 /end COMPU_METHOD
/begin COMPU_METHOD RmpPres_hPaLow "Druck Rampensteigung" RAT_FUNC "%6.3" "[hPa/s]" COEFFS 0 10 0 0 0 1 /end COMPU_METHOD
/begin COMPU_METHOD Rmp_1 "Rampe für EGT" RAT_FUNC "%6.5" "1/s" COEFFS 0 1000 0 0 0 1 /end COMPU_METHOD
/begin COMPU_METHOD SootMassPerHour "Russmasse pro Stunde [g/h], Aufloesung 0.01" RAT_FUNC "%6.4" "[g/h soot]" COEFFS 0 100 0 0 0 1 /end COMPU_METHOD
/begin COMPU_METHOD SootMassPerSec_fine "Russmasse pro Sekunde [g/s], Aufloesung 0.000001" RAT_FUNC "%9.8" "[g/s soot]" COEFFS 0 1000000 0 0 0 1 /end COMPU_METHOD
/begin COMPU_METHOD Soot_gPerLtr "Partikelmasse pro Filtervolumen" RAT_FUNC "%6.4" "g/l" COEFFS 0 100 0 0 0 1 /end COMPU_METHOD
/begin COMPU_METHOD Soot_gPerLtr_fine "relative Russmasse [g/l], Aufloesung 0.0001" RAT_FUNC "%7.6" "g/l" COEFFS 0 10000 0 0 0 1 /end COMPU_METHOD
/begin COMPU_METHOD SpecHeatFlow "Spezifische Wärmekapazität" RAT_FUNC "%6.4" "[J/s/K]" COEFFS 0 100 0 0 0 1 /end COMPU_METHOD
/begin COMPU_METHOD SpecificHeat "spezifische Waermekapazitaet einer Substanz" RAT_FUNC "%7.6" "[J/g/K]" COEFFS 0 10000 0 0 0 1 /end COMPU_METHOD
/begin COMPU_METHOD stroke_pml "hübe pro Volumen [1/ml]" RAT_FUNC "%6.3" "[1/ml]" COEFFS 0 10 0 0 0 1 /end COMPU_METHOD
/begin COMPU_METHOD TempDiff_Kelv "Offsettemperatur dargestellt in [K]" RAT_FUNC "%6.3" "[ deg C ]" COEFFS 0 10 0 0 0 1 /end COMPU_METHOD
/begin COMPU_METHOD Temp_Cels "Temperatur dargestellt in °C (gleiche interne Darstellung wie Temp_Kelv)" RAT_FUNC "%6.1" "[deg C]" COEFFS 0 10 2731.4 0 0 1 /end COMPU_METHOD
/begin COMPU_METHOD Temp_Fahr "Temperatur dargestellt in Fahrenheit (gleiche interne Darstellung wie Temp_Kelv)" RAT_FUNC "%6.1" "[deg F]" COEFFS 0 5.55555555555556 2553.62222222222 0 0 1 /end COMPU_METHOD
/begin COMPU_METHOD Temp_Kelv "Temperatur dargestellt in Kelvin" RAT_FUNC "%6.3" "[ deg C ]" COEFFS 0 10 0 0 0 1 /end COMPU_METHOD
/begin COMPU_METHOD TimeADCFilt "Zeit, spezielle Aufloesung für ADCFilt" RAT_FUNC "%6.4" "[ms]" COEFFS 0 256.016385048643 0 0 0 1 /end COMPU_METHOD
/begin COMPU_METHOD TimeDeb "Entprellzeit in Millisekunden für Libraryfunktion Debounce" RAT_FUNC "%6.1" "[ms]" COEFFS 0 0.1 0 0 0 1 /end COMPU_METHOD
/begin COMPU_METHOD TimeDelay_s "Zeitkonstante T1 (in s) für PT1, DT1, etc." RAT_FUNC "%9.3" "[s]" COEFFS 0 0 1 0 0.00023283064365387 0 /end COMPU_METHOD
/begin COMPU_METHOD TimeDelay_s_1 "Zeitkonstante T1 (in s) für PT1, DT1, etc. normiert auf 16 bit" RAT_FUNC "%9.6" "[s]" COEFFS 0 0 1 0 0.95367431640625 0 /end COMPU_METHOD
/begin COMPU_METHOD TimeDelay_s_Lin_16 "Zeitkonstante T1 (in s) für PT1, DT1, etc. für SINT16, kein Kehrwert" RAT_FUNC "%6.5" "s" COEFFS 0 6553.4 0 0 0 1 /end COMPU_METHOD
/begin COMPU_METHOD TimeDelay_s_Lin_16_3 "Zeitkonstante T1 (in s) für PT1, DT1, etc. für SINT16, kein Kehrwert" RAT_FUNC "%6.4" "s" COEFFS 0 131.068 0 0 0 1 /end COMPU_METHOD
/begin COMPU_METHOD TimeDT_ms "sample time (DT) des Tasks ,verwendet fuer Regler, Filter etc. ... angezeigt in [ms]" RAT_FUNC "%6.5" "[ms]" COEFFS 0 1000 0 0 0 1 /end COMPU_METHOD
/begin COMPU_METHOD TimeEngOn "Motorbetriebszeit in Sekunden" RAT_FUNC "%6.2" "[s]" COEFFS 0 1 0 0 0 1 /end COMPU_METHOD
/begin COMPU_METHOD TimeEngSpdFlt_s "Umrechnungsregel für Zeit in Sekunden für Zeitkonstanten der PT1-Drehzahlfilter" RAT_FUNC "%6.3" "[s]" COEFFS 0 10 0 0 0 1 /end COMPU_METHOD
/begin COMPU_METHOD TimeOneToOne "Zeit  für PT1-Filter in PFlt_EngPOp calculation, gezeigt in s" RAT_FUNC "%6.2" "[s]" COEFFS 0 1 0 0 0 1 /end COMPU_METHOD
/begin COMPU_METHOD Time_4us "Umrechnung mit einer Auflösung von 4 micro Sekunden" RAT_FUNC "%6.4" "ms" COEFFS 0 250 0 0 0 1 /end COMPU_METHOD
/begin COMPU_METHOD Time_5s "Zeit für PFlt Regenerationskurven [s]" RAT_FUNC "%6.2" "[s]" COEFFS 0 0.2 0 0 0 1 /end COMPU_METHOD
/begin COMPU_METHOD Time_BIPDvt_High "Hochauflösende Zeit für gefilterte BIP-Zeit-Erwartungswertabweichung" RAT_FUNC "%6.3" "[us]" COEFFS 0 10 0 0 0 1 /end COMPU_METHOD
/begin COMPU_METHOD Time_DynTst "Zeitumrechung für dynamischen test mit geringerer Auflösung, damit es für KL Ausgang passt" RAT_FUNC "%6.2" "[s]" COEFFS 0 0.390625 0 0 0 1 /end COMPU_METHOD
/begin COMPU_METHOD Time_min_One2One "Zeit in Minuten (mit One2One Umrechnung)" RAT_FUNC "%6.2" "m" COEFFS 0 1 0 0 0 1 /end COMPU_METHOD
/begin COMPU_METHOD Time_ms "Zeit in ms für Fehlerentprellung (DSM) und SW-Timer" RAT_FUNC "%6.1" "[ms]" COEFFS 0 0.1 0 0 0 1 /end COMPU_METHOD
/begin COMPU_METHOD Time_ms_40ms "Aktuelle Zaehler in 40 ms Takt" RAT_FUNC "%6.1" "ms" COEFFS 0 0.025 0 0 0 1 /end COMPU_METHOD
/begin COMPU_METHOD Time_s "Zeit in s für Fehlerentprellung (DSM) und SW-Timer" RAT_FUNC "%6.4" "[s]" COEFFS 0 100 0 0 0 1 /end COMPU_METHOD
/begin COMPU_METHOD Time_s_100us "Zeit mit Aufloesung 0.0001 s" RAT_FUNC "%7.6" "[s]" COEFFS 0 10000 0 0 0 1 /end COMPU_METHOD
/begin COMPU_METHOD TransR "Übersetzungsverhältnis (Getriebe etc.)" RAT_FUNC "%6.4" "[-]" COEFFS 0 100 0 0 0 1 /end COMPU_METHOD
/begin COMPU_METHOD TrbChN_float "Turboladerdrehzahl für Fliesspunktvariable" RAT_FUNC "%6.2" "[rpm]" COEFFS 0 1 0 0 0 1 /end COMPU_METHOD
/begin COMPU_METHOD Trq "Motormoment" RAT_FUNC "%6.3" "[Nm]" COEFFS 0 10 0 0 0 1 /end COMPU_METHOD
/begin COMPU_METHOD TrqPrpHigh "vortriebsmoment" RAT_FUNC "%6.3" "[Nm]" COEFFS 0 10 0 0 0 1 /end COMPU_METHOD
/begin COMPU_METHOD TurboN "Turboladerdrehzahl" RAT_FUNC "%6.1" "[rpm]" COEFFS 0 1 0 0 0 10 /end COMPU_METHOD
/begin COMPU_METHOD Vel "Fahrzeuggeschwindigkeit, gleiche interne Auflösung wie Vel_SI" RAT_FUNC "%6.4" "[km/h]" COEFFS 0 100 0 0 0 1 /end COMPU_METHOD
/begin COMPU_METHOD volAdd_ml_fine "feinere Auflösung des Additivvolumen [ml]" RAT_FUNC "%6.5" "[ml]" COEFFS 0 1000 0 0 0 1 /end COMPU_METHOD
/begin COMPU_METHOD Volt "Spannung in V (von ADC)" RAT_FUNC "%6.2" "[mV]" COEFFS 0 0.2046 0 0 0 1 /end COMPU_METHOD
/begin COMPU_METHOD Volt_Batt "Batteriespannung" RAT_FUNC "%6.1" "[mV]" COEFFS 0 0.0492252911173131 0 0 0 1 /end COMPU_METHOD
/end MODULE
/end PROJECT
