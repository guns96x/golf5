ASAP2_VERSION 1 3
/begin PROJECT X447 "EDC16U34"
/begin HEADER "" VERSION "VAA1" PROJECT_NO X447 /end HEADER
/begin MODULE DIM ""
/begin MOD_COMMON "" BYTE_ORDER MSB_FIRST ALIGNMENT_BYTE 1 ALIGNMENT_WORD 2 ALIGNMENT_LONG 4 ALIGNMENT_FLOAT32_IEEE 4 /end MOD_COMMON
/begin CHARACTERISTIC ACCCD_dtrqSlpNeg_C "Negative Rampensteigung zur Berechnung des aktuellen" VALUE 0x1C2700 Kw_Wu32 6553599.99847 RmpTrqPrpHigh 0.00 6553599.99847 FORMAT "%13.5" /end CHARACTERISTIC
/begin CHARACTERISTIC ACCCD_stBrkActMsk_C "Maskenwert FrmMng_stBrkAct" VALUE 0x1C2450 Kw_Wu8 255.0 OneToOne 0.00 255.0 FORMAT "%5.1" /end CHARACTERISTIC
/begin CHARACTERISTIC ACCCD_tiEPBOn_C "Entprellzeit für EPB-ON" VALUE 0x1C21E4 Kw_Wu16 0.00 TimeDeb 0.00 0.00 FORMAT "%8.2" EXTENDED_LIMITS 0.00 655350.0 /end CHARACTERISTIC
/begin CHARACTERISTIC ACCCD_tiEPBShOff_C "Entprellzeit für EPB-Abschaltung" VALUE 0x1C21E6 Kw_Wu16 655350.0 TimeDeb 0.00 655350.0 FORMAT "%8.1" /end CHARACTERISTIC
/begin CHARACTERISTIC EATSCD_DebCanDefDef_C "Fehlerentprellung  Umgebungstemperatursensor defekt über CAN" VALUE 0x1D25F2 Kw_Wu16 655350.0 Time_ms 0.00 655350.0 FORMAT "%8.1" /end CHARACTERISTIC
/begin CHARACTERISTIC OvRMon_aDecMax_CUR "Beschleunigungskurve für ACCa Überwachung" CURVE 0x1C1E2C Kl_Xs16_Ws16 20.00000 Acc -10.00000 10.00000 FORMAT "%8.5" EXTENDED_LIMITS -32.76800 32.76700
 /begin AXIS_DESCR STD_AXIS VSSCD_v Vel 9 0.00 300.0000 FORMAT "%8.4" EXTENDED_LIMITS -327.6800 327.6700 DEPOSIT ABSOLUTE /end AXIS_DESCR
/end CHARACTERISTIC
/begin CHARACTERISTIC OvRMon_aDecOff_C "Offset für Beschleunigungsvergleich" VALUE 0x1C1E52 Kw_Ws16 20.00000 Acc -10.00000 10.00000 FORMAT "%8.5" EXTENDED_LIMITS -32.76800 32.76700 /end CHARACTERISTIC
/begin CHARACTERISTIC OvRMon_aMaxCrCtlP_C "Maximalwert für die Verzögerung bei der Cruise Control Plus Monitoring Funktion" VALUE 0x1C1E54 Kw_Ws16 65.53500 Acc -32.76800 32.76700 FORMAT "%8.5" /end CHARACTERISTIC
/begin CHARACTERISTIC OvRMon_BrkMsk_C "Maske zum Auswählen der Bremsinformation (Brake Booster)" VALUE 0x1C1E56 Kw_Wu8 15.00 OneToOne 0.00 15.00 FORMAT "%5.2" EXTENDED_LIMITS 0.00 255.0 /end CHARACTERISTIC
/begin CHARACTERISTIC OvRMon_ctCrCtlPDwn_C "Abwärtszählschrittweite für die Cruise Control Plus Monitoring Funktion" VALUE 0x1C1E57 Kw_Wu8 192.0 OneToOne 0.00 192.0 FORMAT "%5.1" EXTENDED_LIMITS 0.00 255.0 /end CHARACTERISTIC
/begin CHARACTERISTIC OvRMon_ctCrCtlPUp_C "Aufwärtszählschrittweite für die Cruise Control Plus Monitoring Funktion" VALUE 0x1C1E58 Kw_Wu8 48.00 OneToOne 0.00 48.00 FORMAT "%5.2" EXTENDED_LIMITS 0.00 255.0 /end CHARACTERISTIC
/begin CHARACTERISTIC OvRMon_ctEngSpdGrad_C "Zähler zum Erkennen eines positiven Drehzahlgradients" VALUE 0x1C1E22 Kw_Wu16 65535.00 OneToOne 0.00 65535.00 FORMAT "%8.2" /end CHARACTERISTIC
/begin CHARACTERISTIC OvRMon_ctQInjDefDwn_C "Defektfehlerzähler für die Schubüberwachung" VALUE 0x1C1C55 Kw_Wu8 192.0 OneToOne 0.00 192.0 FORMAT "%5.1" EXTENDED_LIMITS 0.00 255.0 /end CHARACTERISTIC
/begin CHARACTERISTIC OvRMon_ctQInjDefUp_C "Zähler" VALUE 0x1C1C56 Kw_Wu8 48.00 OneToOne 0.00 48.00 FORMAT "%5.2" EXTENDED_LIMITS 0.00 255.0 /end CHARACTERISTIC
/begin CHARACTERISTIC OvRMon_DebCrCtlPDef_C "Fehlerzählerabschaltwert für die Cruise Control Plus Monitoring Funktion" VALUE 0x1C1E5A Kw_Wu16 65535.00 OneToOne 0.00 65535.00 FORMAT "%8.2" /end CHARACTERISTIC
/begin CHARACTERISTIC OvRMon_DebQInjDef_C "Fehlerentprellzeit bei Menge größer Schwelle" VALUE 0x1C1C58 Kw_Wu16 65535.00 OneToOne 0.00 65535.00 FORMAT "%8.2" /end CHARACTERISTIC
/begin CHARACTERISTIC OvRMon_DebSigA0Def_C "Defekterkennungszeit für Drehzahlplausibilisierung in Schubüberwachung" VALUE 0x1C1E88 Kw_Wu16 655350.0 TimeDeb 0.00 655350.0 FORMAT "%8.1" /end CHARACTERISTIC
/begin CHARACTERISTIC OvRMon_duBattJit_C "Glättungsparameter für die redundant eingelesene Batteriespannung" VALUE 0x1C1EA4 Kw_Ws16 5200.579 Volt_Batt 0.00 5200.579 FORMAT "%8.3" EXTENDED_LIMITS -665674.1 665653.8 /end CHARACTERISTIC
/begin CHARACTERISTIC OvRMon_duBrkJit_C "Glättungsparameter des redundant eingelesenen Hauptbremsschalters" VALUE 0x1C1E76 Kw_Ws16 5200.391 Volt 0.00 5200.391 FORMAT "%8.3" EXTENDED_LIMITS -160156.4 160151.5 /end CHARACTERISTIC
/begin CHARACTERISTIC OvRMon_facBattCor_CUR "Kennfeld für die Berechnung des redundant eingelesenen Batteriespannungskorrekturfaktors" CURVE 0x1C1EA6 Kl_Xs16_Ws16 1.600098 Fact 0.1999512 1.800049 FORMAT "%8.6" EXTENDED_LIMITS -4.000000 3.999878
 /begin AXIS_DESCR STD_AXIS OvRMon_uBatt_mp Volt_Batt 4 0.00 20010.04 FORMAT "%8.2" EXTENDED_LIMITS -665674.1 665653.8 DEPOSIT ABSOLUTE /end AXIS_DESCR
/end CHARACTERISTIC
/begin CHARACTERISTIC OvRMon_facInjEff_MAP "Wirkungsfaktorkennfeld in der Schubüberwachung" MAP 0x1C1ECE Kf_Xs16_Ys16_Ws16 1.000000 Fact 0.00 1.000000 FORMAT "%8.6" EXTENDED_LIMITS -4.000000 3.999878
 /begin AXIS_DESCR STD_AXIS Eng_nAvrg EngN 10 0.00 6000.000 FORMAT "%8.3" EXTENDED_LIMITS -32768.00 32767.00 DEPOSIT ABSOLUTE /end AXIS_DESCR
 /begin AXIS_DESCR STD_AXIS OvRMon_phiActMI_mp AngleCrS 10 -720.0000 720.0000 FORMAT "%8.4" EXTENDED_LIMITS -768.0000 767.9766 DEPOSIT ABSOLUTE /end AXIS_DESCR
/end CHARACTERISTIC
/begin CHARACTERISTIC OvRMon_nDiffMaxHi_C "maximale Drehzahlabweichung bei hohen Drehzahlen" VALUE 0x1C1E8A Kw_Ws16 5960.000 EngN 40.00000 6000.000 FORMAT "%8.3" EXTENDED_LIMITS -32768.00 32767.00 /end CHARACTERISTIC
/begin CHARACTERISTIC OvRMon_nDiffMaxLo_C "maximale Drehzahlabweichung bei niedrigen Drehzahlen" VALUE 0x1C1E8C Kw_Ws16 5960.000 EngN 40.00000 6000.000 FORMAT "%8.3" EXTENDED_LIMITS -32768.00 32767.00 /end CHARACTERISTIC
/begin CHARACTERISTIC OvRMon_nDiffThres_C "Drehzahlschwelle für maximale Drehzahldifferenz" VALUE 0x1C1E8E Kw_Ws16 5960.000 EngN 40.00000 6000.000 FORMAT "%8.3" EXTENDED_LIMITS -32768.00 32767.00 /end CHARACTERISTIC
/begin CHARACTERISTIC OvRMon_nLIGovLim_C "Grenze Kurbelwellen Drehzahl für aktive Leerlaufregler Überwachung" VALUE 0x1C1E24 Kw_Ws16 6000.000 EngN 0.00 6000.000 FORMAT "%8.3" EXTENDED_LIMITS -32768.00 32767.00 /end CHARACTERISTIC
/begin CHARACTERISTIC OvRMon_nLimET_C "Drehzahlschwelle für Ansteuerdauer Schubüberwachung aktiv" VALUE 0x1C1C60 Kw_Ws16 6000.000 EngN 0.00 6000.000 FORMAT "%8.3" EXTENDED_LIMITS -32768.00 32767.00 /end CHARACTERISTIC
/begin CHARACTERISTIC OvRMon_nMin_C "Drehzahlschwelle zur Aktivierung der Schubüberwachung" VALUE 0x1C1E26 Kw_Ws16 6000.000 EngN 0.00 6000.000 FORMAT "%8.3" EXTENDED_LIMITS -32768.00 32767.00 /end CHARACTERISTIC
/begin CHARACTERISTIC OvRMon_nMon_C "Drehzahlschwelle für Überwachung aktiv" VALUE 0x1C1C5A Kw_Ws16 6000.000 EngN 0.00 6000.000 FORMAT "%8.3" EXTENDED_LIMITS -32768.00 32767.00 /end CHARACTERISTIC
/begin CHARACTERISTIC OvRMon_nSegMax_C "Ersatzwert für Segmentdrehzahl bei Unterschreitung der Mindestsegmentdauer" VALUE 0x1C1E90 Kw_Ws16 5960.000 EngN 40.00000 6000.000 FORMAT "%8.3" EXTENDED_LIMITS -32768.00 32767.00 /end CHARACTERISTIC
/begin CHARACTERISTIC OvRMon_nSegMin_C "Mindestdrehzahl zur Aktivierung der Drehzahlplausibilisierung" VALUE 0x1C1E92 Kw_Ws16 5960.000 EngN 40.00000 6000.000 FORMAT "%8.3" EXTENDED_LIMITS -32768.00 32767.00 /end CHARACTERISTIC
/begin CHARACTERISTIC OvRMon_nStSysLim_C "Grenze Kurbelwellen Drehzahl für aktive Startsystem Überwachung" VALUE 0x1C1C5E Kw_Ws16 6000.000 EngN 0.00 6000.000 FORMAT "%8.3" EXTENDED_LIMITS -32768.00 32767.00 /end CHARACTERISTIC
/begin CHARACTERISTIC OvRMon_numCyl_C "Zylinderzahl in der Schubüberwachung" VALUE 0x1C1C5C Kw_Wu8 254.0 OneToOne 1.000 255.0 FORMAT "%5.1" EXTENDED_LIMITS 0.00 255.0 /end CHARACTERISTIC
/begin CHARACTERISTIC OvRMon_qLimEnh_CUR "erweiterte Schubkennlinie für Schubüberwachung (Mengenbasierend)" CURVE 0x1C1D98 Kl_Xs16_Ws16 50.00000 InjMass 0.00 50.00000 FORMAT "%8.5" EXTENDED_LIMITS -327.6800 327.6700
 /begin AXIS_DESCR STD_AXIS Eng_nAvrg EngN 25 0.00 6000.000 FORMAT "%8.3" EXTENDED_LIMITS -32768.00 32767.00 DEPOSIT ABSOLUTE /end AXIS_DESCR
/end CHARACTERISTIC
/begin CHARACTERISTIC OvRMon_rHighLimLowIdle_C "Obere Schwelle für gefiltertes Fahrpedalsignal" VALUE 0x1C1DFE Kw_Ws16 100.0000 Prc 0.00 100.0000 FORMAT "%8.4" EXTENDED_LIMITS -327.6800 327.6700 /end CHARACTERISTIC
/begin CHARACTERISTIC OvRMon_stIntrInit_C "Kennung für Interruptstatus" VALUE 0x1C1E94 Kw_Wu8 255.0 OneToOne 0.00 255.0 FORMAT "%5.1" /end CHARACTERISTIC
/begin CHARACTERISTIC OvRMon_stInvLowIdle_C "Invertierung Leergasschalter (0: gleich  1: invertiert)" VALUE 0x1C1E00 Kw_Wu8 1.000 OneToOne 0.00 1.000 FORMAT "%5.3" EXTENDED_LIMITS 0.00 255.0 /end CHARACTERISTIC
/begin CHARACTERISTIC OvRMon_swtAstAccs_C "Schalter für die Aktivierung des erhöhenden Getriebe3 - Eingriffs in der Ebene2" VALUE 0x1C1EC8 Kw_Wu8 255.0 OneToOne 0.00 255.0 FORMAT "%5.1" /end CHARACTERISTIC
/begin CHARACTERISTIC OvRMon_swtEnaConv_C "Schalter zum aktivieren / deaktivieren der Aktiverungsbedingung Kupplung für die Schubüberwachung" VALUE 0x1C1C5D Kw_Wu8 255.0 OneToOne 0.00 255.0 FORMAT "%5.1" /end CHARACTERISTIC
/begin CHARACTERISTIC OvRMon_swtEngBrkDemDisbl_C "Schalter zur Deaktivierung der Motorbremsanforderung vom FrmMng-Modul" VALUE 0x1C1E5C Kw_Wu8 1.000 OneToOne 0.00 1.000 FORMAT "%5.3" EXTENDED_LIMITS 0.00 255.0 /end CHARACTERISTIC
/begin CHARACTERISTIC OvRMon_tiAPP1Flt_C "Wartezeit Fahrpedalfilterung, Führungsformung in der Schubüberwachung" VALUE 0x1C1E02 Kw_Wu16 655350.0 TimeDeb 0.00 655350.0 FORMAT "%8.1" /end CHARACTERISTIC
/begin CHARACTERISTIC OvRMon_tiAPPNpl_C "Verzögerungszeit für das Statusbit 2 der Plausibilitätsprüfung in der Schubüberwachung" VALUE 0x1C1E04 Kw_Wu16 655350.0 TimeDeb 0.00 655350.0 FORMAT "%8.1" /end CHARACTERISTIC
/begin CHARACTERISTIC OvRMon_tiDebACCActv_C "Entprellzeit adaptive Distanzregelungl high -> low" VALUE 0x1C1E9E Kw_Wu16 655350.0 TimeDeb 0.00 655350.0 FORMAT "%8.1" /end CHARACTERISTIC
/begin CHARACTERISTIC OvRMon_tiDebACCP_C "Entprellzeit für ACCa-Monitoring" VALUE 0x1C1EA0 Kw_Wu16 655350.0 TimeDeb 0.00 655350.0 FORMAT "%8.1" /end CHARACTERISTIC
/begin CHARACTERISTIC OvRMon_tiDebAPP1Pressed_C "Entprellzeit für den APP1 ADC-Spannungsrohwert" VALUE 0x1C1E5E Kw_Wu16 655350.0 TimeDeb 0.00 655350.0 FORMAT "%8.1" /end CHARACTERISTIC
/begin CHARACTERISTIC OvRMon_tiDebAstAccsActv_C "Aktiv-Entprellzeit für AST Eingriff" VALUE 0x1C1ECA Kw_Wu16 655350.0 TimeDeb 0.00 655350.0 FORMAT "%8.1" /end CHARACTERISTIC
/begin CHARACTERISTIC OvRMon_tiDebBattSRCDef_C "Defektentprellzeit  SRC-Fehler redundant eingelesene Batteriespannung" VALUE 0x1C1EB8 Kw_Wu32 42949672950.0 TimeDeb 0.00 42949672950.0 FORMAT "%13.1" /end CHARACTERISTIC
/begin CHARACTERISTIC OvRMon_tiDebBattSRCOk_C "Heilungsentprellzeit SRC Fehler der redundant eingelesenen Batteriespannung" VALUE 0x1C1EBC Kw_Wu32 42949672950.0 TimeDeb 0.00 42949672950.0 FORMAT "%13.1" /end CHARACTERISTIC
/begin CHARACTERISTIC OvRMon_tiDebBrkSRCDef_C "Defektentprellzeit für SRC-Fehler des redundant eingelesenen Hauptbremsschalters" VALUE 0x1C1E79 Kw_Wu8 2550. TimeDeb 0.00 2550. FORMAT "%5.0" /end CHARACTERISTIC
/begin CHARACTERISTIC OvRMon_tiDebBrkSRCOk_C "Heilungsentprellzeit bei SRC-Fehler des redundant eingelesenen Hauptbremsschalters" VALUE 0x1C1E7A Kw_Wu8 2550. TimeDeb 0.00 2550. FORMAT "%5.0" /end CHARACTERISTIC
/begin CHARACTERISTIC OvRMon_tiDebBrk_C "Entprellzeit für redundante Erfassung des Bremssignals" VALUE 0x1C1E7E Kw_Wu8 2550. TimeDeb 0.00 2550. FORMAT "%5.0" /end CHARACTERISTIC
/begin CHARACTERISTIC OvRMon_tiDebConv_C "Entprellzeit für redundante Erfassung des Kupplungssignals" VALUE 0x1C1E86 Kw_Wu8 2550. TimeDeb 0.00 2550. FORMAT "%5.0" /end CHARACTERISTIC
/begin CHARACTERISTIC OvRMon_tiDebCrCtlActv_C "Entprellzeit Cruise Control low -> high" VALUE 0x1C1E28 Kw_Wu16 655350.0 TimeDeb 0.00 655350.0 FORMAT "%8.1" /end CHARACTERISTIC
/begin CHARACTERISTIC OvRMon_tiDebCrCtla_C "Entprellzeit CrCtla low -> high" VALUE 0x1C1E2A Kw_Wu16 655350.0 TimeDeb 0.00 655350.0 FORMAT "%8.1" /end CHARACTERISTIC
/begin CHARACTERISTIC OvRMon_tiDebCrCtlplus3_C "Entprellzeit für ACCa-Monitoring" VALUE 0x1C1E60 Kw_Wu16 655350.0 TimeDeb 0.00 655350.0 FORMAT "%8.1" /end CHARACTERISTIC
/begin CHARACTERISTIC OvRMon_tiDebCrCtlplus4_C "Entprellzeit für CrCtla-Monitoring" VALUE 0x1C1E62 Kw_Wu16 655350.0 TimeDeb 0.00 655350.0 FORMAT "%8.1" /end CHARACTERISTIC
/begin CHARACTERISTIC OvRMon_tiDebCrCtlPone_C "Entprellzeit für die Überwachung der Abschaltbedingung "" Allgemeine Überwachung"" für die Cruise Control Plus Monitoring Funktion" VALUE 0x1C1E64 Kw_Wu16 655350.0 TimeDeb 0.00 655350.0 FORMAT "%8.1" /end CHARACTERISTIC
/begin CHARACTERISTIC OvRMon_tiDebCrCtlPtwo_C "Entprellzeit für die Überwachung der Abschaltbedingung "" Überreiten"" für die Cruise Control Plus Monitoring Funktion" VALUE 0x1C1E66 Kw_Wu16 655350.0 TimeDeb 0.00 655350.0 FORMAT "%8.1" /end CHARACTERISTIC
/begin CHARACTERISTIC OvRMon_tiDebDrvActv_C "Einschaltverzögerung der ARD-SR Überwachung nach Schub" VALUE 0x1C1E1E Kw_Wu16 655350.0 TimeDeb 0.00 655350.0 FORMAT "%8.1" /end CHARACTERISTIC
/begin CHARACTERISTIC OvRMon_tiDebLimEnh_C "Entprellzeit für erweiterte Schubkennlinie" VALUE 0x1C1E06 Kw_Wu16 655350.0 TimeDeb 0.00 655350.0 FORMAT "%8.1" /end CHARACTERISTIC
/begin CHARACTERISTIC OvRMon_tiDebLowIdlActv_C "Entprellzeit für selbsteingelesenen Leergasschalter in AccPed Überwachung - Übergang in den Status ""aktiv""" VALUE 0x1C1E08 Kw_Wu16 655350.0 TimeDeb 0.00 655350.0 FORMAT "%8.1" /end CHARACTERISTIC
/begin CHARACTERISTIC OvRMon_tiDebShtrp_C "Entprellzeit Short-Trip low-> high" VALUE 0x1E8BEA Kw_Wu16 655350.0 TimeDeb 0.00 655350.0 FORMAT "%8.1" /end CHARACTERISTIC
/begin CHARACTERISTIC OvRMon_tiDebStCtlActv_C "Entprellzeit Fahrdynamik low -> high" VALUE 0x1C1E74 Kw_Wu16 655350.0 TimeDeb 0.00 655350.0 FORMAT "%8.1" /end CHARACTERISTIC
/begin CHARACTERISTIC OvRMon_tiDebTIIAccsActv_C "Aktiv-Entprellzeit für TII  Eingriff" VALUE 0x1C1ECC Kw_Wu16 655350.0 TimeDeb 0.00 655350.0 FORMAT "%8.1" /end CHARACTERISTIC
/begin CHARACTERISTIC OvRMon_tiErrAPP_C "Fehlerentprellzeit für Fahrpedalüberwachung" VALUE 0x1C1E0A Kw_Wu8 2550. TimeDeb 0.00 2550. FORMAT "%5.0" /end CHARACTERISTIC
/begin CHARACTERISTIC OvRMon_tiLimET_MAP "zulässige Ansteuerdauer abhängig von Drehzahl und Zeit nach Aktivierung der Schubüberwachung" MAP 0x1C1C62 Kf_Xs16_Ys16_Ws16 3000.000 InjTime_us 0.00 3000.000 FORMAT "%8.3" EXTENDED_LIMITS -32768.00 32767.00
 /begin AXIS_DESCR STD_AXIS OvRMon_nAvrg EngN 10 0.00 6000.000 FORMAT "%8.3" EXTENDED_LIMITS -32768.00 32767.00 DEPOSIT ABSOLUTE /end AXIS_DESCR
 /begin AXIS_DESCR STD_AXIS OvRMon_tiOvRMonActive_mp Time_ms 13 0.00 5000.000 FORMAT "%8.3" EXTENDED_LIMITS -327680.0 327670.0 DEPOSIT ABSOLUTE /end AXIS_DESCR
/end CHARACTERISTIC
/begin CHARACTERISTIC OvRMon_tiSegMin_C "Mindestsegmentdauer für Übernahme der Segmentdrehzahl aus Systemzeit" VALUE 0x1C1E98 Kw_Wu32 4294967295.00 TimeUSResolution 0.00 4294967295.00 FORMAT "%13.2" /end CHARACTERISTIC
/begin CHARACTERISTIC OvRMon_trqACCDec_C "Momentenoffset für ACCa Monitoring" VALUE 0x1C1E68 Kw_Ws32 429496729.500 TrqPrpHigh -214748364.800 214748364.700 FORMAT "%13.3" /end CHARACTERISTIC
/begin CHARACTERISTIC OvRMon_trqMonASD_C "Bedingungsschwelle für CoEng_trqSetASDdc in AccPed Überwachung" VALUE 0x1C1E0C Kw_Ws16 1000.000 Trq 0.00 1000.000 FORMAT "%8.3" EXTENDED_LIMITS -3276.800 3276.700 /end CHARACTERISTIC
/begin CHARACTERISTIC OvRMon_trqThresASDdc_C "Momentenschwelle für ARD Anforderung innerhalb der Schubüberwachung" VALUE 0x1C1E20 Kw_Ws16 6553.500 Trq -3276.800 3276.700 FORMAT "%8.3" /end CHARACTERISTIC
/begin CHARACTERISTIC OvRMon_uAPP1CrCtla_C "Schwelle für den APP1 ADC-Spannungsrohwert" VALUE 0x1C1E6C Kw_Ws16 320307.9 Volt -160156.4 160151.5 FORMAT "%8.1" /end CHARACTERISTIC
/begin CHARACTERISTIC OvRMon_uAPP1LimPS_C "Spannungsgrenze für Poti/Schalter Pedalwertgeber zur Schuberkennung" VALUE 0x1C1E0E Kw_Ws16 5200.391 Volt 0.00 5200.391 FORMAT "%8.3" EXTENDED_LIMITS -160156.4 160151.5 /end CHARACTERISTIC
/begin CHARACTERISTIC OvRMon_uAPP1Lim_C "Spannungsgrenze für Überwachung Pedalwertgeber, Leergasschwelle der Überwachung" VALUE 0x1C1E10 Kw_Ws16 5200.391 Volt 0.00 5200.391 FORMAT "%8.3" EXTENDED_LIMITS -160156.4 160151.5 /end CHARACTERISTIC
/begin CHARACTERISTIC OvRMon_uAPP1Thresone_C "Spannungsschwelle für Überreiten bei Doppelanalog PWG mit MIN Auswahl für die Cruise Control Plus Monitoring Funktion" VALUE 0x1C1E6E Kw_Ws16 320307.9 Volt -160156.4 160151.5 FORMAT "%8.1" /end CHARACTERISTIC
/begin CHARACTERISTIC OvRMon_uAPP1Threstwo_C "Spannungsschwelle für Überreiten bei Poti / Schalter PWG für die Cruise Control Plus Monitoring Funktion" VALUE 0x1C1E70 Kw_Ws16 320307.9 Volt -160156.4 160151.5 FORMAT "%8.1" /end CHARACTERISTIC
/begin CHARACTERISTIC OvRMon_uAPPFull_C "Spannungsgrenze für Fahrpedal im Volllastbereich" VALUE 0x1C1E12 Kw_Ws16 5200.391 Volt 0.00 5200.391 FORMAT "%8.3" EXTENDED_LIMITS -160156.4 160151.5 /end CHARACTERISTIC
/begin CHARACTERISTIC OvRMon_uBattDfl_C "Ersatzwert für die redundant eingelesene Batteriespannung bei endgültigem SRC Fehler" VALUE 0x1C1EC0 Kw_Ws16 1331328. Volt_Batt -665674.1 665653.8 FORMAT "%8.1" /end CHARACTERISTIC
/begin CHARACTERISTIC OvRMon_uBattSRCMax_C "Schwelle für SRC High Fehler der redundant eingelesenen Batteriespannung" VALUE 0x1C1EC2 Kw_Ws16 1331328. Volt_Batt -665674.1 665653.8 FORMAT "%8.1" /end CHARACTERISTIC
/begin CHARACTERISTIC OvRMon_uBattSRCMin_C "Schwelle SRC Low Fehler der redundant eingelesenen Batteriespannung" VALUE 0x1C1EC4 Kw_Ws16 1331328. Volt_Batt -665674.1 665653.8 FORMAT "%8.1" /end CHARACTERISTIC
/begin CHARACTERISTIC OvRMon_uBrkA2DThres_C "Schwelle für die Analog-Digital Umwandlung des redundant eingelesenen Hauptbremsschalters" VALUE 0x1C1E80 Kw_Ws16 320307.9 Volt -160156.4 160151.5 FORMAT "%8.1" /end CHARACTERISTIC
/begin CHARACTERISTIC OvRMon_uBrkSRCMax_C "Schwelle für SRC High-Fehler des redundant eingelesenen Hauptbremsschalters" VALUE 0x1C1E82 Kw_Ws16 320307.9 Volt -160156.4 160151.5 FORMAT "%8.1" /end CHARACTERISTIC
/begin CHARACTERISTIC OvRMon_uBrkSRCMin_C "Schwelle für SRC Low Fehler des redundant eingelesenen Hauptbremsschalters" VALUE 0x1C1E84 Kw_Ws16 320307.9 Volt -160156.4 160151.5 FORMAT "%8.1" /end CHARACTERISTIC
/begin CHARACTERISTIC OvRMon_uHighLimLowIdle_C "Plausibilitätsschwelle Leergasschalter obere Schwelle" VALUE 0x1C1E14 Kw_Ws16 5200.391 Volt 0.00 5200.391 FORMAT "%8.3" EXTENDED_LIMITS -160156.4 160151.5 /end CHARACTERISTIC
/begin CHARACTERISTIC OvRMon_uLowIdlSwtA2DThres_C "Spannungsschwelle für die Analog-Digital Wandlung des Leergasschalters" VALUE 0x1C1E16 Kw_Ws16 5200.391 Volt 0.00 5200.391 FORMAT "%8.3" EXTENDED_LIMITS -160156.4 160151.5 /end CHARACTERISTIC
/begin CHARACTERISTIC OvRMon_uLowLimLowIdle_C "Plausibilitätsschwelle Leergasschalter obere Schwelle" VALUE 0x1C1E18 Kw_Ws16 5200.391 Volt 0.00 5200.391 FORMAT "%8.3" EXTENDED_LIMITS -160156.4 160151.5 /end CHARACTERISTIC
/begin CHARACTERISTIC OvRMon_uPlaWinFull_C "Plausibilitätsfenster für Fahrpedal im Volllastbereich" VALUE 0x1C1E1A Kw_Ws16 5200.391 Volt 0.00 5200.391 FORMAT "%8.3" EXTENDED_LIMITS -160156.4 160151.5 /end CHARACTERISTIC
/begin CHARACTERISTIC OvRMon_uPlaWinIdle_C "Plausibilitätsfenster für Fahpedal im Leerlaufbereich" VALUE 0x1C1E1C Kw_Ws16 5200.391 Volt 0.00 5200.391 FORMAT "%8.3" EXTENDED_LIMITS -160156.4 160151.5 /end CHARACTERISTIC
/begin CHARACTERISTIC OxiCCD_uSRCMinTPre_C "Minimalwert SRC-Überwachung von OxiCCD_uRawTempPre" VALUE 0x1E8BEC Kw_Ws16 5200.391 Volt 0.00 5200.391 FORMAT "%8.3" EXTENDED_LIMITS -160156.4 160151.5 /end CHARACTERISTIC
/begin CHARACTERISTIC OxiCCD_uSRCMaxTPre_C "Maximalwert SRC-Überwachung von OxiCCD_uRawTempPre" VALUE 0x1E8BEE Kw_Ws16 5200.391 Volt 0.00 5200.391 FORMAT "%8.3" EXTENDED_LIMITS -160156.4 160151.5 /end CHARACTERISTIC
/begin CHARACTERISTIC OxiCCD_tLinPre1_CUR "Linearisierungskennlinie für Temperatur vor Abgasturbolader[deg C]" CURVE 0x1E8BF0 Kl_Xs16_Ws16 1095.000 Temp_Cels -45.04000 1049.960 FORMAT "%8.3" EXTENDED_LIMITS -3549.940 3003.560
 /begin AXIS_DESCR STD_AXIS OxiCCD_uRawTempPre Volt 25 0.00 160151.5 FORMAT "%8.1" EXTENDED_LIMITS -160156.4 160151.5 DEPOSIT ABSOLUTE /end AXIS_DESCR
/end CHARACTERISTIC
/begin CHARACTERISTIC OxiCCD_DebSRCHighDefTPre_C "Entprellzeit für Fehlererkennung SRC-high-Fehler für Dfp_OxiCCDTPre" VALUE 0x1E8C56 Kw_Wu16 655350.0 Time_ms 0.00 655350.0 FORMAT "%8.1" /end CHARACTERISTIC
/begin CHARACTERISTIC OxiCCD_DebSRCHighOkTPre_C "Entprellzeit für Fehlerheilung SRC-high-Fehler für Dfp_OxiCCDTPre" VALUE 0x1E8C58 Kw_Wu16 655350.0 Time_ms 0.00 655350.0 FORMAT "%8.1" /end CHARACTERISTIC
/begin CHARACTERISTIC OxiCCD_DebSRCLowDefTPre_C "Entprellzeit für Fehlererkennung SRC-low-Fehler für Dfp_OxiCCDTPre" VALUE 0x1E8C5A Kw_Wu16 655350.0 Time_ms 0.00 655350.0 FORMAT "%8.1" /end CHARACTERISTIC
/begin CHARACTERISTIC OxiCCD_DebSRCLowOkTPre_C "Entprellzeit für Fehlerheilung SRC-low-Fehler für Dfp_OxiCCDTPre" VALUE 0x1E8C5C Kw_Wu16 655350.0 Time_ms 0.00 655350.0 FORMAT "%8.1" /end CHARACTERISTIC
/begin CHARACTERISTIC OxiCCD_dtRmpSlpUpPre_C "Rampensteigung aufwärts für Komponententreiber Temperatur vor Oxidationskatalysator" VALUE 0x1E8C60 Kw_Wu32 6553599.99847 RmpTemp 0.00 6553599.99847 FORMAT "%13.5" /end CHARACTERISTIC
/begin CHARACTERISTIC OxiCCD_dtRmpSlpDwnPre_C "Rampensteigung abwärts für Komponententreiber Temperatur vor Oxidationskatalysator" VALUE 0x1E8C64 Kw_Wu32 6553599.99847 RmpTemp 0.00 6553599.99847 FORMAT "%13.5" /end CHARACTERISTIC
/begin CHARACTERISTIC OxiCCD_swtActvTPre_C "  Aktivierung/Deaktivierung  des Komponententreibers für Abgastemperatur vor Oxidationskatalysator." VALUE 0x1E8C68 Kw_Wu8 1.000 OneToOne 0.00 1.000 FORMAT "%5.3" EXTENDED_LIMITS 0.00 255.0 /end CHARACTERISTIC
/begin CHARACTERISTIC OxiCCD_stSensIDWordTPre_C "Sensor ID Word für Übergangsbedingungen Temperatursensor vor Oxidationskatalysator" VALUE 0x1E8C6A Kw_Wu16 65535.00 OneToOne 0.00 65535.00 FORMAT "%8.2" /end CHARACTERISTIC
/begin CHARACTERISTIC OxiCCD_tDflPre_C "Ersatzwert Temperatur vor Oxidationskatalysator im Fehlerfall" VALUE 0x1E8C6C Kw_Ws16 1095.000 Temp_Cels -45.04000 1049.960 FORMAT "%8.3" EXTENDED_LIMITS -3549.940 3003.560 /end CHARACTERISTIC
/begin CHARACTERISTIC PCR_CoDT1Neg_C "Verzögerungszeitkonstante für Sollwertbildung bei kalten Motor für neg. Ausgangsgröße" VALUE 0x1EAD10 Kw_Wu32 4294.9663 TimeDelay_s 0.0010000001 4294.9673 FORMAT "%9.4" EXTENDED_LIMITS 0.0000010000000 4294.9673 /end CHARACTERISTIC
/begin CHARACTERISTIC PCR_CoDT1Pos_C "Verzögerungszeitkonstante für Sollwertbildung bei kalten Motor für pos. Ausgangsgröße" VALUE 0x1EAD14 Kw_Wu32 4294.9663 TimeDelay_s 0.0010000001 4294.9673 FORMAT "%9.4" EXTENDED_LIMITS 0.0000010000000 4294.9673 /end CHARACTERISTIC
/begin CHARACTERISTIC PCR_CoDKd_C "Kleinsignalverstärkung der dynamischen Sollwertbildung bei kaltem Motor" VALUE 0x1EAD18 Kw_Ws32 65535.9999847 Kd -32768.0000000 32767.9999847 FORMAT "%13.7" /end CHARACTERISTIC
/begin CHARACTERISTIC PCR_CoDKdPos_C "Positive Großsignalverstärkung der dynamischen Sollwertbildung bei kaltem Motor" VALUE 0x1EAD1C Kw_Ws32 65535.9999847 Kd -32768.0000000 32767.9999847 FORMAT "%13.7" /end CHARACTERISTIC
/begin CHARACTERISTIC PCR_CoDKdNeg_C "Negative Großsignalverstärkung der dynamischen Sollwertbildung bei kaltem Motor" VALUE 0x1EAD20 Kw_Ws32 65535.9999847 Kd -32768.0000000 32767.9999847 FORMAT "%13.7" /end CHARACTERISTIC
/begin CHARACTERISTIC PCR_dpCoDWinPos_C "Positive Kleinsignalgrenze bei kaltem Motor" VALUE 0x1EAD24 Kw_Ws16 1638350. Pres_hPaPerSec_20ms 0.00 1638350. FORMAT "%8.0" EXTENDED_LIMITS -1638400. 1638350. /end CHARACTERISTIC
/begin CHARACTERISTIC PCR_dpCoDWinNeg_C "Negative Kleinsignalgrenze bei kaltem Motor" VALUE 0x1EAD26 Kw_Ws16 1638400. Pres_hPaPerSec_20ms -1638400. 0.00 FORMAT "%8.0" EXTENDED_LIMITS -1638400. 1638350. /end CHARACTERISTIC
/begin CHARACTERISTIC PCR_DebSRCHighDef_C "Defektzeit SRC-high" VALUE 0x1EC984 Kw_Wu16 655350.0 Time_ms 0.00 655350.0 FORMAT "%8.1" /end CHARACTERISTIC
/begin CHARACTERISTIC PCR_DebSRCHighOk_C "Heilungszeit SRC-high" VALUE 0x1EC986 Kw_Wu16 655350.0 Time_ms 0.00 655350.0 FORMAT "%8.1" /end CHARACTERISTIC
/begin CHARACTERISTIC PCR_DebSRCLowDef_C "Defektzeit SRC-low" VALUE 0x1EC988 Kw_Wu16 655350.0 Time_ms 0.00 655350.0 FORMAT "%8.1" /end CHARACTERISTIC
/begin CHARACTERISTIC PCR_DebSRCLowOk_C "Heilungszeit SRC-low" VALUE 0x1EC98A Kw_Wu16 655350.0 Time_ms 0.00 655350.0 FORMAT "%8.1" /end CHARACTERISTIC
/begin CHARACTERISTIC PCR_dfacShftUpCorDwn_C "negative Rampensteigung" VALUE 0x1E8C70 Kw_Wu16 3275.900 RmpFact1000Tmp 0.04998779 3275.950 FORMAT "%8.3" EXTENDED_LIMITS 0.00 3275.950 /end CHARACTERISTIC
/begin CHARACTERISTIC PCR_dfacShftUpCorUp_C "positive Rampensteigung" VALUE 0x1E8C72 Kw_Wu16 3275.900 RmpFact1000Tmp 0.04998779 3275.950 FORMAT "%8.3" EXTENDED_LIMITS 0.00 3275.950 /end CHARACTERISTIC
/begin CHARACTERISTIC PCR_DKdNeg_C "Grundwert der D-Verstärkung des PIDT1-Reglers bei negativen Großsignalen" VALUE 0x1EBDCC Kw_Ws32 10.0000000000 Kd_Pres_hPa2Prc 0.00 10.0000000000 FORMAT "%13.10" EXTENDED_LIMITS -327.680000000 327.679999847 /end CHARACTERISTIC
/begin CHARACTERISTIC PCR_DKdPos_C "Grundwert der D-Verstärkung des PIDT1-Reglers bei positiven Großssignalen" VALUE 0x1EBDD0 Kw_Ws32 10.0000000000 Kd_Pres_hPa2Prc 0.00 10.0000000000 FORMAT "%13.10" EXTENDED_LIMITS -327.680000000 327.679999847 /end CHARACTERISTIC
/begin CHARACTERISTIC PCR_DKd_C "Grundwert der D-Verstärkung des PIDT1-Reglers bei Kleinsignalen" VALUE 0x1EBDD4 Kw_Ws32 10.0000000000 Kd_Pres_hPa2Prc 0.00 10.0000000000 FORMAT "%13.10" EXTENDED_LIMITS -327.680000000 327.679999847 /end CHARACTERISTIC
/begin CHARACTERISTIC PCR_tiPTBPGovFlt_C "PT1 Filterkonstante der Ladergeräuschunterdrückung" VALUE 0x1EBDD8 Kw_Wu32 4294.9663 TimeDelay_s 0.0010000001 4294.9673 FORMAT "%9.4" EXTENDED_LIMITS 0.0000010000000 4294.9673 /end CHARACTERISTIC
/begin CHARACTERISTIC PCR_dlyPT1TrbnFlt_C "Zeitkonstante für gefilterte Laderdrehzahl" VALUE 0x1E8C74 Kw_Wu32 4294.9663 TimeDelay_s 0.0010000001 4294.9673 FORMAT "%9.4" EXTENDED_LIMITS 0.0000010000000 4294.9673 /end CHARACTERISTIC
/begin CHARACTERISTIC PCR_dlyPT1_C "Zeitkonstante der Sollwertverzögerung für I-Anteil" VALUE 0x1EBDDC Kw_Wu32 4294.9663 TimeDelay_s 0.0010000001 4294.9673 FORMAT "%9.4" EXTENDED_LIMITS 0.0000010000000 4294.9673 /end CHARACTERISTIC
/begin CHARACTERISTIC PCR_dnAvrgMax_C "Drehzahlgradientenlimit zur Deaktivierung der Gangwechselerkennung im noise suppression-Fall" VALUE 0x1EBDE0 Kw_Ws16 12000.00 Eng_dN -6000.000 6000.000 FORMAT "%8.3" EXTENDED_LIMITS -32768.00 32767.00 /end CHARACTERISTIC
/begin CHARACTERISTIC PCR_dpMinBPGovFlt_C "Minimale zeitliche Ableitung des Ladedrucksollwertes zur Aktivierung der Ladergeräuschunterdrückung" VALUE 0x1EBDE2 Kw_Ws16 1638350. Pres_hPaPerSec_20ms 0.00 1638350. FORMAT "%8.0" EXTENDED_LIMITS -1638400. 1638350. /end CHARACTERISTIC
/begin CHARACTERISTIC PCR_dqAPPBPMin_C "Fahrpedalgradientenschwelle zur Schuberkennung im noise suppression-Fall" VALUE 0x1EBDE4 Kw_Ws16 200000.0 dInjQnt_s -100000.0 100000.0 FORMAT "%8.1" EXTENDED_LIMITS -32768.00 32767.00 /end CHARACTERISTIC
/begin CHARACTERISTIC PCR_dqAPPEGRMin_C "Fahrpedalgradientenschwelle zur Schuberkennung im noise suppression-Fall" VALUE 0x1EBDE6 Kw_Ws16 200000.0 dInjQnt_s -100000.0 100000.0 FORMAT "%8.1" EXTENDED_LIMITS -32768.00 32767.00 /end CHARACTERISTIC
/begin CHARACTERISTIC PCR_dqDesMax_C "obere Einspritzmengengradientenschwelle zur Deaktivierung des Drehmomentfilters" VALUE 0x1E8C78 Kw_Ws16 328.0000 dInjQnt_s 0.00 328.0000 FORMAT "%8.4" EXTENDED_LIMITS -32768.00 32767.00 /end CHARACTERISTIC
/begin CHARACTERISTIC PCR_dqDesMin_C "untere Einspritzmengengradientenschwelle zur Aktivierung des Drehmomentfilters" VALUE 0x1E8C7A Kw_Ws16 328.0000 dInjQnt_s -328.0000 0.00 FORMAT "%8.4" EXTENDED_LIMITS -32768.00 32767.00 /end CHARACTERISTIC
/begin CHARACTERISTIC PCR_dqInjDemMax_C "Einspritzmengengradient für die Rücksetzbedingungen der Anti-Kaudern-Erkennung" VALUE 0x1EBDE8 Kw_Ws16 200000.0 dInjQnt_s -100000.0 100000.0 FORMAT "%8.1" EXTENDED_LIMITS -32768.00 32767.00 /end CHARACTERISTIC
/begin CHARACTERISTIC PCR_DT1RecInjQnt_C "T1 für Einspritzmengengradient" VALUE 0x1E8C7C Kw_Wu32 4294.9673 TimeDelay_s 0.0000010000000 4294.9673 FORMAT "%9.4" /end CHARACTERISTIC
/begin CHARACTERISTIC PCR_DKdInjQnt_C "Kd für Einspritzmengengradient" VALUE 0x1E8C80 Kw_Ws32 6553599.99847 Kd_mgpstroke2mgpstrokeps -3276800.00000 3276799.99847 FORMAT "%13.5" /end CHARACTERISTIC
/begin CHARACTERISTIC PCR_DT1RecN_C "T1 für Drehzahlgradient" VALUE 0x1E8C84 Kw_Wu32 4294.9673 TimeDelay_s 0.0000010000000 4294.9673 FORMAT "%9.4" /end CHARACTERISTIC
/begin CHARACTERISTIC PCR_DKdN_C "Kd für Drehzahlgradient" VALUE 0x1E8C88 Kw_Ws32 65535.9999847 Kd_rpm2rpmps -32768.0000000 32767.9999847 FORMAT "%13.7" /end CHARACTERISTIC
/begin CHARACTERISTIC PCR_DT1_MAP "Kennfeld für Zeitkonstante des DT1-Glieds" MAP 0x1EBDEA Kf_Xs16_Ys16_Ws16 5.5824070 TimeDelay_s_2 0.0099983409 5.5924053 FORMAT "%9.7" EXTENDED_LIMITS 0.00051201563 16.777216
 /begin AXIS_DESCR STD_AXIS Eng_nAvrg EngN 10 0.00 6000.000 FORMAT "%8.3" EXTENDED_LIMITS -32768.00 32767.00 DEPOSIT ABSOLUTE /end AXIS_DESCR
 /begin AXIS_DESCR STD_AXIS InjCtl_qCurr InjMass 10 0.00 327.6700 FORMAT "%8.4" EXTENDED_LIMITS -327.6800 327.6700 DEPOSIT ABSOLUTE /end AXIS_DESCR
/end CHARACTERISTIC
/begin CHARACTERISTIC PCR_facAT_CUR "Lufttemperaturabhängiger Faktor für Sollwertbildung" CURVE 0x1EAD28 Kl_Xs16_Ws16 3.000000 Fact 0.00 3.000000 FORMAT "%8.6" EXTENDED_LIMITS -4.000000 3.999878
 /begin AXIS_DESCR STD_AXIS IATSCD_tAir Temp_Cels 16 -50.14000 199.8600 FORMAT "%8.4" EXTENDED_LIMITS -3549.940 3003.560 DEPOSIT ABSOLUTE /end AXIS_DESCR
/end CHARACTERISTIC
/begin CHARACTERISTIC PCR_facBPAltCorr2_C "Normierter Druckabfall über Ladeluftkühler 2" VALUE 0x1E8C8C Kw_Wr32 0.300000000 OneToOne 0.00 0.300000000 FORMAT "%11.9" EXTENDED_LIMITS -1.00000000E+37 1.00000000E+37 /end CHARACTERISTIC
/begin CHARACTERISTIC PCR_facBPAltCorr_C "Normierter Druckabfall über Ladeluftkühler 1" VALUE 0x1E8C90 Kw_Wr32 0.300000000 OneToOne 0.00 0.300000000 FORMAT "%11.9" EXTENDED_LIMITS -1.00000000E+37 1.00000000E+37 /end CHARACTERISTIC
/begin CHARACTERISTIC PCR_facBPAltDynMax_C "Maximales Ladedruckverhältnis des Vorfilters" VALUE 0x1E8C94 Kw_Ws16 32.76700 Fact1000 0.00 32.76700 FORMAT "%8.5" EXTENDED_LIMITS -32.76800 32.76700 /end CHARACTERISTIC
/begin CHARACTERISTIC PCR_facBPAltMax2_MAP "Ladedruckverhältnis ohne Vorfilter in großen Höhe" MAP 0x1E8C96 Kf_Xs16_Ys16_Ws16 65.53500 Fact1000 -32.76800 32.76700 FORMAT "%8.5"
 /begin AXIS_DESCR STD_AXIS PCR_nTrbnMax_mp TurboN 16 10000.00 250000.0 FORMAT "%8.1" EXTENDED_LIMITS -327680.0 327670.0 DEPOSIT ABSOLUTE /end AXIS_DESCR
 /begin AXIS_DESCR STD_AXIS PCR_dmAirAltCorr2_mp AirMassPerTime 16 0.00 3000.000 FORMAT "%8.3" EXTENDED_LIMITS -3276.800 3276.700 DEPOSIT ABSOLUTE /end AXIS_DESCR
/end CHARACTERISTIC
/begin CHARACTERISTIC PCR_facBPAltMax_MAP "Ladedruckverhältnis ohne Vorfilter in großen Höhen" MAP 0x1E8EDA Kf_Xs16_Ys16_Ws16 65.53500 Fact1000 -32.76800 32.76700 FORMAT "%8.5"
 /begin AXIS_DESCR STD_AXIS PCR_nTrbnMax_mp TurboN 16 10000.00 250000.0 FORMAT "%8.1" EXTENDED_LIMITS -327680.0 327670.0 DEPOSIT ABSOLUTE /end AXIS_DESCR
 /begin AXIS_DESCR STD_AXIS PCR_dmAirAltCorr_mp AirMassPerTime 16 0.00 3000.000 FORMAT "%8.3" EXTENDED_LIMITS -3276.800 3276.700 DEPOSIT ABSOLUTE /end AXIS_DESCR
/end CHARACTERISTIC
/begin CHARACTERISTIC PCR_facBPMaxCorAdd_MAP "Motorbetriebspunktabhängiges Korrekturkennfeld des Ladedruckdruckverhältnisses" MAP 0x1E911E Kf_Xs16_Ys16_Ws16 65.53500 Fact1000 -32.76800 32.76700 FORMAT "%8.5"
 /begin AXIS_DESCR STD_AXIS Eng_nAvrg EngN 10 0.00 6000.000 FORMAT "%8.3" EXTENDED_LIMITS -32768.00 32767.00 DEPOSIT ABSOLUTE /end AXIS_DESCR
 /begin AXIS_DESCR STD_AXIS PCR_dnAvrg dEngSpd_s 9 -6000.000 6000.000 FORMAT "%8.3" EXTENDED_LIMITS -32768.00 32767.00 DEPOSIT ABSOLUTE /end AXIS_DESCR
/end CHARACTERISTIC
/begin CHARACTERISTIC PCR_facCtlAT_CUR "Kennlinie für lufttemperaturabhängigen Korrekturfaktor für Ladedrucksteuerung" CURVE 0x1E9D50 Kl_Xs16_Ws16 3.000000 Fact 0.00 3.000000 FORMAT "%8.6" EXTENDED_LIMITS -4.000000 3.999878
 /begin AXIS_DESCR STD_AXIS IATSCD_tAir Temp_Cels 25 -100.1400 199.8600 FORMAT "%8.4" EXTENDED_LIMITS -3549.940 3003.560 DEPOSIT ABSOLUTE /end AXIS_DESCR
/end CHARACTERISTIC
/begin CHARACTERISTIC PCR_facCtlBas_CUR "Kennlinie für lufttemperaturabhängigen Korrekturfaktor für Ladedrucksteuerung" CURVE 0x1E9DB6 Kl_Xs16_Ws16 7.999878 Fact -4.000000 3.999878 FORMAT "%8.6"
 /begin AXIS_DESCR STD_AXIS APSCD_pVal Pres_hPa 7 0.00 3500.000 FORMAT "%8.3" EXTENDED_LIMITS -32768.00 32767.00 DEPOSIT ABSOLUTE /end AXIS_DESCR
/end CHARACTERISTIC
/begin CHARACTERISTIC PCR_facCtlRgn1_CUR "Kurve für die Berechnung der Steuergröße im Regenerationsbetrieb 1" CURVE 0x1E9DD4 Kl_Xs16_Ws16 7.999878 Fact -4.000000 3.999878 FORMAT "%8.6"
 /begin AXIS_DESCR STD_AXIS APSCD_pVal Pres_hPa 2 0.00 3500.000 FORMAT "%8.3" EXTENDED_LIMITS -32768.00 32767.00 DEPOSIT ABSOLUTE /end AXIS_DESCR
/end CHARACTERISTIC
/begin CHARACTERISTIC PCR_facCtlRgn2_CUR "Kurve für die Berechnung der Steuergröße im Regenerationsbetrieb 2" CURVE 0x1E9DDE Kl_Xs16_Ws16 7.999878 Fact -4.000000 3.999878 FORMAT "%8.6"
 /begin AXIS_DESCR STD_AXIS APSCD_pVal Pres_hPa 2 0.00 3500.000 FORMAT "%8.3" EXTENDED_LIMITS -32768.00 32767.00 DEPOSIT ABSOLUTE /end AXIS_DESCR
/end CHARACTERISTIC
/begin CHARACTERISTIC PCR_facCtlRgn3_CUR "atmosphärendruckabhängige Steuerwertauswahl Regenerationsstufe 3" CURVE 0x1E9DE8 Kl_Xs16_Ws16 7.999878 Fact -4.000000 3.999878 FORMAT "%8.6"
 /begin AXIS_DESCR STD_AXIS APSCD_pVal Pres_hPa 2 0.00 3500.000 FORMAT "%8.3" EXTENDED_LIMITS -32768.00 32767.00 DEPOSIT ABSOLUTE /end AXIS_DESCR
/end CHARACTERISTIC
/begin CHARACTERISTIC PCR_facCtQ_MAP "Kennfeld für Kühlwassertemperaturkorrekturfaktor de Sollwertberechnung" MAP 0x1EAD6A Kf_Xs16_Ys16_Ws16 7.999878 Fact -4.000000 3.999878 FORMAT "%8.6"
 /begin AXIS_DESCR STD_AXIS CTSCD_tClnt Temp_Cels 8 -50.14000 149.8600 FORMAT "%8.4" EXTENDED_LIMITS -3549.940 3003.560 DEPOSIT ABSOLUTE /end AXIS_DESCR
 /begin AXIS_DESCR STD_AXIS PCR_qDes InjMass 8 0.00 327.6700 FORMAT "%8.4" EXTENDED_LIMITS -327.6800 327.6700 DEPOSIT ABSOLUTE /end AXIS_DESCR
/end CHARACTERISTIC
/begin CHARACTERISTIC PCR_facDesBas_CUR "Kurve für die Berechnung des Luftmassensollwertes im Standardbetrieb" CURVE 0x1EAE0E Kl_Xs16_Ws16 7.999878 Fact -4.000000 3.999878 FORMAT "%8.6"
 /begin AXIS_DESCR STD_AXIS APSCD_pVal Pres_hPa 10 0.00 3500.000 FORMAT "%8.3" EXTENDED_LIMITS -32768.00 32767.00 DEPOSIT ABSOLUTE /end AXIS_DESCR
/end CHARACTERISTIC
/begin CHARACTERISTIC PCR_facDesRgn1_CUR "Kurve für die Berechnung des Luftmassensollwertes im Regenerationsbetrieb 1" CURVE 0x1EAE38 Kl_Xs16_Ws16 7.999878 Fact -4.000000 3.999878 FORMAT "%8.6"
 /begin AXIS_DESCR STD_AXIS APSCD_pVal Pres_hPa 2 0.00 3500.000 FORMAT "%8.3" EXTENDED_LIMITS -32768.00 32767.00 DEPOSIT ABSOLUTE /end AXIS_DESCR
/end CHARACTERISTIC
/begin CHARACTERISTIC PCR_facDesRgn2_CUR "Kurve für die Berechnung des Luftmassensollwertes im Regenerationsbetrieb 2" CURVE 0x1EAE42 Kl_Xs16_Ws16 7.999878 Fact -4.000000 3.999878 FORMAT "%8.6"
 /begin AXIS_DESCR STD_AXIS APSCD_pVal Pres_hPa 2 0.00 3500.000 FORMAT "%8.3" EXTENDED_LIMITS -32768.00 32767.00 DEPOSIT ABSOLUTE /end AXIS_DESCR
/end CHARACTERISTIC
/begin CHARACTERISTIC PCR_facDesRgn3_CUR "atmosphärendruckabhängige Sollwertauswahl Regenerationsstufe 3" CURVE 0x1EAE4C Kl_Xs16_Ws16 7.999878 Fact -4.000000 3.999878 FORMAT "%8.6"
 /begin AXIS_DESCR STD_AXIS APSCD_pVal Pres_hPa 2 0.00 3500.000 FORMAT "%8.3" EXTENDED_LIMITS -32768.00 32767.00 DEPOSIT ABSOLUTE /end AXIS_DESCR
/end CHARACTERISTIC
/begin CHARACTERISTIC PCR_facD_MAP "Kennfeld für Adaptionsfaktor der D-Verstärkung" MAP 0x1EBEDE Kf_Xs16_Ys16_Ws16 3.989990 Fact 0.00 3.989990 FORMAT "%8.6" EXTENDED_LIMITS -4.000000 3.999878
 /begin AXIS_DESCR STD_AXIS Eng_nAvrg EngN 10 0.00 6000.000 FORMAT "%8.3" EXTENDED_LIMITS -32768.00 32767.00 DEPOSIT ABSOLUTE /end AXIS_DESCR
 /begin AXIS_DESCR STD_AXIS InjCtl_qCurr InjMass 10 0.00 327.6700 FORMAT "%8.4" EXTENDED_LIMITS -327.6800 327.6700 DEPOSIT ABSOLUTE /end AXIS_DESCR
/end CHARACTERISTIC
/begin CHARACTERISTIC PCR_facEAT_CUR "Umgebungslufttemperaturabhängiger Korrekturfaktor für Sollwertbildung" CURVE 0x1EAE56 Kl_Xs16_Ws16 3.000000 Fact 0.00 3.000000 FORMAT "%8.6" EXTENDED_LIMITS -4.000000 3.999878
 /begin AXIS_DESCR STD_AXIS EATSCD_tAir Temp_Cels 6 -50.14000 199.8600 FORMAT "%8.4" EXTENDED_LIMITS -3549.940 3003.560 DEPOSIT ABSOLUTE /end AXIS_DESCR
/end CHARACTERISTIC
/begin CHARACTERISTIC PCR_facI_MAP "Kennfeld für Adaptionsfaktor der I-Verstärkung" MAP 0x1EBFD2 Kf_Xs16_Ys16_Ws16 3.989990 Fact 0.00 3.989990 FORMAT "%8.6" EXTENDED_LIMITS -4.000000 3.999878
 /begin AXIS_DESCR STD_AXIS Eng_nAvrg EngN 10 0.00 6000.000 FORMAT "%8.3" EXTENDED_LIMITS -32768.00 32767.00 DEPOSIT ABSOLUTE /end AXIS_DESCR
 /begin AXIS_DESCR STD_AXIS InjCtl_qCurr InjMass 10 0.00 327.6700 FORMAT "%8.4" EXTENDED_LIMITS -327.6800 327.6700 DEPOSIT ABSOLUTE /end AXIS_DESCR
/end CHARACTERISTIC
/begin CHARACTERISTIC PCR_facPAltCorr2_C "Umrechnungsfaktor Umgebungsdruck  zu Druck vor Verdichter Luftsystem 2" VALUE 0x1E91FC Kw_Wr32 0.300000000 OneToOne 0.00 0.300000000 FORMAT "%11.9" EXTENDED_LIMITS -1.00000000E+37 1.00000000E+37 /end CHARACTERISTIC
/begin CHARACTERISTIC PCR_facPAltCorr_C "Umrechnungsfaktor Umgebungsdruck  zu Druck vor Verdichter Luftsystem 1" VALUE 0x1E9200 Kw_Wr32 0.300000000 OneToOne 0.00 0.300000000 FORMAT "%11.9" EXTENDED_LIMITS -1.00000000E+37 1.00000000E+37 /end CHARACTERISTIC
/begin CHARACTERISTIC PCR_facP_MAP "Kennfeld für Adaptionsfaktor der P-Verstärkung" MAP 0x1EC0C6 Kf_Xs16_Ys16_Ws16 3.989990 Fact 0.00 3.989990 FORMAT "%8.6" EXTENDED_LIMITS -4.000000 3.999878
 /begin AXIS_DESCR STD_AXIS Eng_nAvrg EngN 10 0.00 6000.000 FORMAT "%8.3" EXTENDED_LIMITS -32768.00 32767.00 DEPOSIT ABSOLUTE /end AXIS_DESCR
 /begin AXIS_DESCR STD_AXIS InjCtl_qCurr InjMass 10 0.00 327.6700 FORMAT "%8.4" EXTENDED_LIMITS -327.6800 327.6700 DEPOSIT ABSOLUTE /end AXIS_DESCR
/end CHARACTERISTIC
/begin CHARACTERISTIC PCR_facShftUpCor_MAP "Korrekturkennfeld des erlaubten Ladedrucks bei Hochschaltung" MAP 0x1E9204 Kf_Xs16_Ys16_Ws16 1.000000 Fact1000 -1.000000 0.00 FORMAT "%8.6" EXTENDED_LIMITS -32.76800 32.76700
 /begin AXIS_DESCR STD_AXIS Eng_nAvrg EngN 10 0.00 6000.000 FORMAT "%8.3" EXTENDED_LIMITS -32768.00 32767.00 DEPOSIT ABSOLUTE /end AXIS_DESCR
 /begin AXIS_DESCR STD_AXIS BPSCD_pFltVal Pres_hPa 10 0.00 3500.000 FORMAT "%8.3" EXTENDED_LIMITS -32768.00 32767.00 DEPOSIT ABSOLUTE /end AXIS_DESCR
/end CHARACTERISTIC
/begin CHARACTERISTIC PCR_IKi_C "Grundwert der I-Verstärkung des PIDT1-Reglers bei Kleinsignalen" VALUE 0x1EC1BC Kw_Wu32 100.000000093 Ki_Pres_hPa2Prc 0.00 100.000000093 FORMAT "%13.9" EXTENDED_LIMITS 0.00 9999.99999767 /end CHARACTERISTIC
/begin CHARACTERISTIC PCR_IKiPos_C "Grundwert der I-Verstärkung des PIDT1-Reglers bei positiven Großsignalen" VALUE 0x1EC1C0 Kw_Wu32 100.000000093 Ki_Pres_hPa2Prc 0.00 100.000000093 FORMAT "%13.9" EXTENDED_LIMITS 0.00 9999.99999767 /end CHARACTERISTIC
/begin CHARACTERISTIC PCR_IKiNeg_C "Grundwert der I-Verstärkung des PIDT1-Reglers bei negativen Großsignalen" VALUE 0x1EC1C4 Kw_Wu32 100.000000093 Ki_Pres_hPa2Prc 0.00 100.000000093 FORMAT "%13.9" EXTENDED_LIMITS 0.00 9999.99999767 /end CHARACTERISTIC
/begin CHARACTERISTIC PCR_pIWinPos_C "Obere Kleinsignalgrenze für das I-Glied des PIDT1-Reglers" VALUE 0x1EC1C8 Kw_Ws16 65535.00 Pres_hPa -32768.00 32767.00 FORMAT "%8.2" /end CHARACTERISTIC
/begin CHARACTERISTIC PCR_pIWinNeg_C "Untere Kleinsignalgrenze für das I-Glied des PIDT1-Reglers" VALUE 0x1EC1CA Kw_Ws16 65535.00 Pres_hPa -32768.00 32767.00 FORMAT "%8.2" /end CHARACTERISTIC
/begin CHARACTERISTIC PCR_kdfacDT1BPAlt_C "Verstärkungskonstante des DT1 Vorfilters für Drehzahlbegrenzung in großer Höhe" VALUE 0x1E92F8 Kw_Ws32 0.0400000000000 Kd_TurboN2Fact1000 0.00 0.0400000000000 FORMAT "%15.13" EXTENDED_LIMITS -3.27680000000 3.27679999847 /end CHARACTERISTIC
/begin CHARACTERISTIC PCR_nAvrgMax_C "Drehzahlschwelle zur Schuberkennung bei der noise suppression_Maßnahme" VALUE 0x1EC1CC Kw_Ws16 6000.000 EngN 0.00 6000.000 FORMAT "%8.3" EXTENDED_LIMITS -32768.00 32767.00 /end CHARACTERISTIC
/begin CHARACTERISTIC PCR_nCoStart_C "untere Drehzahlgrenze für Kaltstarterkennung-Vorgabewert" VALUE 0x1EC98C Kw_Ws16 65535.00 EngN -32768.00 32767.00 FORMAT "%8.2" /end CHARACTERISTIC
/begin CHARACTERISTIC PCR_nGearChngMax_C "Drehzahlschwelle zur Schuberkennung im noise suppression-Fall" VALUE 0x1EC1CE Kw_Ws16 6000.000 EngN 0.00 6000.000 FORMAT "%8.3" EXTENDED_LIMITS -32768.00 32767.00 /end CHARACTERISTIC
/begin CHARACTERISTIC PCR_nTrbn2_MAP "Verdichterkennfeld" MAP 0x1E92FC Kf_Xr32_Yr32_Wr32 300000.000 TrbChN_float 0.00 300000.000 FORMAT "%10.3" EXTENDED_LIMITS -1.00000000E+37 1.00000000E+37
 /begin AXIS_DESCR STD_AXIS PCR_facBPAltCorr2_mp OneToOne 16 0.00 6.55000000 FORMAT "%10.8" EXTENDED_LIMITS -1.00000000E+37 1.00000000E+37 DEPOSIT ABSOLUTE /end AXIS_DESCR
 /begin AXIS_DESCR STD_AXIS PCR_dmAirAltCorrFl2_mp AirmassPerTime_float 16 0.00 1400.00000 FORMAT "%10.5" EXTENDED_LIMITS -1.00000000E+37 1.00000000E+37 DEPOSIT ABSOLUTE /end AXIS_DESCR
/end CHARACTERISTIC
/begin CHARACTERISTIC PCR_nTrbnLim_C "Schwelle ab der Differenzierer  aktiv wird" VALUE 0x1E978C Kw_Ws16 170000.0 TurboN 80000.00 250000.0 FORMAT "%8.1" EXTENDED_LIMITS -327680.0 327670.0 /end CHARACTERISTIC
/begin CHARACTERISTIC PCR_nTrbnMax_CUR "maximale Laderdrehzahl" CURVE 0x1E978E Kl_Xs16_Ws16 250000.0 TurboN 0.00 250000.0 FORMAT "%8.1" EXTENDED_LIMITS -327680.0 327670.0
 /begin AXIS_DESCR STD_AXIS Eng_nAvrg EngN 8 0.00 5000.000 FORMAT "%8.3" EXTENDED_LIMITS -32768.00 32767.00 DEPOSIT ABSOLUTE /end AXIS_DESCR
/end CHARACTERISTIC
/begin CHARACTERISTIC PCR_nTrbn_MAP "Verdichterkennfeld zu Ermittlung der Laderdrehzahl" MAP 0x1E97B0 Kf_Xr32_Yr32_Wr32 300000.000 TrbChN_float 0.00 300000.000 FORMAT "%10.3" EXTENDED_LIMITS -1.00000000E+37 1.00000000E+37
 /begin AXIS_DESCR STD_AXIS PCR_facBPAltCorr_mp OneToOne 16 0.00 6.55000000 FORMAT "%10.8" EXTENDED_LIMITS -1.00000000E+37 1.00000000E+37 DEPOSIT ABSOLUTE /end AXIS_DESCR
 /begin AXIS_DESCR STD_AXIS PCR_dmAirAltCorrFl_mp AirmassPerTime_float 16 0.00 1400.00000 FORMAT "%10.5" EXTENDED_LIMITS -1.00000000E+37 1.00000000E+37 DEPOSIT ABSOLUTE /end AXIS_DESCR
/end CHARACTERISTIC
/begin CHARACTERISTIC PCR_nWrkSph1_C "obere Drehzahlgrenze des Arbeitsbereiches 1" VALUE 0x1EC98E Kw_Ws16 8000.000 EngN 0.00 8000.000 FORMAT "%8.3" EXTENDED_LIMITS -32768.00 32767.00 /end CHARACTERISTIC
/begin CHARACTERISTIC PCR_nWrkSph2_C "Drehzahlgrenze zwischen den Arbeitsbereichen 2 und 3" VALUE 0x1EC990 Kw_Ws16 8000.000 EngN 0.00 8000.000 FORMAT "%8.3" EXTENDED_LIMITS -32768.00 32767.00 /end CHARACTERISTIC
/begin CHARACTERISTIC PCR_nWrkSph3_C "Drehzahlgrenze zwischen den Arbeitsbereichen 3 und 4" VALUE 0x1EC992 Kw_Ws16 8000.000 EngN 0.00 8000.000 FORMAT "%8.3" EXTENDED_LIMITS -32768.00 32767.00 /end CHARACTERISTIC
/begin CHARACTERISTIC PCR_pAirAltCorr2_C "Referenzdruck für Ladedrucksensor 2" VALUE 0x1E9C40 Kw_Wr32 4000.00000 Pres_hPa_float 0.00 4000.00000 FORMAT "%10.5" EXTENDED_LIMITS -1.00000000E+37 1.00000000E+37 /end CHARACTERISTIC
/begin CHARACTERISTIC PCR_pAirAltCorr_C "Referenz Luftdruck" VALUE 0x1E9C44 Kw_Wr32 4000.00000 Pres_hPa_float 0.00 4000.00000 FORMAT "%10.5" EXTENDED_LIMITS -1.00000000E+37 1.00000000E+37 /end CHARACTERISTIC
/begin CHARACTERISTIC PCR_pAPQCmpn_MAP "Kennfeld für atmosphärendruckabhängige Kompensation für Sollwertberechnung" MAP 0x1EAE70 Kf_Xs16_Ys16_Ws16 8000.000 Pres_hPa -4000.000 4000.000 FORMAT "%8.3" EXTENDED_LIMITS -32768.00 32767.00
 /begin AXIS_DESCR STD_AXIS APSCD_pVal Pres_hPa 9 0.00 3500.000 FORMAT "%8.3" EXTENDED_LIMITS -32768.00 32767.00 DEPOSIT ABSOLUTE /end AXIS_DESCR
 /begin AXIS_DESCR STD_AXIS PCR_qDes InjMass 9 0.00 327.6700 FORMAT "%8.4" EXTENDED_LIMITS -327.6800 327.6700 DEPOSIT ABSOLUTE /end AXIS_DESCR
/end CHARACTERISTIC
/begin CHARACTERISTIC PCR_pBDesBas2_MAP "Kennfeld für die Grundwertbestimmung des Ladedruckbasissollwerts" MAP 0x1EAF3A Kf_Xs16_Ys16_Ws16 4000.000 Pres_hPa 0.00 4000.000 FORMAT "%8.3" EXTENDED_LIMITS -32768.00 32767.00
 /begin AXIS_DESCR STD_AXIS Eng_nAvrg EngN 16 0.00 6000.000 FORMAT "%8.3" EXTENDED_LIMITS -32768.00 32767.00 DEPOSIT ABSOLUTE /end AXIS_DESCR
 /begin AXIS_DESCR STD_AXIS PCR_qDes InjMass 10 0.00 327.6700 FORMAT "%8.4" EXTENDED_LIMITS -327.6800 327.6700 DEPOSIT ABSOLUTE /end AXIS_DESCR
/end CHARACTERISTIC
/begin CHARACTERISTIC PCR_pBDesBas_MAP "Kennfeld für die Grundwertbestimmung des Ladedruckbasissollwerts" MAP 0x1EB0B2 Kf_Xs16_Ys16_Ws16 4000.000 Pres_hPa 0.00 4000.000 FORMAT "%8.3" EXTENDED_LIMITS -32768.00 32767.00
 /begin AXIS_DESCR STD_AXIS Eng_nAvrg EngN 16 0.00 6000.000 FORMAT "%8.3" EXTENDED_LIMITS -32768.00 32767.00 DEPOSIT ABSOLUTE /end AXIS_DESCR
 /begin AXIS_DESCR STD_AXIS PCR_qDes InjMass 10 0.00 327.6700 FORMAT "%8.4" EXTENDED_LIMITS -327.6800 327.6700 DEPOSIT ABSOLUTE /end AXIS_DESCR
/end CHARACTERISTIC
/begin CHARACTERISTIC PCR_pBDesMaxAP_MAP "Größter erlaubter Ladedrucksollwert in Abhängigkeit vom Luftdruck" MAP 0x1EB22A Kf_Xs16_Ys16_Ws16 4000.000 Pres_hPa 0.00 4000.000 FORMAT "%8.3" EXTENDED_LIMITS -32768.00 32767.00
 /begin AXIS_DESCR STD_AXIS Eng_nAvrg EngN 16 0.00 6000.000 FORMAT "%8.3" EXTENDED_LIMITS -32768.00 32767.00 DEPOSIT ABSOLUTE /end AXIS_DESCR
 /begin AXIS_DESCR STD_AXIS APSCD_pVal Pres_hPa 10 0.00 3500.000 FORMAT "%8.3" EXTENDED_LIMITS -32768.00 32767.00 DEPOSIT ABSOLUTE /end AXIS_DESCR
/end CHARACTERISTIC
/begin CHARACTERISTIC PCR_pBDesMax_C "Größter erlaubter Ladedrucksollwert" VALUE 0x1EB3A2 Kw_Ws16 4000.000 Pres_hPa 0.00 4000.000 FORMAT "%8.3" EXTENDED_LIMITS -32768.00 32767.00 /end CHARACTERISTIC
/begin CHARACTERISTIC PCR_pBDesMin_C "Kleinster erlaubter Ladedrucksollwert" VALUE 0x1EB3A4 Kw_Ws16 4000.000 Pres_hPa 0.00 4000.000 FORMAT "%8.3" EXTENDED_LIMITS -32768.00 32767.00 /end CHARACTERISTIC
/begin CHARACTERISTIC PCR_pBDesRgn1a_MAP "Kennfeld für den Sollwert A der Partikelfilterregeneration 1" MAP 0x1EB3A6 Kf_Xs16_Ys16_Ws16 4000.000 Pres_hPa 0.00 4000.000 FORMAT "%8.3" EXTENDED_LIMITS -32768.00 32767.00
 /begin AXIS_DESCR STD_AXIS Eng_nAvrg EngN 10 0.00 6000.000 FORMAT "%8.3" EXTENDED_LIMITS -32768.00 32767.00 DEPOSIT ABSOLUTE /end AXIS_DESCR
 /begin AXIS_DESCR STD_AXIS PCR_qDes InjMass 10 0.00 327.6700 FORMAT "%8.4" EXTENDED_LIMITS -327.6800 327.6700 DEPOSIT ABSOLUTE /end AXIS_DESCR
/end CHARACTERISTIC
/begin CHARACTERISTIC PCR_pBDesRgn1b_MAP "Kennfeld für den Sollwert B der Partikelfilterregeneration 1" MAP 0x1EB49A Kf_Xs16_Ys16_Ws16 4000.000 Pres_hPa 0.00 4000.000 FORMAT "%8.3" EXTENDED_LIMITS -32768.00 32767.00
 /begin AXIS_DESCR STD_AXIS Eng_nAvrg EngN 12 0.00 6000.000 FORMAT "%8.3" EXTENDED_LIMITS -32768.00 32767.00 DEPOSIT ABSOLUTE /end AXIS_DESCR
 /begin AXIS_DESCR STD_AXIS PCR_qDes InjMass 12 0.00 327.6700 FORMAT "%8.4" EXTENDED_LIMITS -327.6800 327.6700 DEPOSIT ABSOLUTE /end AXIS_DESCR
/end CHARACTERISTIC
/begin CHARACTERISTIC PCR_pBDesRgn2a_MAP "Kennfeld für den Sollwert A der Partikelfilterregeneration 2" MAP 0x1EB5EE Kf_Xs16_Ys16_Ws16 4000.000 Pres_hPa 0.00 4000.000 FORMAT "%8.3" EXTENDED_LIMITS -32768.00 32767.00
 /begin AXIS_DESCR STD_AXIS Eng_nAvrg EngN 10 0.00 6000.000 FORMAT "%8.3" EXTENDED_LIMITS -32768.00 32767.00 DEPOSIT ABSOLUTE /end AXIS_DESCR
 /begin AXIS_DESCR STD_AXIS PCR_qDes InjMass 10 0.00 327.6700 FORMAT "%8.4" EXTENDED_LIMITS -327.6800 327.6700 DEPOSIT ABSOLUTE /end AXIS_DESCR
/end CHARACTERISTIC
/begin CHARACTERISTIC PCR_pBDesRgn2b_MAP "Kennfeld für den Sollwert B der Partikelfilterregeneration 2" MAP 0x1EB6E2 Kf_Xs16_Ys16_Ws16 4000.000 Pres_hPa 0.00 4000.000 FORMAT "%8.3" EXTENDED_LIMITS -32768.00 32767.00
 /begin AXIS_DESCR STD_AXIS Eng_nAvrg EngN 12 0.00 6000.000 FORMAT "%8.3" EXTENDED_LIMITS -32768.00 32767.00 DEPOSIT ABSOLUTE /end AXIS_DESCR
 /begin AXIS_DESCR STD_AXIS PCR_qDes InjMass 12 0.00 327.6700 FORMAT "%8.4" EXTENDED_LIMITS -327.6800 327.6700 DEPOSIT ABSOLUTE /end AXIS_DESCR
/end CHARACTERISTIC
/begin CHARACTERISTIC PCR_pBDesRgn3a_MAP "Sollwert Regenerationsstufe 3 bei Atmosphärendruck ""a""" MAP 0x1EB836 Kf_Xs16_Ys16_Ws16 4000.000 Pres_hPa 0.00 4000.000 FORMAT "%8.3" EXTENDED_LIMITS -32768.00 32767.00
 /begin AXIS_DESCR STD_AXIS Eng_nAvrg EngN 16 0.00 6000.000 FORMAT "%8.3" EXTENDED_LIMITS -32768.00 32767.00 DEPOSIT ABSOLUTE /end AXIS_DESCR
 /begin AXIS_DESCR STD_AXIS PCR_qDes InjMass 16 0.00 327.6700 FORMAT "%8.4" EXTENDED_LIMITS -327.6800 327.6700 DEPOSIT ABSOLUTE /end AXIS_DESCR
/end CHARACTERISTIC
/begin CHARACTERISTIC PCR_pBDesRgn3b_MAP "Sollwert Regenerationsstufe 3 bei Atmosphärendruck ""b""" MAP 0x1EBA7A Kf_Xs16_Ys16_Ws16 4000.000 Pres_hPa 0.00 4000.000 FORMAT "%8.3" EXTENDED_LIMITS -32768.00 32767.00
 /begin AXIS_DESCR STD_AXIS Eng_nAvrg EngN 16 0.00 6000.000 FORMAT "%8.3" EXTENDED_LIMITS -32768.00 32767.00 DEPOSIT ABSOLUTE /end AXIS_DESCR
 /begin AXIS_DESCR STD_AXIS PCR_qDes InjMass 16 0.00 327.6700 FORMAT "%8.4" EXTENDED_LIMITS -327.6800 327.6700 DEPOSIT ABSOLUTE /end AXIS_DESCR
/end CHARACTERISTIC
/begin CHARACTERISTIC PCR_pBDesRgnCor1_MAP "Erstes Regenerationskennfeld zur Korrektur des Ladedruckbasissollwerts" MAP 0x1EBCBE Kf_Xs16_Ys16_Ws16 4000.000 Pres_hPa 0.00 4000.000 FORMAT "%8.3" EXTENDED_LIMITS -32768.00 32767.00
 /begin AXIS_DESCR STD_AXIS PCR_pBDes1_mp Pres_hPa 2 0.00 4000.000 FORMAT "%8.3" EXTENDED_LIMITS -32768.00 32767.00 DEPOSIT ABSOLUTE /end AXIS_DESCR
 /begin AXIS_DESCR STD_AXIS PFlt_pPre Pres_hPa 2 0.00 4000.000 FORMAT "%8.3" EXTENDED_LIMITS -32768.00 32767.00 DEPOSIT ABSOLUTE /end AXIS_DESCR
/end CHARACTERISTIC
/begin CHARACTERISTIC PCR_pBDesRgnCor2_MAP "Zweites Regenerationskennfeld zur Korrektur des Ladedruckbasissollwerts" MAP 0x1EBCD2 Kf_Xs16_Ys16_Ws16 4000.000 Pres_hPa 0.00 4000.000 FORMAT "%8.3" EXTENDED_LIMITS -32768.00 32767.00
 /begin AXIS_DESCR STD_AXIS PCR_pBDes2_mp Pres_hPa 2 0.00 4000.000 FORMAT "%8.3" EXTENDED_LIMITS -32768.00 32767.00 DEPOSIT ABSOLUTE /end AXIS_DESCR
 /begin AXIS_DESCR STD_AXIS PFlt_pPre Pres_hPa 2 0.00 4000.000 FORMAT "%8.3" EXTENDED_LIMITS -32768.00 32767.00 DEPOSIT ABSOLUTE /end AXIS_DESCR
/end CHARACTERISTIC
/begin CHARACTERISTIC PCR_pBDesRgnCor3_MAP "Abgasdruck abhängiger Korrekturwert Regenerationsstufe 3" MAP 0x1EBCE6 Kf_Xs16_Ys16_Ws16 4000.000 Pres_hPa 0.00 4000.000 FORMAT "%8.3" EXTENDED_LIMITS -32768.00 32767.00
 /begin AXIS_DESCR STD_AXIS PCR_pBDes3_mp Pres_hPa 2 0.00 4000.000 FORMAT "%8.3" EXTENDED_LIMITS -32768.00 32767.00 DEPOSIT ABSOLUTE /end AXIS_DESCR
 /begin AXIS_DESCR STD_AXIS PFlt_pPre Pres_hPa 2 0.00 4000.000 FORMAT "%8.3" EXTENDED_LIMITS -32768.00 32767.00 DEPOSIT ABSOLUTE /end AXIS_DESCR
/end CHARACTERISTIC
/begin CHARACTERISTIC PCR_pBGDevMax_CUR "maximale Regelabweichung, abhängig von Wasser- der Öltemperatur" CURVE 0x1EC994 Kl_Xs16_Ws16 3500.000 Pres_hPa 0.00 3500.000 FORMAT "%8.3" EXTENDED_LIMITS -32768.00 32767.00
 /begin AXIS_DESCR STD_AXIS PCR_tGDevMax_mp Temp_Cels 10 -50.14000 199.8600 FORMAT "%8.4" EXTENDED_LIMITS -3549.940 3003.560 DEPOSIT ABSOLUTE /end AXIS_DESCR
/end CHARACTERISTIC
/begin CHARACTERISTIC PCR_pBGDevMin_C "untere Grenze der erlaubten Regelabwichung" VALUE 0x1EC9BE Kw_Ws16 65535.00 Pres_hPa -32768.00 32767.00 FORMAT "%8.2" /end CHARACTERISTIC
/begin CHARACTERISTIC PCR_pDWinNeg_C "Untere Kleinsignalgrenze für das DT1-Glied des PIDT1-Reglers" VALUE 0x1EC1D0 Kw_Ws16 10000.00 Pres_hPa -5000.000 5000.000 FORMAT "%8.3" EXTENDED_LIMITS -32768.00 32767.00 /end CHARACTERISTIC
/begin CHARACTERISTIC PCR_pDWinPos_C "Obere Kleinsignalgrenze für das DT1-Glied des PIDT1-Reglers" VALUE 0x1EC1D2 Kw_Ws16 10000.00 Pres_hPa -5000.000 5000.000 FORMAT "%8.3" EXTENDED_LIMITS -32768.00 32767.00 /end CHARACTERISTIC
/begin CHARACTERISTIC PCR_pLim_C "Maximaler Ladedruck im Notfahrmodus" VALUE 0x1E9C48 Kw_Ws16 3500.000 Pres_hPa 0.00 3500.000 FORMAT "%8.3" EXTENDED_LIMITS -32768.00 32767.00 /end CHARACTERISTIC
/begin CHARACTERISTIC PCR_pNQCtCmpn_MAP "Kennfeld für Kühlwassertemperaturkorrekturwert für Sollwertberechnung" MAP 0x1EBCFA Kf_Xs16_Ys16_Ws16 4000.000 Pres_hPa 0.00 4000.000 FORMAT "%8.3" EXTENDED_LIMITS -32768.00 32767.00
 /begin AXIS_DESCR STD_AXIS Eng_nAvrg EngN 8 0.00 6000.000 FORMAT "%8.3" EXTENDED_LIMITS -32768.00 32767.00 DEPOSIT ABSOLUTE /end AXIS_DESCR
 /begin AXIS_DESCR STD_AXIS PCR_qDes InjMass 8 0.00 327.6700 FORMAT "%8.4" EXTENDED_LIMITS -327.6800 327.6700 DEPOSIT ABSOLUTE /end AXIS_DESCR
/end CHARACTERISTIC
/begin CHARACTERISTIC PCR_PKp_C "Grundwert der P-Verstärkung des PIDT1-Reglers bei Kleinsignalen" VALUE 0x1EC1D4 Kw_Wu32 100.000000000 Kp_Pres_hPa2Prc 0.00 100.000000000 FORMAT "%13.9" EXTENDED_LIMITS 0.00 655.359999847 /end CHARACTERISTIC
/begin CHARACTERISTIC PCR_PKpPos_C "Grundwert der P-Verstärkung des PIDT1-Reglers bei positiven Großsignalen" VALUE 0x1EC1D8 Kw_Wu32 100.000000000 Kp_Pres_hPa2Prc 0.00 100.000000000 FORMAT "%13.9" EXTENDED_LIMITS 0.00 655.359999847 /end CHARACTERISTIC
/begin CHARACTERISTIC PCR_PKpNeg_C "Grundwert der P-Verstärkung des PIDT1-Reglers bei negativen Großsignalen" VALUE 0x1EC1DC Kw_Wu32 100.000000000 Kp_Pres_hPa2Prc 0.00 100.000000000 FORMAT "%13.9" EXTENDED_LIMITS 0.00 655.359999847 /end CHARACTERISTIC
/begin CHARACTERISTIC PCR_pPWinPos_C "Obere Kleinsignalgrenze für das P-Glied des PIDT1-Reglers" VALUE 0x1EC1E0 Kw_Ws16 65535.00 Pres_hPa -32768.00 32767.00 FORMAT "%8.2" /end CHARACTERISTIC
/begin CHARACTERISTIC PCR_pPWinNeg_C "Untere Kleinsignalgrenze für das P-Glied des PIDT1-Reglers" VALUE 0x1EC1E2 Kw_Ws16 65535.00 Pres_hPa -32768.00 32767.00 FORMAT "%8.2" /end CHARACTERISTIC
/begin CHARACTERISTIC PCR_qBPDemMax_C "Einsprítzmengenschwelle für die Deaktivierung der Anti-Kaudern-Maßnahme" VALUE 0x1EC1E4 Kw_Ws16 327.6700 InjMass 0.00 327.6700 FORMAT "%8.4" EXTENDED_LIMITS -327.6800 327.6700 /end CHARACTERISTIC
/begin CHARACTERISTIC PCR_qGearChngDesMin_C "Einspritzmengenschwelle zur Gangschaltungserkennung im noise suppression-Fall" VALUE 0x1EC1E6 Kw_Ws16 100.0000 InjMass 0.00 100.0000 FORMAT "%8.4" EXTENDED_LIMITS -327.6800 327.6700 /end CHARACTERISTIC
/begin CHARACTERISTIC PCR_qGearChngMin_C "Einspritzmengenschwelle zur Gangschaltungserkennung im noise suppression-Fall" VALUE 0x1EC1E8 Kw_Ws16 100.0000 InjMass 0.00 100.0000 FORMAT "%8.4" EXTENDED_LIMITS -327.6800 327.6700 /end CHARACTERISTIC
/begin CHARACTERISTIC PCR_qMinBPGovFlt_CUR "Minimale Einspritzmenge zur Aktivierung der Ladergeräuschunterdrückung" CURVE 0x1EC1EA Kl_Xs16_Ws16 327.6700 InjMass 0.00 327.6700 FORMAT "%8.4" EXTENDED_LIMITS -327.6800 327.6700
 /begin AXIS_DESCR STD_AXIS Eng_nAvrg EngN 5 0.00 6000.000 FORMAT "%8.3" EXTENDED_LIMITS -32768.00 32767.00 DEPOSIT ABSOLUTE /end AXIS_DESCR
/end CHARACTERISTIC
/begin CHARACTERISTIC PCR_qRgtOff1_CUR "Mengenkennlinie für Reglerabschaltschwelle in Abhängigkeit von der Drehzahl bei EGT-Status gleich Regenerationsmaske 1" CURVE 0x1EC200 Kl_Xs16_Ws16 327.6700 InjMass 0.00 327.6700 FORMAT "%8.4" EXTENDED_LIMITS -327.6800 327.6700
 /begin AXIS_DESCR STD_AXIS Eng_nAvrg EngN 5 0.00 6000.000 FORMAT "%8.3" EXTENDED_LIMITS -32768.00 32767.00 DEPOSIT ABSOLUTE /end AXIS_DESCR
/end CHARACTERISTIC
/begin CHARACTERISTIC PCR_qRgtOff2_CUR "Mengenkennlinie für Reglerabschaltschwelle in Abhängigkeit von der Drehzahl bei EGT-Status gleich Regenerationsmaske 2" CURVE 0x1EC216 Kl_Xs16_Ws16 327.6700 InjMass 0.00 327.6700 FORMAT "%8.4" EXTENDED_LIMITS -327.6800 327.6700
 /begin AXIS_DESCR STD_AXIS Eng_nAvrg EngN 5 0.00 6000.000 FORMAT "%8.3" EXTENDED_LIMITS -32768.00 32767.00 DEPOSIT ABSOLUTE /end AXIS_DESCR
/end CHARACTERISTIC
/begin CHARACTERISTIC PCR_qRgtOff3_CUR "Mengenkennlinie für Reglerabschaltschwelle in Abhängigkeit von der Drehzahl bei EGT-Status gleich Regenerationsmaske 3" CURVE 0x1EC22C Kl_Xs16_Ws16 327.6700 InjMass 0.00 327.6700 FORMAT "%8.4" EXTENDED_LIMITS -327.6800 327.6700
 /begin AXIS_DESCR STD_AXIS Eng_nAvrg EngN 5 0.00 6000.000 FORMAT "%8.3" EXTENDED_LIMITS -32768.00 32767.00 DEPOSIT ABSOLUTE /end AXIS_DESCR
/end CHARACTERISTIC
/begin CHARACTERISTIC PCR_qRgtOff_CUR "Mengenkennlinie für Reglerabschaltschwelle in Abhängigkeit von der Drehzahl" CURVE 0x1EC242 Kl_Xs16_Ws16 327.6700 InjMass 0.00 327.6700 FORMAT "%8.4" EXTENDED_LIMITS -327.6800 327.6700
 /begin AXIS_DESCR STD_AXIS Eng_nAvrg EngN 25 0.00 6000.000 FORMAT "%8.3" EXTENDED_LIMITS -32768.00 32767.00 DEPOSIT ABSOLUTE /end AXIS_DESCR
/end CHARACTERISTIC
/begin CHARACTERISTIC PCR_qRgtOn1_CUR "Mengenkennlinie für Reglereinschaltschwelle in Abhängigkeit von der Drehzahl bei EGT-Status gleich Regenerationsmaske 1" CURVE 0x1EC2A8 Kl_Xs16_Ws16 327.6700 InjMass 0.00 327.6700 FORMAT "%8.4" EXTENDED_LIMITS -327.6800 327.6700
 /begin AXIS_DESCR STD_AXIS Eng_nAvrg EngN 5 0.00 6000.000 FORMAT "%8.3" EXTENDED_LIMITS -32768.00 32767.00 DEPOSIT ABSOLUTE /end AXIS_DESCR
/end CHARACTERISTIC
/begin CHARACTERISTIC PCR_qRgtOn2_CUR "Mengenkennlinie für Reglereinschaltschwelle in Abhängigkeit von der Drehzahl bei EGT-Status gleich Regenerationsmaske 2" CURVE 0x1EC2BE Kl_Xs16_Ws16 327.6700 InjMass 0.00 327.6700 FORMAT "%8.4" EXTENDED_LIMITS -327.6800 327.6700
 /begin AXIS_DESCR STD_AXIS Eng_nAvrg EngN 5 0.00 6000.000 FORMAT "%8.3" EXTENDED_LIMITS -32768.00 32767.00 DEPOSIT ABSOLUTE /end AXIS_DESCR
/end CHARACTERISTIC
/begin CHARACTERISTIC PCR_qRgtOn3_CUR "Mengenkennlinie für Reglereinschaltschwelle in Abhängigkeit von der Drehzahl bei EGT-Status gleich Regenerationsmaske 3" CURVE 0x1EC2D4 Kl_Xs16_Ws16 327.6700 InjMass 0.00 327.6700 FORMAT "%8.4" EXTENDED_LIMITS -327.6800 327.6700
 /begin AXIS_DESCR STD_AXIS Eng_nAvrg EngN 5 0.00 6000.000 FORMAT "%8.3" EXTENDED_LIMITS -32768.00 32767.00 DEPOSIT ABSOLUTE /end AXIS_DESCR
/end CHARACTERISTIC
/begin CHARACTERISTIC PCR_qRgtOn_CUR "Mengenkennlinie für Reglereinschaltschwelle in Abhängigkeit von der Drehzahl" CURVE 0x1EC2EA Kl_Xs16_Ws16 327.6700 InjMass 0.00 327.6700 FORMAT "%8.4" EXTENDED_LIMITS -327.6800 327.6700
 /begin AXIS_DESCR STD_AXIS Eng_nAvrg EngN 25 0.00 6000.000 FORMAT "%8.3" EXTENDED_LIMITS -32768.00 32767.00 DEPOSIT ABSOLUTE /end AXIS_DESCR
/end CHARACTERISTIC
/begin CHARACTERISTIC PCR_qSetUnBalMin_C "Einspritzmengenschwelle zur Schuberkennung im noise suppression-Fall" VALUE 0x1EC350 Kw_Ws16 100.0000 InjMass 0.00 100.0000 FORMAT "%8.4" EXTENDED_LIMITS -327.6800 327.6700 /end CHARACTERISTIC
/begin CHARACTERISTIC PCR_qWrkSph2_C "obere Mengengrenze des Arbeitsbereichs 2" VALUE 0x1EC9C0 Kw_Ws16 200.0000 InjMass 0.00 200.0000 FORMAT "%8.4" EXTENDED_LIMITS -327.6800 327.6700 /end CHARACTERISTIC
/begin CHARACTERISTIC PCR_qWrkSph3_C "Einspritzmengengrenze zwischen den Arbeitsbereichen 2 und 3" VALUE 0x1EC9C2 Kw_Ws16 200.0000 InjMass 0.00 200.0000 FORMAT "%8.4" EXTENDED_LIMITS -327.6800 327.6700 /end CHARACTERISTIC
/begin CHARACTERISTIC PCR_rBPAPRatMin_MAP "Schwelle für den Ladedruck zur Erkennung Schubbetrieb bei der noise suppression-Maßnahme" MAP 0x1EC352 Kf_Xs16_Ys16_Ws16 3.000000 Fact 0.00 3.000000 FORMAT "%8.6" EXTENDED_LIMITS -4.000000 3.999878
 /begin AXIS_DESCR STD_AXIS Eng_nAvrg EngN 6 0.00 6000.000 FORMAT "%8.3" EXTENDED_LIMITS -32768.00 32767.00 DEPOSIT ABSOLUTE /end AXIS_DESCR
 /begin AXIS_DESCR STD_AXIS AFSCD_mAirPerCyl AirMassPerCyl 6 0.00 10000.00 FORMAT "%8.2" EXTENDED_LIMITS -3276.800 3276.700 DEPOSIT ABSOLUTE /end AXIS_DESCR
/end CHARACTERISTIC
/begin CHARACTERISTIC PCR_rBPCtlBas2_MAP "Basissteuerkennfeld für Ladedruck" MAP 0x1E9DF2 Kf_Xs16_Ys16_Ws16 300.0000 Prc -100.0000 200.0000 FORMAT "%8.4" EXTENDED_LIMITS -327.6800 327.6700
 /begin AXIS_DESCR STD_AXIS Eng_nAvrg EngN 16 0.00 6000.000 FORMAT "%8.3" EXTENDED_LIMITS -32768.00 32767.00 DEPOSIT ABSOLUTE /end AXIS_DESCR
 /begin AXIS_DESCR STD_AXIS PCR_qCtl InjMass 13 0.00 200.0000 FORMAT "%8.4" EXTENDED_LIMITS -327.6800 327.6700 DEPOSIT ABSOLUTE /end AXIS_DESCR
/end CHARACTERISTIC
/begin CHARACTERISTIC PCR_rBPCtlBas_MAP "Basissteuerkennfeld für Ladedruck" MAP 0x1E9FD0 Kf_Xs16_Ys16_Ws16 300.0000 Prc -100.0000 200.0000 FORMAT "%8.4" EXTENDED_LIMITS -327.6800 327.6700
 /begin AXIS_DESCR STD_AXIS Eng_nAvrg EngN 16 0.00 6000.000 FORMAT "%8.3" EXTENDED_LIMITS -32768.00 32767.00 DEPOSIT ABSOLUTE /end AXIS_DESCR
 /begin AXIS_DESCR STD_AXIS PCR_qCtl InjMass 13 0.00 200.0000 FORMAT "%8.4" EXTENDED_LIMITS -327.6800 327.6700 DEPOSIT ABSOLUTE /end AXIS_DESCR
/end CHARACTERISTIC
/begin CHARACTERISTIC PCR_rBPCtlGear_MAP "Basissteuerkennfeld für Ladedruck im Leerlauf" MAP 0x1EA1AE Kf_Xs16_Ys16_Ws16 300.0000 Prc -100.0000 200.0000 FORMAT "%8.4" EXTENDED_LIMITS -327.6800 327.6700
 /begin AXIS_DESCR STD_AXIS Eng_nAvrg EngN 16 0.00 6000.000 FORMAT "%8.3" EXTENDED_LIMITS -32768.00 32767.00 DEPOSIT ABSOLUTE /end AXIS_DESCR
 /begin AXIS_DESCR STD_AXIS PCR_qCtl InjMass 10 0.00 200.0000 FORMAT "%8.4" EXTENDED_LIMITS -327.6800 327.6700 DEPOSIT ABSOLUTE /end AXIS_DESCR
/end CHARACTERISTIC
/begin CHARACTERISTIC PCR_rBPCtlInit_C "Initialisierungswert für Steuersignal" VALUE 0x1EA326 Kw_Ws16 655.3500 Prc -327.6800 327.6700 FORMAT "%8.4" /end CHARACTERISTIC
/begin CHARACTERISTIC PCR_rBPCtlRgn1a_MAP "Kennfeld für Steuerwert bei Regenerationsbetrieb 1" MAP 0x1EA328 Kf_Xs16_Ys16_Ws16 100.0000 Prc 0.00 100.0000 FORMAT "%8.4" EXTENDED_LIMITS -327.6800 327.6700
 /begin AXIS_DESCR STD_AXIS Eng_nAvrg EngN 16 0.00 6000.000 FORMAT "%8.3" EXTENDED_LIMITS -32768.00 32767.00 DEPOSIT ABSOLUTE /end AXIS_DESCR
 /begin AXIS_DESCR STD_AXIS PCR_qCtl InjMass 10 0.00 327.6700 FORMAT "%8.4" EXTENDED_LIMITS -327.6800 327.6700 DEPOSIT ABSOLUTE /end AXIS_DESCR
/end CHARACTERISTIC
/begin CHARACTERISTIC PCR_rBPCtlRgn1b_MAP "Kennfeld für Steuerwert bei Regenerationsbetrieb 1" MAP 0x1EA4A0 Kf_Xs16_Ys16_Ws16 100.0000 Prc 0.00 100.0000 FORMAT "%8.4" EXTENDED_LIMITS -327.6800 327.6700
 /begin AXIS_DESCR STD_AXIS Eng_nAvrg EngN 16 0.00 6000.000 FORMAT "%8.3" EXTENDED_LIMITS -32768.00 32767.00 DEPOSIT ABSOLUTE /end AXIS_DESCR
 /begin AXIS_DESCR STD_AXIS PCR_qCtl InjMass 10 0.00 327.6700 FORMAT "%8.4" EXTENDED_LIMITS -327.6800 327.6700 DEPOSIT ABSOLUTE /end AXIS_DESCR
/end CHARACTERISTIC
/begin CHARACTERISTIC PCR_rBPCtlRgn2a_MAP "Kennfeld für Steuerwert bei Regenerationsbetrieb 2" MAP 0x1EA618 Kf_Xs16_Ys16_Ws16 100.0000 Prc 0.00 100.0000 FORMAT "%8.4" EXTENDED_LIMITS -327.6800 327.6700
 /begin AXIS_DESCR STD_AXIS Eng_nAvrg EngN 16 0.00 6000.000 FORMAT "%8.3" EXTENDED_LIMITS -32768.00 32767.00 DEPOSIT ABSOLUTE /end AXIS_DESCR
 /begin AXIS_DESCR STD_AXIS PCR_qCtl InjMass 10 0.00 327.6700 FORMAT "%8.4" EXTENDED_LIMITS -327.6800 327.6700 DEPOSIT ABSOLUTE /end AXIS_DESCR
/end CHARACTERISTIC
/begin CHARACTERISTIC PCR_rBPCtlRgn2b_MAP "Kennfeld für Steuerwert bei Regenerationsbetrieb 2" MAP 0x1EA790 Kf_Xs16_Ys16_Ws16 100.0000 Prc 0.00 100.0000 FORMAT "%8.4" EXTENDED_LIMITS -327.6800 327.6700
 /begin AXIS_DESCR STD_AXIS Eng_nAvrg EngN 16 0.00 6000.000 FORMAT "%8.3" EXTENDED_LIMITS -32768.00 32767.00 DEPOSIT ABSOLUTE /end AXIS_DESCR
 /begin AXIS_DESCR STD_AXIS PCR_qCtl InjMass 10 0.00 327.6700 FORMAT "%8.4" EXTENDED_LIMITS -327.6800 327.6700 DEPOSIT ABSOLUTE /end AXIS_DESCR
/end CHARACTERISTIC
/begin CHARACTERISTIC PCR_rBPCtlRgn3a_MAP "Steuerwert Regenerationsstufe 1 bei Atmosphärendruck ""a""" MAP 0x1EA908 Kf_Xs16_Ys16_Ws16 100.0000 Prc 0.00 100.0000 FORMAT "%8.4" EXTENDED_LIMITS -327.6800 327.6700
 /begin AXIS_DESCR STD_AXIS Eng_nAvrg EngN 16 0.00 6000.000 FORMAT "%8.3" EXTENDED_LIMITS -32768.00 32767.00 DEPOSIT ABSOLUTE /end AXIS_DESCR
 /begin AXIS_DESCR STD_AXIS PCR_qCtl InjMass 10 0.00 327.6700 FORMAT "%8.4" EXTENDED_LIMITS -327.6800 327.6700 DEPOSIT ABSOLUTE /end AXIS_DESCR
/end CHARACTERISTIC
/begin CHARACTERISTIC PCR_rBPCtlRgn3b_MAP "Steuerwert Regenerationsstufe 1 bei Atmosphärendruck ""b""" MAP 0x1EAA80 Kf_Xs16_Ys16_Ws16 100.0000 Prc 0.00 100.0000 FORMAT "%8.4" EXTENDED_LIMITS -327.6800 327.6700
 /begin AXIS_DESCR STD_AXIS Eng_nAvrg EngN 16 0.00 6000.000 FORMAT "%8.3" EXTENDED_LIMITS -32768.00 32767.00 DEPOSIT ABSOLUTE /end AXIS_DESCR
 /begin AXIS_DESCR STD_AXIS PCR_qCtl InjMass 10 0.00 327.6700 FORMAT "%8.4" EXTENDED_LIMITS -327.6800 327.6700 DEPOSIT ABSOLUTE /end AXIS_DESCR
/end CHARACTERISTIC
/begin CHARACTERISTIC PCR_rBPCtlRgnCor1_MAP "Erstes Regenerationskennfeld zur Korrektur des Ladedruckbasissteuerwertes" MAP 0x1EABF8 Kf_Xs16_Ys16_Ws16 100.0000 Prc 0.00 100.0000 FORMAT "%8.4" EXTENDED_LIMITS -327.6800 327.6700
 /begin AXIS_DESCR STD_AXIS PCR_rBPCtl1_mp Prc 2 0.00 100.0000 FORMAT "%8.4" EXTENDED_LIMITS -327.6800 327.6700 DEPOSIT ABSOLUTE /end AXIS_DESCR
 /begin AXIS_DESCR STD_AXIS PFlt_pPre Pres_hPa 2 0.00 4000.000 FORMAT "%8.3" EXTENDED_LIMITS -32768.00 32767.00 DEPOSIT ABSOLUTE /end AXIS_DESCR
/end CHARACTERISTIC
/begin CHARACTERISTIC PCR_rBPCtlRgnCor2_MAP "Zweites Regenerationskennfeld zur Korrektur des Ladedruckbasissteuerwertes" MAP 0x1EAC0C Kf_Xs16_Ys16_Ws16 100.0000 Prc 0.00 100.0000 FORMAT "%8.4" EXTENDED_LIMITS -327.6800 327.6700
 /begin AXIS_DESCR STD_AXIS PCR_rBPCtl2_mp Prc 2 0.00 100.0000 FORMAT "%8.4" EXTENDED_LIMITS -327.6800 327.6700 DEPOSIT ABSOLUTE /end AXIS_DESCR
 /begin AXIS_DESCR STD_AXIS PFlt_pPre Pres_hPa 2 0.00 4000.000 FORMAT "%8.3" EXTENDED_LIMITS -32768.00 32767.00 DEPOSIT ABSOLUTE /end AXIS_DESCR
/end CHARACTERISTIC
/begin CHARACTERISTIC PCR_rBPCtlRgnCor3_MAP "Korrektur abhängig von Druck vor Partikelfilter Regenerationsstufe 3" MAP 0x1EAC20 Kf_Xs16_Ys16_Ws16 100.0000 Prc 0.00 100.0000 FORMAT "%8.4" EXTENDED_LIMITS -327.6800 327.6700
 /begin AXIS_DESCR STD_AXIS PCR_rBPCtl3_mp Prc 2 0.00 100.0000 FORMAT "%8.4" EXTENDED_LIMITS -327.6800 327.6700 DEPOSIT ABSOLUTE /end AXIS_DESCR
 /begin AXIS_DESCR STD_AXIS PFlt_pPre Pres_hPa 2 0.00 4000.000 FORMAT "%8.3" EXTENDED_LIMITS -32768.00 32767.00 DEPOSIT ABSOLUTE /end AXIS_DESCR
/end CHARACTERISTIC
/begin CHARACTERISTIC PCR_rBPGearChngRgn_MAP "PCR Stellerwert während der noise suppression-Gangwechselerkennung und PFlt Regeneration" MAP 0x1EC3B6 Kf_Xs16_Ys16_Ws16 100.0000 Prc 0.00 100.0000 FORMAT "%8.4" EXTENDED_LIMITS -327.6800 327.6700
 /begin AXIS_DESCR STD_AXIS PCR_nAvrgFrz EngN 6 0.00 6000.000 FORMAT "%8.3" EXTENDED_LIMITS -32768.00 32767.00 DEPOSIT ABSOLUTE /end AXIS_DESCR
 /begin AXIS_DESCR STD_AXIS PCR_rBPAPRatFrz Fact 6 0.00 3.000000 FORMAT "%8.6" EXTENDED_LIMITS -4.000000 3.999878 DEPOSIT ABSOLUTE /end AXIS_DESCR
/end CHARACTERISTIC
/begin CHARACTERISTIC PCR_rBPGearChng_C "PCR Stellerwert während der Anti-Kaudern-Gangwechselerkennung nach der Verzögerung" VALUE 0x1EC41A Kw_Wu16 100.0000 Prc 0.00 100.0000 FORMAT "%8.4" EXTENDED_LIMITS 0.00 655.3500 /end CHARACTERISTIC
/begin CHARACTERISTIC PCR_rBPGearChng_MAP "PCR Stellerwert während der noise suppression-Gangwechselerkennung" MAP 0x1EC41C Kf_Xs16_Ys16_Ws16 100.0000 Prc 0.00 100.0000 FORMAT "%8.4" EXTENDED_LIMITS -327.6800 327.6700
 /begin AXIS_DESCR STD_AXIS PCR_nAvrgFrz EngN 6 0.00 6000.000 FORMAT "%8.3" EXTENDED_LIMITS -32768.00 32767.00 DEPOSIT ABSOLUTE /end AXIS_DESCR
 /begin AXIS_DESCR STD_AXIS PCR_rBPAPRatFrz Fact 6 0.00 3.000000 FORMAT "%8.6" EXTENDED_LIMITS -4.000000 3.999878 DEPOSIT ABSOLUTE /end AXIS_DESCR
/end CHARACTERISTIC
/begin CHARACTERISTIC PCR_rBPGovLin2_CUR "Tastverhätnis Linearisierung für Ladedruckregler2" CURVE 0x1EC480 Kl_Xs16_Ws16 100.0000 Prc 0.00 100.0000 FORMAT "%8.4" EXTENDED_LIMITS -327.6800 327.6700
 /begin AXIS_DESCR STD_AXIS PCR_rBPGovUnLin2_mp Prc 21 0.00 100.0000 FORMAT "%8.4" EXTENDED_LIMITS -327.6800 327.6700 DEPOSIT ABSOLUTE /end AXIS_DESCR
/end CHARACTERISTIC
/begin CHARACTERISTIC PCR_rBPGovLin_CUR "Tastverhätnis Linearisierung für Ladedruckregler" CURVE 0x1EC4D6 Kl_Xs16_Ws16 100.0000 Prc 0.00 100.0000 FORMAT "%8.4" EXTENDED_LIMITS -327.6800 327.6700
 /begin AXIS_DESCR STD_AXIS PCR_rBPGovUnLin_mp Prc 21 0.00 100.0000 FORMAT "%8.4" EXTENDED_LIMITS -327.6800 327.6700 DEPOSIT ABSOLUTE /end AXIS_DESCR
/end CHARACTERISTIC
/begin CHARACTERISTIC PCR_rBPGovMax_MAP "Kennfeld zur Bestimmung der maximal zulässigen Stellgröße aus Drehzahl und Einspritzmenge" MAP 0x1EC52C Kf_Xs16_Ys16_Ws16 300.0000 Prc -100.0000 200.0000 FORMAT "%8.4" EXTENDED_LIMITS -327.6800 327.6700
 /begin AXIS_DESCR STD_AXIS Eng_nAvrg EngN 16 0.00 6000.000 FORMAT "%8.3" EXTENDED_LIMITS -32768.00 32767.00 DEPOSIT ABSOLUTE /end AXIS_DESCR
 /begin AXIS_DESCR STD_AXIS InjCtl_qCurr InjMass 10 0.00 327.6700 FORMAT "%8.4" EXTENDED_LIMITS -327.6800 327.6700 DEPOSIT ABSOLUTE /end AXIS_DESCR
/end CHARACTERISTIC
/begin CHARACTERISTIC PCR_rBPGovMin_MAP "Kennfeld zur Bestimmung der minimal zulässigen Stellgröße aus Drehzahl und Einspritzmenge" MAP 0x1EC6A4 Kf_Xs16_Ys16_Ws16 300.0000 Prc -100.0000 200.0000 FORMAT "%8.4" EXTENDED_LIMITS -327.6800 327.6700
 /begin AXIS_DESCR STD_AXIS Eng_nAvrg EngN 16 0.00 6000.000 FORMAT "%8.3" EXTENDED_LIMITS -32768.00 32767.00 DEPOSIT ABSOLUTE /end AXIS_DESCR
 /begin AXIS_DESCR STD_AXIS InjCtl_qCurr InjMass 10 0.00 327.6700 FORMAT "%8.4" EXTENDED_LIMITS -327.6800 327.6700 DEPOSIT ABSOLUTE /end AXIS_DESCR
/end CHARACTERISTIC
/begin CHARACTERISTIC PCR_rBPOvrRunRgn_MAP "PCR Stellerwert während der noise suppression-Schuberkennung und PFlt Regeneration" MAP 0x1EC81C Kf_Xs16_Ys16_Ws16 100.0000 Prc 0.00 100.0000 FORMAT "%8.4" EXTENDED_LIMITS -327.6800 327.6700
 /begin AXIS_DESCR STD_AXIS PCR_nAvrgFrz EngN 6 0.00 6000.000 FORMAT "%8.3" EXTENDED_LIMITS -32768.00 32767.00 DEPOSIT ABSOLUTE /end AXIS_DESCR
 /begin AXIS_DESCR STD_AXIS PCR_rBPAPRatFrz Fact 6 0.00 3.000000 FORMAT "%8.6" EXTENDED_LIMITS -4.000000 3.999878 DEPOSIT ABSOLUTE /end AXIS_DESCR
/end CHARACTERISTIC
/begin CHARACTERISTIC PCR_rBPOvrRun_CUR "PCR Stellerwerte während der Anti-Kaudern-Schuberkennung während der Verzögerung" CURVE 0x1EC880 Kl_Xs16_Ws16 100.0000 Prc 0.00 100.0000 FORMAT "%8.4" EXTENDED_LIMITS -327.6800 327.6700
 /begin AXIS_DESCR STD_AXIS PCR_rBPPT1NS_mp Prc 6 -327.6800 327.6700 FORMAT "%8.4" DEPOSIT ABSOLUTE /end AXIS_DESCR
/end CHARACTERISTIC
/begin CHARACTERISTIC PCR_rBPOvrRun_MAP "PCR Stellerwert während der noise suppression-Schuberkennung" MAP 0x1EC89A Kf_Xs16_Ys16_Ws16 100.0000 Prc 0.00 100.0000 FORMAT "%8.4" EXTENDED_LIMITS -327.6800 327.6700
 /begin AXIS_DESCR STD_AXIS PCR_nAvrgFrz EngN 6 0.00 6000.000 FORMAT "%8.3" EXTENDED_LIMITS -32768.00 32767.00 DEPOSIT ABSOLUTE /end AXIS_DESCR
 /begin AXIS_DESCR STD_AXIS PCR_rBPAPRatFrz Fact 6 0.00 3.000000 FORMAT "%8.6" EXTENDED_LIMITS -4.000000 3.999878 DEPOSIT ABSOLUTE /end AXIS_DESCR
/end CHARACTERISTIC
/begin CHARACTERISTIC PCR_rCtlAPCmpn_MAP "Kennfeld für atmosphärendruckabhängigen Korrekturwert für Ladedrucksteuerung" MAP 0x1EAC34 Kf_Xs16_Ys16_Ws16 200.0000 Prc -100.0000 100.0000 FORMAT "%8.4" EXTENDED_LIMITS -327.6800 327.6700
 /begin AXIS_DESCR STD_AXIS APSCD_pVal Pres_hPa 9 0.00 4000.000 FORMAT "%8.3" EXTENDED_LIMITS -32768.00 32767.00 DEPOSIT ABSOLUTE /end AXIS_DESCR
 /begin AXIS_DESCR STD_AXIS PCR_qCtl InjMass 9 0.00 200.0000 FORMAT "%8.4" EXTENDED_LIMITS -327.6800 327.6700 DEPOSIT ABSOLUTE /end AXIS_DESCR
/end CHARACTERISTIC
/begin CHARACTERISTIC PCR_rDflGvnrOff_C "Vorgabewert für Regelungsausgang zum Ladedrucksteller im Abschaltfall" VALUE 0x1EC9C4 Kw_Ws16 655.3500 Prc -327.6800 327.6700 FORMAT "%8.4" /end CHARACTERISTIC
/begin CHARACTERISTIC PCR_rDflShutOff_C "Vorgabewert für Regelungsausgang zum Ladedrucksteller im Nachlauf" VALUE 0x1EC9C6 Kw_Ws16 655.3500 Prc -327.6800 327.6700 FORMAT "%8.4" /end CHARACTERISTIC
/begin CHARACTERISTIC PCR_rDflSysFault_C "Vorgabewert für Regelungsausgang zum Ladedrucksteller im Abschaltfall bei Systemfehler" VALUE 0x1EC9C8 Kw_Ws16 655.3500 Prc -327.6800 327.6700 FORMAT "%8.4" /end CHARACTERISTIC
/begin CHARACTERISTIC PCR_rIDflNS_C "Initialisierungswert des I-Anteils des Reglers wenn noise suppression aktiv ist" VALUE 0x1EC8FE Kw_Ws16 100.0000 Prc 0.00 100.0000 FORMAT "%8.4" EXTENDED_LIMITS -327.6800 327.6700 /end CHARACTERISTIC
/begin CHARACTERISTIC PCR_rPresGearChngMin_C "Schwelle für den Ladedruck zur Gangwechselerkennung bei der noise suppression-Maßnahme" VALUE 0x1EC900 Kw_Ws16 5.000000 Fact 0.00 5.000000 FORMAT "%8.6" EXTENDED_LIMITS -4.000000 3.999878 /end CHARACTERISTIC
/begin CHARACTERISTIC PCR_rPresOvrRunOff_CUR "Deaktivierungs-Schwelle für den Ladedruck zur Erkennung Schubbetrieb bei der noise suppression-Maßnahme" CURVE 0x1EC902 Kl_Xs16_Ws16 3.000000 Fact -3.000000 0.00 FORMAT "%8.6" EXTENDED_LIMITS -4.000000 3.999878
 /begin AXIS_DESCR STD_AXIS PCR_rBPAPRatFrz Fact 6 0.00 3.000000 FORMAT "%8.6" EXTENDED_LIMITS -4.000000 3.999878 DEPOSIT ABSOLUTE /end AXIS_DESCR
/end CHARACTERISTIC
/begin CHARACTERISTIC PCR_stBPAltDesRgnMsk_C "Maske für EGT_st zur Regenerationsmeldung im noise suppression-Fall" VALUE 0x1EC91C Kw_Wu32 4294967295.00 OneToOne 0.00 4294967295.00 FORMAT "%13.2" /end CHARACTERISTIC
/begin CHARACTERISTIC PCR_stConvCD_C "BIT-Maske für Kupplungszustand" VALUE 0x1E9C4A Kw_Wu8 255.0 OneToOne 0.00 255.0 FORMAT "%5.1" /end CHARACTERISTIC
/begin CHARACTERISTIC PCR_stCtlRgnMsk_CA "Applizierbare Bitmasken für die Regenerationsstufen" VAL_BLK 0x1EAD00 Kwb_Wu32 4294967295.00 OneToOne 0.00 4294967295.00 FORMAT "%13.2" NUMBER 3 /end CHARACTERISTIC
/begin CHARACTERISTIC PCR_stDesRgnMsk_CA "Bitmasken für die Regenerationsstufen" VAL_BLK 0x1EBDA0 Kwb_Wu32 4294967295.00 OneToOne 0.00 4294967295.00 FORMAT "%13.2" NUMBER 3 /end CHARACTERISTIC
/begin CHARACTERISTIC PCR_stEGRGearChngMsk_C "Maske für EGT_st zur Regenerationsmeldung im noise suppression-Fall" VALUE 0x1EC920 Kw_Wu32 4294967295.00 OneToOne 0.00 4294967295.00 FORMAT "%13.2" /end CHARACTERISTIC
/begin CHARACTERISTIC PCR_stRgnActvMsk_C "Maske für EGT_st zur Regenerationsmeldung im noise suppression-Fall" VALUE 0x1EC924 Kw_Wu32 4294967295.00 OneToOne 0.00 4294967295.00 FORMAT "%13.2" /end CHARACTERISTIC
/begin CHARACTERISTIC PCR_stRgtOffMsk1_C "Bitmaske 1 für Regenerationsanforderung für Hysterese" VALUE 0x1EC928 Kw_Wu32 4294967295.00 OneToOne 0.00 4294967295.00 FORMAT "%13.2" /end CHARACTERISTIC
/begin CHARACTERISTIC PCR_stRgtOffMsk2_C "Bitmaske 2 für Regenerationsanforderung für Hysterese" VALUE 0x1EC92C Kw_Wu32 4294967295.00 OneToOne 0.00 4294967295.00 FORMAT "%13.2" /end CHARACTERISTIC
/begin CHARACTERISTIC PCR_stRgtOffMsk3_C "Bitmaske 3 für Regenerationsanforderung für Hysterese" VALUE 0x1EC930 Kw_Wu32 4294967295.00 OneToOne 0.00 4294967295.00 FORMAT "%13.2" /end CHARACTERISTIC
/begin CHARACTERISTIC PCR_stRgtOnMsk1_C "Bitmaske 1 für Regenerationsanforderung für Hysterese" VALUE 0x1EC934 Kw_Wu32 4294967295.00 OneToOne 0.00 4294967295.00 FORMAT "%13.2" /end CHARACTERISTIC
/begin CHARACTERISTIC PCR_stRgtOnMsk2_C "Bitmaske 2 für Regenerationsanforderung für Hysterese" VALUE 0x1EC938 Kw_Wu32 4294967295.00 OneToOne 0.00 4294967295.00 FORMAT "%13.2" /end CHARACTERISTIC
/begin CHARACTERISTIC PCR_stRgtOnMsk3_C "Bitmaske 3 für Regenerationsanforderung für Hysterese" VALUE 0x1EC93C Kw_Wu32 4294967295.00 OneToOne 0.00 4294967295.00 FORMAT "%13.2" /end CHARACTERISTIC
/begin CHARACTERISTIC PCR_stTrqFltActv_MAP "gültiger Drehzahl- und Ladedruckbereich für Parameterumschaltung beim Momentenfilter" MAP 0x1E9C4C Kf_Xs16_Ys16_Ws16 1.000000 OneToOne 0.00 1.000000 FORMAT "%8.6" EXTENDED_LIMITS -32768.00 32767.00
 /begin AXIS_DESCR STD_AXIS Eng_nAvrg EngN 10 0.00 6000.000 FORMAT "%8.3" EXTENDED_LIMITS -32768.00 32767.00 DEPOSIT ABSOLUTE /end AXIS_DESCR
 /begin AXIS_DESCR STD_AXIS BPSCD_pFltVal Pres_hPa 10 0.00 3500.000 FORMAT "%8.3" EXTENDED_LIMITS -32768.00 32767.00 DEPOSIT ABSOLUTE /end AXIS_DESCR
/end CHARACTERISTIC
/begin CHARACTERISTIC PCR_stTVAGearChngMsk_C "Maske für EGT_st zur Regenerationsmeldung im noise suppression-Fall" VALUE 0x1EC940 Kw_Wu32 4294967295.00 OneToOne 0.00 4294967295.00 FORMAT "%13.2" /end CHARACTERISTIC
/begin CHARACTERISTIC PCR_swtActvNS_C "Hauptschalter zur Aktivierung der noise suppression Maßnahme" VALUE 0x1EC944 Kw_Wu8 1.000 OneToOne 0.00 1.000 FORMAT "%5.3" EXTENDED_LIMITS 0.00 255.0 /end CHARACTERISTIC
/begin CHARACTERISTIC PCR_swtAfterRun_C "Schalter, ob der State AfterRun erkannt - und ob darauf reagiert wird" VALUE 0x1EC9CA Kw_Wu8 1.000 OneToOne 0.00 1.000 FORMAT "%5.3" EXTENDED_LIMITS 0.00 255.0 /end CHARACTERISTIC
/begin CHARACTERISTIC PCR_swtBPAltDes_C "Schalter zur Aktivierung von PCR_stBPAltDes" VALUE 0x1EC945 Kw_Wu8 1.000 OneToOne 0.00 1.000 FORMAT "%5.3" EXTENDED_LIMITS 0.00 255.0 /end CHARACTERISTIC
/begin CHARACTERISTIC PCR_swtBPFrzMAP_C "Schalter zur Auswahl zwischen eingefrorenem oder Kennfeld-basiertem Ladedruckstellgröße bei der noise suppression-Maßnahme" VALUE 0x1EC946 Kw_Wu8 1.000 OneToOne 0.00 1.000 FORMAT "%5.3" EXTENDED_LIMITS 0.00 255.0 /end CHARACTERISTIC
/begin CHARACTERISTIC PCR_swtClthInactv_C "Kupplungssignal irrelevant" VALUE 0x1E9D40 Kw_Wu8 1.000 OneToOne 0.00 1.000 FORMAT "%5.3" EXTENDED_LIMITS 0.00 255.0 /end CHARACTERISTIC
/begin CHARACTERISTIC PCR_swtClthInv_C "Schalter für die Kupplungsinversion - muß gleich zu ConvCD_swtInv_C sein" VALUE 0x1EC947 Kw_Wu8 1.000 OneToOne 0.00 1.000 FORMAT "%5.3" EXTENDED_LIMITS 0.00 255.0 /end CHARACTERISTIC
/begin CHARACTERISTIC PCR_swtGDevMax_C "Variantenschalter zwischen Wasser- oder Öltemperatur für maximale Regelabweichung" VALUE 0x1EC9CB Kw_Wu8 1.000 OneToOne 0.00 1.000 FORMAT "%5.3" EXTENDED_LIMITS 0.00 255.0 /end CHARACTERISTIC
/begin CHARACTERISTIC PCR_swtGearChngTrqFlt_C "Schalter zur Deaktivierung von PCR_stGearChngTrqFlt" VALUE 0x1EC948 Kw_Wu8 1.000 OneToOne 0.00 1.000 FORMAT "%5.3" EXTENDED_LIMITS 0.00 255.0 /end CHARACTERISTIC
/begin CHARACTERISTIC PCR_swtLimMpCrVal_C "Schalter zur Auswahl der Größen, aus denen der Stellgrößenbereich bestimmt wird (1: Verbrauch, 0: Drehzahl und Einspritzmenge)" VALUE 0x1EC949 Kw_Wu8 0.00 OneToOne 1.000 1.000 FORMAT "%5.3" EXTENDED_LIMITS 0.00 255.0 READ_ONLY /end CHARACTERISTIC
/begin CHARACTERISTIC PCR_swtLimMpCrType_C "Schaltertyp zur Auswahl der Größen, aus denen der zulässige Stellgrößenbereich bestimmt wird" VALUE 0x1EC94A Kw_Wu8 0.00 OneToOne 0.00 0.00 FORMAT "%5.2" EXTENDED_LIMITS 0.00 255.0 READ_ONLY /end CHARACTERISTIC
/begin CHARACTERISTIC PCR_swtOvrRunTrqFlt_C "Schalter zur Deaktivierung von PCR_stOvrRunTrqFlt" VALUE 0x1EC94B Kw_Wu8 1.000 OneToOne 0.00 1.000 FORMAT "%5.3" EXTENDED_LIMITS 0.00 255.0 /end CHARACTERISTIC
/begin CHARACTERISTIC PCR_swtQCtlVal_C "Schalterwert zur Auswahl der für Steuerung verwendeten Einspritzmenge" VALUE 0x1EAD0C Kw_Wu8 1.000 OneToOne 0.00 1.000 FORMAT "%5.3" EXTENDED_LIMITS 0.00 255.0 /end CHARACTERISTIC
/begin CHARACTERISTIC PCR_swtQCtlType_C "Schaltertyp zur Auswahl der für Steuerung verwendeten Einspritzmenge" VALUE 0x1EAD0D Kw_Wu8 1.000 OneToOne 1.000 2.000 FORMAT "%5.3" EXTENDED_LIMITS 0.00 255.0 /end CHARACTERISTIC
/begin CHARACTERISTIC PCR_swtQDesVal_C "Schalterwert für Mengeneingangswunsch bei der Sollwertberechnung" VALUE 0x1EBDAC Kw_Wu8 1.000 OneToOne 0.00 1.000 FORMAT "%5.3" EXTENDED_LIMITS 0.00 255.0 /end CHARACTERISTIC
/begin CHARACTERISTIC PCR_swtQDesType_C "Schaltertyp für Mengeneingangswunsch bei der Sollwertberechnung" VALUE 0x1EBDAD Kw_Wu8 1.000 OneToOne 1.000 2.000 FORMAT "%5.3" EXTENDED_LIMITS 0.00 255.0 /end CHARACTERISTIC
/begin CHARACTERISTIC PCR_swtRelAbsVal_C "Schalterwert zur  Auswahl zwischen Absolut- und Relativdruckregelung  (0: absolut, 1: relativ)" VALUE 0x1EC94C Kw_Wu8 1.000 OneToOne 0.00 1.000 FORMAT "%5.3" EXTENDED_LIMITS 0.00 255.0 /end CHARACTERISTIC
/begin CHARACTERISTIC PCR_swtRelAbsType_C "Softwareschalter Typ zur  Auswahl zwischen Absolut- und Relativdruckregelung" VALUE 0x1EC94D Kw_Wu8 1.000 OneToOne 1.000 2.000 FORMAT "%5.3" EXTENDED_LIMITS 0.00 255.0 /end CHARACTERISTIC
/begin CHARACTERISTIC PCR_swtShftUpActv_C "Schalter zur Deaktivierung des Gearbx_stShftUp Einflusses" VALUE 0x1EC94E Kw_Wu8 1.000 OneToOne 0.00 1.000 FORMAT "%5.3" EXTENDED_LIMITS 0.00 255.0 /end CHARACTERISTIC
/begin CHARACTERISTIC PCR_swtTmpAir_C "Schalter für Auswahl der für die additiven Korrektur verwendeten Temperatur" VALUE 0x1EBDAE Kw_Ws16 1.000000 OneToOne 0.00 1.000000 FORMAT "%8.6" EXTENDED_LIMITS -32768.00 32767.00 /end CHARACTERISTIC
/begin CHARACTERISTIC PCR_swtTrbnMod_C "Schalter ein/aus Laderdrehzahlbegrenzung in der Höhe" VALUE 0x1EBDB0 Kw_Wu8 1.000 OneToOne 0.00 1.000 FORMAT "%5.3" EXTENDED_LIMITS 0.00 255.0 /end CHARACTERISTIC
/begin CHARACTERISTIC PCR_swtWrkSphSet_C "Parameterumschalter für die Schuberkennung im noise suppression-Fall" VALUE 0x1EC94F Kw_Wu8 1.000 OneToOne 0.00 1.000 FORMAT "%5.3" EXTENDED_LIMITS 0.00 255.0 /end CHARACTERISTIC
/begin CHARACTERISTIC PCR_tAirAltCorr_C "Referenz Temperatur" VALUE 0x1E9D44 Kw_Wr32 250.000000 TempC_float -50.0000000 200.000000 FORMAT "%10.6" EXTENDED_LIMITS -1.00000000E+37 1.00000000E+37 /end CHARACTERISTIC
/begin CHARACTERISTIC PCR_tCThreshold_C "Kühlwassertemperaturschwelle für Parameterumschaltung der dynamischen Sollwertbildung" VALUE 0x1EBDB2 Kw_Ws16 6553.500 Temp_Cels -3549.940 3003.560 FORMAT "%8.3" /end CHARACTERISTIC
/begin CHARACTERISTIC PCR_tEngLimGear_C "Geringste Motortemperatur zum Aktivieren des PCR Leerlaufkennfelds" VALUE 0x1EAD0E Kw_Ws16 250.0000 Temp_Cels -50.14000 199.8600 FORMAT "%8.4" EXTENDED_LIMITS -3549.940 3003.560 /end CHARACTERISTIC
/begin CHARACTERISTIC PCR_tiBPGearChngDly_C "Low-high Verzögerungszeit für PCR Gangwechseleingriff" VALUE 0x1EC950 Kw_Wu16 655350.0 Time_ms 0.00 655350.0 FORMAT "%8.1" /end CHARACTERISTIC
/begin CHARACTERISTIC PCR_tiBPOvrRunDly_C "Low-high Verzögerungszeit für PCR Schubeingriff" VALUE 0x1EC952 Kw_Wu16 655350.0 Time_ms 0.00 655350.0 FORMAT "%8.1" /end CHARACTERISTIC
/begin CHARACTERISTIC PCR_tiBPPT1Rgn_C "PCR noise suppression Regenerations-Zeitkonstante für PT1 Filter" VALUE 0x1EC954 Kw_Wu32 4294.9673 TimeDelay_s 0.0000010000000 4294.9673 FORMAT "%9.4" /end CHARACTERISTIC
/begin CHARACTERISTIC PCR_tiBPPT1_C "PCR noise suppression Zeitkonstante für PT1 Filter" VALUE 0x1EC958 Kw_Wu32 4294.9673 TimeDelay_s 0.0000010000000 4294.9673 FORMAT "%9.4" /end CHARACTERISTIC
/begin CHARACTERISTIC PCR_tiClutchIntv_C "Dauer der Freigabe der Anti-Kaudern Maßnahme bei gedrückter Kupplung" VALUE 0x1EC95C Kw_Wu16 655350.0 Time_ms 0.00 655350.0 FORMAT "%8.1" /end CHARACTERISTIC
/begin CHARACTERISTIC PCR_tiClutchSetDebPos_C "Entprellzeit-Zeit der pos. Flanke des Kupplungrohsignales - Kupplung gedrückt" VALUE 0x1EC95E Kw_Wu16 655350.0 Time_ms 0.00 655350.0 FORMAT "%8.1" /end CHARACTERISTIC
/begin CHARACTERISTIC PCR_tiCoStrt_CUR "Kennlinie für die Zeit, die die Regelung nach Startabwurf abgeschaltet bleibt" CURVE 0x1EC9CC Kl_Xs16_Ws16 33000.00 Time_ms 0.00 33000.00 FORMAT "%8.2" EXTENDED_LIMITS -327680.0 327670.0
 /begin AXIS_DESCR STD_AXIS CTSCD_tClnt Temp_Cels 30 -100.1400 199.8600 FORMAT "%8.4" EXTENDED_LIMITS -3549.940 3003.560 DEPOSIT ABSOLUTE /end AXIS_DESCR
/end CHARACTERISTIC
/begin CHARACTERISTIC PCR_tiDebswtRgt_C "Zeitverzögerung für Umschaltung von Regel- in Steuerbetrieb des PCR" VALUE 0x1EC960 Kw_Wu16 20.00000 Time_s 0.00 20.00000 FORMAT "%8.5" EXTENDED_LIMITS 0.00 655.3500 /end CHARACTERISTIC
/begin CHARACTERISTIC PCR_tiDelBPGovFlt_C "Auschaltverzögerungszeit der Ladergeräuschunterdrückung" VALUE 0x1EC962 Kw_Wu16 60000.00 Time_ms 0.00 60000.00 FORMAT "%8.2" EXTENDED_LIMITS 0.00 655350.0 /end CHARACTERISTIC
/begin CHARACTERISTIC PCR_tiDT1BPAlt_C "Zeitkonstante des DT1 Vorfilters in großen Höhen" VALUE 0x1E9D48 Kw_Wu32 4294.9663 TimeDelay_s 0.0010000001 4294.9673 FORMAT "%9.4" EXTENDED_LIMITS 0.0000010000000 4294.9673 /end CHARACTERISTIC
/begin CHARACTERISTIC PCR_tiEGRGearChngRgnRst_C "Verzögerungszeit bei Regeneration für den Reset von PCR_stEGRGearChngDet" VALUE 0x1EC964 Kw_Wu16 5000.000 Time_ms 0.00 5000.000 FORMAT "%8.3" EXTENDED_LIMITS 0.00 655350.0 /end CHARACTERISTIC
/begin CHARACTERISTIC PCR_tiEGRGearChngRst_C "Verzögerungszeit für den Reset von PCR_stEGRGearChngDet" VALUE 0x1EC966 Kw_Wu16 5000.000 Time_ms 0.00 5000.000 FORMAT "%8.3" EXTENDED_LIMITS 0.00 655350.0 /end CHARACTERISTIC
/begin CHARACTERISTIC PCR_tiEGROvrRunRgnRst_C "Verzögerungszeit bei Regeneration für den Reset von PCR_stEGROvrRunDet" VALUE 0x1EC968 Kw_Wu16 5000.000 Time_ms 0.00 5000.000 FORMAT "%8.3" EXTENDED_LIMITS 0.00 655350.0 /end CHARACTERISTIC
/begin CHARACTERISTIC PCR_tiEGROvrRunRst_C "Verzögerungszeit für den Reset von PCR_stEGROvrRunDet" VALUE 0x1EC96A Kw_Wu16 5000.000 Time_ms 0.00 5000.000 FORMAT "%8.3" EXTENDED_LIMITS 0.00 655350.0 /end CHARACTERISTIC
/begin CHARACTERISTIC PCR_tiGearChngMax_C "Verzögerungszeit für den Reset von allen Gangwechsel-noise suppression Ausgängen" VALUE 0x1EC96C Kw_Wu16 5000.000 Time_ms 0.00 5000.000 FORMAT "%8.3" EXTENDED_LIMITS 0.00 655350.0 /end CHARACTERISTIC
/begin CHARACTERISTIC PCR_tiGearChngRgnMax_C "Verzögerungszeit bei Regeneration für den Reset von allen Gangwechsel-noise suppression Ausgängen" VALUE 0x1EC96E Kw_Wu16 5000.000 Time_ms 0.00 5000.000 FORMAT "%8.3" EXTENDED_LIMITS 0.00 655350.0 /end CHARACTERISTIC
/begin CHARACTERISTIC PCR_tiOvrRunDetMax_C "Verzögerungszeit für den Reset von allen Schubbetrieb-noise suppression Ausgängen" VALUE 0x1EC970 Kw_Wu16 5000.000 Time_ms 0.00 5000.000 FORMAT "%8.3" EXTENDED_LIMITS 0.00 655350.0 /end CHARACTERISTIC
/begin CHARACTERISTIC PCR_tiOvrRunRgnDetMax_C "Verzögerungszeit bei Regeneration für den Reset von allen Schubbetriebs-noise suppression Ausgängen" VALUE 0x1EC972 Kw_Wu16 5000.000 Time_ms 0.00 5000.000 FORMAT "%8.3" EXTENDED_LIMITS 0.00 655350.0 /end CHARACTERISTIC
/begin CHARACTERISTIC PCR_tiShftUpDur_C "Dauer des verzögenden Gearbx_stShftUp Signals" VALUE 0x1EC974 Kw_Wu16 5000.000 Time_ms 0.00 5000.000 FORMAT "%8.3" EXTENDED_LIMITS 0.00 655350.0 /end CHARACTERISTIC
/begin CHARACTERISTIC PCR_tiShftUpOn_C "Low-high Verzögerungszeit für Gearbx_stShftUp" VALUE 0x1EC976 Kw_Wu16 5000.000 Time_ms 0.00 5000.000 FORMAT "%8.3" EXTENDED_LIMITS 0.00 655350.0 /end CHARACTERISTIC
/begin CHARACTERISTIC PCR_tiStrtDelayInit_C "Inititalisierungswert der Zeit, die der PCR nach dem Startabfall abgeschaltet bleibt" VALUE 0x1ECA46 Kw_Wu16 655350.0 Time_ms 0.00 655350.0 FORMAT "%8.1" /end CHARACTERISTIC
/begin CHARACTERISTIC PCR_tiTrqFltActv_C "Aktivierungzeitraum für Parameterumschaltung beim Momentenfilter" VALUE 0x1E9D4C Kw_Wu16 655350.0 Time_ms 0.00 655350.0 FORMAT "%8.1" /end CHARACTERISTIC
/begin CHARACTERISTIC PCR_tiTVAGearChngRgnRst_C "Verzögerungszeit bei Regeneration für den Reset von PCR_stEGRGearChngDet" VALUE 0x1EC978 Kw_Wu16 5000.000 Time_ms 0.00 5000.000 FORMAT "%8.3" EXTENDED_LIMITS 0.00 655350.0 /end CHARACTERISTIC
/begin CHARACTERISTIC PCR_tiTVAGearChngRst_C "Verzögerungszeit für den Reset von PCR_stTVAGearChngDet" VALUE 0x1EC97A Kw_Wu16 5000.000 Time_ms 0.00 5000.000 FORMAT "%8.3" EXTENDED_LIMITS 0.00 655350.0 /end CHARACTERISTIC
/begin CHARACTERISTIC PCR_tiTVAOvrRunRgnRst_C "Verzögerungszeit bei Regeneration für den Reset von PCR_stTVAOvrRunDet" VALUE 0x1EC97C Kw_Wu16 5000.000 Time_ms 0.00 5000.000 FORMAT "%8.3" EXTENDED_LIMITS 0.00 655350.0 /end CHARACTERISTIC
/begin CHARACTERISTIC PCR_tiTVAOvrRunRst_C "Verzögerungszeit für den Reset von PCR_stTVAOvrRunDet" VALUE 0x1EC97E Kw_Wu16 5000.000 Time_ms 0.00 5000.000 FORMAT "%8.3" EXTENDED_LIMITS 0.00 655350.0 /end CHARACTERISTIC
/begin CHARACTERISTIC PCR_tiVSAOvrRunRst_C "maximale Schuberkennungsdetektionszeit für die Drallklappe bei der Anti-Kaudern-Maßnahme" VALUE 0x1EC980 Kw_Wu16 655350.0 Time_ms 0.00 655350.0 FORMAT "%8.1" /end CHARACTERISTIC
/begin CHARACTERISTIC PCR_vMax_C "Geschwindigkeitsschwelle für Parameterumschaltung beim Momentenfilter" VALUE 0x1E9D4E Kw_Ws16 300.0000 Vel 0.00 300.0000 FORMAT "%8.4" EXTENDED_LIMITS -327.6800 327.6700 /end CHARACTERISTIC
/begin CHARACTERISTIC PCR_WmDT1Neg_C "Verzögerungszeitkonstante der dynamischen Sollwertbildung bei warmem Motor für neg. Ausgang" VALUE 0x1EBDB4 Kw_Wu32 4294.9663 TimeDelay_s 0.0010000001 4294.9673 FORMAT "%9.4" EXTENDED_LIMITS 0.0000010000000 4294.9673 /end CHARACTERISTIC
/begin CHARACTERISTIC PCR_WmDT1Pos_C "Verzögerungszeitkonstante der dynamischen Sollwertbildung bei warmem Motor für pos. Ausgang" VALUE 0x1EBDB8 Kw_Wu32 4294.9663 TimeDelay_s 0.0010000001 4294.9673 FORMAT "%9.4" EXTENDED_LIMITS 0.0000010000000 4294.9673 /end CHARACTERISTIC
/begin CHARACTERISTIC PCR_WmDKd_C "Kleinsignalverstärkung der dynamischen Sollwertbildung bei warmem Motor" VALUE 0x1EBDBC Kw_Ws32 65535.9999847 Kd -32768.0000000 32767.9999847 FORMAT "%13.7" /end CHARACTERISTIC
/begin CHARACTERISTIC PCR_WmDKdPos_C "Positive Großsignalverstärkung der dynamischen Sollwertbildung bei warmem Motor" VALUE 0x1EBDC0 Kw_Ws32 65535.9999847 Kd -32768.0000000 32767.9999847 FORMAT "%13.7" /end CHARACTERISTIC
/begin CHARACTERISTIC PCR_WmDKdNeg_C "Negative Großsignalverstärkung der dynamischen Sollwertbildung bei warmem Motor" VALUE 0x1EBDC4 Kw_Ws32 65535.9999847 Kd -32768.0000000 32767.9999847 FORMAT "%13.7" /end CHARACTERISTIC
/begin CHARACTERISTIC PCR_dpWmDWinPos_C "Positive Kleinsignalgrenze bei warmem Motor" VALUE 0x1EBDC8 Kw_Ws16 1638350. Pres_hPaPerSec_20ms 0.00 1638350. FORMAT "%8.0" EXTENDED_LIMITS -1638400. 1638350. /end CHARACTERISTIC
/begin CHARACTERISTIC PCR_dpWmDWinNeg_C "Negative Kleinsignalgrenze bei warmem Motor" VALUE 0x1EBDCA Kw_Ws16 1638400. Pres_hPaPerSec_20ms -1638400. 0.00 FORMAT "%8.0" EXTENDED_LIMITS -1638400. 1638350. /end CHARACTERISTIC
/begin CHARACTERISTIC PFltCD_uSRCMinPDiff_C "Spannungsrohwert SRC-Min für Differenzdruck über Partikelfilter" VALUE 0x1EF610 Kw_Ws16 5200.391 Volt 0.00 5200.391 FORMAT "%8.3" EXTENDED_LIMITS -160156.4 160151.5 /end CHARACTERISTIC
/begin CHARACTERISTIC PFltCD_uSRCMaxPDiff_C "Spannungsrohwert SRC_Max für Differenzdruck über Partikelfilter" VALUE 0x1EF612 Kw_Ws16 5200.391 Volt 0.00 5200.391 FORMAT "%8.3" EXTENDED_LIMITS -160156.4 160151.5 /end CHARACTERISTIC
/begin CHARACTERISTIC PFltCD_pLinDiff_CUR "Linearisierungskennlinie für Differenzdruck über Partikelfilter [kPa]" CURVE 0x1EF614 Kl_Xs16_Ws16 1000.000 Pres_hPa 0.00 1000.000 FORMAT "%8.3" EXTENDED_LIMITS -32768.00 32767.00
 /begin AXIS_DESCR STD_AXIS PFltCD_uRawPresDiffBnk_mp Volt 25 0.00 5200.391 FORMAT "%8.3" EXTENDED_LIMITS -160156.4 160151.5 DEPOSIT ABSOLUTE /end AXIS_DESCR
/end CHARACTERISTIC
/begin CHARACTERISTIC PFltCD_uSRCMinTempPre_C "Spannungsrohwert SRC-Min der Abgastemperatur vor dem Partikelfilter [mV]" VALUE 0x1EF6A0 Kw_Ws16 5200.391 Volt 0.00 5200.391 FORMAT "%8.3" EXTENDED_LIMITS -160156.4 160151.5 /end CHARACTERISTIC
/begin CHARACTERISTIC PFltCD_uSRCMaxTempPre_C "Spannungsrohwert SRC-Max der Abgastemperatur vor dem Partikelfilter [mV]" VALUE 0x1EF6A2 Kw_Ws16 5200.391 Volt 0.00 5200.391 FORMAT "%8.3" EXTENDED_LIMITS -160156.4 160151.5 /end CHARACTERISTIC
/begin CHARACTERISTIC PFltCD_tLinPre1_CUR "Linearisierungskennlinie für Temperatur vor Partikelfilter [deg C]" CURVE 0x1EF6A4 Kl_Xs16_Ws16 1323.100 Temp_Cels -50.14000 1272.960 FORMAT "%8.3" EXTENDED_LIMITS -3549.940 3003.560
 /begin AXIS_DESCR STD_AXIS PFltCD_uRawTempPre Volt 40 0.00 5200.391 FORMAT "%8.3" EXTENDED_LIMITS -160156.4 160151.5 DEPOSIT ABSOLUTE /end AXIS_DESCR
/end CHARACTERISTIC
/begin CHARACTERISTIC PFltCD_uSRCMinTempPst_C "Spannungsrohwert SRC-Min für die Abgastemperatur hinter dem Partikelfilter" VALUE 0x1EF75C Kw_Ws16 5200.391 Volt 0.00 5200.391 FORMAT "%8.3" EXTENDED_LIMITS -160156.4 160151.5 /end CHARACTERISTIC
/begin CHARACTERISTIC PFltCD_uSRCMaxTempPst_C "Spannungsrohwert SRC-Max für die Abgastemperatur hinter dem Partikelfilter" VALUE 0x1EF75E Kw_Ws16 5200.391 Volt 0.00 5200.391 FORMAT "%8.3" EXTENDED_LIMITS -160156.4 160151.5 /end CHARACTERISTIC
/begin CHARACTERISTIC PFltCD_tLinPst_CUR "Linearisierungskurve fuer die Abgastemperatur nach Partikelfilter" CURVE 0x1EF760 Kl_Xs16_Ws16 1323.100 Temp_Cels -50.14000 1272.960 FORMAT "%8.3" EXTENDED_LIMITS -3549.940 3003.560
 /begin AXIS_DESCR STD_AXIS PFltCD_uRawTempPstBnk_mp Volt 40 0.00 5200.391 FORMAT "%8.3" EXTENDED_LIMITS -160156.4 160151.5 DEPOSIT ABSOLUTE /end AXIS_DESCR
/end CHARACTERISTIC
/begin CHARACTERISTIC PFltCD_ctPwrStgOnMax_C "Maximale Anzahl der Einschaltungen der Partikelfilter-Heizungs Endstufe im Fehlerfall" VALUE 0x1EF818 Kw_Wu16 65535.00 OneToOne 0.00 65535.00 FORMAT "%8.2" /end CHARACTERISTIC
/begin CHARACTERISTIC PFltCD_DebSigPDiffDef_C "Fehlerentprellzeit Signal-Fehler über CAN für Differenzdruck über Partikelfilter" VALUE 0x1EF67A Kw_Wu16 655350.0 Time_ms 0.00 655350.0 FORMAT "%8.1" /end CHARACTERISTIC
/begin CHARACTERISTIC PFltCD_DebSigPDiffOk_C "Heilungsentprellzeit Signal-Fehler über CAN für Differenzdruck über Partikelfilter" VALUE 0x1EF67C Kw_Wu16 655350.0 Time_ms 0.00 655350.0 FORMAT "%8.1" /end CHARACTERISTIC
/begin CHARACTERISTIC PFltCD_DebSRCHighPDiffDef_C "Fehlerentprellzeit SRC_High-Fehler für Differenzdruck über Partikelfilter [ms]" VALUE 0x1EF67E Kw_Wu16 655350.0 Time_ms 0.00 655350.0 FORMAT "%8.1" /end CHARACTERISTIC
/begin CHARACTERISTIC PFltCD_DebSRCHighPDiffOk_C "Heilungsentprellzeit SRC_High für Differenzdruck über Partikelfilter [ms]" VALUE 0x1EF680 Kw_Wu16 655350.0 Time_ms 0.00 655350.0 FORMAT "%8.1" /end CHARACTERISTIC
/begin CHARACTERISTIC PFltCD_DebSRCHighDefTPre_C "Fehlerentprellzeit SRC-High-Fehler für die Abgastemperatur vor dem Partikelfilter [ms]" VALUE 0x1EF746 Kw_Wu16 655350.0 Time_ms 0.00 655350.0 FORMAT "%8.1" /end CHARACTERISTIC
/begin CHARACTERISTIC PFltCD_DebSRCHighOkTPre_C "Heilungsentprellzeit SRC-High für die Abgastemperatur vor dem Partikelfilter [ms]" VALUE 0x1EF748 Kw_Wu16 655350.0 Time_ms 0.00 655350.0 FORMAT "%8.1" /end CHARACTERISTIC
/begin CHARACTERISTIC PFltCD_DebSRCHighDefTPst_C "Fehlerentprellzeit SRC-High-Fehler für Temperatur nach Par-tikelfilter" VALUE 0x1EF802 Kw_Wu16 655350.0 Time_ms 0.00 655350.0 FORMAT "%8.1" /end CHARACTERISTIC
/begin CHARACTERISTIC PFltCD_DebSRCHighOkTPst_C "Heilungsentprellzeit SRC-High-Fehler für Temperatur nach Partikelfilter" VALUE 0x1EF804 Kw_Wu16 655350.0 Time_ms 0.00 655350.0 FORMAT "%8.1" /end CHARACTERISTIC
/begin CHARACTERISTIC PFltCD_DebSRCLowPDiffDef_C "Fehlerentprellzeit SRC-Low-Fehler für Differenzdruck über Partikelfilter [ms]" VALUE 0x1EF682 Kw_Wu16 655350.0 Time_ms 0.00 655350.0 FORMAT "%8.1" /end CHARACTERISTIC
/begin CHARACTERISTIC PFltCD_DebSRCLowPDiffOk_C "Heilungsentprellzeit SRC-Low für Differenzdruck über Partikelfilter [ms]" VALUE 0x1EF684 Kw_Wu16 655350.0 Time_ms 0.00 655350.0 FORMAT "%8.1" /end CHARACTERISTIC
/begin CHARACTERISTIC PFltCD_DebSRCLowDefTPre_C "Fehlerentprellzeit SRC-Low-Fehler für die Abgastemperatur vor dem Partikelfilter [ms]" VALUE 0x1EF74A Kw_Wu16 655350.0 Time_ms 0.00 655350.0 FORMAT "%8.1" /end CHARACTERISTIC
/begin CHARACTERISTIC PFltCD_DebSRCLowOkTPre_C "Heilungsentprellzeit SRC-Low für die Abgastemperatur vor dem Partikelfilter [ms]" VALUE 0x1EF74C Kw_Wu16 655350.0 Time_ms 0.00 655350.0 FORMAT "%8.1" /end CHARACTERISTIC
/begin CHARACTERISTIC PFltCD_DebSRCLowDefTPst_C "Fehlerentprellzeit SRC-Low-Fehler für Temperatur nach Partikelfilter" VALUE 0x1EF806 Kw_Wu16 655350.0 Time_ms 0.00 655350.0 FORMAT "%8.1" /end CHARACTERISTIC
/begin CHARACTERISTIC PFltCD_DebSRCLowOkTPst_C "Heilungsentprellzeit SRC-Low-Fehler für Temperatur nach Partikelfilter" VALUE 0x1EF808 Kw_Wu16 655350.0 Time_ms 0.00 655350.0 FORMAT "%8.1" /end CHARACTERISTIC
/begin CHARACTERISTIC PFltCD_dtRmpSlpUpPDiff_C "Aufw.-Schritt für Rampe für Differenzdruck über Partikelfilter [kPa/s]" VALUE 0x1EF688 Kw_Wu32 65535999.9847 RmpPres_hPa 0.00 65535999.9847 FORMAT "%13.4" /end CHARACTERISTIC
/begin CHARACTERISTIC PFltCD_dtRmpSlpDwnPDiff_C "Abw.-Schritt für Rampe für Differenzdruck über Partikelfilter [kPa/s]" VALUE 0x1EF68C Kw_Wu32 65535999.9847 RmpPres_hPa 0.00 65535999.9847 FORMAT "%13.4" /end CHARACTERISTIC
/begin CHARACTERISTIC PFltCD_dtRmpSlpUpPre_C "Aufw.-Schritt für Rampe der Abgastemperatur vor dem Partikelfilter [K/s]" VALUE 0x1EF750 Kw_Wu32 6553599.99847 RmpTemp 0.00 6553599.99847 FORMAT "%13.5" /end CHARACTERISTIC
/begin CHARACTERISTIC PFltCD_dtRmpSlpDwnPre_C "Abw.-Schritt für Rampe der Abgastemperatur vor dem Partikelfilter [K/s]" VALUE 0x1EF754 Kw_Wu32 6553599.99847 RmpTemp 0.00 6553599.99847 FORMAT "%13.5" /end CHARACTERISTIC
/begin CHARACTERISTIC PFltCD_dtRmpSlpUpPst_C "Aufw.-Schritt für Rampe für Temperatur nach Partikelfilter" VALUE 0x1EF80C Kw_Wu32 6553599.99847 RmpTemp 0.00 6553599.99847 FORMAT "%13.5" /end CHARACTERISTIC
/begin CHARACTERISTIC PFltCD_dtRmpSlpDwnPst_C "Abw.-Schritt für Rampe für Temperatur nach Partikelfilter" VALUE 0x1EF810 Kw_Wu32 6553599.99847 RmpTemp 0.00 6553599.99847 FORMAT "%13.5" /end CHARACTERISTIC
/begin CHARACTERISTIC PFltCD_numSSpPDiff_C "Wahlschalter für Sensorversorgungsspannungsmonitor" VALUE 0x1EF690 Kw_Wu8 2.000 OneToOne 1.000 3.000 FORMAT "%5.3" EXTENDED_LIMITS 0.00 255.0 /end CHARACTERISTIC
/begin CHARACTERISTIC PFltCD_tiPDiffPT1_C "Zeitkonstante für Tiefpassfilter des Differenzdrucksensors [s]" VALUE 0x1EF694 Kw_Wu32 4294.9663 TimeDelay_s 0.0010000001 4294.9673 FORMAT "%9.4" EXTENDED_LIMITS 0.0000010000000 4294.9673 /end CHARACTERISTIC
/begin CHARACTERISTIC PFltCD_rThresHtg_C "Schwellwert der Partikelfilterheizung" VALUE 0x1EF81A Kw_Ws16 100.0000 Prc 0.00 100.0000 FORMAT "%8.4" EXTENDED_LIMITS -327.6800 327.6700 /end CHARACTERISTIC
/begin CHARACTERISTIC PFltCD_stInvOutHtg_C "Invertiertes Signal der Partikelfilterheizung" VALUE 0x1EF81C Kw_Wu8 1.000 OneToOne 0.00 1.000 FORMAT "%5.3" EXTENDED_LIMITS 0.00 255.0 /end CHARACTERISTIC
/begin CHARACTERISTIC PFltCD_stPwrStgActvHtg_C "Abschaltbedingungen der Partikelfilterheizung" VALUE 0x1EF81D Kw_Wu8 255.0 OneToOne 0.00 255.0 FORMAT "%5.1" /end CHARACTERISTIC
/begin CHARACTERISTIC PFltCD_stPwrStgDiaHtg_C "Abschaltbedingungen der Partikelfilterheizung" VALUE 0x1EF81E Kw_Wu8 255.0 OneToOne 0.00 255.0 FORMAT "%5.1" /end CHARACTERISTIC
/begin CHARACTERISTIC PFltCD_stSPICtl_C "Parameter zur Anzeige der verwendeten Endstufenart (1 = SPI kontrollierte Endstufe, 0 = nicht SPI kontrollierte Endstufe)" VALUE 0x1EF81F Kw_Wu8 1.000 OneToOne 0.00 1.000 FORMAT "%5.3" EXTENDED_LIMITS 0.00 255.0 /end CHARACTERISTIC
/begin CHARACTERISTIC PFltCD_swtSigPDiff_C "Wahlschalter für Eingangssignal des Differenzdrucksensors" VALUE 0x1EF698 Kw_Wu8 1.000 OneToOne 0.00 1.000 FORMAT "%5.3" EXTENDED_LIMITS 0.00 255.0 /end CHARACTERISTIC
/begin CHARACTERISTIC PFltCD_tiBtwTst_C "Zeitabstand, in dem die Endstufe im Fehlerfall getestet wird (KSUB und Übertemperatur bei PFlt Heizung)" VALUE 0x1EF820 Kw_Wu16 29900.00 Time_ms 100.0000 30000.00 FORMAT "%8.2" EXTENDED_LIMITS 0.00 655350.0 /end CHARACTERISTIC
/begin CHARACTERISTIC PFltCD_tiDebExcTmpHtgDef_C "Fehlerentprellzeit für Übertemperatur der Partikelfilterheizung [ms]" VALUE 0x1EF822 Kw_Wu16 655350.0 Time_ms 0.00 655350.0 FORMAT "%8.1" /end CHARACTERISTIC
/begin CHARACTERISTIC PFltCD_tiDebExcTmpHtgOk_C "Heilungsentprellzeit für Übertemperatur der Partikelfilterheizung [ms]" VALUE 0x1EF824 Kw_Wu16 655350.0 Time_ms 0.00 655350.0 FORMAT "%8.1" /end CHARACTERISTIC
/begin CHARACTERISTIC PFltCD_tiDebNoLoadHtgDef_C "Fehlerentprellzeit für Leerlauf der Partikelfilterheizung [ms]" VALUE 0x1EF826 Kw_Wu16 655350.0 Time_ms 0.00 655350.0 FORMAT "%8.1" /end CHARACTERISTIC
/begin CHARACTERISTIC PFltCD_tiDebNoLoadHtgOk_C "Heilungsentprellzeit für Leerlauf der Partikelfilterheizung [ms]" VALUE 0x1EF828 Kw_Wu16 655350.0 Time_ms 0.00 655350.0 FORMAT "%8.1" /end CHARACTERISTIC
/begin CHARACTERISTIC PFltCD_tiDebShrtBatHtgDef_C "Fehlerentprellzeit für Kurzschluß nach U-Batt der Partikelfilterheizung [ms]" VALUE 0x1EF82A Kw_Wu16 655350.0 Time_ms 0.00 655350.0 FORMAT "%8.1" /end CHARACTERISTIC
/begin CHARACTERISTIC PFltCD_tiDebShrtBatHtgOk_C "Heilungsentprellzeit für Kurzschluß nach U-Batt der Partikelfilterheizung [ms]" VALUE 0x1EF82C Kw_Wu16 655350.0 Time_ms 0.00 655350.0 FORMAT "%8.1" /end CHARACTERISTIC
/begin CHARACTERISTIC PFltCD_tiDebShrtGndHtgDef_C "Fehlerentprellzeit für Kurzschluß nach Masse der Partikelfilterheizung [ms]" VALUE 0x1EF82E Kw_Wu16 655350.0 Time_ms 0.00 655350.0 FORMAT "%8.1" /end CHARACTERISTIC
/begin CHARACTERISTIC PFltCD_tiDebShrtGndHtgOk_C "Heilungsentprellzeit für Kurzschluß nach Masse der Partikelfilterheizung [ms]" VALUE 0x1EF830 Kw_Wu16 655350.0 Time_ms 0.00 655350.0 FORMAT "%8.1" /end CHARACTERISTIC
/begin CHARACTERISTIC PFltCD_tiPwrStgOn_C "Zeit, für welche die Endstufe beim Fall der nicht-SPI-Endstufe eingeschaltet wird" VALUE 0x1EF832 Kw_Wu16 500.0000 Time_ms 0.00 500.0000 FORMAT "%8.4" EXTENDED_LIMITS 0.00 655350.0 /end CHARACTERISTIC
/begin CHARACTERISTIC PFltCD_stSensIDWordPDiff_C "Geberkennwort für Differenzdruck über PFlt" VALUE 0x1EF69A Kw_Wu16 65535.00 OneToOne 0.00 65535.00 FORMAT "%8.2" /end CHARACTERISTIC
/begin CHARACTERISTIC PFltCD_pDflDiff_C "Vorgabewert für Diffenenzdruck über Partikelfilter [kPa]" VALUE 0x1EF69C Kw_Ws16 3500.000 Pres_hPa 0.00 3500.000 FORMAT "%8.3" EXTENDED_LIMITS -32768.00 32767.00 /end CHARACTERISTIC
/begin CHARACTERISTIC PFltCD_stSensIDWordTPre_C "Geberkennwort für Abgastemperatur vor dem Partikelfilter" VALUE 0x1EF758 Kw_Wu16 65535.00 OneToOne 0.00 65535.00 FORMAT "%8.2" /end CHARACTERISTIC
/begin CHARACTERISTIC PFltCD_tDflPre_C "Vorgabewert für die Abgastemperatur vor dem Partikelfilter [K]" VALUE 0x1EF75A Kw_Ws16 1323.100 Temp_Cels -50.14000 1272.960 FORMAT "%8.3" EXTENDED_LIMITS -3549.940 3003.560 /end CHARACTERISTIC
/begin CHARACTERISTIC PFltCD_stSensIDWordTPst_C "Geberkennwort für Temperatur nach Partikelfilter" VALUE 0x1EF814 Kw_Wu16 65535.00 OneToOne 0.00 65535.00 FORMAT "%8.2" /end CHARACTERISTIC
/begin CHARACTERISTIC PFltCD_tDflPst_C "Vorgabewert für Temperatur nach Partikelfilter" VALUE 0x1EF816 Kw_Ws16 1323.100 Temp_Cels -50.14000 1272.960 FORMAT "%8.3" EXTENDED_LIMITS -3549.940 3003.560 /end CHARACTERISTIC
/begin CHARACTERISTIC PFlt_cpEGOxi_MAP "Spezifische Wärmekapazität Abgas im DOC" MAP 0x1ED52E Kf_Xs16_Ys16_Ws16 6.553500 SpecificHeat -3.276800 3.276700 FORMAT "%8.6"
 /begin AXIS_DESCR STD_AXIS PFlt_tOxiSurf Temp_Cels 6 -3549.940 3003.560 FORMAT "%8.3" DEPOSIT ABSOLUTE /end AXIS_DESCR
 /begin AXIS_DESCR STD_AXIS PFlt_rLmbd lambda 6 -32.76800 32.76700 FORMAT "%8.5" DEPOSIT ABSOLUTE /end AXIS_DESCR
/end CHARACTERISTIC
/begin CHARACTERISTIC PFlt_cpEG_MAP "Wärmekapazität Abgas im DPF" MAP 0x1ED592 Kf_Xs16_Ys16_Ws16 6.553500 SpecificHeat -3.276800 3.276700 FORMAT "%8.6"
 /begin AXIS_DESCR STD_AXIS PFlt_tFlt Temp_Cels 6 -3549.940 3003.560 FORMAT "%8.3" DEPOSIT ABSOLUTE /end AXIS_DESCR
 /begin AXIS_DESCR STD_AXIS PFlt_rLmbd lambda 6 -32.76800 32.76700 FORMAT "%8.5" DEPOSIT ABSOLUTE /end AXIS_DESCR
/end CHARACTERISTIC
/begin CHARACTERISTIC PFlt_CPFlt_C "Wärmekapazität des Partikelfilters" VALUE 0x1EF0F8 Kw_Wu16 32900.00 Thr_Cpty 100.0000 33000.00 FORMAT "%8.2" EXTENDED_LIMITS 0.00 65535.00 /end CHARACTERISTIC
/begin CHARACTERISTIC PFlt_ctRgnLckMax_C "Maximallezahl für nicht erfolgreiche Reggenerationen" VALUE 0x1ECE50 Kw_Wu8 255.0 OneToOne 0.00 255.0 FORMAT "%5.1" /end CHARACTERISTIC
/begin CHARACTERISTIC PFlt_ctRgnLckThres1_C "Die erste Schwelle für den nicht erfolgreiche Regenerations Zähler" VALUE 0x1ECA48 Kw_Wu8 255.0 OneToOne 0.00 255.0 FORMAT "%5.1" /end CHARACTERISTIC
/begin CHARACTERISTIC PFlt_ctRgnLckThres2_C "Die zweite Schwelle für den nicht erfolgreiche Regenerations Zähler" VALUE 0x1ECA49 Kw_Wu8 255.0 OneToOne 0.00 255.0 FORMAT "%5.1" /end CHARACTERISTIC
/begin CHARACTERISTIC PFlt_DebRgnLckPermMaxDef_C "Entprellzeit setzen Fehler Regenerationsstrategie endgültig gescheitert" VALUE 0x1ECE52 Kw_Wu16 655350.0 Time_ms 0.00 655350.0 FORMAT "%8.1" /end CHARACTERISTIC
/begin CHARACTERISTIC PFlt_DebRgnLckPermMaxOK_C "Entprellzeit heilen Fehler Regenerationsstrategie endgültig gescheitert" VALUE 0x1ECE54 Kw_Wu16 655350.0 Time_ms 0.00 655350.0 FORMAT "%8.1" /end CHARACTERISTIC
/begin CHARACTERISTIC PFlt_DebRgnLckPermMinDef_C "Entprellzeit setzen Fehler Regenerationsstrategie endgültig gescheitert" VALUE 0x1ECE56 Kw_Wu16 655350.0 Time_ms 0.00 655350.0 FORMAT "%8.1" /end CHARACTERISTIC
/begin CHARACTERISTIC PFlt_DebRgnLckPermMinOK_C "Entprellzeit heilen Fehler Regenerationsstrategie endgültig gescheitert" VALUE 0x1ECE58 Kw_Wu16 655350.0 Time_ms 0.00 655350.0 FORMAT "%8.1" /end CHARACTERISTIC
/begin CHARACTERISTIC PFlt_DebRgnLckPermSigDef_C "Entprellzeit setzen Fehler Regenerationsstrategie endgültig gescheitert" VALUE 0x1ECE5A Kw_Wu16 655350.0 Time_ms 0.00 655350.0 FORMAT "%8.1" /end CHARACTERISTIC
/begin CHARACTERISTIC PFlt_DebRgnLckPermSigOK_C "Entprellzeit heilen Fehler Regenerationsstrategie endgültig gescheitert" VALUE 0x1ECE5C Kw_Wu16 655350.0 Time_ms 0.00 655350.0 FORMAT "%8.1" /end CHARACTERISTIC
/begin CHARACTERISTIC PFlt_dmNOxEngBas_MAP "Emissionskennfeld NOx-Massenstrom" MAP 0x1ED8D0 Kf_Xs16_Ys16_Ws16 982.8000 dmNOx_mg_p_s 0.00 982.8000 FORMAT "%8.4" EXTENDED_LIMITS -983.0400 983.0100
 /begin AXIS_DESCR STD_AXIS Eng_nAvrg EngN 16 40.00000 6000.000 FORMAT "%8.3" EXTENDED_LIMITS -32768.00 32767.00 DEPOSIT ABSOLUTE /end AXIS_DESCR
 /begin AXIS_DESCR STD_AXIS InjCrv_qPoI2Op InjMass 12 0.00 327.6700 FORMAT "%8.4" EXTENDED_LIMITS -327.6800 327.6700 DEPOSIT ABSOLUTE /end AXIS_DESCR
/end CHARACTERISTIC
/begin CHARACTERISTIC PFlt_dmSotSimLmbdRgn_MAP "Emissionskennfeld Partikelmassenstrom Lambda in der Regeneration" MAP 0x1EE3EC Kf_Xs16_Ys16_Ws16 100.0000 dmSoot_mg_p_s 0.00 100.0000 FORMAT "%8.4" EXTENDED_LIMITS -327.6800 327.6700
 /begin AXIS_DESCR STD_AXIS PFlt_rLmbdDyn_mp lambda 8 -32.00000 30.00000 FORMAT "%8.5" EXTENDED_LIMITS -32.76800 32.76700 DEPOSIT ABSOLUTE /end AXIS_DESCR
 /begin AXIS_DESCR STD_AXIS EGSys_rLmbdAprx lambda 8 0.00 30.00000 FORMAT "%8.5" EXTENDED_LIMITS -32.76800 32.76700 DEPOSIT ABSOLUTE /end AXIS_DESCR
/end CHARACTERISTIC
/begin CHARACTERISTIC PFlt_dmSotSimLmbd_MAP "statischer Teil der Partikelmasse als Funktion von n und Lamda" MAP 0x1EE490 Kf_Xs16_Ys16_Ws16 100.0000 dmSoot_mg_p_s 0.00 100.0000 FORMAT "%8.4" EXTENDED_LIMITS -327.6800 327.6700
 /begin AXIS_DESCR STD_AXIS PFlt_rLmbdDyn_mp lambda 8 -32.00000 30.00000 FORMAT "%8.5" EXTENDED_LIMITS -32.76800 32.76700 DEPOSIT ABSOLUTE /end AXIS_DESCR
 /begin AXIS_DESCR STD_AXIS EGSys_rLmbdAprx lambda 8 0.00 30.00000 FORMAT "%8.5" EXTENDED_LIMITS -32.76800 32.76700 DEPOSIT ABSOLUTE /end AXIS_DESCR
/end CHARACTERISTIC
/begin CHARACTERISTIC PFlt_dtAccPedMax_C "Min. Fahrpedal-Betätigungsgeschwindigkeit für schnelle Regenerations-Unterbrechung" VALUE 0x1ECA4A Kw_Ws16 300.0000 TrqPerSec 0.00 300.0000 FORMAT "%8.4" EXTENDED_LIMITS -32768.00 32767.00 /end CHARACTERISTIC
/begin CHARACTERISTIC PFlt_dvolMinSotSim_C "Minimaler Abgasvolumenstrom für Rußbeladungsberechnung" VALUE 0x1ED630 Kw_Ws16 3000.000 CubMtrPerHr 0.00 3000.000 FORMAT "%8.3" EXTENDED_LIMITS -3276.800 3276.700 /end CHARACTERISTIC
/begin CHARACTERISTIC PFlt_facAdd2Ash_C "Umrechnungsfaktor Aschemasse pro verbrannte Additivmenge [g/l]" VALUE 0x1ED632 Kw_Wu16 9999.847 volAddfine2mAsh 0.00 9999.847 FORMAT "%8.3" /end CHARACTERISTIC
/begin CHARACTERISTIC PFlt_facFl2Ash_C "Umrechnungsfaktor Aschemasse pro verbrannte Treibstoffmenge [g/l]" VALUE 0x1ED67E Kw_Wu16 0.1525856 volFl2mAsh 0.00 0.1525856 FORMAT "%9.7" /end CHARACTERISTIC
/begin CHARACTERISTIC PFlt_facFltEmpConst_C "Faktor zur Ermittlung des simulierten Differenzdruckes bei leerem Filter [1/m^4]" VALUE 0x1ED680 Kw_Ws16 1200000. facEulerToPres 0.00 1200000. FORMAT "%8.0" EXTENDED_LIMITS -1241212. 1241174. /end CHARACTERISTIC
/begin CHARACTERISTIC PFlt_facFltFulConst_C "Faktor zur Ermittlung des simulierten Differenzdruckes bei vollem Filter [1/m^4]" VALUE 0x1ED682 Kw_Ws16 1200000. facEulerToPres 0.00 1200000. FORMAT "%8.0" EXTENDED_LIMITS -1241212. 1241174. /end CHARACTERISTIC
/begin CHARACTERISTIC PFlt_facSotPresFac_C "Steigung für Partikelfilterbeladung [-]" VALUE 0x1ED684 Kw_Ws16 1.000000 Fact 0.00 1.000000 FORMAT "%8.6" EXTENDED_LIMITS -4.000000 3.999878 /end CHARACTERISTIC
/begin CHARACTERISTIC PFlt_facSumRgnMaxRlx_C "Faktor für das Abwärtszählen des akkumulierten Regenerations-Timers" VALUE 0x1ECA4C Kw_Ws16 7.999878 Fact -4.000000 3.999878 FORMAT "%8.6" READ_ONLY /end CHARACTERISTIC
/begin CHARACTERISTIC PFlt_facTRgnMaxRlx_C "Faktor für Herunterzählverhältnis des Regenerationsüberwachungszählers" VALUE 0x1ECA4E Kw_Wu16 7.999878 Fact 0.00 7.999878 FORMAT "%8.6" /end CHARACTERISTIC
/begin CHARACTERISTIC PFlt_KdDT1TempCor_C "Sprunghöhe des DT1-Filters der Wärmeübergangssim. im Filter" VALUE 0x1EF110 Kw_Ws32 100.000000000 Kd -50.0000000000 50.0000000000 FORMAT "%13.10" EXTENDED_LIMITS -32768.0000000 32767.9999847 /end CHARACTERISTIC
/begin CHARACTERISTIC PFlt_lSumMaxDef_C "gefahrene Strecke Schwelle für Regeneration im Fehlerfall" VALUE 0x1ECA50 Kw_Wu32 4294967295.00 Length 0.00 4294967295.00 FORMAT "%13.2" /end CHARACTERISTIC
/begin CHARACTERISTIC PFlt_lSumMax_CUR "gefahrene Strecke Schwelle für Regeneration" CURVE 0x1ECA54 Kl_Xs16_Ws16 32767.00 Length_km 0.00 32767.00 FORMAT "%8.2" EXTENDED_LIMITS -32768.00 32767.00
 /begin AXIS_DESCR STD_AXIS PFlt_mAshTrmTot mAsh 4 0.00 500.0000 FORMAT "%8.4" EXTENDED_LIMITS -3276.800 3276.700 DEPOSIT ABSOLUTE /end AXIS_DESCR
/end CHARACTERISTIC
/begin CHARACTERISTIC PFlt_lSumSubs_C "Ersatzwert für gefahrene Strecke im Fall eines Eeprom lese Fehlers" VALUE 0x1ECA68 Kw_Wu32 4294967295.00 Length 0.00 4294967295.00 FORMAT "%13.2" /end CHARACTERISTIC
/begin CHARACTERISTIC PFlt_mAshfacAdjDfl_C "Standardablgleichwert für Aschemasse" VALUE 0x1ED688 Kw_Wu32 300.000000000 mAsh_g 0.00 300.000000000 FORMAT "%13.9" EXTENDED_LIMITS 0.00 655.359999847 /end CHARACTERISTIC
/begin CHARACTERISTIC PFlt_mAshfacAdjMax_C "Maximaler Abgleichwert für Aschemasse" VALUE 0x1ED68C Kw_Wu32 300.000000000 mAsh_g 0.00 300.000000000 FORMAT "%13.9" EXTENDED_LIMITS 0.00 655.359999847 /end CHARACTERISTIC
/begin CHARACTERISTIC PFlt_mAshfacAdjMin_C "Minimaler Abgleichwert für Aschemasse" VALUE 0x1ED690 Kw_Wu32 300.000000000 mAsh_g 0.00 300.000000000 FORMAT "%13.9" EXTENDED_LIMITS 0.00 655.359999847 /end CHARACTERISTIC
/begin CHARACTERISTIC PFlt_mFltSimRgn5PT1_C "Beeinflussungswert bei der Berechnung der Zeitkonstante des PT1-Gliedes bei der Betriebszustandsberechnung Stufe 5" VALUE 0x1ECE68 Kw_Ws16 32767.00 AirMass_kg 0.00 32767.00 FORMAT "%8.2" EXTENDED_LIMITS -32768.00 32767.00 /end CHARACTERISTIC
/begin CHARACTERISTIC PFlt_mFltSimRgn7PT1_C "Beeinflussungswert bei der Berechnung der Zeitkonstante des PT1-Gliedes bei der Betriebszustandsberechnung für die Stufe 7" VALUE 0x1ECE6A Kw_Ws16 32767.00 AirMass_kg 0.00 32767.00 FORMAT "%8.2" EXTENDED_LIMITS -32768.00 32767.00 /end CHARACTERISTIC
/begin CHARACTERISTIC PFlt_nAvrgHysHigh1_C "Oberer Hystereseschwellwert Drehzahlhysterese 1" VALUE 0x1ECE6C Kw_Ws16 5960.000 EngN 40.00000 6000.000 FORMAT "%8.3" EXTENDED_LIMITS -32768.00 32767.00 /end CHARACTERISTIC
/begin CHARACTERISTIC PFlt_nAvrgHysHigh2_C "Oberer Hystereseschwellwert Drehzahlhysterese 2" VALUE 0x1ECE6E Kw_Ws16 5960.000 EngN 40.00000 6000.000 FORMAT "%8.3" EXTENDED_LIMITS -32768.00 32767.00 /end CHARACTERISTIC
/begin CHARACTERISTIC PFlt_nAvrgHysLow1_C "Unterer Hystereseschwellwert Drehzahlhysterese 1" VALUE 0x1ECE70 Kw_Ws16 5960.000 EngN 40.00000 6000.000 FORMAT "%8.3" EXTENDED_LIMITS -32768.00 32767.00 /end CHARACTERISTIC
/begin CHARACTERISTIC PFlt_nAvrgHysLow2_C "Oberer Hystereseschwellwert Drehzahlhysterese 2" VALUE 0x1ECE72 Kw_Ws16 5960.000 EngN 40.00000 6000.000 FORMAT "%8.3" EXTENDED_LIMITS -32768.00 32767.00 /end CHARACTERISTIC
/begin CHARACTERISTIC PFlt_nErLpEngN_C "Drehzahlgrenze für PFlt-Lampentest" VALUE 0x1ECA6C Kw_Ws16 6000.000 EngN 0.00 6000.000 FORMAT "%8.3" EXTENDED_LIMITS -32768.00 32767.00 /end CHARACTERISTIC
/begin CHARACTERISTIC PFlt_numEngPOp1_CA "Matrix 1 zur Berücksichtigung des Motorbetriebszustandes bei der Regeneration" MAP 0x1ECA6E Kf_Xu8_Yu8_Wu8 6.000 OneToOne 0.00 6.000 FORMAT "%5.3" EXTENDED_LIMITS 0.00 255.0
 /begin AXIS_DESCR STD_AXIS PFlt_stEngPOp OneToOne 8 0.00 15.00 FORMAT "%5.2" EXTENDED_LIMITS 0.00 255.0 DEPOSIT ABSOLUTE /end AXIS_DESCR
 /begin AXIS_DESCR STD_AXIS PFlt_numRgn OneToOne 8 0.00 7.000 FORMAT "%5.3" EXTENDED_LIMITS 0.00 255.0 DEPOSIT ABSOLUTE /end AXIS_DESCR
/end CHARACTERISTIC
/begin CHARACTERISTIC PFlt_numFltEmpEu_CUR "Eulerzahl für leeres filter [-]" CURVE 0x1ED694 Kl_Xs16_Ws16 3276.700 EulerNum 0.00 3276.700 FORMAT "%8.3" EXTENDED_LIMITS -3276.800 3276.700
 /begin AXIS_DESCR STD_AXIS PFlt_numFltEmpRe_mp ReynoldsNum 16 0.00 3276700. FORMAT "%8.0" EXTENDED_LIMITS -3276800. 3276700. DEPOSIT ABSOLUTE /end AXIS_DESCR
/end CHARACTERISTIC
/begin CHARACTERISTIC PFlt_numFltEmpRe_MAP "Reynoldszahl für leeres Filter" MAP 0x1ED6D6 Kf_Xs16_Ys16_Ws16 3276700. ReynoldsNum 0.00 3276700. FORMAT "%8.0" EXTENDED_LIMITS -3276800. 3276700.
 /begin AXIS_DESCR STD_AXIS PFlt_tFlt Temp_Cels 8 -50.14000 1272.960 FORMAT "%8.3" EXTENDED_LIMITS -3549.940 3003.560 DEPOSIT ABSOLUTE /end AXIS_DESCR
 /begin AXIS_DESCR STD_AXIS PFlt_dmEG AirMassPerTime 8 0.00 1000.000 FORMAT "%8.3" EXTENDED_LIMITS -3276.800 3276.700 DEPOSIT ABSOLUTE /end AXIS_DESCR
/end CHARACTERISTIC
/begin CHARACTERISTIC PFlt_numFltFulEu_CUR "Eulerzahl für volles Filter [-]" CURVE 0x1ED77A Kl_Xs16_Ws16 3276.700 EulerNum 0.00 3276.700 FORMAT "%8.3" EXTENDED_LIMITS -3276.800 3276.700
 /begin AXIS_DESCR STD_AXIS PFlt_numFltFulRe_mp ReynoldsNum 16 0.00 3276700. FORMAT "%8.0" EXTENDED_LIMITS -3276800. 3276700. DEPOSIT ABSOLUTE /end AXIS_DESCR
/end CHARACTERISTIC
/begin CHARACTERISTIC PFlt_numFltFulRe_MAP "Reynoldszahl für volles Filter [-]" MAP 0x1ED7BC Kf_Xs16_Ys16_Ws16 3276700. ReynoldsNum 0.00 3276700. FORMAT "%8.0" EXTENDED_LIMITS -3276800. 3276700.
 /begin AXIS_DESCR STD_AXIS PFlt_tFlt Temp_Cels 8 -50.14000 1272.960 FORMAT "%8.3" EXTENDED_LIMITS -3549.940 3003.560 DEPOSIT ABSOLUTE /end AXIS_DESCR
 /begin AXIS_DESCR STD_AXIS PFlt_dmEG AirMassPerTime 8 0.00 1000.000 FORMAT "%8.3" EXTENDED_LIMITS -3276.800 3276.700 DEPOSIT ABSOLUTE /end AXIS_DESCR
/end CHARACTERISTIC
/begin CHARACTERISTIC PFlt_numLstRstMin_C "Schwelle für Regenerationsanforderungszahl aus Zählerblöcken für Erkennen einer erfolgreichen Regeneration" VALUE 0x1ECAC0 Kw_Wu8 255.0 OneToOne 0.00 255.0 FORMAT "%5.1" /end CHARACTERISTIC
/begin CHARACTERISTIC PFlt_numLst_C "Regenerationsanforderung aufgrund von gefahrener Strecke, Betriebszeit oder Verbrauch" VALUE 0x1ECAC1 Kw_Wu8 255.0 OneToOne 0.00 255.0 FORMAT "%5.1" /end CHARACTERISTIC
/begin CHARACTERISTIC PFlt_numLvlRgnDur0_C "Wert bei Überschreitung der ersten Schwelle der akkumulativen Regenerationszeitüberwachung" VALUE 0x1ECAC2 Kw_Wu8 255.0 OneToOne 0.00 255.0 FORMAT "%5.1" /end CHARACTERISTIC
/begin CHARACTERISTIC PFlt_numLvlRgnDur1_C "Wert bei Überschreitung der zweiten Schwelle der akkumulativen Regenerationszeitüberwachung" VALUE 0x1ECAC3 Kw_Wu8 255.0 OneToOne 0.00 255.0 FORMAT "%5.1" /end CHARACTERISTIC
/begin CHARACTERISTIC PFlt_numLvlRgnDur2_C "Wert bei Überschreitung der dritten Schwelle der akkumulativen Regenerationszeitüberwachung" VALUE 0x1ECAC4 Kw_Wu8 255.0 OneToOne 0.00 255.0 FORMAT "%5.1" /end CHARACTERISTIC
/begin CHARACTERISTIC PFlt_numPrioRgnStg1_C "Priorität für Regenerationstate 1" VALUE 0x1ECAC6 Kw_Wu16 65535.00 OneToOne 0.00 65535.00 FORMAT "%8.2" /end CHARACTERISTIC
/begin CHARACTERISTIC PFlt_numPrioRgnStg2_C "Priorität für Regenerationstate 2" VALUE 0x1ECAC8 Kw_Wu16 65535.00 OneToOne 0.00 65535.00 FORMAT "%8.2" /end CHARACTERISTIC
/begin CHARACTERISTIC PFlt_numPrioRgnStg3_C "Priorität für Regenerationstate 3" VALUE 0x1ECACA Kw_Wu16 65535.00 OneToOne 0.00 65535.00 FORMAT "%8.2" /end CHARACTERISTIC
/begin CHARACTERISTIC PFlt_numPrioRgnStg4_C "Priorität für Regenerationstate 4" VALUE 0x1ECACC Kw_Wu16 65535.00 OneToOne 0.00 65535.00 FORMAT "%8.2" /end CHARACTERISTIC
/begin CHARACTERISTIC PFlt_numPrioRgnStg5_C "Priorität für Regenerationstate 5" VALUE 0x1ECACE Kw_Wu16 65535.00 OneToOne 0.00 65535.00 FORMAT "%8.2" /end CHARACTERISTIC
/begin CHARACTERISTIC PFlt_numPrioRgnStg6_C "Prioritätszahl für Regenerationsstufe 6" VALUE 0x1ECAD0 Kw_Wu16 65535.00 OneToOne 0.00 65535.00 FORMAT "%8.2" /end CHARACTERISTIC
/begin CHARACTERISTIC PFlt_numPrt_C "Regenerationsanforderung aufgrund v. Motorschutz" VALUE 0x1ECAD2 Kw_Wu8 255.0 OneToOne 0.00 255.0 FORMAT "%5.1" /end CHARACTERISTIC
/begin CHARACTERISTIC PFlt_numRgnStgShtrp1_C "Regenerationsstufe 1 im Shorttrip T3 Test" VALUE 0x1ECAD3 Kw_Wu8 6.000 OneToOne 0.00 6.000 FORMAT "%5.3" EXTENDED_LIMITS 0.00 255.0 /end CHARACTERISTIC
/begin CHARACTERISTIC PFlt_numRgnStgShtrp2_C "Regenerationsstufe 2 im Shorttrip T3 test" VALUE 0x1ECAD4 Kw_Wu8 6.000 OneToOne 0.00 6.000 FORMAT "%5.3" EXTENDED_LIMITS 0.00 255.0 /end CHARACTERISTIC
/begin CHARACTERISTIC PFlt_numRgnTrgRgn_C "Regenerationsanforderung aufgrund durch VAG-Tester Login" VALUE 0x1ECAD5 Kw_Wu8 255.0 OneToOne 0.00 255.0 FORMAT "%5.1" /end CHARACTERISTIC
/begin CHARACTERISTIC PFlt_numRgnTxtMsg_C "Auswahl für Partikefiltertextanzeig am Kombiinstrument" VALUE 0x1ECAD6 Kw_Wu8 255.0 OneToOne 0.00 255.0 FORMAT "%5.1" /end CHARACTERISTIC
/begin CHARACTERISTIC PFlt_pDiffDfl_C "Ersatzwert bei Differenzdruck unplausibel" VALUE 0x1ED860 Kw_Ws16 5000.000 Pres_hPa 0.00 5000.000 FORMAT "%8.3" EXTENDED_LIMITS -32768.00 32767.00 /end CHARACTERISTIC
/begin CHARACTERISTIC PFlt_pDiffMaxSotSim_C "Maximaler Abgasgegendruck für Rußbeladungsberechnung [hpa]" VALUE 0x1ED862 Kw_Ws16 5000.000 Pres_hPa 0.00 5000.000 FORMAT "%8.3" EXTENDED_LIMITS -32768.00 32767.00 /end CHARACTERISTIC
/begin CHARACTERISTIC PFlt_pEngPrtMaxInit_C "Inititialisierungswert des PT1-Filters für den Maximalwert im Motorschutz" VALUE 0x1ECAD8 Kw_Ws16 32767.00 Pres_hPa 0.00 32767.00 FORMAT "%8.2" EXTENDED_LIMITS -32768.00 32767.00 /end CHARACTERISTIC
/begin CHARACTERISTIC PFlt_pEngPrtMax_MAP "Kennfeld obere Druckschwelle Motorschutz" MAP 0x1ECADA Kf_Xs16_Ys16_Ws16 1500.000 Pres_hPa 0.00 1500.000 FORMAT "%8.3" EXTENDED_LIMITS -32768.00 32767.00
 /begin AXIS_DESCR STD_AXIS Eng_nAvrg EngN 2 40.00000 6000.000 FORMAT "%8.3" EXTENDED_LIMITS -32768.00 32767.00 DEPOSIT ABSOLUTE /end AXIS_DESCR
 /begin AXIS_DESCR STD_AXIS InjCtl_qSetUnBal InjMass 2 0.00 327.6700 FORMAT "%8.4" EXTENDED_LIMITS -327.6800 327.6700 DEPOSIT ABSOLUTE /end AXIS_DESCR
/end CHARACTERISTIC
/begin CHARACTERISTIC PFlt_pEngPrtMin_MAP "untere Druckschwelle Motorschutz" MAP 0x1ECAEE Kf_Xs16_Ys16_Ws16 1500.000 Pres_hPa 0.00 1500.000 FORMAT "%8.3" EXTENDED_LIMITS -32768.00 32767.00
 /begin AXIS_DESCR STD_AXIS Eng_nAvrg EngN 2 40.00000 6000.000 FORMAT "%8.3" EXTENDED_LIMITS -32768.00 32767.00 DEPOSIT ABSOLUTE /end AXIS_DESCR
 /begin AXIS_DESCR STD_AXIS InjCtl_qSetUnBal InjMass 2 0.00 327.6700 FORMAT "%8.4" EXTENDED_LIMITS -327.6800 327.6700 DEPOSIT ABSOLUTE /end AXIS_DESCR
/end CHARACTERISTIC
/begin CHARACTERISTIC PFlt_pHysHigh1_C "Oberer Hystereseschwellwert Atmosphärendruck 1" VALUE 0x1ECE74 Kw_Ws16 1323.000 Pres_hPa -50.00000 1273.000 FORMAT "%8.3" EXTENDED_LIMITS -32768.00 32767.00 /end CHARACTERISTIC
/begin CHARACTERISTIC PFlt_pHysHigh2_C "Oberer Hystereseschwellwert Atmosphärendruck 2" VALUE 0x1ECE76 Kw_Ws16 3500.000 Pres_hPa 0.00 3500.000 FORMAT "%8.3" EXTENDED_LIMITS -32768.00 32767.00 /end CHARACTERISTIC
/begin CHARACTERISTIC PFlt_pHysHigh3_C "Oberer Hystereseschwellwert Atmosphärendruck 3" VALUE 0x1ECE78 Kw_Ws16 3500.000 Pres_hPa 0.00 3500.000 FORMAT "%8.3" EXTENDED_LIMITS -32768.00 32767.00 /end CHARACTERISTIC
/begin CHARACTERISTIC PFlt_pHysHigh4_C "Oberer Hystereseschwellwert Atmosphärendruck 4" VALUE 0x1ECE7A Kw_Ws16 3500.000 Pres_hPa 0.00 3500.000 FORMAT "%8.3" EXTENDED_LIMITS -32768.00 32767.00 /end CHARACTERISTIC
/begin CHARACTERISTIC PFlt_pHysHigh5_C "Oberer Hystereseschwellwert Atmosphärendruck 5" VALUE 0x1ECE7C Kw_Ws16 3500.000 Pres_hPa 0.00 3500.000 FORMAT "%8.3" EXTENDED_LIMITS -32768.00 32767.00 /end CHARACTERISTIC
/begin CHARACTERISTIC PFlt_pHysLow1_C "Unterer Hystereseschwellwert Atmosphärendruck 1" VALUE 0x1ECE7E Kw_Ws16 3500.000 Pres_hPa 0.00 3500.000 FORMAT "%8.3" EXTENDED_LIMITS -32768.00 32767.00 /end CHARACTERISTIC
/begin CHARACTERISTIC PFlt_pHysLow2_C "Unterer Hystereseschwellwert Atmosphärendruck 2" VALUE 0x1ECE80 Kw_Ws16 3500.000 Pres_hPa 0.00 3500.000 FORMAT "%8.3" EXTENDED_LIMITS -32768.00 32767.00 /end CHARACTERISTIC
/begin CHARACTERISTIC PFlt_pHysLow3_C "Unterer Hystereseschwellwert Atmosphärendruck 3" VALUE 0x1ECE82 Kw_Ws16 3500.000 Pres_hPa 0.00 3500.000 FORMAT "%8.3" EXTENDED_LIMITS -32768.00 32767.00 /end CHARACTERISTIC
/begin CHARACTERISTIC PFlt_pHysLow4_C "Unterer Hystereseschwellwert Atmosphärendruck 4" VALUE 0x1ECE84 Kw_Ws16 3500.000 Pres_hPa 0.00 3500.000 FORMAT "%8.3" EXTENDED_LIMITS -32768.00 32767.00 /end CHARACTERISTIC
/begin CHARACTERISTIC PFlt_pHysLow5_C "Unterer Hystereseschwellwert Atmosphärendruck 5" VALUE 0x1ECE86 Kw_Ws16 3500.000 Pres_hPa 0.00 3500.000 FORMAT "%8.3" EXTENDED_LIMITS -32768.00 32767.00 /end CHARACTERISTIC
/begin CHARACTERISTIC PFlt_pPreDfl_C "Ersatzwert bei Druck vor Partikelfilter unplausibel" VALUE 0x1ED5F6 Kw_Ws16 5000.000 Pres_hPa 0.00 5000.000 FORMAT "%8.3" EXTENDED_LIMITS -32768.00 32767.00 /end CHARACTERISTIC
/begin CHARACTERISTIC PFlt_qActThres7_CUR "Einspritzmenge berechnet aus mittlerer Drehzahl" CURVE 0x1ECE88 Kl_Xs16_Ws16 327.6700 InjMass 0.00 327.6700 FORMAT "%8.4" EXTENDED_LIMITS -327.6800 327.6700
 /begin AXIS_DESCR STD_AXIS Eng_nAvrg EngN 8 40.00000 6000.000 FORMAT "%8.3" EXTENDED_LIMITS -32768.00 32767.00 DEPOSIT ABSOLUTE /end AXIS_DESCR
/end CHARACTERISTIC
/begin CHARACTERISTIC PFlt_qActUpLim7_CUR "Einspritzmenge berechnet aus mittlerer Drehzahl" CURVE 0x1ECEAA Kl_Xs16_Ws16 327.6700 InjMass 0.00 327.6700 FORMAT "%8.4" EXTENDED_LIMITS -327.6800 327.6700
 /begin AXIS_DESCR STD_AXIS Eng_nAvrg EngN 8 40.00000 6000.000 FORMAT "%8.3" EXTENDED_LIMITS -32768.00 32767.00 DEPOSIT ABSOLUTE /end AXIS_DESCR
/end CHARACTERISTIC
/begin CHARACTERISTIC PFlt_qFlMaxDef_C "Regenerationsschwelle für Treibstoffverbrauch im Fehlerfall" VALUE 0x1ECB02 Kw_Ws16 320.0000 Fl_L 0.00 320.0000 FORMAT "%8.4" EXTENDED_LIMITS -327.6800 327.6700 /end CHARACTERISTIC
/begin CHARACTERISTIC PFlt_qFlMax_C "Regenerationsschwelle für Treibstoffverbrauch" VALUE 0x1ECB04 Kw_Ws16 320.0000 Fl_L 0.00 320.0000 FORMAT "%8.4" EXTENDED_LIMITS -327.6800 327.6700 /end CHARACTERISTIC
/begin CHARACTERISTIC PFlt_qFlSubs_C "Treibstoffverbrauch Ersatzwert für den Fall eines Eeprom lese Fehlers" VALUE 0x1ECB06 Kw_Ws16 320.0000 Fl_L 0.00 320.0000 FORMAT "%8.4" EXTENDED_LIMITS -327.6800 327.6700 /end CHARACTERISTIC
/begin CHARACTERISTIC PFlt_rHtg1_C "Stellgröße zu Ansteuerung der Heizung Stufe 1" VALUE 0x1ED5FC Kw_Ws16 100.0000 Prc 0.00 100.0000 FORMAT "%8.4" EXTENDED_LIMITS -327.6800 327.6700 /end CHARACTERISTIC
/begin CHARACTERISTIC PFlt_rHtg2_C "Stellgröße zur Ansteuerung der Heizung Stufe 2" VALUE 0x1ED5FE Kw_Ws16 100.0000 Prc 0.00 100.0000 FORMAT "%8.4" EXTENDED_LIMITS -327.6800 327.6700 /end CHARACTERISTIC
/begin CHARACTERISTIC PFlt_rHtg3_C "Stellgröße zu Ansteuerung der Heizung Stufe 3" VALUE 0x1ED600 Kw_Ws16 100.0000 Prc 0.00 100.0000 FORMAT "%8.4" EXTENDED_LIMITS -327.6800 327.6700 /end CHARACTERISTIC
/begin CHARACTERISTIC PFlt_rSotCntRst_C "Untere Beladungsschwelle zur Rücksetzung des Zählers für nicht erfolgreiche Regenerationen [%]" VALUE 0x1ECB08 Kw_Ws16 100.0000 Prc 0.00 100.0000 FORMAT "%8.4" EXTENDED_LIMITS -327.6800 327.6700 /end CHARACTERISTIC
/begin CHARACTERISTIC PFlt_rSotCntRst_CUR "Schwellenwert für leeres Filter über Differenzdruck" CURVE 0x1ECB0A Kl_Xs16_Ws16 100.0000 Prc 0.00 100.0000 FORMAT "%8.4" EXTENDED_LIMITS -327.6800 327.6700
 /begin AXIS_DESCR STD_AXIS PFlt_tiSumRgnMaxTmr_mp Time_5s 5 -163840.0 163835.0 FORMAT "%8.1" DEPOSIT ABSOLUTE /end AXIS_DESCR
/end CHARACTERISTIC
/begin CHARACTERISTIC PFlt_rSotPresMax_C "Maximale Partikelfilterbeladung [%]" VALUE 0x1ED892 Kw_Ws16 100.0000 Prc 0.00 100.0000 FORMAT "%8.4" EXTENDED_LIMITS -327.6800 327.6700 /end CHARACTERISTIC
/begin CHARACTERISTIC PFlt_rSotPresMin_C "Minimale Partikelfilterbeladung [%]" VALUE 0x1ED894 Kw_Ws16 100.0000 Prc 0.00 100.0000 FORMAT "%8.4" EXTENDED_LIMITS -327.6800 327.6700 /end CHARACTERISTIC
/begin CHARACTERISTIC PFlt_rSotPresOfs_C "Offset zur Partikelfilterbeladung [%]" VALUE 0x1ED896 Kw_Ws16 100.0000 Prc 0.00 100.0000 FORMAT "%8.4" EXTENDED_LIMITS -327.6800 327.6700 /end CHARACTERISTIC
/begin CHARACTERISTIC PFlt_rSotSimPresAddHigh_C "obere Hystereseschwelle für bedarfsgesteuerte Additivierung" VALUE 0x1ECB20 Kw_Ws16 100.0000 Prc 0.00 100.0000 FORMAT "%8.4" EXTENDED_LIMITS -327.6800 327.6700 /end CHARACTERISTIC
/begin CHARACTERISTIC PFlt_rSotSimPresAddLow_C "untere Hystereseschwelle für bedarfsgesteuerte Additivierung" VALUE 0x1ECB22 Kw_Ws16 100.0000 Prc 0.00 100.0000 FORMAT "%8.4" EXTENDED_LIMITS -327.6800 327.6700 /end CHARACTERISTIC
/begin CHARACTERISTIC PFlt_rSotSimPresDfl_C "Startwert für PT1-Filter der Rußbeladung" VALUE 0x1ED89A Kw_Ws16 100.0000 Prc 0.00 100.0000 FORMAT "%8.4" EXTENDED_LIMITS -327.6800 327.6700 /end CHARACTERISTIC
/begin CHARACTERISTIC PFlt_rSotSimPresHigh1_CUR "Höherer Schwellenwert des Ladezustands 1, abgeleitet vom Druckabfall über das Luftmassenniveau" CURVE 0x1ECB24 Kl_Xs16_Ws16 100.0000 Prc 0.00 100.0000 FORMAT "%8.4" EXTENDED_LIMITS -327.6800 327.6700
 /begin AXIS_DESCR STD_AXIS PFlt_tiSumRgnMaxTmr_mp Time_5s 5 -163840.0 163835.0 FORMAT "%8.1" DEPOSIT ABSOLUTE /end AXIS_DESCR
/end CHARACTERISTIC
/begin CHARACTERISTIC PFlt_rSotSimPresHigh2_CUR "Höherer Schwellenwert des Ladezustands 2, abgeleitet vom Druckabfall über das Luftmassenniveau" CURVE 0x1ECB3A Kl_Xs16_Ws16 100.0000 Prc 0.00 100.0000 FORMAT "%8.4" EXTENDED_LIMITS -327.6800 327.6700
 /begin AXIS_DESCR STD_AXIS PFlt_tiSumRgnMaxTmr_mp Time_5s 5 -163840.0 163835.0 FORMAT "%8.1" DEPOSIT ABSOLUTE /end AXIS_DESCR
/end CHARACTERISTIC
/begin CHARACTERISTIC PFlt_rSotSimPresHigh3_CUR "Höherer Schwellenwert des Ladezustands 3, abgeleitet vom Druckabfall über das Luftmassenniveau" CURVE 0x1ECB50 Kl_Xs16_Ws16 100.0000 Prc 0.00 100.0000 FORMAT "%8.4" EXTENDED_LIMITS -327.6800 327.6700
 /begin AXIS_DESCR STD_AXIS PFlt_tiSumRgnMaxTmr_mp Time_5s 5 -163840.0 163835.0 FORMAT "%8.1" DEPOSIT ABSOLUTE /end AXIS_DESCR
/end CHARACTERISTIC
/begin CHARACTERISTIC PFlt_rSotSimPresHigh4_CUR "Höherer Schwellenwert des Ladezustands 4, abgeleitet vom Druckabfall über das Luftmassenniveau" CURVE 0x1ECB66 Kl_Xs16_Ws16 100.0000 Prc 0.00 100.0000 FORMAT "%8.4" EXTENDED_LIMITS -327.6800 327.6700
 /begin AXIS_DESCR STD_AXIS PFlt_tiSumRgnMaxTmr_mp Time_5s 5 -163840.0 163835.0 FORMAT "%8.1" DEPOSIT ABSOLUTE /end AXIS_DESCR
/end CHARACTERISTIC
/begin CHARACTERISTIC PFlt_rSotSimPresLow1_CUR "stellt die temperaturabhängige untere Hysteresenschwelle bei Stufe 1 [s] zur Verfügung." CURVE 0x1ECB7C Kl_Xs16_Ws16 100.0000 Prc 0.00 100.0000 FORMAT "%8.4" EXTENDED_LIMITS -327.6800 327.6700
 /begin AXIS_DESCR STD_AXIS PFlt_tFlt Temp_Cels 5 -50.14000 999.8600 FORMAT "%8.4" EXTENDED_LIMITS -3549.940 3003.560 DEPOSIT ABSOLUTE /end AXIS_DESCR
/end CHARACTERISTIC
/begin CHARACTERISTIC PFlt_rSotSimPresLow2_CUR "stellt die temperaturabhängige untere Hysteresenschwelle bei Stufe 2 [s] zur Verfügung." CURVE 0x1ECB92 Kl_Xs16_Ws16 100.0000 Prc 0.00 100.0000 FORMAT "%8.4" EXTENDED_LIMITS -327.6800 327.6700
 /begin AXIS_DESCR STD_AXIS PFlt_tFlt Temp_Cels 5 -50.14000 999.8600 FORMAT "%8.4" EXTENDED_LIMITS -3549.940 3003.560 DEPOSIT ABSOLUTE /end AXIS_DESCR
/end CHARACTERISTIC
/begin CHARACTERISTIC PFlt_rSotSimPresLow3_CUR "stellt die temperaturabhängige untere Hysteresenschwelle bei Stufe 3 [s] zur Verfügung." CURVE 0x1ECBA8 Kl_Xs16_Ws16 100.0000 Prc 0.00 100.0000 FORMAT "%8.4" EXTENDED_LIMITS -327.6800 327.6700
 /begin AXIS_DESCR STD_AXIS PFlt_tFlt Temp_Cels 5 -50.14000 999.8600 FORMAT "%8.4" EXTENDED_LIMITS -3549.940 3003.560 DEPOSIT ABSOLUTE /end AXIS_DESCR
/end CHARACTERISTIC
/begin CHARACTERISTIC PFlt_rSotSimPresLow4_CUR "stellt die temperaturabhängige untere Hysteresenschwelle bei Stufe 4 [s] zur Verfügung." CURVE 0x1ECBBE Kl_Xs16_Ws16 100.0000 Prc 0.00 100.0000 FORMAT "%8.4" EXTENDED_LIMITS -327.6800 327.6700
 /begin AXIS_DESCR STD_AXIS PFlt_tFlt Temp_Cels 5 -50.14000 999.8600 FORMAT "%8.4" EXTENDED_LIMITS -3549.940 3003.560 DEPOSIT ABSOLUTE /end AXIS_DESCR
/end CHARACTERISTIC
/begin CHARACTERISTIC PFlt_rSotSimPresMax_C "Maximalle Beladungskoefizzient" VALUE 0x1ECE5E Kw_Ws16 100.0000 Prc 0.00 100.0000 FORMAT "%8.4" EXTENDED_LIMITS -327.6800 327.6700 /end CHARACTERISTIC
/begin CHARACTERISTIC PFlt_rSotSimPresRstLow1_C "Niedrigerer Schwellenwert des Ladezustands 1, abgeleitet vom Druckabfall über das Luftmassenniveau." VALUE 0x1ECBD4 Kw_Ws16 100.0000 Prc 0.00 100.0000 FORMAT "%8.4" EXTENDED_LIMITS -327.6800 327.6700 /end CHARACTERISTIC
/begin CHARACTERISTIC PFlt_rSotSimPresRstLow2_C "Niedrigerer Schwellenwert des Ladezustands 2, abgeleitet vom Druckabfall über das Luftmassenniveau." VALUE 0x1ECBD6 Kw_Ws16 100.0000 Prc 0.00 100.0000 FORMAT "%8.4" EXTENDED_LIMITS -327.6800 327.6700 /end CHARACTERISTIC
/begin CHARACTERISTIC PFlt_rSotSimPresRstLow3_C "Niedrigerer Schwellenwert des Ladezustands 3, abgeleitet vom Druckabfall über das Luftmassenniveau." VALUE 0x1ECBD8 Kw_Ws16 100.0000 Prc 0.00 100.0000 FORMAT "%8.4" EXTENDED_LIMITS -327.6800 327.6700 /end CHARACTERISTIC
/begin CHARACTERISTIC PFlt_rSotSimPresRstLow4_C "Niedrigerer Schwellenwert des Ladezustands 4, abgeleitet vom Druckabfall über das Luftmassenniveau." VALUE 0x1ECBDA Kw_Ws16 100.0000 Prc 0.00 100.0000 FORMAT "%8.4" EXTENDED_LIMITS -327.6800 327.6700 /end CHARACTERISTIC
/begin CHARACTERISTIC PFlt_rSotSimPresSubs_C "Ersatzwert für Rußbeladung bei permanentem Defekt in der Druckmessung" VALUE 0x1ED89C Kw_Ws16 100.0000 Prc 0.00 100.0000 FORMAT "%8.4" EXTENDED_LIMITS -327.6800 327.6700 /end CHARACTERISTIC
/begin CHARACTERISTIC PFlt_rSotSimTempCntRst_C "Schwellwert für die Rücksetzung des erfolglos-regeneriert Zählers für den Aschemassensimulationspfad" VALUE 0x1ECBDC Kw_Ws16 100.0000 Prc 0.00 100.0000 FORMAT "%8.4" EXTENDED_LIMITS -327.6800 327.6700 /end CHARACTERISTIC
/begin CHARACTERISTIC PFlt_rSotSimTempCntRst_CUR "Schwellenwert für leeres Filter über Beladungssimulation" CURVE 0x1ECBDE Kl_Xs16_Ws16 100.0000 Prc 0.00 100.0000 FORMAT "%8.4" EXTENDED_LIMITS -327.6800 327.6700
 /begin AXIS_DESCR STD_AXIS PFlt_tiSumRgnMaxTmr_mp Time_5s 5 -163840.0 163835.0 FORMAT "%8.1" DEPOSIT ABSOLUTE /end AXIS_DESCR
/end CHARACTERISTIC
/begin CHARACTERISTIC PFlt_rSotSimTempLow1_CUR "Temperaturabhängiger unterer Schwellwert für die aschemassensimulations Hysterese 1" CURVE 0x1ECBF4 Kl_Xs16_Ws16 100.0000 Prc 0.00 100.0000 FORMAT "%8.4" EXTENDED_LIMITS -327.6800 327.6700
 /begin AXIS_DESCR STD_AXIS PFlt_tFlt Temp_Cels 5 -50.14000 999.8600 FORMAT "%8.4" EXTENDED_LIMITS -3549.940 3003.560 DEPOSIT ABSOLUTE /end AXIS_DESCR
/end CHARACTERISTIC
/begin CHARACTERISTIC PFlt_rSotSimTempLow2_CUR "Temperaturabhängiger unterer Schwellwert für die aschemassensimulations Hysterese 2" CURVE 0x1ECC0A Kl_Xs16_Ws16 100.0000 Prc 0.00 100.0000 FORMAT "%8.4" EXTENDED_LIMITS -327.6800 327.6700
 /begin AXIS_DESCR STD_AXIS PFlt_tFlt Temp_Cels 5 -50.14000 999.8600 FORMAT "%8.4" EXTENDED_LIMITS -3549.940 3003.560 DEPOSIT ABSOLUTE /end AXIS_DESCR
/end CHARACTERISTIC
/begin CHARACTERISTIC PFlt_rSotSimTempLow3_CUR "Temperaturabhängiger unterer Schwellwert für die aschemassensimulations Hysterese 3" CURVE 0x1ECC20 Kl_Xs16_Ws16 100.0000 Prc 0.00 100.0000 FORMAT "%8.4" EXTENDED_LIMITS -327.6800 327.6700
 /begin AXIS_DESCR STD_AXIS PFlt_tFlt Temp_Cels 5 -50.14000 999.8600 FORMAT "%8.4" EXTENDED_LIMITS -3549.940 3003.560 DEPOSIT ABSOLUTE /end AXIS_DESCR
/end CHARACTERISTIC
/begin CHARACTERISTIC PFlt_rSotSimTempLow4_CUR "Temperaturabhängiger unterer Schwellwert für die aschemassensimulations Hysterese 4" CURVE 0x1ECC36 Kl_Xs16_Ws16 100.0000 Prc 0.00 100.0000 FORMAT "%8.4" EXTENDED_LIMITS -327.6800 327.6700
 /begin AXIS_DESCR STD_AXIS PFlt_tFlt Temp_Cels 5 -50.14000 999.8600 FORMAT "%8.4" EXTENDED_LIMITS -3549.940 3003.560 DEPOSIT ABSOLUTE /end AXIS_DESCR
/end CHARACTERISTIC
/begin CHARACTERISTIC PFlt_rSotSimTempLst_C "Initialisierungswert fuer Russmassenintegrator bei Regenerationsanforderung ueber Weg, Zeit oder Kraftstoffmenge" VALUE 0x1EED22 Kw_Ws16 100.0000 Prc 0.00 100.0000 FORMAT "%8.4" EXTENDED_LIMITS -327.6800 327.6700 /end CHARACTERISTIC
/begin CHARACTERISTIC PFlt_rSotSimTempMax_C "Maximale akkumulierte Aschemasse des Aschemassensimulationspfades bevor eine Fehlerreaktion ausgelöst wird" VALUE 0x1ECE60 Kw_Ws16 100.0000 Prc 0.00 100.0000 FORMAT "%8.4" EXTENDED_LIMITS -327.6800 327.6700 /end CHARACTERISTIC
/begin CHARACTERISTIC PFlt_rSotSimTempRstLow1_C "unterer Schwellwert des Filterbeladungskoeffizienten für den Aschemassensimulaions-Status 1" VALUE 0x1ECC4C Kw_Ws16 100.0000 Prc 0.00 100.0000 FORMAT "%8.4" EXTENDED_LIMITS -327.6800 327.6700 /end CHARACTERISTIC
/begin CHARACTERISTIC PFlt_rSotSimTempRstLow2_C "unterer Schwellwert des Filterbeladungskoeffizienten für den Aschemassensimulaions-Status 2" VALUE 0x1ECC4E Kw_Ws16 100.0000 Prc 0.00 100.0000 FORMAT "%8.4" EXTENDED_LIMITS -327.6800 327.6700 /end CHARACTERISTIC
/begin CHARACTERISTIC PFlt_rSotSimTempRstLow3_C "unterer Schwellwert des Filterbeladungskoeffizienten für den Aschemassensimulaions-Status 3" VALUE 0x1ECC50 Kw_Ws16 100.0000 Prc 0.00 100.0000 FORMAT "%8.4" EXTENDED_LIMITS -327.6800 327.6700 /end CHARACTERISTIC
/begin CHARACTERISTIC PFlt_rSotSimTempRstLow4_C "unterer Schwellwert des Filterbeladungskoeffizienten für den Aschemassensimulaions-Status 4" VALUE 0x1ECC52 Kw_Ws16 100.0000 Prc 0.00 100.0000 FORMAT "%8.4" EXTENDED_LIMITS -327.6800 327.6700 /end CHARACTERISTIC
/begin CHARACTERISTIC PFlt_rsTransThres7_C "Schwelle für das Untersetzungsgetreibe" VALUE 0x1ECECC Kw_Ws16 100.0000 TransR 0.00 100.0000 FORMAT "%8.4" EXTENDED_LIMITS -327.6800 327.6700 /end CHARACTERISTIC
/begin CHARACTERISTIC PFlt_rThresTransAWD_C "Schwelle für das zusätzliche Unterzungsgetriebe ,wenn die Rduzierung aktiviert." VALUE 0x1ECECE Kw_Ws16 100.0000 TransR 0.00 100.0000 FORMAT "%8.4" EXTENDED_LIMITS -327.6800 327.6700 /end CHARACTERISTIC
/begin CHARACTERISTIC PFlt_rThresTrans_C "Schwelle für das zusätzliche Unterzungsgetriebe,wenn di Reduzierung nicht aktiviert." VALUE 0x1ECED0 Kw_Ws16 100.0000 TransR 0.00 100.0000 FORMAT "%8.4" EXTENDED_LIMITS -327.6800 327.6700 /end CHARACTERISTIC
/begin CHARACTERISTIC PFlt_t1DT1Sim_C "Totzeit für q_inj DT1 Filter" VALUE 0x1EED28 Kw_Wu32 4294.9673 TimeDelay_s 0.0000010000000 4294.9673 FORMAT "%9.4" /end CHARACTERISTIC
/begin CHARACTERISTIC PFlt_kdDT1Sim_C "kd für q_inj DT1 Filter" VALUE 0x1EED2C Kw_Ws32 32767.9999847 Kd 0.00 32767.9999847 FORMAT "%13.7" EXTENDED_LIMITS -32768.0000000 32767.9999847 /end CHARACTERISTIC
/begin CHARACTERISTIC PFlt_stCmpHtg1_C "Maske zur Ansteuerung der Heizung Stufe 2" VALUE 0x1ED604 Kw_Wu32 2147483647.00 OneToOne 0.00 2147483647.00 FORMAT "%13.2" EXTENDED_LIMITS 0.00 4294967295.00 /end CHARACTERISTIC
/begin CHARACTERISTIC PFlt_stCmpHtg2_C "Maske zur Ansteuerung der Heizung Stufe 2" VALUE 0x1ED608 Kw_Wu32 2147483647.00 OneToOne 0.00 2147483647.00 FORMAT "%13.2" EXTENDED_LIMITS 0.00 4294967295.00 /end CHARACTERISTIC
/begin CHARACTERISTIC PFlt_stCmpHtg3_C "Maske zu Ansteuerung der Heizung Stufe 3" VALUE 0x1ED60C Kw_Wu32 2147483647.00 OneToOne 0.00 2147483647.00 FORMAT "%13.2" EXTENDED_LIMITS 0.00 4294967295.00 /end CHARACTERISTIC
/begin CHARACTERISTIC PFlt_stEngPOpShOffMsk_C "Maske zur Ausblendung der Betriebsbedingung PFlt_stEngPopCalc_mp." VALUE 0x1ECED2 Kw_Wu8 255.0 OneToOne 0.00 255.0 FORMAT "%5.1" /end CHARACTERISTIC
/begin CHARACTERISTIC PFlt_stInrRgnMsk1_C "Maske 1 für Regenerations-Unterbrechung wegen hohem Moment" VALUE 0x1ECC54 Kw_Wu32 2147483647.00 OneToOne 0.00 2147483647.00 FORMAT "%13.2" EXTENDED_LIMITS 0.00 4294967295.00 /end CHARACTERISTIC
/begin CHARACTERISTIC PFlt_stInrRgnMsk2_C "Maske 2 für Regenerations-Unterbrechung wegen hohem Moment" VALUE 0x1ECC58 Kw_Wu32 2147483647.00 OneToOne 0.00 2147483647.00 FORMAT "%13.2" EXTENDED_LIMITS 0.00 4294967295.00 /end CHARACTERISTIC
/begin CHARACTERISTIC PFlt_stLckRgnMsk_C "Maske für Blockierung und Freigabe der Regeneration" VALUE 0x1ECC5C Kw_Wu32 2147483647.00 OneToOne 0.00 2147483647.00 FORMAT "%13.2" EXTENDED_LIMITS 0.00 4294967295.00 /end CHARACTERISTIC
/begin CHARACTERISTIC PFlt_stRgnStg1_C "PFlt_st im Fall Regenerationsstate 1" VALUE 0x1ECC60 Kw_Wu32 4294967295.00 OneToOne 0.00 4294967295.00 FORMAT "%13.2" /end CHARACTERISTIC
/begin CHARACTERISTIC PFlt_stRgnStg2_C "PFlt_st im Fall Regenerationsstate 2" VALUE 0x1ECC64 Kw_Wu32 4294967295.00 OneToOne 0.00 4294967295.00 FORMAT "%13.2" /end CHARACTERISTIC
/begin CHARACTERISTIC PFlt_stRgnStg3_C "PFlt_st im Fall Regenerationsstate 3" VALUE 0x1ECC68 Kw_Wu32 4294967295.00 OneToOne 0.00 4294967295.00 FORMAT "%13.2" /end CHARACTERISTIC
/begin CHARACTERISTIC PFlt_stRgnStg4_C "PFlt_st im Fall Regenerationsstate 4" VALUE 0x1ECC6C Kw_Wu32 4294967295.00 OneToOne 0.00 4294967295.00 FORMAT "%13.2" /end CHARACTERISTIC
/begin CHARACTERISTIC PFlt_stRgnStg5_C "PFlt_st im Fall Regenerationsstate 5" VALUE 0x1ECC70 Kw_Wu32 4294967295.00 OneToOne 0.00 4294967295.00 FORMAT "%13.2" /end CHARACTERISTIC
/begin CHARACTERISTIC PFlt_stRgnStg6_C "Maßnahmenbitwort Regenerationsstufe 6" VALUE 0x1ECC74 Kw_Wu32 4294967295.00 OneToOne 0.00 4294967295.00 FORMAT "%13.2" /end CHARACTERISTIC
/begin CHARACTERISTIC PFlt_stSumRgnMsk_C "Maske für die akkumulative Regenerationszeitüberwachung" VALUE 0x1ECC78 Kw_Wu32 2147483647.00 OneToOne 0.00 2147483647.00 FORMAT "%13.2" EXTENDED_LIMITS 0.00 4294967295.00 /end CHARACTERISTIC
/begin CHARACTERISTIC PFlt_swtAftRunHys_C "Schalter zum Selektieren der Parameter für die Ermittlung des Beladungskoeffizienten im Nachlauf" VALUE 0x1ECC7C Kw_Wu8 1.000 OneToOne 0.00 1.000 FORMAT "%5.3" EXTENDED_LIMITS 0.00 255.0 /end CHARACTERISTIC
/begin CHARACTERISTIC PFlt_swtCntSel_C "Auswahlschalter für Eingangsgröße nicht erfolgreiche Regeneration" VALUE 0x1ECC7D Kw_Wu8 1.000 OneToOne 0.00 1.000 FORMAT "%5.3" EXTENDED_LIMITS 0.00 255.0 /end CHARACTERISTIC
/begin CHARACTERISTIC PFlt_swtEngPrtSel_C "Auswahlschalter für Eingangsgröße Motorschutz" VALUE 0x1ECC7E Kw_Wu8 1.000 OneToOne 0.00 1.000 FORMAT "%5.3" EXTENDED_LIMITS 0.00 255.0 /end CHARACTERISTIC
/begin CHARACTERISTIC PFlt_swtFltTemp_C "Umschalter des Filteroberflächentemperaturmodells" VALUE 0x1EF125 Kw_Wu8 1.000 OneToOne 0.00 1.000 FORMAT "%5.3" EXTENDED_LIMITS 0.00 255.0 /end CHARACTERISTIC
/begin CHARACTERISTIC PFlt_swtLmbdAprx_C "Mess- oder Simulationssignal für Lambda-Messung (1: Simulation, 0: Messsignal)" VALUE 0x1ED5F8 Kw_Wu8 1.000 OneToOne 0.00 1.000 FORMAT "%5.3" EXTENDED_LIMITS 0.00 255.0 /end CHARACTERISTIC
/begin CHARACTERISTIC PFlt_swtLowThresSel_C "Auswahlschalter für Umschaltung für untere Baladungsschwellen" VALUE 0x1ECC7F Kw_Wu8 1.000 OneToOne 0.00 1.000 FORMAT "%5.3" EXTENDED_LIMITS 0.00 255.0 /end CHARACTERISTIC
/begin CHARACTERISTIC PFlt_swtOxiCatTemp_C "Schalter fur OxiKatTemperaturwert" VALUE 0x1ECED3 Kw_Wu8 2.000 OneToOne 0.00 2.000 FORMAT "%5.3" EXTENDED_LIMITS 0.00 255.0 /end CHARACTERISTIC
/begin CHARACTERISTIC PFlt_swtRgnEndTempEna_C "Schalter fuer Aktivierung der Regeneration erfolgreich Erkennung ueber Russmassenintegrator bei Lst Anforderung" VALUE 0x1ECC80 Kw_Wu8 1.000 OneToOne 0.00 1.000 FORMAT "%5.3" EXTENDED_LIMITS 0.00 255.0 /end CHARACTERISTIC
/begin CHARACTERISTIC PFlt_swtRgnEndTempInit_C "Schalter fuer Aktivierung der Initialisierung des Russmassenintegrators bei Lst Anforderung" VALUE 0x1EED35 Kw_Wu8 1.000 OneToOne 0.00 1.000 FORMAT "%5.3" EXTENDED_LIMITS 0.00 255.0 /end CHARACTERISTIC
/begin CHARACTERISTIC PFlt_swtSotSimPT1Init_C "Auswahlschalter für Initialisierung des PT1 Filters im Beladungskoeffizienten" VALUE 0x1ED8A0 Kw_Wu8 1.000 OneToOne 0.00 1.000 FORMAT "%5.3" EXTENDED_LIMITS 0.00 255.0 /end CHARACTERISTIC
/begin CHARACTERISTIC PFlt_swtTempNorm_C "Schalter der Temperaturwert des Arrays auswählt" VALUE 0x1ECED4 Kw_Wu8 4.00000000000 EngTempFldSel 0.00 4.00000000000 FORMAT "%13.11" /end CHARACTERISTIC
/begin CHARACTERISTIC PFlt_swtTempPOpCalc_C "Schalter der Temperaturwert des Arrays auswählt" VALUE 0x1ECED5 Kw_Wu8 4.00000000000 EngTempFldSel 0.00 4.00000000000 FORMAT "%13.11" /end CHARACTERISTIC
/begin CHARACTERISTIC PFlt_swtTmrLckRst_C "Schalter zum Rücksetzen des EEPROM Wertes der Sperrzeit (1: Reset, 0: kein Reset)" VALUE 0x1ECC81 Kw_Wu8 255.0 OneToOne 0.00 255.0 FORMAT "%5.1" READ_ONLY /end CHARACTERISTIC
/begin CHARACTERISTIC PFlt_swtTmrRgnRst_C "Schalter für Initialisierung des Rengenerationsdauerzählers mit EEPROM Wert oder Ersatzwert" VALUE 0x1ECC82 Kw_Wu8 1.000 OneToOne 0.00 1.000 FORMAT "%5.3" EXTENDED_LIMITS 0.00 255.0 /end CHARACTERISTIC
/begin CHARACTERISTIC PFlt_tAccPedOff_C "Verzögerungszeit für schnelle Regenerations-Unterbrechung bei schneller Fahrpedalbetätigung" VALUE 0x1ECC84 Kw_Wu16 300.0000 Time_s 0.00 300.0000 FORMAT "%8.4" EXTENDED_LIMITS 0.00 655.3500 /end CHARACTERISTIC
/begin CHARACTERISTIC PFlt_tClntHysHigh1_C "Oberer Hystereseschwellwert Kühlmitteltemperatur 1" VALUE 0x1ECED6 Kw_Ws16 200.0000 Temp_Cels -50.14000 149.8600 FORMAT "%8.4" EXTENDED_LIMITS -3549.940 3003.560 /end CHARACTERISTIC
/begin CHARACTERISTIC PFlt_tClntHysHigh2_C "Oberer Hystereseschwellwert Kühlmitteltemperatur 2" VALUE 0x1ECED8 Kw_Ws16 200.0000 Temp_Cels -50.14000 149.8600 FORMAT "%8.4" EXTENDED_LIMITS -3549.940 3003.560 /end CHARACTERISTIC
/begin CHARACTERISTIC PFlt_tClntHysHigh3_C "Oberer Hystereseschwellwert Kühlmitteltemperatur 3" VALUE 0x1ECEDA Kw_Ws16 200.0000 Temp_Cels -50.14000 149.8600 FORMAT "%8.4" EXTENDED_LIMITS -3549.940 3003.560 /end CHARACTERISTIC
/begin CHARACTERISTIC PFlt_tClntHysHigh4_C "Oberer Hystereseschwellwert Kühlmitteltemperatur 4" VALUE 0x1ECEDC Kw_Ws16 200.0000 Temp_Cels -50.14000 149.8600 FORMAT "%8.4" EXTENDED_LIMITS -3549.940 3003.560 /end CHARACTERISTIC
/begin CHARACTERISTIC PFlt_tClntHysHigh5_C "Oberer Hystereseschwellwert Kühlmitteltemperatur 5" VALUE 0x1ECEDE Kw_Ws16 200.0000 Temp_Cels -50.14000 149.8600 FORMAT "%8.4" EXTENDED_LIMITS -3549.940 3003.560 /end CHARACTERISTIC
/begin CHARACTERISTIC PFlt_tClntHysHigh7_C "Oberer Hystereseschwellwert für max. erlaubte Wassertemperatur" VALUE 0x1ECEE0 Kw_Ws16 200.0000 Temp_Cels -50.14000 149.8600 FORMAT "%8.4" EXTENDED_LIMITS -3549.940 3003.560 /end CHARACTERISTIC
/begin CHARACTERISTIC PFlt_tClntHysLow1_C "Unterer Hystereseschwellwert Kühlmitteltemperatur 1" VALUE 0x1ECEE2 Kw_Ws16 200.0000 Temp_Cels -50.14000 149.8600 FORMAT "%8.4" EXTENDED_LIMITS -3549.940 3003.560 /end CHARACTERISTIC
/begin CHARACTERISTIC PFlt_tClntHysLow2_C "Unterer Hystereseschwellwert Kühlmitteltemperatur 2" VALUE 0x1ECEE4 Kw_Ws16 200.0000 Temp_Cels -50.14000 149.8600 FORMAT "%8.4" EXTENDED_LIMITS -3549.940 3003.560 /end CHARACTERISTIC
/begin CHARACTERISTIC PFlt_tClntHysLow3_C "Unterer Hystereseschwellwert Kühlmitteltemperatur 3" VALUE 0x1ECEE6 Kw_Ws16 200.0000 Temp_Cels -50.14000 149.8600 FORMAT "%8.4" EXTENDED_LIMITS -3549.940 3003.560 /end CHARACTERISTIC
/begin CHARACTERISTIC PFlt_tClntHysLow4_C "Unterer Hystereseschwellwert Kühlmitteltemperatur 4" VALUE 0x1ECEE8 Kw_Ws16 200.0000 Temp_Cels -50.14000 149.8600 FORMAT "%8.4" EXTENDED_LIMITS -3549.940 3003.560 /end CHARACTERISTIC
/begin CHARACTERISTIC PFlt_tClntHysLow5_C "Unterer Hystereseschwellwert Kühlmitteltemperatur 5" VALUE 0x1ECEEA Kw_Ws16 200.0000 Temp_Cels -50.14000 149.8600 FORMAT "%8.4" EXTENDED_LIMITS -3549.940 3003.560 /end CHARACTERISTIC
/begin CHARACTERISTIC PFlt_tClntHysLow7_C "Unterer Hystereseschwellwert für max. erlaubte Wassertemperatur" VALUE 0x1ECEEC Kw_Ws16 200.0000 Temp_Cels -50.14000 149.8600 FORMAT "%8.4" EXTENDED_LIMITS -3549.940 3003.560 /end CHARACTERISTIC
/begin CHARACTERISTIC PFlt_tClntLowMax_C "Unterer Hysterese Wert für max. erlaubte Wassertemperatur" VALUE 0x1ECC86 Kw_Ws16 200.0000 Temp_Cels -50.14000 149.8600 FORMAT "%8.4" EXTENDED_LIMITS -3549.940 3003.560 /end CHARACTERISTIC
/begin CHARACTERISTIC PFlt_tClntUppMax_C "Oberer Hysterese Wert für max. erlaubte Wassertemperatur" VALUE 0x1ECC88 Kw_Ws16 200.0000 Temp_Cels -50.14000 149.8600 FORMAT "%8.4" EXTENDED_LIMITS -3549.940 3003.560 /end CHARACTERISTIC
/begin CHARACTERISTIC PFlt_tExhGsSty_MAP "Kennfeld für Stationärtemperaturen [K]" MAP 0x1EF21E Kf_Xs16_Ys16_Ws16 700.0000 TempDiff_Kelv 100.0000 800.0000 FORMAT "%8.4" EXTENDED_LIMITS -3276.800 3276.700
 /begin AXIS_DESCR STD_AXIS Eng_nAvrg EngN 2 40.00000 6000.000 FORMAT "%8.3" EXTENDED_LIMITS -32768.00 32767.00 DEPOSIT ABSOLUTE /end AXIS_DESCR
 /begin AXIS_DESCR STD_AXIS InjCtl_qSetUnBal InjMass 2 0.00 327.6700 FORMAT "%8.4" EXTENDED_LIMITS -327.6800 327.6700 DEPOSIT ABSOLUTE /end AXIS_DESCR
/end CHARACTERISTIC
/begin CHARACTERISTIC PFlt_tFltCorrHysHigh3_C "Oberer Hystereseschwellwert für Filtertemperaturkorrektur 3" VALUE 0x1ECEEE Kw_Ws16 1323.100 TempDiff_Kelv -50.10000 1273.000 FORMAT "%8.3" EXTENDED_LIMITS -3276.800 3276.700 /end CHARACTERISTIC
/begin CHARACTERISTIC PFlt_tFltCorrHysHigh4_C "Oberer Hystereseschwellwert für Filtertemperaturkorrektur 4" VALUE 0x1ECEF0 Kw_Ws16 1323.100 TempDiff_Kelv -50.10000 1273.000 FORMAT "%8.3" EXTENDED_LIMITS -3276.800 3276.700 /end CHARACTERISTIC
/begin CHARACTERISTIC PFlt_tFltCorrHysLow3_C "Unterer Hystereseschwellwert für Filtertemperaturkorrektur 3" VALUE 0x1ECEF2 Kw_Ws16 1323.100 TempDiff_Kelv -50.10000 1273.000 FORMAT "%8.3" EXTENDED_LIMITS -3276.800 3276.700 /end CHARACTERISTIC
/begin CHARACTERISTIC PFlt_tFltCorrHysLow4_C "Unterer Hystereseschwellwert für Filtertemperaturkorrektur 4" VALUE 0x1ECEF4 Kw_Ws16 1323.100 TempDiff_Kelv -50.10000 1273.000 FORMAT "%8.3" EXTENDED_LIMITS -3276.800 3276.700 /end CHARACTERISTIC
/begin CHARACTERISTIC PFlt_tFltHysHigh1_C "Unterer Hystereseschwellwert für Temperatur im Filter 1" VALUE 0x1ECEF6 Kw_Ws16 1323.100 Temp_Cels -50.14000 1272.960 FORMAT "%8.3" EXTENDED_LIMITS -3549.940 3003.560 /end CHARACTERISTIC
/begin CHARACTERISTIC PFlt_tFltHysHigh2_C "Oberer Hystereseschwellwert für Temperatur im Filter 2" VALUE 0x1ECEF8 Kw_Ws16 1323.100 Temp_Cels -50.14000 1272.960 FORMAT "%8.3" EXTENDED_LIMITS -3549.940 3003.560 /end CHARACTERISTIC
/begin CHARACTERISTIC PFlt_tFltHysHigh3_C "Oberer Hystereseschwellwert für Temperatur im Filter 3" VALUE 0x1ECEFA Kw_Ws16 1323.100 Temp_Cels -50.14000 1272.960 FORMAT "%8.3" EXTENDED_LIMITS -3549.940 3003.560 /end CHARACTERISTIC
/begin CHARACTERISTIC PFlt_tFltHysHigh4_C "Oberer Hystereseschwellwert für Temperatur im Filter 4" VALUE 0x1ECEFC Kw_Ws16 1323.100 Temp_Cels -50.14000 1272.960 FORMAT "%8.3" EXTENDED_LIMITS -3549.940 3003.560 /end CHARACTERISTIC
/begin CHARACTERISTIC PFlt_tFltHysHigh5_C "Oberer Hystereseschwellwert für Temperatur im Filter 5" VALUE 0x1ECEFE Kw_Ws16 1323.100 Temp_Cels -50.14000 1272.960 FORMAT "%8.3" EXTENDED_LIMITS -3549.940 3003.560 /end CHARACTERISTIC
/begin CHARACTERISTIC PFlt_tFltHysHigh7_C "Oberer Hystereseschwellwert für max. erlaubte Abgastemperatur" VALUE 0x1ECF00 Kw_Ws16 1323.100 Temp_Cels -50.14000 1272.960 FORMAT "%8.3" EXTENDED_LIMITS -3549.940 3003.560 /end CHARACTERISTIC
/begin CHARACTERISTIC PFlt_tFltHysLow1_C "Unterer Hystereseschwellwert für Temperatur im Filter 1" VALUE 0x1ECF02 Kw_Ws16 1323.100 Temp_Cels -50.14000 1272.960 FORMAT "%8.3" EXTENDED_LIMITS -3549.940 3003.560 /end CHARACTERISTIC
/begin CHARACTERISTIC PFlt_tFltHysLow2_C "Unterer Hystereseschwellwert für Temperatur im Filter 2" VALUE 0x1ECF04 Kw_Ws16 1323.100 Temp_Cels -50.14000 1272.960 FORMAT "%8.3" EXTENDED_LIMITS -3549.940 3003.560 /end CHARACTERISTIC
/begin CHARACTERISTIC PFlt_tFltHysLow3_C "Unterer Hystereseschwellwert für Temperatur im Filter 3" VALUE 0x1ECF06 Kw_Ws16 1323.100 Temp_Cels -50.14000 1272.960 FORMAT "%8.3" EXTENDED_LIMITS -3549.940 3003.560 /end CHARACTERISTIC
/begin CHARACTERISTIC PFlt_tFltHysLow4_C "Unterer Hystereseschwellwert für Temperatur im Filter 4" VALUE 0x1ECF08 Kw_Ws16 1323.100 Temp_Cels -50.14000 1272.960 FORMAT "%8.3" EXTENDED_LIMITS -3549.940 3003.560 /end CHARACTERISTIC
/begin CHARACTERISTIC PFlt_tFltHysLow5_C "Unterer Hystereseschwellwert für Temperatur im Filter 5" VALUE 0x1ECF0A Kw_Ws16 1323.100 Temp_Cels -50.14000 1272.960 FORMAT "%8.3" EXTENDED_LIMITS -3549.940 3003.560 /end CHARACTERISTIC
/begin CHARACTERISTIC PFlt_tFltHysLow7_C "Untere Hystereseschwellwert für max. erlaubte Abgastemperatur" VALUE 0x1ECF0C Kw_Ws16 1323.100 Temp_Cels -50.14000 1272.960 FORMAT "%8.3" EXTENDED_LIMITS -3549.940 3003.560 /end CHARACTERISTIC
/begin CHARACTERISTIC PFlt_tFltThres_C "Vergleichstemperatur für Temperatur in Filter für Bit 6" VALUE 0x1ECF0E Kw_Ws16 1323.100 Temp_Cels -50.14000 1272.960 FORMAT "%8.3" EXTENDED_LIMITS -3549.940 3003.560 /end CHARACTERISTIC
/begin CHARACTERISTIC PFlt_tiCntThres_C "Zeitschwelle für akkumulativ nichterfolgreiche Regeneration" VALUE 0x1ECC8A Kw_Ws16 163835.0 Time_5s 0.00 163835.0 FORMAT "%8.1" EXTENDED_LIMITS -163840.0 163835.0 /end CHARACTERISTIC
/begin CHARACTERISTIC PFlt_tiDebSimRgn5Off_C "Entprellzeit zum Zurücksetzen bei der Betriebszustandsberechnung für die Stufe 5" VALUE 0x1ECF10 Kw_Wu16 655350.0 TimeDeb 0.00 655350.0 FORMAT "%8.1" /end CHARACTERISTIC
/begin CHARACTERISTIC PFlt_tiDebSimRgn5On_C "Entprellzeit zum Setzen bei der Betriebszustandsberechnung für die Stufe 5" VALUE 0x1ECF12 Kw_Wu16 655350.0 TimeDeb 0.00 655350.0 FORMAT "%8.1" /end CHARACTERISTIC
/begin CHARACTERISTIC PFlt_tiDebSimRgn7Off_C "Entprellzeit zum Zurücksetzen bei der Betriebszustandsberechnung für die Stufe 7" VALUE 0x1ECF14 Kw_Wu16 655350.0 TimeDeb 0.00 655350.0 FORMAT "%8.1" /end CHARACTERISTIC
/begin CHARACTERISTIC PFlt_tiDebSimRgn7On_C "Entprellzeit zum Setzen bei der Betriebszustandsberechnung für die Stufe 7" VALUE 0x1ECF16 Kw_Wu16 655350.0 TimeDeb 0.00 655350.0 FORMAT "%8.1" /end CHARACTERISTIC
/begin CHARACTERISTIC PFlt_tiDebSpeed5Off_C "Entprellzeit zum Zurücksetzen bei der Betriebszustandsberechnung für die Stufe 5" VALUE 0x1ECF18 Kw_Wu16 655350.0 TimeDeb 0.00 655350.0 FORMAT "%8.1" /end CHARACTERISTIC
/begin CHARACTERISTIC PFlt_tiDebSpeed5On_C "Entprellzeit zum Setzen bei der Betriebszustandsberechnung für die Stufe 5" VALUE 0x1ECF1A Kw_Wu16 655350.0 TimeDeb 0.00 655350.0 FORMAT "%8.1" /end CHARACTERISTIC
/begin CHARACTERISTIC PFlt_tiEngOnMaxDef_C "maximale Motorbetriebszeit für Regeneration im Fehlerfall" VALUE 0x1ECC8C Kw_Wu32 4294967295.00 TimeEngOn 0.00 4294967295.00 FORMAT "%13.2" /end CHARACTERISTIC
/begin CHARACTERISTIC PFlt_tiEngOnMax_C "maximale Motorbetriebszeit für Regeneration" VALUE 0x1ECC90 Kw_Wu32 4294967295.00 TimeEngOn 0.00 4294967295.00 FORMAT "%13.2" /end CHARACTERISTIC
/begin CHARACTERISTIC PFlt_tiEngPrtPT1_C "Zeitkonstante des PT1-Gliedes für den Motorschutz" VALUE 0x1ECC94 Kw_Wu32 4294.9673 TimeDelay_s 0.0000010000000 4294.9673 FORMAT "%9.4" /end CHARACTERISTIC
/begin CHARACTERISTIC PFlt_tiEngPrt_C "Regenerationsdauer aufgrund von Motorschutz" VALUE 0x1ECC98 Kw_Wu32 42949672.9500 Time_s 0.00 42949672.9500 FORMAT "%13.4" /end CHARACTERISTIC
/begin CHARACTERISTIC PFlt_tiErLpDel_C "Verzögerung der PFlt-Lampe nach Lampentest" VALUE 0x1ECC9C Kw_Wu16 655140.0 Time_ms 0.00 655140.0 FORMAT "%8.1" EXTENDED_LIMITS 0.00 655350.0 /end CHARACTERISTIC
/begin CHARACTERISTIC PFlt_tiErLpMax_C "Zeitgrenze für PFlt-Lampentest" VALUE 0x1ECC9E Kw_Wu16 655140.0 Time_ms 0.00 655140.0 FORMAT "%8.1" EXTENDED_LIMITS 0.00 655350.0 /end CHARACTERISTIC
/begin CHARACTERISTIC PFlt_tiErLpTst_C "zusätzliche PFlt-Testzeit nach Überschreiten der Drehzahlschwelle oder max Testzeit" VALUE 0x1ECCA0 Kw_Wu16 655140.0 Time_ms 0.00 655140.0 FORMAT "%8.1" EXTENDED_LIMITS 0.00 655350.0 /end CHARACTERISTIC
/begin CHARACTERISTIC PFlt_tiFltTempPT1_C "Filterzeitkonstante für Oberflächentemperatursimulation" VALUE 0x1EF4CE Kw_Ws16 32766.00 Time_s 1.000000 32767.00 FORMAT "%8.2" EXTENDED_LIMITS -327.6800 327.6700 /end CHARACTERISTIC
/begin CHARACTERISTIC PFlt_tiGear_C "Ausschaltverzögerungszeit für Gangvergleich" VALUE 0x1ECF1C Kw_Wu16 655350.0 TimeDeb 0.00 655350.0 FORMAT "%8.1" /end CHARACTERISTIC
/begin CHARACTERISTIC PFlt_tiHtTransDT1_CUR "Wärmeübertragungszeit" CURVE 0x1EF4D0 Kl_Xs16_Ws16 10.00000 Time_s 0.00 10.00000 FORMAT "%8.5" EXTENDED_LIMITS -327.6800 327.6700
 /begin AXIS_DESCR STD_AXIS PFlt_dmEG AirMassPerTime 2 -1000.000 1000.000 FORMAT "%8.3" EXTENDED_LIMITS -3276.800 3276.700 DEPOSIT ABSOLUTE /end AXIS_DESCR
/end CHARACTERISTIC
/begin CHARACTERISTIC PFlt_tiLckSubs_C "Ersatzwert für Sperrzeit" VALUE 0x1ECCA4 Kw_Wu32 42949672.9500 Time_s 0.00 42949672.9500 FORMAT "%13.4" /end CHARACTERISTIC
/begin CHARACTERISTIC PFlt_tiMaxTstrRgnShOff_C "Schwellwert zur Freigabe der über Tester-Login gesperrten DPF Regeneration" VALUE 0x1ECCA8 Kw_Ws16 36000.00 Time_5s 0.00 36000.00 FORMAT "%8.2" EXTENDED_LIMITS -163840.0 163835.0 /end CHARACTERISTIC
/begin CHARACTERISTIC PFlt_tiOpSubs_C "Ersatzwert für Motorbetriebszeit im Fall Eeprom lese Fehler" VALUE 0x1ECCAC Kw_Wu32 4294967295.00 TimeEngOn 0.00 4294967295.00 FORMAT "%13.2" /end CHARACTERISTIC
/begin CHARACTERISTIC PFlt_tiPopCalc7DebNeg_C "Entprellzeit zum Zurücksetzen der Betriebszustandsberechnung für die Stufe 7" VALUE 0x1ECF1E Kw_Wu16 655350.0 TimeDeb 0.00 655350.0 FORMAT "%8.1" /end CHARACTERISTIC
/begin CHARACTERISTIC PFlt_tiPopCalc7DebPos_C "Entprellzeit zum Setzen der Betriebszustandsberechnung für die Stufe 7" VALUE 0x1ECF20 Kw_Wu16 655350.0 TimeDeb 0.00 655350.0 FORMAT "%8.1" /end CHARACTERISTIC
/begin CHARACTERISTIC PFlt_tiPOpCalcHold_C "Haltezeit bei Bit 6" VALUE 0x1ECF22 Kw_Ws16 327670.0 Time_ms 0.00 327670.0 FORMAT "%8.1" EXTENDED_LIMITS -327680.0 327670.0 /end CHARACTERISTIC
/begin CHARACTERISTIC PFlt_tiPOpCalcOn_C "Entprellzeit bei Bit 6" VALUE 0x1ECF24 Kw_Wu16 655350.0 TimeDeb 0.00 655350.0 FORMAT "%8.1" /end CHARACTERISTIC
/begin CHARACTERISTIC PFlt_tiqAct7DebNeg_C "Entprellzeit zum Zurücksetzen der Betriebszustandsberechnung für die Stufe 7" VALUE 0x1ECF26 Kw_Wu16 1000.000 TimeDeb 0.00 1000.000 FORMAT "%8.3" EXTENDED_LIMITS 0.00 655350.0 /end CHARACTERISTIC
/begin CHARACTERISTIC PFlt_tiqAct7DebPos_C "Entprellzeit zum Zurücksetzen der Betriebszustandsberechnung für die Stufe 7" VALUE 0x1ECF28 Kw_Wu16 1000.000 TimeDeb 0.00 1000.000 FORMAT "%8.3" EXTENDED_LIMITS 0.00 655350.0 /end CHARACTERISTIC
/begin CHARACTERISTIC PFlt_tiRgnCtlMax_C "Regenerationszeit für open loop mode" VALUE 0x1ECCB0 Kw_Wu32 429496.000000 Time_s 0.00 429496.000000 FORMAT "%13.6" EXTENDED_LIMITS 0.00 42949672.9500 /end CHARACTERISTIC
/begin CHARACTERISTIC PFlt_tiRgnCtlSpo_C "Regenerationszeit zur Detektierung einer spontanen Regeneration bei Steuerung" VALUE 0x1ECCB4 Kw_Wu16 655.3500 Time_s 0.00 655.3500 FORMAT "%8.4" /end CHARACTERISTIC
/begin CHARACTERISTIC PFlt_tiRgnLckMax0_C "Überwachte Maximalsperrungsdauer der Regeneration Stufe 0 [s]" VALUE 0x1ECCB8 Kw_Wu32 42949672.9500 Time_s 0.00 42949672.9500 FORMAT "%13.4" /end CHARACTERISTIC
/begin CHARACTERISTIC PFlt_tiRgnLckMax1_C "überwachte Maximalsperrungsdauer der Regeneration Stufe 1[ s]." VALUE 0x1ECCBC Kw_Wu32 42949672.9500 Time_s 0.00 42949672.9500 FORMAT "%13.4" /end CHARACTERISTIC
/begin CHARACTERISTIC PFlt_tiRgnLckMax2_C "überwachte Maximalsperrungsdauer der Regeneration Stufe 2[ s]." VALUE 0x1ECCC0 Kw_Wu32 42949672.9500 Time_s 0.00 42949672.9500 FORMAT "%13.4" /end CHARACTERISTIC
/begin CHARACTERISTIC PFlt_tiRgnLckMax3_C "überwachte Maximalsperrungsdauer der Regeneration Stufe 3[ s]" VALUE 0x1ECCC4 Kw_Wu32 42949672.9500 Time_s 0.00 42949672.9500 FORMAT "%13.4" /end CHARACTERISTIC
/begin CHARACTERISTIC PFlt_tiRgnLckMax4_C "überwachte Maximalsperrungsdauer der Regeneration Stufe 4[ s]" VALUE 0x1ECCC8 Kw_Wu32 42949672.9500 Time_s 0.00 42949672.9500 FORMAT "%13.4" /end CHARACTERISTIC
/begin CHARACTERISTIC PFlt_tiRgnLckMax5_C "überwachte Maximalsperrungsdauer der Regeneration Stufe 5[ s]" VALUE 0x1ECCCC Kw_Wu32 42949672.9500 Time_s 0.00 42949672.9500 FORMAT "%13.4" /end CHARACTERISTIC
/begin CHARACTERISTIC PFlt_tiRgnLckMax6_C "überwachte Maximalsperrungsdauer der Regeneration Stufe 6[ s]" VALUE 0x1ECCD0 Kw_Wu32 42949672.9500 Time_s 0.00 42949672.9500 FORMAT "%13.4" /end CHARACTERISTIC
/begin CHARACTERISTIC PFlt_tiRgnMaxTmrSubs_C "Ersatzwert für Regenerationsdauerzähler" VALUE 0x1ECCD4 Kw_Wu32 4294967.29000 Time_s 0.00 4294967.29000 FORMAT "%13.5" EXTENDED_LIMITS 0.00 42949672.9500 /end CHARACTERISTIC
/begin CHARACTERISTIC PFlt_tiRgnSpo_C "Regenerationszeit zur Detektierung einer spontanen Regeneration" VALUE 0x1ECCD8 Kw_Wu16 655.3500 Time_s 0.00 655.3500 FORMAT "%8.4" /end CHARACTERISTIC
/begin CHARACTERISTIC PFlt_tiRgnStg0_CUR "überwachte Maximaldauer der Regeneration Stufe 0[ s]." CURVE 0x1ECCDA Kl_Xs16_Ws16 32767.00 Time_s_sint16 0.00 32767.00 FORMAT "%8.2" EXTENDED_LIMITS -32768.00 32767.00
 /begin AXIS_DESCR STD_AXIS PFlt_tFlt Temp_Cels 5 -50.14000 999.8600 FORMAT "%8.4" EXTENDED_LIMITS -3549.940 3003.560 DEPOSIT ABSOLUTE /end AXIS_DESCR
/end CHARACTERISTIC
/begin CHARACTERISTIC PFlt_tiRgnStg1_CUR "überwachte Maximaldauer der Regeneration Stufe 1[ s]." CURVE 0x1ECCF0 Kl_Xs16_Ws16 32767.00 Time_s_sint16 0.00 32767.00 FORMAT "%8.2" EXTENDED_LIMITS -32768.00 32767.00
 /begin AXIS_DESCR STD_AXIS PFlt_tFlt Temp_Cels 5 -50.14000 999.8600 FORMAT "%8.4" EXTENDED_LIMITS -3549.940 3003.560 DEPOSIT ABSOLUTE /end AXIS_DESCR
/end CHARACTERISTIC
/begin CHARACTERISTIC PFlt_tiRgnStg2_CUR "überwachte Maximaldauer der Regeneration Stufe 2[ s]." CURVE 0x1ECD06 Kl_Xs16_Ws16 32767.00 Time_s_sint16 0.00 32767.00 FORMAT "%8.2" EXTENDED_LIMITS -32768.00 32767.00
 /begin AXIS_DESCR STD_AXIS PFlt_tFlt Temp_Cels 5 -50.14000 999.8600 FORMAT "%8.4" EXTENDED_LIMITS -3549.940 3003.560 DEPOSIT ABSOLUTE /end AXIS_DESCR
/end CHARACTERISTIC
/begin CHARACTERISTIC PFlt_tiRgnStg3_CUR "überwachte Maximaldauer der Regeneration Stufe 3[ s]." CURVE 0x1ECD1C Kl_Xs16_Ws16 32767.00 Time_s_sint16 0.00 32767.00 FORMAT "%8.2" EXTENDED_LIMITS -32768.00 32767.00
 /begin AXIS_DESCR STD_AXIS PFlt_tFlt Temp_Cels 5 -50.14000 999.8600 FORMAT "%8.4" EXTENDED_LIMITS -3549.940 3003.560 DEPOSIT ABSOLUTE /end AXIS_DESCR
/end CHARACTERISTIC
/begin CHARACTERISTIC PFlt_tiRgnStg4_CUR "überwachte Maximaldauer der Regeneration Stufe 4[ s]." CURVE 0x1ECD32 Kl_Xs16_Ws16 32767.00 Time_s_sint16 0.00 32767.00 FORMAT "%8.2" EXTENDED_LIMITS -32768.00 32767.00
 /begin AXIS_DESCR STD_AXIS PFlt_tFlt Temp_Cels 5 -50.14000 999.8600 FORMAT "%8.4" EXTENDED_LIMITS -3549.940 3003.560 DEPOSIT ABSOLUTE /end AXIS_DESCR
/end CHARACTERISTIC
/begin CHARACTERISTIC PFlt_tiRgnStg5_CUR "überwachte Maximaldauer der Regeneration Stufe 5[ s]." CURVE 0x1ECD48 Kl_Xs16_Ws16 32767.00 Time_s_sint16 0.00 32767.00 FORMAT "%8.2" EXTENDED_LIMITS -32768.00 32767.00
 /begin AXIS_DESCR STD_AXIS PFlt_tFlt Temp_Cels 5 -50.14000 999.8600 FORMAT "%8.4" EXTENDED_LIMITS -3549.940 3003.560 DEPOSIT ABSOLUTE /end AXIS_DESCR
/end CHARACTERISTIC
/begin CHARACTERISTIC PFlt_tiRgnStg6_CUR "überwachte Maximaldauer der Regeneration Stufe 6[ s]." CURVE 0x1ECD5E Kl_Xs16_Ws16 32767.00 Time_s_sint16 0.00 32767.00 FORMAT "%8.2" EXTENDED_LIMITS -32768.00 32767.00
 /begin AXIS_DESCR STD_AXIS PFlt_tFlt Temp_Cels 5 -50.14000 999.8600 FORMAT "%8.4" EXTENDED_LIMITS -3549.940 3003.560 DEPOSIT ABSOLUTE /end AXIS_DESCR
/end CHARACTERISTIC
/begin CHARACTERISTIC PFlt_tiSotPresDiffPT1_C "Filterzeitkonstante für Differenzdruck [s]" VALUE 0x1ED8A8 Kw_Wu32 4294.9673 TimeDelay_s 0.0000010000000 4294.9673 FORMAT "%9.4" /end CHARACTERISTIC
/begin CHARACTERISTIC PFlt_tiSotRatDiffPT1_C "Filterzeitkonstante für simulierten Druckunterschied [s]" VALUE 0x1ED8AC Kw_Wu32 4294.9673 TimeDelay_s 0.0000010000000 4294.9673 FORMAT "%9.4" /end CHARACTERISTIC
/begin CHARACTERISTIC PFlt_tiSumRgnMaxThres0_C "Erste Schwelle für die akkumulative Regenerationszeitüberwachung" VALUE 0x1ECD74 Kw_Wu32 429496.000000 Time_s 0.00 429496.000000 FORMAT "%13.6" EXTENDED_LIMITS 0.00 42949672.9500 /end CHARACTERISTIC
/begin CHARACTERISTIC PFlt_tiSumRgnMaxThres1_C "Erste Schwelle für die akkumulative Regenerationszeitüberwachung" VALUE 0x1ECD78 Kw_Wu32 429496.000000 Time_s 0.00 429496.000000 FORMAT "%13.6" EXTENDED_LIMITS 0.00 42949672.9500 /end CHARACTERISTIC
/begin CHARACTERISTIC PFlt_tiSumRgnMaxThres2_C "Zweite Schwelle für die akkumulative Regenerationszeitüberwachung" VALUE 0x1ECD7C Kw_Wu32 429496.000000 Time_s 0.00 429496.000000 FORMAT "%13.6" EXTENDED_LIMITS 0.00 42949672.9500 /end CHARACTERISTIC
/begin CHARACTERISTIC PFlt_tiSumRgnMaxTmr_C "Maximalzeit für die akkumulative Regenerationszeit" VALUE 0x1ECE64 Kw_Wu32 429496.000000 Time_s 0.00 429496.000000 FORMAT "%13.6" EXTENDED_LIMITS 0.00 42949672.9500 /end CHARACTERISTIC
/begin CHARACTERISTIC PFlt_tiThresNorm_MAP "Schwellwert-Kennfeld zum Vergleich mit Zeit seit Erreichen Zustand NORMAL" MAP 0x1ECF2A Kf_Xs16_Ys16_Ws16 327670.0 Time_ms 0.00 327670.0 FORMAT "%8.1" EXTENDED_LIMITS -327680.0 327670.0
 /begin AXIS_DESCR STD_AXIS PFlt_tEngNorm_mp Temp_Cels 2 -50.14000 149.8600 FORMAT "%8.4" EXTENDED_LIMITS -3549.940 3003.560 DEPOSIT ABSOLUTE /end AXIS_DESCR
 /begin AXIS_DESCR STD_AXIS PFlt_tOxiSurf Temp_Cels 2 -50.14000 1272.960 FORMAT "%8.3" EXTENDED_LIMITS -3549.940 3003.560 DEPOSIT ABSOLUTE /end AXIS_DESCR
/end CHARACTERISTIC
/begin CHARACTERISTIC PFlt_tiVelVeh_CUR "Kennlinie für Ausschaltverzögerung bei Bit" CURVE 0x1ECF3E Kl_Xs16_Ws16 327670.0 TimeDeb 0.00 327670.0 FORMAT "%8.1" EXTENDED_LIMITS -327680.0 327670.0
 /begin AXIS_DESCR STD_AXIS PFlt_tFlt Temp_Cels 4 -50.14000 999.8600 FORMAT "%8.4" EXTENDED_LIMITS -3549.940 3003.560 DEPOSIT ABSOLUTE /end AXIS_DESCR
/end CHARACTERISTIC
/begin CHARACTERISTIC PFlt_tOxiCatHysHigh3_C "Oberer Hystereseschwellwert Oxidationskatalysatortemperatur" VALUE 0x1ECF50 Kw_Ws16 1323.100 Temp_Cels -50.14000 1272.960 FORMAT "%8.3" EXTENDED_LIMITS -3549.940 3003.560 /end CHARACTERISTIC
/begin CHARACTERISTIC PFlt_tOxiCatHysLow3_C "Unterer Hystereseschwellwert Oxidationskatalysator" VALUE 0x1ECF52 Kw_Ws16 1323.100 Temp_Cels -50.14000 1272.960 FORMAT "%8.3" EXTENDED_LIMITS -3549.940 3003.560 /end CHARACTERISTIC
/begin CHARACTERISTIC PFlt_tPreDfl_C "Ersatzwert bei Temperatur vor Partikelfilter unplausibel" VALUE 0x1EF60A Kw_Ws16 1323.100 Temp_Cels -50.14000 1272.960 FORMAT "%8.3" EXTENDED_LIMITS -3549.940 3003.560 /end CHARACTERISTIC
/begin CHARACTERISTIC PFlt_tPreTrbnLowMax_C "Unterer Hystereseschwellwert für max. Abgastemperatur vor Turbolader" VALUE 0x1ECD84 Kw_Ws16 1095.000 Temp_Cels -45.04000 1049.960 FORMAT "%8.3" EXTENDED_LIMITS -3549.940 3003.560 /end CHARACTERISTIC
/begin CHARACTERISTIC PFlt_tPreTrbnUppMax_C "Oberer Hystereseschwellwert für max. Abgastemperatur vor Turbolader" VALUE 0x1ECD86 Kw_Ws16 1095.000 Temp_Cels -45.04000 1049.960 FORMAT "%8.3" EXTENDED_LIMITS -3549.940 3003.560 /end CHARACTERISTIC
/begin CHARACTERISTIC PFlt_tPstRgn5Min_C "Schwellwert zum Vergleich mit Abgastemperatur nach Partikelfilter bei der Betriebszustandsberechnung Stufe 5" VALUE 0x1ECF54 Kw_Ws16 1323.100 Temp_Cels -50.14000 1272.960 FORMAT "%8.3" EXTENDED_LIMITS -3549.940 3003.560 /end CHARACTERISTIC
/begin CHARACTERISTIC PFlt_tPstRgn7Min_C "Schwellwert zum Vergleich mit Abgastemperatur nach Partikelfilter bei der Betriebszustandsberechnung Stufe 7" VALUE 0x1ECF56 Kw_Ws16 1323.100 Temp_Cels -50.14000 1272.960 FORMAT "%8.3" EXTENDED_LIMITS -3549.940 3003.560 /end CHARACTERISTIC
/begin CHARACTERISTIC PFlt_tPstSimRgn5_MAP "Schwellwert- Kennfeld zum Vergleich Abgastemperatur in Motorzustandsberechnung Stufe 5" MAP 0x1ECF58 Kf_Xs16_Ys16_Ws16 1323.100 Temp_Cels -50.14000 1272.960 FORMAT "%8.3" EXTENDED_LIMITS -3549.940 3003.560
 /begin AXIS_DESCR STD_AXIS Eng_nAvrg EngN 16 40.00000 6000.000 FORMAT "%8.3" EXTENDED_LIMITS -32768.00 32767.00 DEPOSIT ABSOLUTE /end AXIS_DESCR
 /begin AXIS_DESCR STD_AXIS InjCtl_qAct InjMass 16 0.00 327.6700 FORMAT "%8.4" EXTENDED_LIMITS -327.6800 327.6700 DEPOSIT ABSOLUTE /end AXIS_DESCR
/end CHARACTERISTIC
/begin CHARACTERISTIC PFlt_tPstSimRgn7_MAP "Schwellwert- Kennfeld zum Vergleich Abgastemperatur in Motorzustandsberechnung Stufe 7" MAP 0x1ED19C Kf_Xs16_Ys16_Ws16 1323.100 Temp_Cels -50.14000 1272.960 FORMAT "%8.3" EXTENDED_LIMITS -3549.940 3003.560
 /begin AXIS_DESCR STD_AXIS Eng_nAvrg EngN 16 40.00000 6000.000 FORMAT "%8.3" EXTENDED_LIMITS -32768.00 32767.00 DEPOSIT ABSOLUTE /end AXIS_DESCR
 /begin AXIS_DESCR STD_AXIS InjCtl_qAct InjMass 16 0.00 327.6700 FORMAT "%8.4" EXTENDED_LIMITS -327.6800 327.6700 DEPOSIT ABSOLUTE /end AXIS_DESCR
/end CHARACTERISTIC
/begin CHARACTERISTIC PFlt_trqInrRgnLowMax1_CUR "Kennlinie für untere Grenze 1 der Regenerations-Unterbrechung wegen hohem geforderten Moment" CURVE 0x1ECD88 Kl_Xs16_Ws16 1500.000 Trq -500.0000 1000.000 FORMAT "%8.3" EXTENDED_LIMITS -3276.800 3276.700
 /begin AXIS_DESCR STD_AXIS Eng_nAvrg EngN 12 40.00000 6000.000 FORMAT "%8.3" EXTENDED_LIMITS -32768.00 32767.00 DEPOSIT ABSOLUTE /end AXIS_DESCR
/end CHARACTERISTIC
/begin CHARACTERISTIC PFlt_trqInrRgnLowMax2_CUR "Kennlinie für untere Grenze 2 der Regenerations-Unterbrechung wegen hohem geforderten Moment" CURVE 0x1ECDBA Kl_Xs16_Ws16 1500.000 Trq -500.0000 1000.000 FORMAT "%8.3" EXTENDED_LIMITS -3276.800 3276.700
 /begin AXIS_DESCR STD_AXIS Eng_nAvrg EngN 12 40.00000 6000.000 FORMAT "%8.3" EXTENDED_LIMITS -32768.00 32767.00 DEPOSIT ABSOLUTE /end AXIS_DESCR
/end CHARACTERISTIC
/begin CHARACTERISTIC PFlt_trqInrRgnUppMax1_CUR "Kennlinie für obere Grenze 1 der Regenerations-Unterbrechung wegen hohem geforderten Moment" CURVE 0x1ECDEC Kl_Xs16_Ws16 1500.000 Trq -500.0000 1000.000 FORMAT "%8.3" EXTENDED_LIMITS -3276.800 3276.700
 /begin AXIS_DESCR STD_AXIS Eng_nAvrg EngN 12 40.00000 6000.000 FORMAT "%8.3" EXTENDED_LIMITS -32768.00 32767.00 DEPOSIT ABSOLUTE /end AXIS_DESCR
/end CHARACTERISTIC
/begin CHARACTERISTIC PFlt_trqInrRgnUppMax2_CUR "Kennlinie für obere Grenze 2 der Regenerations-Unterbrechung wegen hohem geforderten Moment" CURVE 0x1ECE1E Kl_Xs16_Ws16 1500.000 Trq -500.0000 1000.000 FORMAT "%8.3" EXTENDED_LIMITS -3276.800 3276.700
 /begin AXIS_DESCR STD_AXIS Eng_nAvrg EngN 12 40.00000 6000.000 FORMAT "%8.3" EXTENDED_LIMITS -32768.00 32767.00 DEPOSIT ABSOLUTE /end AXIS_DESCR
/end CHARACTERISTIC
/begin CHARACTERISTIC PFlt_tSurfInit_C "Oberflächentemperatur Partikelfilter Initialisierungswert" VALUE 0x1EF60E Kw_Ws16 6553.500 Temp_Cels -3549.940 3003.560 FORMAT "%8.3" /end CHARACTERISTIC
/begin CHARACTERISTIC PFlt_tThresPre1_MAP "Schwellwert- Kennfeld 1 zum Vergleich Abgastemperatur in Motorzustandsberechnung" MAP 0x1ED3E0 Kf_Xs16_Ys16_Ws16 1323.100 Temp_Cels -50.14000 1272.960 FORMAT "%8.3" EXTENDED_LIMITS -3549.940 3003.560
 /begin AXIS_DESCR STD_AXIS Eng_nAvrg EngN 8 40.00000 6000.000 FORMAT "%8.3" EXTENDED_LIMITS -32768.00 32767.00 DEPOSIT ABSOLUTE /end AXIS_DESCR
 /begin AXIS_DESCR STD_AXIS InjCtl_qAct InjMass 8 0.00 327.6700 FORMAT "%8.4" EXTENDED_LIMITS -327.6800 327.6700 DEPOSIT ABSOLUTE /end AXIS_DESCR
/end CHARACTERISTIC
/begin CHARACTERISTIC PFlt_tThresPre2_MAP "Schwellwert- Kennfeld 1 zum Vergleich Abgastemperatur in Motorzustandsberechnung" MAP 0x1ED484 Kf_Xs16_Ys16_Ws16 1323.100 Temp_Cels -50.14000 1272.960 FORMAT "%8.3" EXTENDED_LIMITS -3549.940 3003.560
 /begin AXIS_DESCR STD_AXIS Eng_nAvrg EngN 8 40.00000 6000.000 FORMAT "%8.3" EXTENDED_LIMITS -32768.00 32767.00 DEPOSIT ABSOLUTE /end AXIS_DESCR
 /begin AXIS_DESCR STD_AXIS InjCtl_qAct InjMass 8 0.00 327.6700 FORMAT "%8.4" EXTENDED_LIMITS -327.6800 327.6700 DEPOSIT ABSOLUTE /end AXIS_DESCR
/end CHARACTERISTIC
/begin CHARACTERISTIC PFlt_vThresVeh_C "Schwellwert zum Vergleich mit Fahrzeuggeschwindigkeit" VALUE 0x1ED528 Kw_Ws16 300.0000 Vel 0.00 300.0000 FORMAT "%8.4" EXTENDED_LIMITS -327.6800 327.6700 /end CHARACTERISTIC
/begin CHARACTERISTIC PFlt_vVehThres5_C "Schwellwert zum Vergleich mit Fahrzeuggeschwindigkeit" VALUE 0x1ED52A Kw_Ws16 300.0000 Vel 0.00 300.0000 FORMAT "%8.4" EXTENDED_LIMITS -327.6800 327.6700 /end CHARACTERISTIC
/begin CHARACTERISTIC PFlt_vVehThres7_C "Schwellwert zum Vergleich mit Fahrzeuggeschwindigkeit." VALUE 0x1ED52C Kw_Ws16 300.0000 Vel 0.00 300.0000 FORMAT "%8.4" EXTENDED_LIMITS -327.6800 327.6700 /end CHARACTERISTIC
/begin CHARACTERISTIC SigTst_PFltRLYHtgEn_C "Stelltestüberwachung Freigabemaske für Partikelfilterheizung" VALUE 0x1F04AE Kw_Wu8 7.000 OneToOne 0.00 7.000 FORMAT "%5.3" EXTENDED_LIMITS 0.00 255.0 /end CHARACTERISTIC
/begin COMPU_METHOD Acc "Fahrzeugbeschleunigung" RAT_FUNC "%6.5" "[m/s^2]" COEFFS 0 1000 0 0 0 1 /end COMPU_METHOD
/begin COMPU_METHOD AirMassPerCyl "Luftmasse pro Zylinder" RAT_FUNC "%6.3" "[mg/Hub Luft]" COEFFS 0 10 0 0 0 1 /end COMPU_METHOD
/begin COMPU_METHOD AirMassPerTime "Luftmasse pro Zeit" RAT_FUNC "%6.3" "[Kg/h Luft]" COEFFS 0 10 0 0 0 1 /end COMPU_METHOD
/begin COMPU_METHOD AirmassPerTime_float "Umrechnungsformel für Luftmasse pro Zeit" RAT_FUNC "%6.2" "[kg/h]" COEFFS 0 1 0 0 0 1 /end COMPU_METHOD
/begin COMPU_METHOD AirMass_kg "Luftmasse in kg [s*kg/h] - verwendet in PFlt_EngPOpCalc" RAT_FUNC "%6.2" "[s*Kg/h]" COEFFS 0 1 0 0 0 1 /end COMPU_METHOD
/begin COMPU_METHOD AngleCrS "Winkel Kurbelwelle" RAT_FUNC "%6.4" "[deg CrS]" COEFFS 0 42.6666666666667 0 0 0 1 /end COMPU_METHOD
/begin COMPU_METHOD CubMtrPerHr "Volumsstrom in m^3/h" RAT_FUNC "%6.3" "[m^3/h]" COEFFS 0 10 0 0 0 1 /end COMPU_METHOD
/begin COMPU_METHOD dEngSpd_s "Einspritzmengenanstieg/s" RAT_FUNC "%6.2" "[rpm/s]" COEFFS 0 1 0 0 0 1 /end COMPU_METHOD
/begin COMPU_METHOD dInjQnt_s "Einspritzmengenanstieg/s" RAT_FUNC "%6.2" "[(mg/stroke)/s]" COEFFS 0 1 0 0 0 1 /end COMPU_METHOD
/begin COMPU_METHOD dmNOx_mg_p_s "differentielle NOx Masse" RAT_FUNC "%6.4" "mg/s" COEFFS 0 33.3333333333333 0 0 0 1 /end COMPU_METHOD
/begin COMPU_METHOD dmSoot_mg_p_s "differenzielle Rußmasse mg/s" RAT_FUNC "%6.4" "mg/s" COEFFS 0 100 0 0 0 1 /end COMPU_METHOD
/begin COMPU_METHOD EngN "Motordrehzahl" RAT_FUNC "%6.2" "[rpm]" COEFFS 0 1 0 0 0 1 /end COMPU_METHOD
/begin COMPU_METHOD EngTempFldSel "Verbale Umrechnung für Auswahl aus dem Motortemperatur-Feld Eng_tFld" TAB_VERB "%6.3" "" COMPU_TAB_REF EngTempFldSel /end COMPU_METHOD
/begin COMPU_VTAB EngTempFldSel "Verbale Umrechnung für Auswahl aus dem Motortemperatur-Feld Eng_tFld" TAB_VERB 5 0 "Coolant_Temperature" 1 "Oil_Temperature" 2 "Engine_Temperature" 3 "Fuel_Temperature" 4 "Coolant_Temperature_CAN" /end COMPU_VTAB
/begin COMPU_METHOD Eng_dN "Motorbeschleunigung" RAT_FUNC "%6.2" "rpm/s" COEFFS 0 1 0 0 0 1 /end COMPU_METHOD
/begin COMPU_METHOD EulerNum "Euler number" RAT_FUNC "%6.3" "[-]" COEFFS 0 10 0 0 0 1 /end COMPU_METHOD
/begin COMPU_METHOD facEulerToPres "Faktur um Druck in hPa zu berechnen" RAT_FUNC "%6.1" "[1/m^4]" COEFFS 0 0.0264 0 0 0 1 /end COMPU_METHOD
/begin COMPU_METHOD Fact "Faktor mit Auflösung 1 / 8192, hauptsächlich für einen Faktorenbereich 0...1 verwendet" RAT_FUNC "%6.5" "[-]" COEFFS 0 8192 0 0 0 1 /end COMPU_METHOD
/begin COMPU_METHOD Fact1000 "Faktor mit einer Auflösung von 0.001" RAT_FUNC "%6.5" "-" COEFFS 0 1000 0 0 0 1 /end COMPU_METHOD
/begin COMPU_METHOD Fl_L "Treibstoffmenge [l]" RAT_FUNC "%6.4" "[l]" COEFFS 0 100 0 0 0 1 /end COMPU_METHOD
/begin COMPU_METHOD InjMass "Einspritzmenge" RAT_FUNC "%6.4" "[mg/hub]" COEFFS 0 100 0 0 0 1 /end COMPU_METHOD
/begin COMPU_METHOD InjTime_us "Zeit in Microsekunden für das Einspritztiming" RAT_FUNC "%6.2" "[us]" COEFFS 0 1 0 0 0 1 /end COMPU_METHOD
/begin COMPU_METHOD Kd "Differentialverstärkung Kd (gleiche Einheit/Umrechnungsformel an Ein- und Ausgang)" RAT_FUNC "%7.6" "[1/1]" COEFFS 0 65536 0 0 0 1 /end COMPU_METHOD
/begin COMPU_METHOD Kd_mgpstroke2mgpstrokeps "Einspritzmenge zu Einspritzmengengradient (Zeitbasis 1s) berechnet im 20ms task" RAT_FUNC "%6.4" "[1/s]" COEFFS 0 655.36 0 0 0 1 /end COMPU_METHOD
/begin COMPU_METHOD Kd_Pres_hPa2Prc "Differentialverstärkung Kd (Druck Pres_hPa zu Prozent Prc)" RAT_FUNC "%9.8" "[%/hPa]" COEFFS 0 6553600 0 0 0 1 /end COMPU_METHOD
/begin COMPU_METHOD Kd_rpm2rpmps "Drehzahl zu Drehzahlgradient (Zeitbasis 1s) berechnet im 20ms task" RAT_FUNC "%7.6" "[1/s]" COEFFS 0 65536 0 0 0 1 /end COMPU_METHOD
/begin COMPU_METHOD Kd_TurboN2Fact1000 "" RAT_FUNC "%11.10" "[1/rpm/s]" COEFFS 0 655360000 0 0 0 1 /end COMPU_METHOD
/begin COMPU_METHOD Ki_Pres_hPa2Prc "Integralverstärkung (Druck Pres_hPa zu Prozent Prc)" RAT_FUNC "%8.7" "[%/(hPa*s)]" COEFFS 0 429496.7296 0 0 0 1 /end COMPU_METHOD
/begin COMPU_METHOD Kp_Pres_hPa2Prc "Proportionale Verstärkung (Druck Pres_hPa zu Prozent Prc)" RAT_FUNC "%9.8" "[%/hPa]" COEFFS 0 6553600 0 0 0 1 /end COMPU_METHOD
/begin COMPU_METHOD lambda "Lambda" RAT_FUNC "%6.5" "[-]" COEFFS 0 1000 0 0 0 1 /end COMPU_METHOD
/begin COMPU_METHOD Length "Länge in Meter" RAT_FUNC "%6.2" "[m]" COEFFS 0 1 0 0 0 1 /end COMPU_METHOD
/begin COMPU_METHOD Length_km "Länge in Kilometer" RAT_FUNC "%6.2" "[km]" COEFFS 0 1 0 0 0 1 /end COMPU_METHOD
/begin COMPU_METHOD mAsh "Umrechnung für Aschemasse in niedrigere Auflösung (s32 auf s16)" RAT_FUNC "%6.3" "[g]" COEFFS 0 10 0 0 0 1 /end COMPU_METHOD
/begin COMPU_METHOD mAsh_g "Asche Masse" RAT_FUNC "%9.8" "[g]" COEFFS 0 6553600 0 0 0 1 /end COMPU_METHOD
/begin COMPU_METHOD OneToOne "eins zu eins (physikalischer Wert ist gleich dem internen Wert)" RAT_FUNC "%6.2" "[-]" COEFFS 0 1 0 0 0 1 /end COMPU_METHOD
/begin COMPU_METHOD Prc "Prozent, gleiche interne Auflösung wie Fact, aber Darstellung in Prozent (0...100%)" RAT_FUNC "%6.4" "[%]" COEFFS 0 100 0 0 0 1 /end COMPU_METHOD
/begin COMPU_METHOD Pres_hPa "Druck (angezeigt in [hPa])" RAT_FUNC "%6.2" "[hPa]" COEFFS 0 1 0 0 0 1 /end COMPU_METHOD
/begin COMPU_METHOD Pres_hPaPerSec_20ms "Druck pro Sekunde [hPa/s]" RAT_FUNC "%6.1" "[hPa/s]" COEFFS 0 0.02 0 0 0 1 /end COMPU_METHOD
/begin COMPU_METHOD Pres_hPa_float "Druck (angezeigt in [hPa])" RAT_FUNC "%6.2" "[hPa]" COEFFS 0 1 0 0 0 1 /end COMPU_METHOD
/begin COMPU_METHOD ReynoldsNum "Reynolds Nummer um den thermischen Koeffizienten zu bestimmen" RAT_FUNC "%6.0" "[-]" COEFFS 0 0.01 0 0 0 1 /end COMPU_METHOD
/begin COMPU_METHOD RmpFact1000Tmp "" RAT_FUNC "%6.4" "[1/s]" COEFFS 0 20.004884004884 0 0 0 1 /end COMPU_METHOD
/begin COMPU_METHOD RmpPres_hPa "Rampengradient für Druck angezeigt in [hPa/s]" RAT_FUNC "%6.4" "[hPa/s]" COEFFS 0 65.536 0 0 0 1 /end COMPU_METHOD
/begin COMPU_METHOD RmpTemp "Rampengradient für Temperatur" RAT_FUNC "%6.4" "[deg C/s]" COEFFS 0 655.36 0 0 0 1 /end COMPU_METHOD
/begin COMPU_METHOD RmpTrqPrpHigh "Rampenanstieg für Vortriebsmoment [Nm/s]" RAT_FUNC "%6.4" "[Nm/s]" COEFFS 0 655.36 0 0 0 1 /end COMPU_METHOD
/begin COMPU_METHOD SpecificHeat "spezifische Waermekapazitaet einer Substanz" RAT_FUNC "%7.6" "[J/g/K]" COEFFS 0 10000 0 0 0 1 /end COMPU_METHOD
/begin COMPU_METHOD TempC_float "Temperatur in Celsius für Fliesspunktvariable" RAT_FUNC "%6.1" "[deg C]" COEFFS 0 1 273.14 0 0 1 /end COMPU_METHOD
/begin COMPU_METHOD TempDiff_Kelv "Offsettemperatur dargestellt in [K]" RAT_FUNC "%6.3" "[ deg C ]" COEFFS 0 10 0 0 0 1 /end COMPU_METHOD
/begin COMPU_METHOD Temp_Cels "Temperatur dargestellt in °C (gleiche interne Darstellung wie Temp_Kelv)" RAT_FUNC "%6.1" "[deg C]" COEFFS 0 10 2731.4 0 0 1 /end COMPU_METHOD
/begin COMPU_METHOD Thr_Cpty "Wärmekapazität" RAT_FUNC "%6.2" "[J/K]" COEFFS 0 1 0 0 0 1 /end COMPU_METHOD
/begin COMPU_METHOD TimeDeb "Entprellzeit in Millisekunden für Libraryfunktion Debounce" RAT_FUNC "%6.1" "[ms]" COEFFS 0 0.1 0 0 0 1 /end COMPU_METHOD
/begin COMPU_METHOD TimeDelay_s "Zeitkonstante T1 (in s) für PT1, DT1, etc." RAT_FUNC "%9.3" "[s]" COEFFS 0 0 1 0 0.00023283064365387 0 /end COMPU_METHOD
/begin COMPU_METHOD TimeDelay_s_2 "Zeitkonstante T1 (in s) für PT1, DT1, etc. normiert auf 16 bit" RAT_FUNC "%9.4" "[s]" COEFFS 0 0 1 0 0.0596046447753906 0 /end COMPU_METHOD
/begin COMPU_METHOD TimeEngOn "Motorbetriebszeit in Sekunden" RAT_FUNC "%6.2" "[s]" COEFFS 0 1 0 0 0 1 /end COMPU_METHOD
/begin COMPU_METHOD TimeUSResolution "Zeit in Mikrosekunden für TPU Zeiten, Auflösung 1 us" RAT_FUNC "%6.2" "[us]" COEFFS 0 1 0 0 0 1 /end COMPU_METHOD
/begin COMPU_METHOD Time_5s "Zeit für PFlt Regenerationskurven [s]" RAT_FUNC "%6.2" "[s]" COEFFS 0 0.2 0 0 0 1 /end COMPU_METHOD
/begin COMPU_METHOD Time_ms "Zeit in ms für Fehlerentprellung (DSM) und SW-Timer" RAT_FUNC "%6.1" "[ms]" COEFFS 0 0.1 0 0 0 1 /end COMPU_METHOD
/begin COMPU_METHOD Time_s "Zeit in s für Fehlerentprellung (DSM) und SW-Timer" RAT_FUNC "%6.4" "[s]" COEFFS 0 100 0 0 0 1 /end COMPU_METHOD
/begin COMPU_METHOD Time_s_sint16 "für die Verwendung in signed 16 Bit Kennfeldern und Kennlinien, um eine 32 Bit Zeitperiode zu erhalten" RAT_FUNC "%6.2" "[s]" COEFFS 0 1 0 0 0 1 /end COMPU_METHOD
/begin COMPU_METHOD TransR "Übersetzungsverhältnis (Getriebe etc.)" RAT_FUNC "%6.4" "[-]" COEFFS 0 100 0 0 0 1 /end COMPU_METHOD
/begin COMPU_METHOD TrbChN_float "Turboladerdrehzahl für Fliesspunktvariable" RAT_FUNC "%6.2" "[rpm]" COEFFS 0 1 0 0 0 1 /end COMPU_METHOD
/begin COMPU_METHOD Trq "Motormoment" RAT_FUNC "%6.3" "[Nm]" COEFFS 0 10 0 0 0 1 /end COMPU_METHOD
/begin COMPU_METHOD TrqPerSec "Motormomentengradient" RAT_FUNC "%6.2" "[Nm/s]" COEFFS 0 1 0 0 0 1 /end COMPU_METHOD
/begin COMPU_METHOD TrqPrpHigh "vortriebsmoment" RAT_FUNC "%6.3" "[Nm]" COEFFS 0 10 0 0 0 1 /end COMPU_METHOD
/begin COMPU_METHOD TurboN "Turboladerdrehzahl" RAT_FUNC "%6.1" "[rpm]" COEFFS 0 1 0 0 0 10 /end COMPU_METHOD
/begin COMPU_METHOD Vel "Fahrzeuggeschwindigkeit, gleiche interne Auflösung wie Vel_SI" RAT_FUNC "%6.4" "[km/h]" COEFFS 0 100 0 0 0 1 /end COMPU_METHOD
/begin COMPU_METHOD volAddfine2mAsh "Aschemasse zu Additivvolumen hohe Auflösung [g/l]" RAT_FUNC "%6.3" "[g/l]" COEFFS 0 6.5536 0 0 0 1 /end COMPU_METHOD
/begin COMPU_METHOD volFl2mAsh "Aschemasse zu Treibstoffmenge [g/l]" RAT_FUNC "%8.7" "[g/l]" COEFFS 0 429496.7296 0 0 0 1 /end COMPU_METHOD
/begin COMPU_METHOD Volt "Spannung in V (von ADC)" RAT_FUNC "%6.2" "[mV]" COEFFS 0 0.2046 0 0 0 1 /end COMPU_METHOD
/begin COMPU_METHOD Volt_Batt "Batteriespannung" RAT_FUNC "%6.1" "[mV]" COEFFS 0 0.0492252911173131 0 0 0 1 /end COMPU_METHOD
/begin RECORD_LAYOUT Kf_Xr32_Yr32_Wr32 NO_AXIS_PTS_X 1 ULONG NO_AXIS_PTS_Y 2 ULONG AXIS_PTS_X 3 FLOAT32_IEEE INDEX_INCR DIRECT AXIS_PTS_Y 4 FLOAT32_IEEE INDEX_INCR DIRECT FNC_VALUES 5 FLOAT32_IEEE COLUMN_DIR DIRECT /end RECORD_LAYOUT
/begin RECORD_LAYOUT Kf_Xs16_Ys16_Ws16 NO_AXIS_PTS_X 1 SWORD NO_AXIS_PTS_Y 2 SWORD AXIS_PTS_X 3 SWORD INDEX_INCR DIRECT AXIS_PTS_Y 4 SWORD INDEX_INCR DIRECT FNC_VALUES 5 SWORD COLUMN_DIR DIRECT /end RECORD_LAYOUT
/begin RECORD_LAYOUT Kf_Xu8_Yu8_Wu8 NO_AXIS_PTS_X 1 UBYTE NO_AXIS_PTS_Y 2 UBYTE AXIS_PTS_X 3 UBYTE INDEX_INCR DIRECT AXIS_PTS_Y 4 UBYTE INDEX_INCR DIRECT FNC_VALUES 5 UBYTE COLUMN_DIR DIRECT /end RECORD_LAYOUT
/begin RECORD_LAYOUT Kl_Xs16_Ws16 NO_AXIS_PTS_X 1 SWORD AXIS_PTS_X 2 SWORD INDEX_INCR DIRECT FNC_VALUES 3 SWORD COLUMN_DIR DIRECT /end RECORD_LAYOUT
/begin RECORD_LAYOUT Kwb_Wu32 FNC_VALUES 1 ULONG COLUMN_DIR DIRECT /end RECORD_LAYOUT
/begin RECORD_LAYOUT Kw_Wr32 FNC_VALUES 1 FLOAT32_IEEE COLUMN_DIR DIRECT /end RECORD_LAYOUT
/begin RECORD_LAYOUT Kw_Ws16 FNC_VALUES 1 SWORD COLUMN_DIR DIRECT /end RECORD_LAYOUT
/begin RECORD_LAYOUT Kw_Ws32 FNC_VALUES 1 SLONG COLUMN_DIR DIRECT /end RECORD_LAYOUT
/begin RECORD_LAYOUT Kw_Wu16 FNC_VALUES 1 UWORD COLUMN_DIR DIRECT /end RECORD_LAYOUT
/begin RECORD_LAYOUT Kw_Wu32 FNC_VALUES 1 ULONG COLUMN_DIR DIRECT /end RECORD_LAYOUT
/begin RECORD_LAYOUT Kw_Wu8 FNC_VALUES 1 UBYTE COLUMN_DIR DIRECT /end RECORD_LAYOUT
/begin FUNCTION OvRMon_Co "Funktionsüberwachung auf Systemebene Koordination"
 /begin DEF_CHARACTERISTIC OvRMon_DebQInjDef_C OvRMon_ctEngSpdGrad_C OvRMon_ctQInjDefDwn_C OvRMon_ctQInjDefUp_C OvRMon_duBattJit_C OvRMon_duBrkJit_C OvRMon_facBattCor_CUR OvRMon_nLIGovLim_C OvRMon_nLimET_C OvRMon_nMin_C OvRMon_nMon_C OvRMon_nStSysLim_C OvRMon_qLimEnh_CUR OvRMon_rHighLimLowIdle_C OvRMon_stInvLowIdle_C OvRMon_swtAstAccs_C OvRMon_swtEnaConv_C OvRMon_tiAPP1Flt_C OvRMon_tiAPPNpl_C OvRMon_tiDebACCActv_C OvRMon_tiDebACCP_C OvRMon_tiDebAstAccsActv_C OvRMon_tiDebBattSRCDef_C OvRMon_tiDebBattSRCOk_C OvRMon_tiDebBrkSRCDef_C OvRMon_tiDebBrkSRCOk_C OvRMon_tiDebBrk_C OvRMon_tiDebConv_C OvRMon_tiDebCrCtlActv_C OvRMon_tiDebCrCtla_C OvRMon_tiDebDrvActv_C OvRMon_tiDebLimEnh_C OvRMon_tiDebLowIdlActv_C OvRMon_tiDebShtrp_C OvRMon_tiDebStCtlActv_C OvRMon_tiDebTIIAccsActv_C OvRMon_tiErrAPP_C OvRMon_tiLimET_MAP OvRMon_trqMonASD_C OvRMon_trqThresASDdc_C OvRMon_uAPP1LimPS_C OvRMon_uAPP1Lim_C OvRMon_uAPPFull_C OvRMon_uBattDfl_C OvRMon_uBattSRCMax_C OvRMon_uBattSRCMin_C OvRMon_uBrkA2DThres_C OvRMon_uBrkSRCMax_C OvRMon_uBrkSRCMin_C OvRMon_uHighLimLowIdle_C OvRMon_uLowIdlSwtA2DThres_C OvRMon_uLowLimLowIdle_C OvRMon_uPlaWinFull_C OvRMon_uPlaWinIdle_C /end DEF_CHARACTERISTIC
/end FUNCTION
/begin FUNCTION OvRMon_CrCtlplus "Schubüberwachung des Fahrgeschwindigkeitsreglers-Plus"
 /begin DEF_CHARACTERISTIC OvRMon_BrkMsk_C OvRMon_DebCrCtlPDef_C OvRMon_aDecMax_CUR OvRMon_aDecOff_C OvRMon_aMaxCrCtlP_C OvRMon_ctCrCtlPDwn_C OvRMon_ctCrCtlPUp_C OvRMon_swtEngBrkDemDisbl_C OvRMon_tiDebAPP1Pressed_C OvRMon_tiDebCrCtlPone_C OvRMon_tiDebCrCtlPtwo_C OvRMon_tiDebCrCtlplus3_C OvRMon_tiDebCrCtlplus4_C OvRMon_trqACCDec_C OvRMon_uAPP1CrCtla_C OvRMon_uAPP1Thresone_C OvRMon_uAPP1Threstwo_C /end DEF_CHARACTERISTIC
/end FUNCTION
/begin FUNCTION OvRMon_EngSpdSens "Drehzahlüberwachung für die Schubüberwachung"
 /begin DEF_CHARACTERISTIC OvRMon_DebSigA0Def_C OvRMon_nDiffMaxHi_C OvRMon_nDiffMaxLo_C OvRMon_nDiffThres_C OvRMon_nSegMax_C OvRMon_nSegMin_C OvRMon_numCyl_C OvRMon_stIntrInit_C OvRMon_tiSegMin_C /end DEF_CHARACTERISTIC
/end FUNCTION
/begin FUNCTION OvRMon_GetSumInj "Berechnung des Drehmoments zur Schubüberwachung" /begin DEF_CHARACTERISTIC OvRMon_facInjEff_MAP /end DEF_CHARACTERISTIC /end FUNCTION
/begin FUNCTION OxiCCD_GetTempPre "Abgastemperatur vor Oxidationskatalysator"
 /begin DEF_CHARACTERISTIC OxiCCD_DebSRCHighDefTPre_C OxiCCD_DebSRCHighOkTPre_C OxiCCD_DebSRCLowDefTPre_C OxiCCD_DebSRCLowOkTPre_C OxiCCD_dtRmpSlpDwnPre_C OxiCCD_dtRmpSlpUpPre_C OxiCCD_stSensIDWordTPre_C OxiCCD_swtActvTPre_C OxiCCD_tDflPre_C OxiCCD_tLinPre1_CUR OxiCCD_uSRCMaxTPre_C OxiCCD_uSRCMinTPre_C /end DEF_CHARACTERISTIC
/end FUNCTION
/begin FUNCTION PCR "Ladedruckregler"
 /begin SUB_FUNCTION PCR_Cmpr PCR_CtlValCalc PCR_CtrlValCalc PCR_DesValCalc PCR_Governor PCR_Monitor /end SUB_FUNCTION
/end FUNCTION
/begin FUNCTION PCR_Cmpr "Basisstruktur für die Berechnung der Turboladergeschwindigkeit und des erlaubten Ladedruckes"
 /begin DEF_CHARACTERISTIC PCR_DKdInjQnt_C PCR_DKdN_C PCR_DT1RecInjQnt_C PCR_DT1RecN_C PCR_dfacShftUpCorDwn_C PCR_dfacShftUpCorUp_C PCR_dlyPT1TrbnFlt_C PCR_dqDesMax_C PCR_dqDesMin_C PCR_facBPAltCorr2_C PCR_facBPAltCorr_C PCR_facBPAltDynMax_C PCR_facBPAltMax2_MAP PCR_facBPAltMax_MAP PCR_facBPMaxCorAdd_MAP PCR_facPAltCorr2_C PCR_facPAltCorr_C PCR_facShftUpCor_MAP PCR_kdfacDT1BPAlt_C PCR_nTrbnMax_CUR PCR_pAirAltCorr2_C PCR_stConvCD_C PCR_stTrqFltActv_MAP PCR_swtClthInactv_C PCR_tiTrqFltActv_C PCR_vMax_C /end DEF_CHARACTERISTIC
/end FUNCTION
/begin FUNCTION PCR_CtlValCalc "Ladedruck-Steuerung"
 /begin DEF_CHARACTERISTIC PCR_facCtlAT_CUR PCR_facCtlBas_CUR PCR_facCtlRgn3_CUR PCR_rBPCtlBas2_MAP PCR_rBPCtlBas_MAP PCR_rBPCtlGear_MAP PCR_rBPCtlInit_C PCR_rBPCtlRgn3a_MAP PCR_rBPCtlRgn3b_MAP PCR_rBPCtlRgnCor2_MAP PCR_rBPCtlRgnCor3_MAP PCR_rCtlAPCmpn_MAP PCR_stCtlRgnMsk_CA PCR_swtQCtlType_C PCR_swtQCtlVal_C PCR_tEngLimGear_C /end DEF_CHARACTERISTIC
/end FUNCTION
/begin FUNCTION PCR_CtrlValCalc "LDR-Steuerung"
 /begin DEF_CHARACTERISTIC PCR_facCtlRgn1_CUR PCR_facCtlRgn2_CUR PCR_rBPCtlRgn1a_MAP PCR_rBPCtlRgn1b_MAP PCR_rBPCtlRgn2a_MAP PCR_rBPCtlRgn2b_MAP PCR_rBPCtlRgnCor1_MAP /end DEF_CHARACTERISTIC
/end FUNCTION
/begin FUNCTION PCR_DesValCalc "Ladedruck Sollwertbildung"
 /begin DEF_CHARACTERISTIC PCR_CoDKdNeg_C PCR_CoDKdPos_C PCR_CoDKd_C PCR_CoDT1Neg_C PCR_CoDT1Pos_C PCR_WmDKdNeg_C PCR_WmDKdPos_C PCR_WmDKd_C PCR_WmDT1Neg_C PCR_WmDT1Pos_C PCR_dpCoDWinNeg_C PCR_dpCoDWinPos_C PCR_dpWmDWinNeg_C PCR_dpWmDWinPos_C PCR_facAT_CUR PCR_facCtQ_MAP PCR_facDesBas_CUR PCR_facDesRgn1_CUR PCR_facDesRgn2_CUR PCR_facDesRgn3_CUR PCR_facEAT_CUR PCR_nTrbn2_MAP PCR_nTrbnLim_C PCR_nTrbn_MAP PCR_pAPQCmpn_MAP PCR_pAirAltCorr_C PCR_pBDesBas2_MAP PCR_pBDesBas_MAP PCR_pBDesMaxAP_MAP PCR_pBDesMax_C PCR_pBDesMin_C PCR_pBDesRgn1a_MAP PCR_pBDesRgn1b_MAP PCR_pBDesRgn2a_MAP PCR_pBDesRgn2b_MAP PCR_pBDesRgn3a_MAP PCR_pBDesRgn3b_MAP PCR_pBDesRgnCor1_MAP PCR_pBDesRgnCor2_MAP PCR_pBDesRgnCor3_MAP PCR_pLim_C PCR_pNQCtCmpn_MAP PCR_stDesRgnMsk_CA PCR_swtQDesType_C PCR_swtQDesVal_C PCR_swtTmpAir_C PCR_swtTrbnMod_C PCR_tAirAltCorr_C PCR_tCThreshold_C PCR_tiDT1BPAlt_C /end DEF_CHARACTERISTIC
/end FUNCTION
/begin FUNCTION PCR_Governor "Adaptiver Ladedruckregler"
 /begin DEF_CHARACTERISTIC PCR_DKdNeg_C PCR_DKdPos_C PCR_DKd_C PCR_DT1_MAP PCR_IKiNeg_C PCR_IKiPos_C PCR_IKi_C PCR_PKpNeg_C PCR_PKpPos_C PCR_PKp_C PCR_dlyPT1_C PCR_dnAvrgMax_C PCR_dpMinBPGovFlt_C PCR_dqAPPBPMin_C PCR_dqAPPEGRMin_C PCR_dqInjDemMax_C PCR_facD_MAP PCR_facI_MAP PCR_facP_MAP PCR_nAvrgMax_C PCR_nGearChngMax_C PCR_pDWinNeg_C PCR_pDWinPos_C PCR_pIWinNeg_C PCR_pIWinPos_C PCR_pPWinNeg_C PCR_pPWinPos_C PCR_qBPDemMax_C PCR_qGearChngDesMin_C PCR_qGearChngMin_C PCR_qMinBPGovFlt_CUR PCR_qRgtOff1_CUR PCR_qRgtOff2_CUR PCR_qRgtOff3_CUR PCR_qRgtOn1_CUR PCR_qRgtOn2_CUR PCR_qRgtOn3_CUR PCR_qSetUnBalMin_C PCR_rBPAPRatMin_MAP PCR_rBPGearChngRgn_MAP PCR_rBPGearChng_C PCR_rBPGearChng_MAP PCR_rBPGovLin2_CUR PCR_rBPGovLin_CUR PCR_rBPGovMax_MAP PCR_rBPGovMin_MAP PCR_rBPOvrRunRgn_MAP PCR_rBPOvrRun_CUR PCR_rBPOvrRun_MAP PCR_rIDflNS_C PCR_rPresGearChngMin_C PCR_rPresOvrRunOff_CUR PCR_stBPAltDesRgnMsk_C PCR_stEGRGearChngMsk_C PCR_stRgnActvMsk_C PCR_stRgtOffMsk1_C PCR_stRgtOffMsk2_C PCR_stRgtOffMsk3_C PCR_stRgtOnMsk1_C PCR_stRgtOnMsk2_C PCR_stRgtOnMsk3_C PCR_stTVAGearChngMsk_C PCR_swtActvNS_C PCR_swtBPAltDes_C PCR_swtBPFrzMAP_C PCR_swtClthInv_C PCR_swtGearChngTrqFlt_C PCR_swtLimMpCrType_C PCR_swtLimMpCrVal_C PCR_swtOvrRunTrqFlt_C PCR_swtRelAbsType_C PCR_swtRelAbsVal_C PCR_swtShftUpActv_C PCR_swtWrkSphSet_C PCR_tiBPGearChngDly_C PCR_tiBPOvrRunDly_C PCR_tiBPPT1Rgn_C PCR_tiBPPT1_C PCR_tiClutchIntv_C PCR_tiClutchSetDebPos_C PCR_tiDebswtRgt_C PCR_tiDelBPGovFlt_C PCR_tiEGRGearChngRgnRst_C PCR_tiEGRGearChngRst_C PCR_tiEGROvrRunRgnRst_C PCR_tiEGROvrRunRst_C PCR_tiGearChngMax_C PCR_tiGearChngRgnMax_C PCR_tiOvrRunDetMax_C PCR_tiOvrRunRgnDetMax_C PCR_tiPTBPGovFlt_C PCR_tiShftUpDur_C PCR_tiShftUpOn_C PCR_tiTVAGearChngRgnRst_C PCR_tiTVAGearChngRst_C PCR_tiTVAOvrRunRgnRst_C PCR_tiTVAOvrRunRst_C PCR_tiVSAOvrRunRst_C /end DEF_CHARACTERISTIC
/end FUNCTION
/begin FUNCTION PCR_Monitor "Ladedruckregelung - Überwachung und Abschaltung"
 /begin DEF_CHARACTERISTIC PCR_DebSRCHighDef_C PCR_DebSRCHighOk_C PCR_DebSRCLowDef_C PCR_DebSRCLowOk_C PCR_nCoStart_C PCR_nWrkSph1_C PCR_nWrkSph2_C PCR_nWrkSph3_C PCR_pBGDevMax_CUR PCR_pBGDevMin_C PCR_qRgtOff_CUR PCR_qRgtOn_CUR PCR_qWrkSph2_C PCR_qWrkSph3_C PCR_rDflGvnrOff_C PCR_rDflShutOff_C PCR_rDflSysFault_C PCR_swtAfterRun_C PCR_swtGDevMax_C PCR_tiCoStrt_CUR PCR_tiStrtDelayInit_C /end DEF_CHARACTERISTIC
/end FUNCTION
/begin FUNCTION PCU "Pumpenspezifika" /begin SUB_FUNCTION InjUn_PSG16 /end SUB_FUNCTION /end FUNCTION
/begin FUNCTION PFltCD_EvalTPst "Particulate Filter Post temperature Component Driver"
 /begin DEF_CHARACTERISTIC PFltCD_DebSRCHighDefTPst_C PFltCD_DebSRCHighOkTPst_C PFltCD_DebSRCLowDefTPst_C PFltCD_DebSRCLowOkTPst_C PFltCD_dtRmpSlpDwnPst_C PFltCD_dtRmpSlpUpPst_C PFltCD_stSensIDWordTPst_C PFltCD_tLinPst_CUR /end DEF_CHARACTERISTIC
/end FUNCTION
/begin FUNCTION PFltCD_GetPDiff "Differenzdruck über Partikelfilter"
 /begin DEF_CHARACTERISTIC PFltCD_DebSRCLowPDiffOk_C PFltCD_dtRmpSlpDwnPDiff_C PFltCD_dtRmpSlpUpPDiff_C PFltCD_numSSpPDiff_C PFltCD_pDflDiff_C PFltCD_pLinDiff_CUR PFltCD_stSensIDWordPDiff_C PFltCD_swtSigPDiff_C PFltCD_tiPDiffPT1_C PFltCD_uSRCMaxPDiff_C PFltCD_uSRCMinPDiff_C PFlt_tiVelVeh_CUR /end DEF_CHARACTERISTIC
/end FUNCTION
/begin FUNCTION PFltCD_GetTPre "Abgastemperatur vor dem Partikelfilter"
 /begin DEF_CHARACTERISTIC PFltCD_DebSRCHighDefTPre_C PFltCD_DebSRCHighOkTPre_C PFltCD_DebSRCLowDefTPre_C PFltCD_DebSRCLowOkTPre_C PFltCD_dtRmpSlpDwnPre_C PFltCD_dtRmpSlpUpPre_C PFltCD_stSensIDWordTPre_C PFltCD_tDflPre_C PFltCD_tLinPre1_CUR PFltCD_uSRCMaxTempPre_C PFltCD_uSRCMinTempPre_C /end DEF_CHARACTERISTIC
/end FUNCTION
/begin FUNCTION PFltCD_GetTPst "Abgastemperatur nach dem Partikelfilter"
 /begin DEF_CHARACTERISTIC PFltCD_tDflPst_C PFltCD_uSRCMaxTempPst_C PFltCD_uSRCMinTempPst_C /end DEF_CHARACTERISTIC
/end FUNCTION
/begin FUNCTION PFltCD_GettDiff "Temperatur über Partikelfilter"
 /begin DEF_CHARACTERISTIC PFltCD_DebSRCHighPDiffDef_C PFltCD_DebSRCHighPDiffOk_C PFltCD_DebSRCLowPDiffDef_C PFltCD_DebSigPDiffDef_C PFltCD_DebSigPDiffOk_C /end DEF_CHARACTERISTIC
/end FUNCTION
/begin FUNCTION PFltCD_Htg "Partikelfilterheizung"
 /begin DEF_CHARACTERISTIC PFltCD_ctPwrStgOnMax_C PFltCD_rThresHtg_C PFltCD_stInvOutHtg_C PFltCD_stPwrStgActvHtg_C PFltCD_stPwrStgDiaHtg_C PFltCD_stSPICtl_C PFltCD_tiBtwTst_C PFltCD_tiDebExcTmpHtgDef_C PFltCD_tiDebExcTmpHtgOk_C PFltCD_tiDebNoLoadHtgDef_C PFltCD_tiDebNoLoadHtgOk_C PFltCD_tiDebShrtBatHtgDef_C PFltCD_tiDebShrtBatHtgOk_C PFltCD_tiDebShrtGndHtgDef_C PFltCD_tiDebShrtGndHtgOk_C PFltCD_tiPwrStgOn_C SigTst_PFltRLYHtgEn_C /end DEF_CHARACTERISTIC
/end FUNCTION
/begin FUNCTION PFlt_AshCor_Proc "Pflt Ash Correction Adjustment"
 /begin DEF_CHARACTERISTIC ACCCD_dtrqSlpNeg_C ACCCD_stBrkActMsk_C ACCCD_tiEPBOn_C ACCCD_tiEPBShOff_C EATSCD_DebCanDefDef_C /end DEF_CHARACTERISTIC
/end FUNCTION
/begin FUNCTION PFlt_CoRgn "Partikelfilterregenerationskoordinator"
 /begin DEF_CHARACTERISTIC PFlt_numLstRstMin_C PFlt_numLvlRgnDur0_C PFlt_numLvlRgnDur1_C PFlt_numLvlRgnDur2_C PFlt_numRgnStgShtrp1_C PFlt_numRgnStgShtrp2_C PFlt_rSotCntRst_CUR PFlt_rSotSimTempCntRst_C PFlt_rSotSimTempCntRst_CUR PFlt_rSotSimTempLow1_CUR PFlt_rSotSimTempLow2_CUR PFlt_rSotSimTempLow3_CUR PFlt_rSotSimTempLow4_CUR PFlt_rSotSimTempLst_C PFlt_rSotSimTempRstLow1_C PFlt_rSotSimTempRstLow2_C PFlt_rSotSimTempRstLow3_C PFlt_rSotSimTempRstLow4_C PFlt_swtCntSel_C PFlt_swtLowThresSel_C PFlt_swtRgnEndTempEna_C PFlt_swtRgnEndTempInit_C PFlt_swtTmrRgnRst_C PFlt_tiCntThres_C PFlt_tiMaxTstrRgnShOff_C PFlt_tiRgnMaxTmrSubs_C PFlt_tiSumRgnMaxThres0_C /end DEF_CHARACTERISTIC
/end FUNCTION
/begin FUNCTION PFlt_CoRgn2 "particulate filter regeneration coordinator 2"
 /begin DEF_CHARACTERISTIC PFlt_CPFlt_C PFlt_KdDT1TempCor_C PFlt_ctRgnLckThres1_C PFlt_ctRgnLckThres2_C PFlt_dmNOxEngBas_MAP PFlt_dmSotSimLmbdRgn_MAP PFlt_dmSotSimLmbd_MAP PFlt_dtAccPedMax_C PFlt_dvolMinSotSim_C PFlt_facAdd2Ash_C PFlt_facFl2Ash_C PFlt_facFltEmpConst_C PFlt_facFltFulConst_C PFlt_facSotPresFac_C PFlt_facSumRgnMaxRlx_C PFlt_facTRgnMaxRlx_C PFlt_kdDT1Sim_C PFlt_lSumMaxDef_C PFlt_lSumMax_CUR PFlt_lSumSubs_C PFlt_mAshfacAdjDfl_C PFlt_mAshfacAdjMax_C PFlt_mAshfacAdjMin_C PFlt_nErLpEngN_C PFlt_numEngPOp1_CA PFlt_numFltEmpEu_CUR PFlt_numFltEmpRe_MAP PFlt_numFltFulEu_CUR PFlt_numFltFulRe_MAP PFlt_numLst_C PFlt_numPrioRgnStg1_C PFlt_numPrioRgnStg2_C PFlt_numPrioRgnStg3_C PFlt_numPrioRgnStg4_C PFlt_numPrioRgnStg5_C PFlt_numPrioRgnStg6_C PFlt_numPrt_C PFlt_numRgnTrgRgn_C PFlt_numRgnTxtMsg_C PFlt_pDiffDfl_C PFlt_pDiffMaxSotSim_C PFlt_pEngPrtMaxInit_C PFlt_pEngPrtMax_MAP PFlt_pEngPrtMin_MAP PFlt_pPreDfl_C PFlt_qFlMaxDef_C PFlt_qFlMax_C PFlt_qFlSubs_C PFlt_rSotCntRst_C PFlt_rSotPresMax_C PFlt_rSotPresMin_C PFlt_rSotPresOfs_C PFlt_rSotSimPresAddHigh_C PFlt_rSotSimPresAddLow_C PFlt_rSotSimPresDfl_C PFlt_rSotSimPresHigh1_CUR PFlt_rSotSimPresHigh2_CUR PFlt_rSotSimPresHigh3_CUR PFlt_rSotSimPresHigh4_CUR PFlt_rSotSimPresLow1_CUR PFlt_rSotSimPresLow2_CUR PFlt_rSotSimPresLow3_CUR PFlt_rSotSimPresLow4_CUR PFlt_rSotSimPresRstLow1_C PFlt_rSotSimPresRstLow2_C PFlt_rSotSimPresRstLow3_C PFlt_rSotSimPresRstLow4_C PFlt_rSotSimPresSubs_C PFlt_stInrRgnMsk1_C PFlt_stInrRgnMsk2_C PFlt_stLckRgnMsk_C PFlt_stRgnStg1_C PFlt_stRgnStg2_C PFlt_stRgnStg3_C PFlt_stRgnStg4_C PFlt_stRgnStg5_C PFlt_stRgnStg6_C PFlt_stSumRgnMsk_C PFlt_swtAftRunHys_C PFlt_swtEngPrtSel_C PFlt_swtFltTemp_C PFlt_swtLmbdAprx_C PFlt_swtSotSimPT1Init_C PFlt_swtTmrLckRst_C PFlt_t1DT1Sim_C PFlt_tAccPedOff_C PFlt_tClntLowMax_C PFlt_tClntUppMax_C PFlt_tExhGsSty_MAP PFlt_tPreDfl_C PFlt_tPreTrbnLowMax_C PFlt_tPreTrbnUppMax_C PFlt_tSurfInit_C PFlt_tiEngOnMaxDef_C PFlt_tiEngOnMax_C PFlt_tiEngPrtPT1_C PFlt_tiEngPrt_C PFlt_tiErLpDel_C PFlt_tiErLpMax_C PFlt_tiErLpTst_C PFlt_tiFltTempPT1_C PFlt_tiHtTransDT1_CUR PFlt_tiLckSubs_C PFlt_tiOpSubs_C PFlt_tiRgnCtlMax_C PFlt_tiRgnCtlSpo_C PFlt_tiRgnLckMax0_C PFlt_tiRgnLckMax1_C PFlt_tiRgnLckMax2_C PFlt_tiRgnLckMax3_C PFlt_tiRgnLckMax4_C PFlt_tiRgnLckMax5_C PFlt_tiRgnLckMax6_C PFlt_tiRgnSpo_C PFlt_tiRgnStg0_CUR PFlt_tiRgnStg1_CUR PFlt_tiRgnStg2_CUR PFlt_tiRgnStg3_CUR PFlt_tiRgnStg4_CUR PFlt_tiRgnStg5_CUR PFlt_tiRgnStg6_CUR PFlt_tiSotPresDiffPT1_C PFlt_tiSotRatDiffPT1_C PFlt_tiSumRgnMaxThres1_C PFlt_tiSumRgnMaxThres2_C PFlt_trqInrRgnLowMax1_CUR PFlt_trqInrRgnLowMax2_CUR PFlt_trqInrRgnUppMax1_CUR PFlt_trqInrRgnUppMax2_CUR /end DEF_CHARACTERISTIC
/end FUNCTION
/begin FUNCTION PFlt_Diag "Diagnose für den Partikelfilter"
 /begin DEF_CHARACTERISTIC PFlt_DebRgnLckPermMaxDef_C PFlt_DebRgnLckPermMaxOK_C PFlt_DebRgnLckPermMinDef_C PFlt_DebRgnLckPermMinOK_C PFlt_DebRgnLckPermSigDef_C PFlt_DebRgnLckPermSigOK_C PFlt_ctRgnLckMax_C PFlt_rSotSimPresMax_C PFlt_rSotSimTempMax_C PFlt_tiSumRgnMaxTmr_C /end DEF_CHARACTERISTIC
/end FUNCTION
/begin FUNCTION PFlt_EngPOpCalc "Betriebszustandsberechnung für Partikelfilter"
 /begin DEF_CHARACTERISTIC PFlt_mFltSimRgn5PT1_C PFlt_mFltSimRgn7PT1_C PFlt_nAvrgHysHigh1_C PFlt_nAvrgHysHigh2_C PFlt_nAvrgHysLow1_C PFlt_nAvrgHysLow2_C PFlt_pHysHigh1_C PFlt_pHysHigh2_C PFlt_pHysHigh3_C PFlt_pHysHigh4_C PFlt_pHysHigh5_C PFlt_pHysLow1_C PFlt_pHysLow2_C PFlt_pHysLow3_C PFlt_pHysLow4_C PFlt_pHysLow5_C PFlt_qActThres7_CUR PFlt_qActUpLim7_CUR PFlt_rThresTransAWD_C PFlt_rThresTrans_C PFlt_rsTransThres7_C PFlt_stEngPOpShOffMsk_C PFlt_swtOxiCatTemp_C PFlt_swtTempNorm_C PFlt_swtTempPOpCalc_C PFlt_tClntHysHigh1_C PFlt_tClntHysHigh2_C PFlt_tClntHysHigh3_C PFlt_tClntHysHigh4_C PFlt_tClntHysHigh5_C PFlt_tClntHysHigh7_C PFlt_tClntHysLow1_C PFlt_tClntHysLow2_C PFlt_tClntHysLow3_C PFlt_tClntHysLow4_C PFlt_tClntHysLow5_C PFlt_tClntHysLow7_C PFlt_tFltCorrHysHigh3_C PFlt_tFltCorrHysHigh4_C PFlt_tFltCorrHysLow3_C PFlt_tFltCorrHysLow4_C PFlt_tFltHysHigh1_C PFlt_tFltHysHigh2_C PFlt_tFltHysHigh3_C PFlt_tFltHysHigh4_C PFlt_tFltHysHigh5_C PFlt_tFltHysHigh7_C PFlt_tFltHysLow1_C PFlt_tFltHysLow2_C PFlt_tFltHysLow3_C PFlt_tFltHysLow4_C PFlt_tFltHysLow5_C PFlt_tFltHysLow7_C PFlt_tFltThres_C PFlt_tOxiCatHysHigh3_C PFlt_tOxiCatHysLow3_C PFlt_tPstRgn5Min_C PFlt_tPstRgn7Min_C PFlt_tPstSimRgn5_MAP PFlt_tPstSimRgn7_MAP PFlt_tThresPre1_MAP PFlt_tThresPre2_MAP PFlt_tiDebSimRgn5Off_C PFlt_tiDebSimRgn5On_C PFlt_tiDebSimRgn7Off_C PFlt_tiDebSimRgn7On_C PFlt_tiDebSpeed5Off_C PFlt_tiDebSpeed5On_C PFlt_tiGear_C PFlt_tiPOpCalcHold_C PFlt_tiPOpCalcOn_C PFlt_tiPopCalc7DebNeg_C PFlt_tiPopCalc7DebPos_C PFlt_tiqAct7DebNeg_C PFlt_tiqAct7DebPos_C PFlt_vVehThres5_C PFlt_vVehThres7_C /end DEF_CHARACTERISTIC
/end FUNCTION
/begin FUNCTION PFlt_EngPOpPrj "Erweiterung für Betriebszustandsberechnung" /begin DEF_CHARACTERISTIC PFlt_tiThresNorm_MAP PFlt_vThresVeh_C /end DEF_CHARACTERISTIC /end FUNCTION
/begin FUNCTION PFlt_ExhGsPpty "dvol + Lambda" /begin DEF_CHARACTERISTIC PFlt_cpEGOxi_MAP PFlt_cpEG_MAP /end DEF_CHARACTERISTIC /end FUNCTION
/begin FUNCTION PFlt_HtgActv "Partikelfilter Heizungssteuerung"
 /begin DEF_CHARACTERISTIC PFlt_rHtg1_C PFlt_rHtg2_C PFlt_rHtg3_C PFlt_stCmpHtg1_C PFlt_stCmpHtg2_C PFlt_stCmpHtg3_C /end DEF_CHARACTERISTIC
/end FUNCTION
/end MODULE
/end PROJECT
