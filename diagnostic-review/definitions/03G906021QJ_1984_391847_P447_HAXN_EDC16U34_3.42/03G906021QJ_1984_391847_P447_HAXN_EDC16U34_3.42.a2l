ASAP2_VERSION 1 3
/begin PROJECT X447 "EDC16U34"
/begin HEADER "" VERSION "VAA1" PROJECT_NO X447 /end HEADER
/begin MODULE DIM ""
/begin MOD_COMMON "" BYTE_ORDER MSB_FIRST ALIGNMENT_BYTE 1 ALIGNMENT_WORD 2 ALIGNMENT_LONG 4 ALIGNMENT_FLOAT32_IEEE 4 /end MOD_COMMON
/begin CHARACTERISTIC ACCCD_swtGvnrOutI_C "Steuerungsschalter zum Vorwählen I-Teil Verhalten" VALUE 0x1C2677 Kw_Wu8 1.000 OneToOne 0.00 1.000 FORMAT "%5.3" EXTENDED_LIMITS 0.00 255.0 /end CHARACTERISTIC
/begin CHARACTERISTIC Signals_adFreeApplic1_C "adresse eines frei applizierbaren Signals" VALUE 0x1C0FC8 Kw_Wu32 4294967295.00 OneToOne 0.00 4294967295.00 FORMAT "%13.2" /end CHARACTERISTIC
/begin CHARACTERISTIC Signals_numTypFreeApplic1_C "Datentyp eines frei applizierbaren Signals" VALUE 0x1C0FCC Kw_Wu8 5.00000000000 SigDatatyp 0.00 5.00000000000 FORMAT "%13.11" /end CHARACTERISTIC
/begin CHARACTERISTIC Signals_adFreeApplic2_C "adresse eines frei applizierbaren Signals" VALUE 0x1C0FD0 Kw_Wu32 4294967295.00 OneToOne 0.00 4294967295.00 FORMAT "%13.2" /end CHARACTERISTIC
/begin CHARACTERISTIC Signals_numTypFreeApplic2_C "Datentyp eines frei applizierbaren Signals" VALUE 0x1C0FD4 Kw_Wu8 5.00000000000 SigDatatyp 0.00 5.00000000000 FORMAT "%13.11" /end CHARACTERISTIC
/begin CHARACTERISTIC Signals_adFreeApplic3_C "adresse eines frei applizierbaren Signals" VALUE 0x1C0FD8 Kw_Wu32 4294967295.00 OneToOne 0.00 4294967295.00 FORMAT "%13.2" /end CHARACTERISTIC
/begin CHARACTERISTIC Signals_numTypFreeApplic3_C "Datentyp eines frei applizierbaren Signals" VALUE 0x1C0FDC Kw_Wu8 5.00000000000 SigDatatyp 0.00 5.00000000000 FORMAT "%13.11" /end CHARACTERISTIC
/begin CHARACTERISTIC Signals_adFreeApplic4_C "Adresse eines frei applizierbaren Signals" VALUE 0x1C0FE0 Kw_Wu32 4294967295.00 OneToOne 0.00 4294967295.00 FORMAT "%13.2" /end CHARACTERISTIC
/begin CHARACTERISTIC Signals_numTypFreeApplic4_C "Datentyp für freiapplizierbare Signals" VALUE 0x1C0FE4 Kw_Wu8 5.00000000000 SigDatatyp 0.00 5.00000000000 FORMAT "%13.11" /end CHARACTERISTIC
/begin CHARACTERISTIC BasAdj_rVSA_C "Sollwert des VSA-Stellglieds bei VSA Grundeinstellung  (Diagnose)" VAL_BLK 0x1CC148 Kwb_Ws16 655.3500 Prc -327.6800 327.6700 FORMAT "%8.4" NUMBER 2 /end CHARACTERISTIC
/begin CHARACTERISTIC CrCCD_stPanelVer_C "Art des verbauten Bedienteils" VALUE 0x1CCF74 Kw_Wu8 7.000 OneToOne 0.00 7.000 FORMAT "%5.3" EXTENDED_LIMITS 0.00 255.0 /end CHARACTERISTIC
/begin CHARACTERISTIC Eng_tqMaxClu_T_VW "maximum torque at clutch" CURVE 0x001C1C36 _REC_CUR_20_u1_u1 1275. _CNV_R_R_RATIONALFU_1_CM 0. 1275. FORMAT "%6.0"
 /begin AXIS_DESCR COM_AXIS NO_INPUT_QUANTITY _CNV_R_R_RATIONALFU_0_CM 8 0. 10200. FORMAT "%6.0" AXIS_PTS_REF Eng_nQuoSpdRev8_A_VW /end AXIS_DESCR
/end CHARACTERISTIC
/begin CHARACTERISTIC Eng_stEnaSdwnRegPmt_C_VW "Enabeling shift down adwise during PM-trap regeneration" VALUE 0x001C1C49 _REC_VAL_20_u1 1. _CNV_R_R_RATIONALFU_3_CM 0. 1. FORMAT "%6.0" /end CHARACTERISTIC
/begin CHARACTERISTIC Eng_nMinSdwnAcc_C_VW "Minimum engine speed for shift down advise during ACC active" VALUE 0x001C1C44 _REC_VAL_20_u1 10200. _CNV_R_R_RATIONALFU_0_CM 0. 10200. /end CHARACTERISTIC
/begin CHARACTERISTIC Eng_nMaxSdwn_T_VW "Maximum engine speed for shift down advise" CURVE 0x001C1BA6 _REC_CUR_20_u1_u1 10200. _CNV_R_R_RATIONALFU_0_CM 0. 10200. FORMAT "%6.0"
 /begin AXIS_DESCR COM_AXIS NO_INPUT_QUANTITY _CNV_R_R_RATIONALFU_3_CM 8 0. 255. FORMAT "%6.0" AXIS_PTS_REF Eng_noGear8_A_VW /end AXIS_DESCR
/end CHARACTERISTIC
/begin CHARACTERISTIC Eng_rRevSpd_T_VW "Ratio between engine and vehicle speed (ratio n/v)" CURVE 0x001C1BE6 _REC_CUR_20_u2_u2 511.9921875 _CNV_R_R_RATIONALFU_5_CM 0. 511.9921875
 /begin AXIS_DESCR COM_AXIS NO_INPUT_QUANTITY _CNV_R_R_RATIONALFU_3_CM 8 0. 65535. FORMAT "%6.0" AXIS_PTS_REF Eng_noGearConv8_A_VW /end AXIS_DESCR
/end CHARACTERISTIC
/begin CHARACTERISTIC Eng_noGearMax_C_VW "Maximum gear" VALUE 0x001C1C46 _REC_VAL_20_u1 255. _CNV_R_R_RATIONALFU_3_CM 0. 255. FORMAT "%6.0" /end CHARACTERISTIC
/begin CHARACTERISTIC Eng_noCycGearDisp_C_VW "Number of cycles for blinking gear display" VALUE 0x001C1C45 _REC_VAL_20_u1 255. _CNV_R_R_RATIONALFU_3_CM 0. 255. FORMAT "%6.0" /end CHARACTERISTIC
/begin CHARACTERISTIC Eng_nMaxSup_C_VW "Maximum engine speed before shift up advise" VALUE 0x001C1C43 _REC_VAL_20_u1 10200. _CNV_R_R_RATIONALFU_0_CM 0. 10200. FORMAT "%6.0" /end CHARACTERISTIC
/begin CHARACTERISTIC Eng_tiWaitSdwnKd_C_VW "Debounce time for shift down advise due to kick down" VALUE 0x001C1C4F _REC_VAL_20_u1 25.5 _CNV_R_R_RATIONALFU_6_CM 0. 25.5 FORMAT "%6.1" /end CHARACTERISTIC
/begin CHARACTERISTIC Eng_nMaxSdwnReq_C_VW "Maximum engine speed for shift down advise" VALUE 0x001C1C42 _REC_VAL_20_u1 10200. _CNV_R_R_RATIONALFU_0_CM 0. 10200. FORMAT "%6.0" /end CHARACTERISTIC
/begin CHARACTERISTIC Eng_nHysSdwn_C_VW "Hysteresis for shift down advise" VALUE 0x001C1C41 _REC_VAL_20_u1 10200. _CNV_R_R_RATIONALFU_0_CM 0. 10200. FORMAT "%6.0" /end CHARACTERISTIC
/begin CHARACTERISTIC Eng_rAcePedMaxGearReq_C_VW "Maximum ratio acceleration pedal for gear request" VALUE 0x001C1C47 _REC_VAL_20_u1 99.609375 _CNV_R_R_RATIONALFU_7_CM 0. 99.609375 /end CHARACTERISTIC
/begin CHARACTERISTIC Eng_bEnaDispGearAct_C_VW "Constant for enabeling display of actual gear and disabeling blinking" VALUE 0x001C1C40 _REC_VAL_20_u1 255. _CNV_R_R_RATIONALFU_3_CM 0. 255. FORMAT "%6.0" /end CHARACTERISTIC
/begin CHARACTERISTIC Eng_nMinSup_M_VW "Minimum engine speed for shift up advise (gear, temperature)" MAP 0x001C1BAE _REC_MAP_20_u1_u1_u1 10200. _CNV_R_R_RATIONALFU_0_CM 0. 10200. FORMAT "%6.0"
 /begin AXIS_DESCR COM_AXIS NO_INPUT_QUANTITY _CNV_R_R_RATIONALFU_9_CM 6 -48. 143.25 AXIS_PTS_REF Eng_tCo6_A_VW /end AXIS_DESCR
 /begin AXIS_DESCR COM_AXIS NO_INPUT_QUANTITY _CNV_R_R_RATIONALFU_3_CM 8 0. 255. FORMAT "%6.0" AXIS_PTS_REF Eng_noGear8_A_VW /end AXIS_DESCR
/end CHARACTERISTIC
/begin CHARACTERISTIC Eng_noGearDispCmu_T_VW "Gear for communication with display" CURVE 0x001C1BDE _REC_CUR_20_u1_u1 255. _CNV_R_R_RATIONALFU_3_CM 0. 255. FORMAT "%6.0"
 /begin AXIS_DESCR COM_AXIS NO_INPUT_QUANTITY _CNV_R_R_RATIONALFU_3_CM 8 0. 255. FORMAT "%6.0" AXIS_PTS_REF Eng_noGear8_A_VW /end AXIS_DESCR
/end CHARACTERISTIC
/begin CHARACTERISTIC Eng_tiDlyPu_C_VW "delay time after fuel cut off is detected" VALUE 0x001C1C4B _REC_VAL_20_u1 25.5 _CNV_R_R_RATIONALFU_6_CM 0. 25.5 FORMAT "%6.1" /end CHARACTERISTIC
/begin CHARACTERISTIC Eng_tiWaitCluOp_C_VW "wait time until open clutch is detected" VALUE 0x001C1C4C _REC_VAL_20_u1 25.5 _CNV_R_R_RATIONALFU_6_CM 0. 25.5 FORMAT "%6.1" /end CHARACTERISTIC
/begin CHARACTERISTIC Eng_tiWaitTogNegGearReq_C_VW "Waiting time after requested gear toggle negativ" VALUE 0x001C1C52 _REC_VAL_20_u1 25.5 _CNV_R_R_RATIONALFU_6_CM 0. 25.5 /end CHARACTERISTIC
/begin CHARACTERISTIC Eng_tiWaitInc2GearReq_C_VW "Wait time before increase of 2 for requested gear is allowed" VALUE 0x001C1C4E _REC_VAL_20_u1 25.5 _CNV_R_R_RATIONALFU_6_CM 0. 25.5 FORMAT "%6.1" /end CHARACTERISTIC
/begin CHARACTERISTIC Eng_tiWaitTogGearReq_C_VW "Waiting time after gequested gear toggle" VALUE 0x001C1C51 _REC_VAL_20_u1 25.5 _CNV_R_R_RATIONALFU_6_CM 0. 25.5 FORMAT "%6.1" /end CHARACTERISTIC
/begin CHARACTERISTIC Eng_tiWaitTogGearAct_C_VW "Wait time after actual gear toggle" VALUE 0x001C1C50 _REC_VAL_20_u1 25.5 _CNV_R_R_RATIONALFU_6_CM 0. 25.5 FORMAT "%6.1" /end CHARACTERISTIC
/begin CHARACTERISTIC Eng_agPwrStgMax_C_VW "Maximum angle of power steering for gear advise" VALUE 0x001C1C3E _REC_VAL_20_s2 2867.15625 _CNV_R_R_RATIONALFU_10_CM -1433.6 1433.55625 /end CHARACTERISTIC
/begin CHARACTERISTIC Eng_tiDlyBrk_C_VW "delay time after braking is detected" VALUE 0x001C1C4A _REC_VAL_20_u1 25.5 _CNV_R_R_RATIONALFU_6_CM 0. 25.5 FORMAT "%6.1" /end CHARACTERISTIC
/begin CHARACTERISTIC Eng_tiWaitDisp_C_VW "Waiting time before display update after cluch switch" VALUE 0x001C1C4D _REC_VAL_20_u1 25.5 _CNV_R_R_RATIONALFU_6_CM 0. 25.5 FORMAT "%6.2" /end CHARACTERISTIC
/begin CHARACTERISTIC Eng_tqIdRed_M_VW "Reduction of maximum indicated torque due to influence of air density" MAP 0x001C1BF6 _REC_MAP_20_u1_u1_u1 1275. _CNV_R_R_RATIONALFU_1_CM 0. 1275. FORMAT "%6.0"
 /begin AXIS_DESCR COM_AXIS NO_INPUT_QUANTITY _CNV_R_R_RATIONALFU_4_CM 8 0. 1.9921875 AXIS_PTS_REF Eng_densAir8_A_VW /end AXIS_DESCR
 /begin AXIS_DESCR COM_AXIS NO_INPUT_QUANTITY _CNV_R_R_RATIONALFU_0_CM 8 0. 10200. FORMAT "%6.0" AXIS_PTS_REF Eng_nQuoSpdRev8_A_VW /end AXIS_DESCR
/end CHARACTERISTIC
/begin CHARACTERISTIC Eng_stAccAct_C_VW "Status ACC-system active" VALUE 0x001C1C48 _REC_VAL_20_u1 255. _CNV_R_R_RATIONALFU_3_CM 0. 255. FORMAT "%6.0" /end CHARACTERISTIC
/begin AXIS_PTS Eng_nQuoSpdRev8_A_VW " Axis calculated engine speed (ratio n/v)" 0x001C1B80 NO_INPUT_QUANTITY _REC_AXS_1_u1 10200. _CNV_R_R_RATIONALFU_0_CM 8 0. 10200. FORMAT "%6.0" /end AXIS_PTS
/begin AXIS_PTS Eng_densAir8_A_VW "Air density" 0x001C1B78 NO_INPUT_QUANTITY _REC_AXS_1_u1 1.9921875 _CNV_R_R_RATIONALFU_4_CM 8 0. 1.9921875 /end AXIS_PTS
/begin AXIS_PTS Eng_noGear8_A_VW "Gear" 0x001C1B88 NO_INPUT_QUANTITY _REC_AXS_1_u1 255. _CNV_R_R_RATIONALFU_3_CM 8 0. 255. FORMAT "%6.0" /end AXIS_PTS
/begin AXIS_PTS Eng_noGearConv8_A_VW "Gear (converted to word)" 0x001C1B90 NO_INPUT_QUANTITY _REC_AXS_1_u2 65535. _CNV_R_R_RATIONALFU_3_CM 8 0. 65535. FORMAT "%6.0" /end AXIS_PTS
/begin AXIS_PTS Eng_tCo6_A_VW "Engine coolant temperature" 0x001C1BA0 NO_INPUT_QUANTITY _REC_AXS_1_u1 191.25 _CNV_R_R_RATIONALFU_9_CM 6 -48. 143.25 /end AXIS_PTS
/begin CHARACTERISTIC K2RDI_DiaNum_C "Diagnosenummer" ASCII 0x1C1446 Ktx 255.0 defaultAscii 0.00 255.0 NUMBER 5 /end CHARACTERISTIC
/begin CHARACTERISTIC Prp_factAPPThres_C "" VALUE 0x1EF840 Kw_Ws16 1.000000 FactLow 0.00 1.000000 FORMAT "%8.6" EXTENDED_LIMITS -32.00000 31.99902 /end CHARACTERISTIC
/begin CHARACTERISTIC Prp_swtCANrAPP_C "" VALUE 0x1EFD7A Kw_Wu8 1.000 OneToOne 0.00 1.000 FORMAT "%5.3" EXTENDED_LIMITS 0.00 255.0 /end CHARACTERISTIC
/begin CHARACTERISTIC Sig_LimLowDigital_C "Unterer Grenzwert für Stellertests mit digitaler Stellgröße" VALUE 0x1C13CE Kw_Ws16 65535.00 OneToOne -32768.00 32767.00 FORMAT "%8.2" /end CHARACTERISTIC
/begin CHARACTERISTIC Sig_LimUpDigital_C "Oberer Grenzwert für Stellertests mit digitaler Stellgröße" VALUE 0x1C13D0 Kw_Ws16 1.000000 OneToOne 0.00 1.000000 FORMAT "%8.6" EXTENDED_LIMITS -32768.00 32767.00 /end CHARACTERISTIC
/begin CHARACTERISTIC Sig_LimLown_C "Unterer Grenzwert für Stellertests mit Drehzahl Stellgröße" VALUE 0x1C13D2 Kw_Ws16 65535.00 EngN -32768.00 32767.00 FORMAT "%8.2" /end CHARACTERISTIC
/begin CHARACTERISTIC Sig_LimUpn_C "Oberer Grenzwert für Stellertests mit Drehzahl Stellgröße" VALUE 0x1C13D4 Kw_Ws16 65535.00 EngN -32768.00 32767.00 FORMAT "%8.2" /end CHARACTERISTIC
/begin CHARACTERISTIC Sig_LimLowPwm_C "Unterer Grenzwert für Stellertests mit PWM Stellgröße" VALUE 0x1C13D6 Kw_Ws16 655.3500 DtyCyc -327.6800 327.6700 FORMAT "%8.4" /end CHARACTERISTIC
/begin CHARACTERISTIC Sig_LimUpPwm_C "Oberer Grenzwert für Stellertests mit PWM Stellgröße" VALUE 0x1C13D8 Kw_Ws16 655.3500 DtyCyc -327.6800 327.6700 FORMAT "%8.4" /end CHARACTERISTIC
/begin CHARACTERISTIC signals_tiTstDemHeal_C "Minimale Zeit ohne Stellertestanforderung nach Verriegelung wegen Zeitüberschreitung." VALUE 0x1F0488 Kw_Wu16 655350.0 Time_ms 0.00 655350.0 FORMAT "%8.1" /end CHARACTERISTIC
/begin CHARACTERISTIC signals_tiTstDemMax_C "Maximale zulässige Testzeit für Stellertest über Diagnosetester" VALUE 0x1F048A Kw_Wu16 655350.0 Time_ms 0.00 655350.0 FORMAT "%8.1" /end CHARACTERISTIC
/begin CHARACTERISTIC signals_TmrBehaviour_C "Verhalten der Zeitbegrenzung für Stellertest" VALUE 0x1F048C Kw_Wu8 255.0 OneToOne 0.00 255.0 FORMAT "%5.1" /end CHARACTERISTIC
/begin CHARACTERISTIC signals_TstDemMaxEngN_C "Maximale Drehzahl für Stellertest über Diagnosetester" VALUE 0x1F048E Kw_Ws16 65535.00 EngN -32768.00 32767.00 FORMAT "%8.2" /end CHARACTERISTIC
/begin CHARACTERISTIC signals_TstDemMaxVSSCDV_C "Maximale Geschwindigkeit für Stellertest über Diagnosetester" VALUE 0x1F0490 Kw_Ws16 655.3500 Vel -327.6800 327.6700 FORMAT "%8.4" /end CHARACTERISTIC
/begin CHARACTERISTIC SigTst_ACEn_C "Stellertestüberwachung Freigabemaske für Klimaanlage Ausgang" VALUE 0x1F0492 Kw_Wu8 7.000 OneToOne 0.00 7.000 FORMAT "%5.3" EXTENDED_LIMITS 0.00 255.0 /end CHARACTERISTIC
/begin CHARACTERISTIC SigTst_AFVEn_C "Stellertestüberwachung Freigabemaske für Luftfilterklappen Ausgang" VALUE 0x1F0493 Kw_Wu8 7.000 OneToOne 0.00 7.000 FORMAT "%5.3" EXTENDED_LIMITS 0.00 255.0 /end CHARACTERISTIC
/begin CHARACTERISTIC SigTst_AOHtCDHt1En_C "Stellertestüberwachung Freigabemaske für Zuheizer1 Ausgang" VALUE 0x1F0494 Kw_Wu8 7.000 OneToOne 0.00 7.000 FORMAT "%5.3" EXTENDED_LIMITS 0.00 255.0 /end CHARACTERISTIC
/begin CHARACTERISTIC SigTst_AOHtCDHt2En_C "Stellertestüberwachung Freigabemaske für Zuheizer2 Ausgang" VALUE 0x1F0495 Kw_Wu8 7.000 OneToOne 0.00 7.000 FORMAT "%5.3" EXTENDED_LIMITS 0.00 255.0 /end CHARACTERISTIC
/begin CHARACTERISTIC SigTst_ENGMENGEn_C "Stellertestüberwachung Freigabemaske für Motorlager Ausgang" VALUE 0x1F049D Kw_Wu8 7.000 OneToOne 0.00 7.000 FORMAT "%5.3" EXTENDED_LIMITS 0.00 255.0 /end CHARACTERISTIC
/begin CHARACTERISTIC SigTst_ENGMENG1En_C "Stellertestüberwachng Freischaltmaske für Motorlager Ausgang 1" VALUE 0x1F049E Kw_Wu8 7.000 OneToOne 0.00 7.000 FORMAT "%5.3" EXTENDED_LIMITS 0.00 255.0 /end CHARACTERISTIC
/begin CHARACTERISTIC SigTst_ENGMENG2En_C "Stellertestüberwachung Freischaltmaske für Motorlager Ausgang 2" VALUE 0x1F049F Kw_Wu8 7.000 OneToOne 0.00 7.000 FORMAT "%5.3" EXTENDED_LIMITS 0.00 255.0 /end CHARACTERISTIC
/begin CHARACTERISTIC SigTst_ENGMGEAREn_C "Stellertestüberwachung Freigabemaske für Getriebelager Ausgang" VALUE 0x1F04A0 Kw_Wu8 7.000 OneToOne 0.00 7.000 FORMAT "%5.3" EXTENDED_LIMITS 0.00 255.0 /end CHARACTERISTIC
/begin CHARACTERISTIC SigTst_ENGMGEAR1En_C "Stellertestüberwachung Freischaltmaske für Getriebelager 1" VALUE 0x1F04A1 Kw_Wu8 7.000 OneToOne 0.00 7.000 FORMAT "%5.3" EXTENDED_LIMITS 0.00 255.0 /end CHARACTERISTIC
/begin CHARACTERISTIC SigTst_ENGMGEAR2En_C "Stellertestüberwachung Freischaltmaske für Getriebelager 2" VALUE 0x1F04A2 Kw_Wu8 7.000 OneToOne 0.00 7.000 FORMAT "%5.3" EXTENDED_LIMITS 0.00 255.0 /end CHARACTERISTIC
/begin CHARACTERISTIC SigTst_EngMEn_C "Remote-Control für Drehzahl Eng_nAvrg aktivieren" VALUE 0x1F04A3 Kw_Wu8 7.000 OneToOne 0.00 7.000 FORMAT "%5.3" EXTENDED_LIMITS 0.00 255.0 /end CHARACTERISTIC
/begin CHARACTERISTIC SigTst_PFltLmpEn_C "Stellertestüberwachung Freigabemaske für PFlt Lampen Ausgang" VALUE 0x1F04AD Kw_Wu8 7.000 OneToOne 0.00 7.000 FORMAT "%5.3" EXTENDED_LIMITS 0.00 255.0 /end CHARACTERISTIC
/begin CHARACTERISTIC SigTst_PSPEn_C "Stellertestüberwachung Freigabemaske für Vorförderpumpen  Ausgang" VALUE 0x1F04AF Kw_Wu8 7.000 OneToOne 0.00 7.000 FORMAT "%5.3" EXTENDED_LIMITS 0.00 255.0 /end CHARACTERISTIC
/begin CHARACTERISTIC SigTst_WDALEn_C "Schalter um den Stellgliedtest der Winterfahrprogrammlampe zu aktivieren." VALUE 0x1F04B5 Kw_Wu8 7.000 OneToOne 0.00 7.000 FORMAT "%5.3" EXTENDED_LIMITS 0.00 255.0 /end CHARACTERISTIC
/begin CHARACTERISTIC Sig_aDSMOffset_C "Offset fuer Umrechung SG->DSM fuer Beschleunigung" VALUE 0x1C0FE8 Kw_Ws16 65535.00 OneToOne -32768.00 32767.00 FORMAT "%8.2" /end CHARACTERISTIC
/begin CHARACTERISTIC Sig_aDSMScale_C "Skalierung Umrechungs Faktor SG->DSM fuer Beschleunigung" VALUE 0x1C0FEA Kw_Wu16 6.553500 FactHigh 0.00 6.553500 FORMAT "%8.6" /end CHARACTERISTIC
/begin CHARACTERISTIC Sig_Byte2DSMOffset_C "Offset für Umrechnung SG -> DSM für Byte 2" VALUE 0x1C0FF4 Kw_Ws16 65535.00 OneToOne -32768.00 32767.00 FORMAT "%8.2" /end CHARACTERISTIC
/begin CHARACTERISTIC Sig_Byte2DSMScale_C "Skalierung für Umrechnung SG -> DSM für Byte 2" VALUE 0x1C0FF6 Kw_Wu16 6.553500 FactHigh 0.00 6.553500 FORMAT "%8.6" /end CHARACTERISTIC
/begin CHARACTERISTIC Sig_Byte3DSMOffset_C "Offset für Umrechnung SG -> DSM für Byte 3" VALUE 0x1C1000 Kw_Ws16 65535.00 OneToOne -32768.00 32767.00 FORMAT "%8.2" /end CHARACTERISTIC
/begin CHARACTERISTIC Sig_Byte3DSMScale_C "Skalierung für Umrechnung SG -> DSM für  Byte 3" VALUE 0x1C1002 Kw_Wu16 6.553500 FactHigh 0.00 6.553500 FORMAT "%8.6" /end CHARACTERISTIC
/begin CHARACTERISTIC Sig_Carb_drDSMOffset_C "Offset für die Konvertierung von ECU auf DSM der Lambda-Ratio Differenz" VALUE 0x1C100C Kw_Ws16 65535.00 OneToOne -32768.00 32767.00 FORMAT "%8.2" /end CHARACTERISTIC
/begin CHARACTERISTIC Sig_Carb_drDSMScale_C "Scale für die Konvertierung von ECU auf DSM der Lambda-Ratio Differenz" VALUE 0x1C100E Kw_Wu16 7.999878 Fact 0.00 7.999878 FORMAT "%8.6" /end CHARACTERISTIC
/begin CHARACTERISTIC Sig_Carb_lrDSMOffset_C "Offset für die Konvertierung von ECU auf DSM des Lambda-Ratio" VALUE 0x1C1018 Kw_Ws16 65535.00 OneToOne -32768.00 32767.00 FORMAT "%8.2" /end CHARACTERISTIC
/begin CHARACTERISTIC Sig_Carb_lrDSMScale_C "Scale für die Konvertierung von ECU auf DSM des Lambda-Ratio" VALUE 0x1C101A Kw_Wu16 7.999878 Fact 0.00 7.999878 FORMAT "%8.6" /end CHARACTERISTIC
/begin CHARACTERISTIC Sig_Carb_lDSMOffset_C "Signals Offset für Umrechung  Fahrstrecke Intern nach DSM mit CARB Normierung" VALUE 0x1C1024 Kw_Ws16 65535.00 OneToOne -32768.00 32767.00 FORMAT "%8.2" /end CHARACTERISTIC
/begin CHARACTERISTIC Sig_Carb_lDSMScale_C "Signals Skalierungsfaktor für Umrechung  Fahrstrecke Intern nach DSM mit CARB Normierung" VALUE 0x1C1026 Kw_Wu16 7.999878 Fact 0.00 7.999878 FORMAT "%8.6" /end CHARACTERISTIC
/begin CHARACTERISTIC Sig_Carb_mAirTimDSMOffset_C "Offset fuer Umrechung SG->DSM fuer Luftmasse pro Zeit (OBD)" VALUE 0x1C1030 Kw_Ws16 65535.00 OneToOne -32768.00 32767.00 FORMAT "%8.2" /end CHARACTERISTIC
/begin CHARACTERISTIC Sig_Carb_mAirTimDSMScale_C "Skalierung Umrechungs Faktor SG->DSM fuer Luftmasse pro Zeit (OBD)" VALUE 0x1C1032 Kw_Wu16 7.999878 Fact 0.00 7.999878 FORMAT "%8.6" /end CHARACTERISTIC
/begin CHARACTERISTIC Sig_Carb_nDSMOffset_C "Offset fuer Umrechung SG->DSM fuer Drehzahl (OBD)" VALUE 0x1C103C Kw_Ws16 65535.00 OneToOne -32768.00 32767.00 FORMAT "%8.2" /end CHARACTERISTIC
/begin CHARACTERISTIC Sig_Carb_nDSMScale_C "Skalierung Umrechungs Faktor SG->DSM fuer Drehzahl (OBD)" VALUE 0x1C103E Kw_Wu16 7.999878 Fact 0.00 7.999878 FORMAT "%8.6" /end CHARACTERISTIC
/begin CHARACTERISTIC Sig_Carb_pDSMOffset_C "Offset fuer Umrechung SG->DSM fuer Druck (OBD)" VALUE 0x1C1048 Kw_Ws16 65535.00 OneToOne -32768.00 32767.00 FORMAT "%8.2" /end CHARACTERISTIC
/begin CHARACTERISTIC Sig_Carb_pDSMScale_C "Skalierung Umrechungs Faktor SG->DSM fuer Druck (OBD)" VALUE 0x1C104A Kw_Wu16 7.999878 Fact 0.00 7.999878 FORMAT "%8.6" /end CHARACTERISTIC
/begin CHARACTERISTIC Sig_Carb_rNegDSMOffset_C "Offset fuer Umrechung SG->DSM fuer Verhältnis (OBD)" VALUE 0x1C1054 Kw_Ws16 65535.00 OneToOne -32768.00 32767.00 FORMAT "%8.2" /end CHARACTERISTIC
/begin CHARACTERISTIC Sig_Carb_rNegDSMScale_C "Skalierungsfaktor fuer Umrechung SG->DSM fuer Verhältnis (OBD)" VALUE 0x1C1056 Kw_Wu16 7.999878 Fact 0.00 7.999878 FORMAT "%8.6" /end CHARACTERISTIC
/begin CHARACTERISTIC Sig_Carb_rDSMOffset_C "Offset fuer Umrechung SG->DSM fuer Verhältnis (OBD)" VALUE 0x1C1060 Kw_Ws16 65535.00 OneToOne -32768.00 32767.00 FORMAT "%8.2" /end CHARACTERISTIC
/begin CHARACTERISTIC Sig_Carb_rDSMScale_C "Skalierung Umrechungs Faktor SG->DSM fuer Verhältnis (OBD)" VALUE 0x1C1062 Kw_Wu16 7.999878 Fact 0.00 7.999878 FORMAT "%8.6" /end CHARACTERISTIC
/begin CHARACTERISTIC Sig_Carb_tHighM1DSMOffset_C "Offset für Umrechung SG->DSM für Temperatur mit hoher Auflösung(OBD Mode1)" VALUE 0x1C106C Kw_Ws16 65535.00 OneToOne -32768.00 32767.00 FORMAT "%8.2" /end CHARACTERISTIC
/begin CHARACTERISTIC Sig_Carb_tHighM1DSMScale_C "Skalierung für Umrechung SG->DSM für Temperatur mit hoher Auflösung(OBD Mode1)" VALUE 0x1C106E Kw_Wu16 7.999878 Fact 0.00 7.999878 FORMAT "%8.6" /end CHARACTERISTIC
/begin CHARACTERISTIC Sig_Carb_tDSMOffset_C "Offset fuer Umrechung SG->DSM fuer Temperatur (OBD)" VALUE 0x1C1078 Kw_Ws16 65535.00 OneToOne -32768.00 32767.00 FORMAT "%8.2" /end CHARACTERISTIC
/begin CHARACTERISTIC Sig_Carb_tDSMScale_C "Skalierung Umrechungs Faktor SG->DSM fuer Temperatur (OBD)" VALUE 0x1C107A Kw_Wu16 7.999878 Fact 0.00 7.999878 FORMAT "%8.6" /end CHARACTERISTIC
/begin CHARACTERISTIC Sig_Carb_uBattDSMOffset_C "Offset fuer Umrechung SG->DSM fuer Batteriespannung (OBD)" VALUE 0x1C1084 Kw_Ws16 65535.00 OneToOne -32768.00 32767.00 FORMAT "%8.2" /end CHARACTERISTIC
/begin CHARACTERISTIC Sig_Carb_uBattDSMScale_C "Skalierung Umrechungs Faktor SG->DSM fuer Batteriespannung (OBD)" VALUE 0x1C1086 Kw_Wu16 63.99902 FactLow 0.00 63.99902 FORMAT "%8.5" /end CHARACTERISTIC
/begin CHARACTERISTIC Sig_Carb_uDSMOffset_C "Offset für Umrechnung SG -> DSM für Spannung (OBD)" VALUE 0x1C1090 Kw_Ws16 65535.00 OneToOne -32768.00 32767.00 FORMAT "%8.2" /end CHARACTERISTIC
/begin CHARACTERISTIC Sig_Carb_uDSMScale_C "Skalierung Umrechnungsfaktor SG -> DSM für Spannung (OBD)" VALUE 0x1C1092 Kw_Wu16 63.99902 FactLow 0.00 63.99902 FORMAT "%8.5" /end CHARACTERISTIC
/begin CHARACTERISTIC Sig_Carb_vDSMOffset_C "Offset fuer Umrechung SG->DSM fuer Geschwindigkeit (OBD)" VALUE 0x1C109C Kw_Ws16 65535.00 OneToOne -32768.00 32767.00 FORMAT "%8.2" /end CHARACTERISTIC
/begin CHARACTERISTIC Sig_Carb_vDSMScale_C "Skalierung Umrechungs Faktor SG->DSM fuer Geschwindigkeit (OBD)" VALUE 0x1C109E Kw_Wu16 7.999878 Fact 0.00 7.999878 FORMAT "%8.6" /end CHARACTERISTIC
/begin CHARACTERISTIC Sig_CnsmpDSMOffset_C "Offset für Umrechnung SG -> DSM für Verbrauch" VALUE 0x1C10A8 Kw_Ws16 65535.00 OneToOne -32768.00 32767.00 FORMAT "%8.2" /end CHARACTERISTIC
/begin CHARACTERISTIC Sig_CnsmpDSMScale_C "Skalierung für Umrechnung SG -> DSM für Verbrauch" VALUE 0x1C10AA Kw_Wu16 6.553500 FactHigh 0.00 6.553500 FORMAT "%8.6" /end CHARACTERISTIC
/begin CHARACTERISTIC Sig_dcycNeghighresDSMOffset_C "Offset Umrechnung SG->DSM für neg. Verhältnisse mit hoher Auflösung" VALUE 0x1C10C0 Kw_Ws16 65535.00 OneToOne -32768.00 32767.00 FORMAT "%8.2" /end CHARACTERISTIC
/begin CHARACTERISTIC Sig_dcycNeghighresDSMScale_C "Skalierung Umrechnung SG->DSM für neg. Verhältnisse mit hoher Auflösung" VALUE 0x1C10C2 Kw_Wu16 6.553500 FactHigh 0.00 6.553500 FORMAT "%8.6" /end CHARACTERISTIC
/begin CHARACTERISTIC Sig_dcycNegDSMOffset_C "Offset Umrechung SG->DSM für neg. Verhältnisse" VALUE 0x1C10CC Kw_Ws16 65535.00 OneToOne -32768.00 32767.00 FORMAT "%8.2" /end CHARACTERISTIC
/begin CHARACTERISTIC Sig_dcycNegDSMScale_C "Skalierung Umrechung SG->DSM für neg. Verhältnisse" VALUE 0x1C10CE Kw_Wu16 6.553500 FactHigh 0.00 6.553500 FORMAT "%8.6" /end CHARACTERISTIC
/begin CHARACTERISTIC Sig_dcycDSMOffset_C "Offset Umrechung SG->DSM für Tastverhältnisse" VALUE 0x1C10D8 Kw_Ws16 65535.00 OneToOne -32768.00 32767.00 FORMAT "%8.2" /end CHARACTERISTIC
/begin CHARACTERISTIC Sig_dcycDSMScale_C "Skalierung Umrechung SG->DSM für Tastverhältnisse" VALUE 0x1C10DA Kw_Wu16 6.553500 FactHigh 0.00 6.553500 FORMAT "%8.6" /end CHARACTERISTIC
/begin CHARACTERISTIC Sig_dmASMODDSMOffset_C "Offset fuer ASMOD Luftmassen Umrechung SG -> DSM" VALUE 0x1C13DA Kw_Ws16 65535.00 OneToOne -32768.00 32767.00 FORMAT "%8.2" /end CHARACTERISTIC
/begin CHARACTERISTIC Sig_dmASMODDSMScale_C "Skalierung fuer ASMOD Luftmassen Umrechung SG -> DSM" VALUE 0x1C13DC Kw_Wu16 6.553500 FactHigh 0.00 6.553500 FORMAT "%8.6" /end CHARACTERISTIC
/begin CHARACTERISTIC Sig_dqDSMOffset_C "Umrechnung fuer Additionsfaktor: dsm offset" VALUE 0x1C13E6 Kw_Ws16 65535.00 OneToOne -32768.00 32767.00 FORMAT "%8.2" /end CHARACTERISTIC
/begin CHARACTERISTIC Sig_dqDSMScale_C "Umrechnung fuer Additionsfaktor: dsm scale" VALUE 0x1C13E8 Kw_Wu16 6.553500 FactHigh 0.00 6.553500 FORMAT "%8.6" /end CHARACTERISTIC
/begin CHARACTERISTIC Sig_dvolDSMOffset_C "Umrechnung Volumenstrom: dsm offset" VALUE 0x1C10E4 Kw_Ws16 65535.00 OneToOne -32768.00 32767.00 FORMAT "%8.2" /end CHARACTERISTIC
/begin CHARACTERISTIC Sig_dvolDSMScale_C "Umrechnung Volumenstrom: dsm scale" VALUE 0x1C10E6 Kw_Wu16 6.553500 FactHigh 0.00 6.553500 FORMAT "%8.6" /end CHARACTERISTIC
/begin CHARACTERISTIC Sig_facArrhDSMOffset_C "Offset für Umrechnung ecu -> dsm" VALUE 0x1C13F2 Kw_Ws16 65535.00 OneToOne -32768.00 32767.00 FORMAT "%8.2" /end CHARACTERISTIC
/begin CHARACTERISTIC Sig_facArrhDSMScale_C "Skalierung Umrechung SG->DSM" VALUE 0x1C13F4 Kw_Wu16 6.553500 FactHigh 0.00 6.553500 FORMAT "%8.6" /end CHARACTERISTIC
/begin CHARACTERISTIC Sig_facArrhCANOffset_C "Offset für Umrechnung ecu -> can" VALUE 0x1C13F6 Kw_Ws16 65535.00 OneToOne -32768.00 32767.00 FORMAT "%8.2" /end CHARACTERISTIC
/begin CHARACTERISTIC Sig_facArrhCANScale_C "Skalierung Umrechung SG->CAN" VALUE 0x1C13F8 Kw_Wu16 6.553500 FactHigh 0.00 6.553500 FORMAT "%8.6" /end CHARACTERISTIC
/begin CHARACTERISTIC Sig_facArrhDIAOffset_C "Offset für Umrechnung ecu -> dia" VALUE 0x1C13FA Kw_Ws16 65535.00 OneToOne -32768.00 32767.00 FORMAT "%8.2" /end CHARACTERISTIC
/begin CHARACTERISTIC Sig_facArrhDIAScale_C "Skalierung Umrechung SG->DIA" VALUE 0x1C13FC Kw_Wu16 6.553500 FactHigh 0.00 6.553500 FORMAT "%8.6" /end CHARACTERISTIC
/begin CHARACTERISTIC Sig_FactDSMOffset_C "Offset Umrechnungsfaktor SG -> DSM fuer Faktoren" VALUE 0x1C10FC Kw_Ws16 65535.00 OneToOne -32768.00 32767.00 FORMAT "%8.2" /end CHARACTERISTIC
/begin CHARACTERISTIC Sig_FactDSMScale_C "Skalierung Umrechnungsfaktor SG -> DSM fuer Faktoren" VALUE 0x1C10FE Kw_Wu16 6.553500 FactHigh 0.00 6.553500 FORMAT "%8.6" /end CHARACTERISTIC
/begin CHARACTERISTIC Sig_fas1DSMOffset_C "Offset fuer Umrechung SG->DSM fuer ein frei applizierbares Signal" VALUE 0x1C1108 Kw_Ws16 65535.00 OneToOne -32768.00 32767.00 FORMAT "%8.2" /end CHARACTERISTIC
/begin CHARACTERISTIC Sig_fas1DSMScale_C "Skalierung Umrechungs Faktor SG->DSM fuer ein frei applizierbares Signal" VALUE 0x1C110A Kw_Wu16 6.553500 FactHigh 0.00 6.553500 FORMAT "%8.6" /end CHARACTERISTIC
/begin CHARACTERISTIC Sig_fas1CANOffset_C "Offset fuer Umrechung SG->CAN fuer ein frei applizierbares Signal" VALUE 0x1C110C Kw_Ws16 65535.00 OneToOne -32768.00 32767.00 FORMAT "%8.2" /end CHARACTERISTIC
/begin CHARACTERISTIC Sig_fas1CANScale_C "Skalierung Umrechungs Faktor SG->CAN fuer ein frei applizierbares Signal" VALUE 0x1C110E Kw_Wu16 6.553500 FactHigh 0.00 6.553500 FORMAT "%8.6" /end CHARACTERISTIC
/begin CHARACTERISTIC Sig_fas1DIAOffset_C "Offset fuer Umrechung SG->DIA fuer ein frei applizierbares Signal" VALUE 0x1C1110 Kw_Ws16 65535.00 OneToOne -32768.00 32767.00 FORMAT "%8.2" /end CHARACTERISTIC
/begin CHARACTERISTIC Sig_fas1DIAScale_C "Skalierung Umrechungs Faktor SG->DIA fuer ein frei applizierbares Signal" VALUE 0x1C1112 Kw_Wu16 6.553500 FactHigh 0.00 6.553500 FORMAT "%8.6" /end CHARACTERISTIC
/begin CHARACTERISTIC Sig_fas2DSMOffset_C "Offset fuer Umrechung SG->DSM fuer ein frei applizierbares Signal" VALUE 0x1C1114 Kw_Ws16 65535.00 OneToOne -32768.00 32767.00 FORMAT "%8.2" /end CHARACTERISTIC
/begin CHARACTERISTIC Sig_fas2DSMScale_C "Skalierung Umrechungs Faktor SG->DSM fuer ein frei applizierbares Signal" VALUE 0x1C1116 Kw_Wu16 6.553500 FactHigh 0.00 6.553500 FORMAT "%8.6" /end CHARACTERISTIC
/begin CHARACTERISTIC Sig_fas2CANOffset_C "Offset fuer Umrechung SG->CAN fuer ein frei applizierbares Signal" VALUE 0x1C1118 Kw_Ws16 65535.00 OneToOne -32768.00 32767.00 FORMAT "%8.2" /end CHARACTERISTIC
/begin CHARACTERISTIC Sig_fas2CANScale_C "Skalierung Umrechungs Faktor SG->CAN fuer ein frei applizierbares Signal" VALUE 0x1C111A Kw_Wu16 6.553500 FactHigh 0.00 6.553500 FORMAT "%8.6" /end CHARACTERISTIC
/begin CHARACTERISTIC Sig_fas2DIAOffset_C "Offset fuer Umrechung SG->DIA fuer ein frei applizierbares Signal" VALUE 0x1C111C Kw_Ws16 65535.00 OneToOne -32768.00 32767.00 FORMAT "%8.2" /end CHARACTERISTIC
/begin CHARACTERISTIC Sig_fas2DIAScale_C "Skalierung Umrechungs Faktor SG->DIA fuer ein frei applizierbares Signal" VALUE 0x1C111E Kw_Wu16 6.553500 FactHigh 0.00 6.553500 FORMAT "%8.6" /end CHARACTERISTIC
/begin CHARACTERISTIC Sig_fas3DSMOffset_C "Offset fuer Umrechung SG->DSM fuer ein frei applizierbares Signal" VALUE 0x1C1120 Kw_Ws16 65535.00 OneToOne -32768.00 32767.00 FORMAT "%8.2" /end CHARACTERISTIC
/begin CHARACTERISTIC Sig_fas3DSMScale_C "Skalierung Umrechungs Faktor SG->DSM fuer ein frei applizierbares Signal" VALUE 0x1C1122 Kw_Wu16 6.553500 FactHigh 0.00 6.553500 FORMAT "%8.6" /end CHARACTERISTIC
/begin CHARACTERISTIC Sig_fas3CANOffset_C "Offset fuer Umrechung SG->CAN fuer ein frei applizierbares Signal" VALUE 0x1C1124 Kw_Ws16 65535.00 OneToOne -32768.00 32767.00 FORMAT "%8.2" /end CHARACTERISTIC
/begin CHARACTERISTIC Sig_fas3CANScale_C "Skalierung Umrechungs Faktor SG->CAN fuer ein frei applizierbares Signal" VALUE 0x1C1126 Kw_Wu16 6.553500 FactHigh 0.00 6.553500 FORMAT "%8.6" /end CHARACTERISTIC
/begin CHARACTERISTIC Sig_fas3DIAOffset_C "Offset fuer Umrechung SG->DIA fuer ein frei applizierbares Signal" VALUE 0x1C1128 Kw_Ws16 65535.00 OneToOne -32768.00 32767.00 FORMAT "%8.2" /end CHARACTERISTIC
/begin CHARACTERISTIC Sig_fas3DIAScale_C "Skalierung Umrechungs Faktor SG->DIA fuer ein frei applizierbares Signal" VALUE 0x1C112A Kw_Wu16 6.553500 FactHigh 0.00 6.553500 FORMAT "%8.6" /end CHARACTERISTIC
/begin CHARACTERISTIC Sig_fas4DSMOffset_C "Offset Umrechnung SG -> DSM für frei applizierbares Signal" VALUE 0x1C112C Kw_Ws16 65535.00 OneToOne -32768.00 32767.00 FORMAT "%8.2" /end CHARACTERISTIC
/begin CHARACTERISTIC Sig_fas4DSMScale_C "Skalierung Umrechnung Faktor SG -> DSM für frei applizierbares Signal" VALUE 0x1C112E Kw_Wu16 6.553500 FactHigh 0.00 6.553500 FORMAT "%8.6" /end CHARACTERISTIC
/begin CHARACTERISTIC Sig_HighByteDSMOffset_C "Offset für Umrechnung SG -> DSM für High Byte" VALUE 0x1C1138 Kw_Ws16 65535.00 OneToOne -32768.00 32767.00 FORMAT "%8.2" /end CHARACTERISTIC
/begin CHARACTERISTIC Sig_HighByteDSMScale_C "Skalierung für Umrechnung SG -> DSM für High Byte" VALUE 0x1C113A Kw_Wu16 6.553500 FactHigh 0.00 6.553500 FORMAT "%8.6" /end CHARACTERISTIC
/begin CHARACTERISTIC Sig_lLvl2DSMOffset_C "Offset Umrechung SG -> DSM für kleine Längenwerte (z.B. Ölniveau)" VALUE 0x1C1144 Kw_Ws16 65535.00 OneToOne -32768.00 32767.00 FORMAT "%8.2" /end CHARACTERISTIC
/begin CHARACTERISTIC Sig_lLvl2DSMScale_C "Skalierung Umrechung SG -> DSM für kleine Längenwerte (z.B. Ölniveau)" VALUE 0x1C1146 Kw_Wu16 6.553500 FactHigh 0.00 6.553500 FORMAT "%8.6" /end CHARACTERISTIC
/begin CHARACTERISTIC Sig_lLvlDSMOffset_C "Offset Umrechung SG -> DSM für kleine Längenwerte (z.B. Ölniveau)" VALUE 0x1C1150 Kw_Ws16 65535.00 OneToOne -32768.00 32767.00 FORMAT "%8.2" /end CHARACTERISTIC
/begin CHARACTERISTIC Sig_lLvlDSMScale_C "Skalierung Umrechung SG -> DSM für kleine Längenwerte (z.B. Ölniveau)" VALUE 0x1C1152 Kw_Wu16 6.553500 FactHigh 0.00 6.553500 FORMAT "%8.6" /end CHARACTERISTIC
/begin CHARACTERISTIC Sig_LowByteDSMOffset_C "Offset für Umrechnung SG -> DSM für Low Byte" VALUE 0x1C115C Kw_Ws16 65535.00 OneToOne -32768.00 32767.00 FORMAT "%8.2" /end CHARACTERISTIC
/begin CHARACTERISTIC Sig_LowByteDSMScale_C "Skalierung für Umrechnung SG -> DSM für Low Byte" VALUE 0x1C115E Kw_Wu16 6.553500 FactHigh 0.00 6.553500 FORMAT "%8.6" /end CHARACTERISTIC
/begin CHARACTERISTIC Sig_lDSMOffset_C "Offset Umrechnung SG -> DSM" VALUE 0x1C1168 Kw_Ws16 65535.00 OneToOne -32768.00 32767.00 FORMAT "%8.2" /end CHARACTERISTIC
/begin CHARACTERISTIC Sig_lDSMScale_C "Skalierung Umrechnung SG -> DSM" VALUE 0x1C116A Kw_Wu16 6.553500 FactHigh 0.00 6.553500 FORMAT "%8.6" /end CHARACTERISTIC
/begin CHARACTERISTIC Sig_mAirCylGovDSMOffset_C "Offset für Umrechung SG -> DSM für Luftmasse pro Zylinder für Regelabweichung" VALUE 0x1C1174 Kw_Ws16 65535.00 OneToOne -32768.00 32767.00 FORMAT "%8.2" /end CHARACTERISTIC
/begin CHARACTERISTIC Sig_mAirCylGovDSMScale_C "Skalierung für Umrechung SG -> DSM für Luftmasse pro Zylinder für Regelabweichung" VALUE 0x1C1176 Kw_Wu16 6.553500 FactHigh 0.00 6.553500 FORMAT "%8.6" /end CHARACTERISTIC
/begin CHARACTERISTIC Sig_mAirCylDSMOffset_C "Offset Umrechung SG->DSM für Luftmasse pro Zylinder" VALUE 0x1C1180 Kw_Ws16 65535.00 OneToOne -32768.00 32767.00 FORMAT "%8.2" /end CHARACTERISTIC
/begin CHARACTERISTIC Sig_mAirCylDSMScale_C "Skalierung Umrechung SG->DSM für Luftmasse pro Zylinder" VALUE 0x1C1182 Kw_Wu16 6.553500 FactHigh 0.00 6.553500 FORMAT "%8.6" /end CHARACTERISTIC
/begin CHARACTERISTIC Sig_mAirTimDSMOffset_C "Offset Umrechung SG->DSM für Luftmasse pro Zeiteinheit" VALUE 0x1C118C Kw_Ws16 65535.00 OneToOne -32768.00 32767.00 FORMAT "%8.2" /end CHARACTERISTIC
/begin CHARACTERISTIC Sig_mAirTimDSMScale_C "Skalierung Umrechung SG->DSM für Luftmasse pro Zeiteinheit" VALUE 0x1C118E Kw_Wu16 6.553500 FactHigh 0.00 6.553500 FORMAT "%8.6" /end CHARACTERISTIC
/begin CHARACTERISTIC Sig_mAirDSMOffset_C "Offset Umrechung SG->DSM für Luftmasse" VALUE 0x1C1198 Kw_Ws16 65535.00 OneToOne -32768.00 32767.00 FORMAT "%8.2" /end CHARACTERISTIC
/begin CHARACTERISTIC Sig_mAirDSMScale_C "Skalierung Umrechung SG->DSM für Luftmasse" VALUE 0x1C119A Kw_Wu16 6.553500 FactHigh 0.00 6.553500 FORMAT "%8.6" /end CHARACTERISTIC
/begin CHARACTERISTIC Sig_mAshDSMOffset_C "Offset Umrechung SG->DSM" VALUE 0x1C11A4 Kw_Ws16 65535.00 OneToOne -32768.00 32767.00 FORMAT "%8.2" /end CHARACTERISTIC
/begin CHARACTERISTIC Sig_mAshDSMScale_C "Skalierung Umrechung SG->DSM" VALUE 0x1C11A6 Kw_Wu16 6.553500 FactHigh 0.00 6.553500 FORMAT "%8.6" /end CHARACTERISTIC
/begin CHARACTERISTIC Sig_MLperLDSMOffset_C "Offset Umrechnung SG->DSM für ml/l" VALUE 0x1C11B0 Kw_Ws16 65535.00 OneToOne -32768.00 32767.00 FORMAT "%8.2" /end CHARACTERISTIC
/begin CHARACTERISTIC Sig_MLperLDSMScale_C "Skalierung Umrechnung SG->DSM für ml/l" VALUE 0x1C11B2 Kw_Wu16 6.553500 FactHigh 0.00 6.553500 FORMAT "%8.6" /end CHARACTERISTIC
/begin CHARACTERISTIC Sig_mSotDSMOffset_C "Offset für die Umrechnung ecu -> dsm" VALUE 0x1C13FE Kw_Ws16 65535.00 OneToOne -32768.00 32767.00 FORMAT "%8.2" /end CHARACTERISTIC
/begin CHARACTERISTIC Sig_mSotDSMScale_C "Skala für die Umrechnung ecu -> dsm" VALUE 0x1C1400 Kw_Wu16 6.553500 FactHigh 0.00 6.553500 FORMAT "%8.6" /end CHARACTERISTIC
/begin CHARACTERISTIC Sig_mDSMScale_C "Skalierung Umrechung SG->DSM" VALUE 0x1C11BE Kw_Wu16 6.553500 FactHigh 0.00 6.553500 FORMAT "%8.6" /end CHARACTERISTIC
/begin CHARACTERISTIC Sig_nASMODDSMOffset_C "Offset fuer ASMOD Drehzahl Umrechung SG -> DSM" VALUE 0x1C140A Kw_Ws16 65535.00 OneToOne -32768.00 32767.00 FORMAT "%8.2" /end CHARACTERISTIC
/begin CHARACTERISTIC Sig_nASMODDSMScale_C "Skalierung fuer ASMOD Drehzahl Umrechung SG -> DSM" VALUE 0x1C140C Kw_Wu16 6.553500 FactHigh 0.00 6.553500 FORMAT "%8.6" /end CHARACTERISTIC
/begin CHARACTERISTIC Sig_nCmpTstDSMOffset_C "Offset Umrechung SG -> DSM für Drehzahlsignale für Kompressionstest" VALUE 0x1C11C8 Kw_Ws16 65535.00 OneToOne -32768.00 32767.00 FORMAT "%8.2" /end CHARACTERISTIC
/begin CHARACTERISTIC Sig_nCmpTstDSMScale_C "Skalierung Umrechung SG -> DSM für Drehzahlsignale für Kompressionstest" VALUE 0x1C11CA Kw_Wu16 6.553500 FactHigh 0.00 6.553500 FORMAT "%8.6" /end CHARACTERISTIC
/begin CHARACTERISTIC Sig_NoUnitIIDSMOffset_C "Offset Umrechnung SG ->DSM" VALUE 0x1C11D4 Kw_Ws16 65535.00 OneToOne -32768.00 32767.00 FORMAT "%8.2" /end CHARACTERISTIC
/begin CHARACTERISTIC Sig_NoUnitIIDSMScale_C "Skalierung Umrechnung SG -> DSM" VALUE 0x1C11D6 Kw_Wu16 6.553500 FactHigh 0.00 6.553500 FORMAT "%8.6" /end CHARACTERISTIC
/begin CHARACTERISTIC Sig_NoUnitDSMOffset_C "Offset Umrechnung SG ->DSM" VALUE 0x1C11E0 Kw_Ws16 65535.00 OneToOne -32768.00 32767.00 FORMAT "%8.2" /end CHARACTERISTIC
/begin CHARACTERISTIC Sig_NoUnitDSMScale_C "Skalierung Umrechnung SG -> DSM" VALUE 0x1C11E2 Kw_Wu16 6.553500 FactHigh 0.00 6.553500 FORMAT "%8.6" /end CHARACTERISTIC
/begin CHARACTERISTIC Sig_nDSMOffset_C "Offset Umrechung SG->DSM für Drehzahlsignale" VALUE 0x1C11EC Kw_Ws16 65535.00 OneToOne -32768.00 32767.00 FORMAT "%8.2" /end CHARACTERISTIC
/begin CHARACTERISTIC Sig_nDSMScale_C "Skalierung Umrechung SG->DSM für Drehzahlsignale" VALUE 0x1C11EE Kw_Wu16 6.553500 FactHigh 0.00 6.553500 FORMAT "%8.6" /end CHARACTERISTIC
/begin CHARACTERISTIC Sig_O2diffDSMOffset_C "Offset für Umrechnung SG -> DSM fuer O2" VALUE 0x1C11F8 Kw_Ws16 65535.00 OneToOne -32768.00 32767.00 FORMAT "%8.2" /end CHARACTERISTIC
/begin CHARACTERISTIC Sig_O2diffDSMScale_C "Skalierung Umrechung SG->DSM fuer O2" VALUE 0x1C11FA Kw_Wu16 6.553500 FactHigh 0.00 6.553500 FORMAT "%8.6" /end CHARACTERISTIC
/begin CHARACTERISTIC Sig_OneToOneDSMOffset_C "Offset Umrechung SG->DSM" VALUE 0x1C1204 Kw_Ws16 65535.00 OneToOne -32768.00 32767.00 FORMAT "%8.2" /end CHARACTERISTIC
/begin CHARACTERISTIC Sig_OneToOneDSMScale_C "Skalierung Umrechung SG->DSM" VALUE 0x1C1206 Kw_Wu16 6.553500 FactHigh 0.00 6.553500 FORMAT "%8.6" /end CHARACTERISTIC
/begin CHARACTERISTIC Sig_OnOffDSMOffset_C "Offset Umrechung SG->DSM für Digitalsignale" VALUE 0x1C1210 Kw_Ws16 65535.00 OneToOne -32768.00 32767.00 FORMAT "%8.2" /end CHARACTERISTIC
/begin CHARACTERISTIC Sig_OnOffDSMScale_C "Skalierung Umrechung SG->DSM für Digitalsignale" VALUE 0x1C1212 Kw_Wu16 6.553500 FactHigh 0.00 6.553500 FORMAT "%8.6" /end CHARACTERISTIC
/begin CHARACTERISTIC Sig_pACDSMOffset_C "Offset für Klimadruck Umrechnung für Fehlerspeicher" VALUE 0x1C121C Kw_Ws16 65535.00 OneToOne -32768.00 32767.00 FORMAT "%8.2" /end CHARACTERISTIC
/begin CHARACTERISTIC Sig_pACDSMScale_C "Steigung für Umrechnung des Klimadrucks für Fehlerspeicher" VALUE 0x1C121E Kw_Wu16 6.553500 FactHigh 0.00 6.553500 FORMAT "%8.6" /end CHARACTERISTIC
/begin CHARACTERISTIC Sig_pASMODDSMOffset_C "Offset fuer ASMOD Druck Umrechung SG -> DSM" VALUE 0x1C1416 Kw_Ws16 65535.00 OneToOne -32768.00 32767.00 FORMAT "%8.2" /end CHARACTERISTIC
/begin CHARACTERISTIC Sig_pASMODDSMScale_C "Skalierung fuer ASMOD Druck Umrechung SG -> DSM" VALUE 0x1C1418 Kw_Wu16 6.553500 FactHigh 0.00 6.553500 FORMAT "%8.6" /end CHARACTERISTIC
/begin CHARACTERISTIC Sig_pDiffDSMOffset_C "Umrechnung fuer ECU auf DSM: Offset für kleine Druckdifferenzen" VALUE 0x1C1228 Kw_Ws16 65535.00 OneToOne -32768.00 32767.00 FORMAT "%8.2" /end CHARACTERISTIC
/begin CHARACTERISTIC Sig_pDiffDSMScale_C "Umrechnung fuer ECU auf DSM: Faktor für kleine Druckdifferenzen" VALUE 0x1C122A Kw_Wu16 6.553500 FactHigh 0.00 6.553500 FORMAT "%8.6" /end CHARACTERISTIC
/begin CHARACTERISTIC Sig_pEgrDSMOffset_C "Offset für die Umrechnung ecu -> dsm für neg. Druck" VALUE 0x1C1234 Kw_Ws16 65535.00 OneToOne -32768.00 32767.00 FORMAT "%8.2" /end CHARACTERISTIC
/begin CHARACTERISTIC Sig_pEgrDSMScale_C "Scale für die Umrechnung ecu -> dsm für neg. Druck" VALUE 0x1C1236 Kw_Wu16 6.553500 FactHigh 0.00 6.553500 FORMAT "%8.6" /end CHARACTERISTIC
/begin CHARACTERISTIC Sig_phi2DSMOffset_C "Offset fuer Umrechung SG->DSM fuer Winkel" VALUE 0x1C1240 Kw_Ws16 65535.00 OneToOne -32768.00 32767.00 FORMAT "%8.2" /end CHARACTERISTIC
/begin CHARACTERISTIC Sig_phi2DSMScale_C "Offset fuer Umrechung SG->DSM fuer Winkel" VALUE 0x1C1242 Kw_Wu16 6.553500 FactHigh 0.00 6.553500 FORMAT "%8.6" /end CHARACTERISTIC
/begin CHARACTERISTIC Sig_phi2CANOffset_C "Offset fuer Umrechung SG->DSM fuer Winkel" VALUE 0x1C1244 Kw_Ws16 65535.00 OneToOne -32768.00 32767.00 FORMAT "%8.2" /end CHARACTERISTIC
/begin CHARACTERISTIC Sig_phi2CANScale_C "Offset fuer Umrechung SG->DSM fuer Winkel" VALUE 0x1C1246 Kw_Wu16 6.553500 FactHigh 0.00 6.553500 FORMAT "%8.6" /end CHARACTERISTIC
/begin CHARACTERISTIC Sig_phi2DIAOffset_C "Offset fuer Umrechung SG->DSM fuer Winkel" VALUE 0x1C1248 Kw_Ws16 65535.00 OneToOne -32768.00 32767.00 FORMAT "%8.2" /end CHARACTERISTIC
/begin CHARACTERISTIC Sig_phi2DIAScale_C "Offset fuer Umrechung SG->DSM fuer Winkel" VALUE 0x1C124A Kw_Wu16 6.553500 FactHigh 0.00 6.553500 FORMAT "%8.6" /end CHARACTERISTIC
/begin CHARACTERISTIC Sig_phiHResolDSMOffset_C "Offset für Umrechnung SG -> DSM für Winkel mit hoher Auflösung" VALUE 0x1C124C Kw_Ws16 65535.00 OneToOne -32768.00 32767.00 FORMAT "%8.2" /end CHARACTERISTIC
/begin CHARACTERISTIC Sig_phiHResolDSMScale_C "Skalierung für Umrechnung SG -> DSM für Winkel mit hoher Auflösung" VALUE 0x1C124E Kw_Wu16 6.553500 FactHigh 0.00 6.553500 FORMAT "%8.6" /end CHARACTERISTIC
/begin CHARACTERISTIC Sig_phiDSMOffset_C "Offset fuer Umrechung SG->DSM fuer Winkel" VALUE 0x1C1258 Kw_Ws16 65535.00 OneToOne -32768.00 32767.00 FORMAT "%8.2" /end CHARACTERISTIC
/begin CHARACTERISTIC Sig_phiDSMScale_C "Skalierung Umrechungs Faktor SG->DSM fuer Winkel" VALUE 0x1C125A Kw_Wu16 6.553500 FactHigh 0.00 6.553500 FORMAT "%8.6" /end CHARACTERISTIC
/begin CHARACTERISTIC Sig_pPFltDSMOffset_C "Offset für die Umrechnung ecu -> dsm für PFlt Druck" VALUE 0x1C1264 Kw_Ws16 65535.00 OneToOne -32768.00 32767.00 FORMAT "%8.2" /end CHARACTERISTIC
/begin CHARACTERISTIC Sig_pPFltDSMScale_C "Scale für die Umrechnung ecu -> dsm für PFlt Druck" VALUE 0x1C1266 Kw_Wu16 6.553500 FactHigh 0.00 6.553500 FORMAT "%8.6" /end CHARACTERISTIC
/begin CHARACTERISTIC Sig_pPFltCANOffset_C "Offset für die Umrechnung ecu -> can für PFlt Druck" VALUE 0x1C1268 Kw_Ws16 65535.00 OneToOne -32768.00 32767.00 FORMAT "%8.2" /end CHARACTERISTIC
/begin CHARACTERISTIC Sig_pPFltCANScale_C "Scale für die Umrechnung ecu -> can für PFlt Druck" VALUE 0x1C126A Kw_Wu16 6.553500 FactHigh 0.00 6.553500 FORMAT "%8.6" /end CHARACTERISTIC
/begin CHARACTERISTIC Sig_pPFltDIAOffset_C "Offset für die Umrechnung ecu -> dia für PFlt Druck" VALUE 0x1C126C Kw_Ws16 65535.00 OneToOne -32768.00 32767.00 FORMAT "%8.2" /end CHARACTERISTIC
/begin CHARACTERISTIC Sig_pPFltDIAScale_C "Scale für die Umrechnung ecu -> dia für PFlt Druck" VALUE 0x1C126E Kw_Wu16 6.553500 FactHigh 0.00 6.553500 FORMAT "%8.6" /end CHARACTERISTIC
/begin CHARACTERISTIC Sig_pwrDSMOffset_C "Offset Umrechung SG->DSM für Leistung" VALUE 0x1C1270 Kw_Ws16 65535.00 OneToOne -32768.00 32767.00 FORMAT "%8.2" /end CHARACTERISTIC
/begin CHARACTERISTIC Sig_pwrDSMScale_C "Skalierung Umrechung SG->DSM für Leistung" VALUE 0x1C1272 Kw_Wu16 6.553500 FactHigh 0.00 6.553500 FORMAT "%8.6" /end CHARACTERISTIC
/begin CHARACTERISTIC Sig_pDSMOffset_C "Offset Umrechung SG->DSM für Druck" VALUE 0x1C127C Kw_Ws16 65535.00 OneToOne -32768.00 32767.00 FORMAT "%8.2" /end CHARACTERISTIC
/begin CHARACTERISTIC Sig_pDSMScale_C "Skalierung Umrechung SG->DSM für Druck" VALUE 0x1C127E Kw_Wu16 6.553500 FactHigh 0.00 6.553500 FORMAT "%8.6" /end CHARACTERISTIC
/begin CHARACTERISTIC Sig_qdiffSysDSMOffset_C "Offset für Umrechnung SG -> DSM für Differenzmenge System" VALUE 0x1C1288 Kw_Ws16 65535.00 OneToOne -32768.00 32767.00 FORMAT "%8.2" /end CHARACTERISTIC
/begin CHARACTERISTIC Sig_qdiffSysDSMScale_C "Skalierung für Umrechnung SG -> DSM für Differenzmenge System" VALUE 0x1C128A Kw_Wu16 6.553500 FactHigh 0.00 6.553500 FORMAT "%8.6" /end CHARACTERISTIC
/begin CHARACTERISTIC Sig_qdiffDSMOffset_C "Offset für Umrechnung SG -> DSM für Differenzmenge" VALUE 0x1C1294 Kw_Ws16 65535.00 OneToOne -32768.00 32767.00 FORMAT "%8.2" /end CHARACTERISTIC
/begin CHARACTERISTIC Sig_qdiffDSMScale_C "Skalierung für Umrechnung SG -> DSM für Differenzmenge" VALUE 0x1C1296 Kw_Wu16 6.553500 FactHigh 0.00 6.553500 FORMAT "%8.6" /end CHARACTERISTIC
/begin CHARACTERISTIC Sig_qNegDSMOffset_C "Offset fuer Umrechung SG->DSM fuer Menge mit negativem Bereich" VALUE 0x1C12A0 Kw_Ws16 65535.00 OneToOne -32768.00 32767.00 FORMAT "%8.2" /end CHARACTERISTIC
/begin CHARACTERISTIC Sig_qNegDSMScale_C "Skalierungsfaktor fuer Umrechnung SG->DSM fuer Menge mit negativem Bereich" VALUE 0x1C12A2 Kw_Wu16 6.553500 FactHigh 0.00 6.553500 FORMAT "%8.6" /end CHARACTERISTIC
/begin CHARACTERISTIC Sig_qDSMOffset_C "Offset fuer Umrechung SG->DSM fuer Menge" VALUE 0x1C12AC Kw_Ws16 65535.00 OneToOne -32768.00 32767.00 FORMAT "%8.2" /end CHARACTERISTIC
/begin CHARACTERISTIC Sig_qDSMScale_C "Skalierung Umrechungs Faktor SG->DSM fuer Menge" VALUE 0x1C12AE Kw_Wu16 6.553500 FactHigh 0.00 6.553500 FORMAT "%8.6" /end CHARACTERISTIC
/begin CHARACTERISTIC Sig_ratioDSMOffset_C "Offset Umrechung SG->DSM für Verhältnisse 2" VALUE 0x1C12C4 Kw_Ws16 65535.00 OneToOne -32768.00 32767.00 FORMAT "%8.2" /end CHARACTERISTIC
/begin CHARACTERISTIC Sig_ratioDSMScale_C "Skalierung Umrechung SG->DSM für Verhältnisse 2" VALUE 0x1C12C6 Kw_Wu16 6.553500 FactHigh 0.00 6.553500 FORMAT "%8.6" /end CHARACTERISTIC
/begin CHARACTERISTIC Sig_resDSMOffset_C "Offset Umrechung SG->DSM für Widerstand" VALUE 0x1C12DC Kw_Ws16 65535.00 OneToOne -32768.00 32767.00 FORMAT "%8.2" /end CHARACTERISTIC
/begin CHARACTERISTIC Sig_resDSMScale_C "Skalierung Umrechung SG->DSM für Widerstand" VALUE 0x1C12DE Kw_Wu16 6.553500 FactHigh 0.00 6.553500 FORMAT "%8.6" /end CHARACTERISTIC
/begin CHARACTERISTIC Sig_rLmbdDSMOffset_C "Offset für die Umrechnung ecu -> dsm für Lambda Verhältnisse" VALUE 0x1C12E8 Kw_Ws16 65535.00 OneToOne -32768.00 32767.00 FORMAT "%8.2" /end CHARACTERISTIC
/begin CHARACTERISTIC Sig_rLmbdDSMScale_C "Scale für die Umrechnung ecu -> dsm für Lambda Verhältnisse" VALUE 0x1C12EA Kw_Wu16 6.553500 FactHigh 0.00 6.553500 FORMAT "%8.6" /end CHARACTERISTIC
/begin CHARACTERISTIC Sig_rLmbdCANOffset_C "Offset für die Umrechnung ecu -> can für Lambda Verhältnisse" VALUE 0x1C12EC Kw_Ws16 65535.00 OneToOne -32768.00 32767.00 FORMAT "%8.2" /end CHARACTERISTIC
/begin CHARACTERISTIC Sig_rLmbdCANScale_C "Scale für die Umrechnung ecu -> can für Lambda Verhältnisse" VALUE 0x1C12EE Kw_Wu16 6.553500 FactHigh 0.00 6.553500 FORMAT "%8.6" /end CHARACTERISTIC
/begin CHARACTERISTIC Sig_rLmbdDIAOffset_C "Offset für die Umrechnung ecu -> dia für Lambda Verhältnisse" VALUE 0x1C12F0 Kw_Ws16 65535.00 OneToOne -32768.00 32767.00 FORMAT "%8.2" /end CHARACTERISTIC
/begin CHARACTERISTIC Sig_rLmbdDIAScale_C "Scale für die Umrechnung ecu -> dia für Lambda Verhältnisse" VALUE 0x1C12F2 Kw_Wu16 6.553500 FactHigh 0.00 6.553500 FORMAT "%8.6" /end CHARACTERISTIC
/begin CHARACTERISTIC Sig_rNegDSMOffset_C "Offset Umrechung SG->DSM für neg. Verhältnisse" VALUE 0x1C12F4 Kw_Ws16 65535.00 OneToOne -32768.00 32767.00 FORMAT "%8.2" /end CHARACTERISTIC
/begin CHARACTERISTIC Sig_rNegDSMScale_C "Skalierung Umrechung SG->DSM für neg. Verhältnisse" VALUE 0x1C12F6 Kw_Wu16 6.553500 FactHigh 0.00 6.553500 FORMAT "%8.6" /end CHARACTERISTIC
/begin CHARACTERISTIC Sig_rDSMOffset_C "Offset Umrechung SG->DSM für Verhältnisse" VALUE 0x1C1300 Kw_Ws16 65535.00 OneToOne -32768.00 32767.00 FORMAT "%8.2" /end CHARACTERISTIC
/begin CHARACTERISTIC Sig_rDSMScale_C "Skalierung Umrechung SG->DSM für Verhältnisse" VALUE 0x1C1302 Kw_Wu16 6.553500 FactHigh 0.00 6.553500 FORMAT "%8.6" /end CHARACTERISTIC
/begin CHARACTERISTIC Sig_strokeDSMOffset_C "Offset Umrechnung der Pumpenhübe SG -> DSM" VALUE 0x1C130C Kw_Ws16 65535.00 OneToOne -32768.00 32767.00 FORMAT "%8.2" /end CHARACTERISTIC
/begin CHARACTERISTIC Sig_strokeDSMScale_C "Skalierung Umrechnung der Pumpenhübe SG -> DSM" VALUE 0x1C130E Kw_Wu16 6.553500 FactHigh 0.00 6.553500 FORMAT "%8.6" /end CHARACTERISTIC
/begin CHARACTERISTIC Sig_tASMODDSMOffset_C "Offset fuer ASMOD Temperatur Umrechung SG -> DSM" VALUE 0x1C1422 Kw_Ws16 65535.00 OneToOne -32768.00 32767.00 FORMAT "%8.2" /end CHARACTERISTIC
/begin CHARACTERISTIC Sig_tASMODDSMScale_C "Skalierung fuer ASMOD Temperatur Umrechung SG -> DSM" VALUE 0x1C1424 Kw_Wu16 6.553500 FactHigh 0.00 6.553500 FORMAT "%8.6" /end CHARACTERISTIC
/begin CHARACTERISTIC Sig_tExhaustDSMOffset_C "Offset Umrechnung SG->DSM" VALUE 0x1C1318 Kw_Ws16 65535.00 OneToOne -32768.00 32767.00 FORMAT "%8.2" /end CHARACTERISTIC
/begin CHARACTERISTIC Sig_tExhaustDSMScale_C "Skalierung Umrechnung SG->DSM" VALUE 0x1C131A Kw_Wu16 6.553500 FactHigh 0.00 6.553500 FORMAT "%8.6" /end CHARACTERISTIC
/begin CHARACTERISTIC Sig_tiGlwDSMOffset_C "Offset der Umrechnung SG -> DSM für Glühzeit" VALUE 0x1C1324 Kw_Ws16 65535.00 OneToOne -32768.00 32767.00 FORMAT "%8.2" /end CHARACTERISTIC
/begin CHARACTERISTIC Sig_tiGlwDSMScale_C "Skalierung der Umrechnung SG -> DSM für Glühzeit" VALUE 0x1C1326 Kw_Wu16 6.553500 FactHigh 0.00 6.553500 FORMAT "%8.6" /end CHARACTERISTIC
/begin CHARACTERISTIC Sig_tiHourDSMOffset_C "Offset Umrechnung SG->DSM" VALUE 0x1C1330 Kw_Ws16 65535.00 OneToOne -32768.00 32767.00 FORMAT "%8.2" /end CHARACTERISTIC
/begin CHARACTERISTIC Sig_tiHourDSMScale_C "Skalierung Umrechnung SG->DSM" VALUE 0x1C1332 Kw_Wu16 6.553500 FactHigh 0.00 6.553500 FORMAT "%8.6" /end CHARACTERISTIC
/begin CHARACTERISTIC Sig_tisecondDSMOffset_C "Offset Umrechnung SG->DSM" VALUE 0x1C133C Kw_Ws16 65535.00 OneToOne -32768.00 32767.00 FORMAT "%8.2" /end CHARACTERISTIC
/begin CHARACTERISTIC Sig_tisecondDSMScale_C "Skalierung Umrechnung SG->DSM" VALUE 0x1C133E Kw_Wu16 6.553500 FactHigh 0.00 6.553500 FORMAT "%8.6" /end CHARACTERISTIC
/begin CHARACTERISTIC Sig_tiusDSMOffset_C "Offset Umrechnung SG -> DSM für Zeit in us" VALUE 0x1C1348 Kw_Ws16 65535.00 OneToOne -32768.00 32767.00 FORMAT "%8.2" /end CHARACTERISTIC
/begin CHARACTERISTIC Sig_tiusDSMScale_C "Skalierung Umrechnung SG -> DSM für Zeit in us" VALUE 0x1C134A Kw_Wu16 6.553500 FactHigh 0.00 6.553500 FORMAT "%8.6" /end CHARACTERISTIC
/begin CHARACTERISTIC Sig_tiDSMOffset_C "Offset für Umrechnung SG -> DSM für Zeit" VALUE 0x1C1354 Kw_Ws16 65535.00 OneToOne -32768.00 32767.00 FORMAT "%8.2" /end CHARACTERISTIC
/begin CHARACTERISTIC Sig_tiDSMScale_C "Skalierung für Umrechnung SG -> DSM für Zeit" VALUE 0x1C1356 Kw_Wu16 6.553500 FactHigh 0.00 6.553500 FORMAT "%8.6" /end CHARACTERISTIC
/begin CHARACTERISTIC Sig_trqhighDSMOffset_C "Offset Umrechnung SG -> DSM für höhere Momente" VALUE 0x1C1360 Kw_Ws16 65535.00 OneToOne -32768.00 32767.00 FORMAT "%8.2" /end CHARACTERISTIC
/begin CHARACTERISTIC Sig_trqhighDSMScale_C "Skalierung Umrechnung SG -> DSM für höhere Momente" VALUE 0x1C1362 Kw_Wu16 6.553500 FactHigh 0.00 6.553500 FORMAT "%8.6" /end CHARACTERISTIC
/begin CHARACTERISTIC Sig_trqDSMOffset_C "Offset Umrechung SG->DSM für Drehmoment" VALUE 0x1C136C Kw_Ws16 65535.00 OneToOne -32768.00 32767.00 FORMAT "%8.2" /end CHARACTERISTIC
/begin CHARACTERISTIC Sig_trqDSMScale_C "Skalierung Umrechung SG->DSM für Drehmoment" VALUE 0x1C136E Kw_Wu16 6.553500 FactHigh 0.00 6.553500 FORMAT "%8.6" /end CHARACTERISTIC
/begin CHARACTERISTIC Sig_tDSMOffset_C "Offset Umrechung SG->DSM für Temperatur" VALUE 0x1C1378 Kw_Ws16 65535.00 OneToOne -32768.00 32767.00 FORMAT "%8.2" /end CHARACTERISTIC
/begin CHARACTERISTIC Sig_tDSMScale_C "Skalierung Umrechung SG->DSM für Temperatur" VALUE 0x1C137A Kw_Wu16 6.553500 FactHigh 0.00 6.553500 FORMAT "%8.6" /end CHARACTERISTIC
/begin CHARACTERISTIC Sig_uBattDSMOffset_C "Offset fuer Umrechung SG->DSM fuer Batteriespannung" VALUE 0x1C1384 Kw_Ws16 65535.00 OneToOne -32768.00 32767.00 FORMAT "%8.2" /end CHARACTERISTIC
/begin CHARACTERISTIC Sig_uBattDSMScale_C "Skalierung Umrechungs Faktor SG->DSM fuer Batteriespannung" VALUE 0x1C1386 Kw_Wu16 6.553500 FactHigh 0.00 6.553500 FORMAT "%8.6" /end CHARACTERISTIC
/begin CHARACTERISTIC Sig_uDSMOffset_C "Offset Umrechung SG->DSM für Spannung" VALUE 0x1C1390 Kw_Ws16 65535.00 OneToOne -32768.00 32767.00 FORMAT "%8.2" /end CHARACTERISTIC
/begin CHARACTERISTIC Sig_uDSMScale_C "Skalierung Umrechung SG->DSM für Spannungen" VALUE 0x1C1392 Kw_Wu16 6.553500 FactHigh 0.00 6.553500 FORMAT "%8.6" /end CHARACTERISTIC
/begin CHARACTERISTIC Sig_volHighDSMOffset_C "Offset Umrechnung der High-Volumsmenge SG -> DSM" VALUE 0x1C139C Kw_Ws16 65535.00 OneToOne -32768.00 32767.00 FORMAT "%8.2" /end CHARACTERISTIC
/begin CHARACTERISTIC Sig_volHighDSMScale_C "Skalierung Umrechnung der High-Volumsmenge SG -> DSM" VALUE 0x1C139E Kw_Wu16 6.553500 FactHigh 0.00 6.553500 FORMAT "%8.6" /end CHARACTERISTIC
/begin CHARACTERISTIC Sig_volLiterDSMOffset_C "Offset Umrechnung der Volumsmenge SG -> DSM" VALUE 0x1C142E Kw_Ws16 65535.00 OneToOne -32768.00 32767.00 FORMAT "%8.2" /end CHARACTERISTIC
/begin CHARACTERISTIC Sig_volLiterDSMScale_C "Skalierung Umrechnung der Volumsmenge SG -> DSM" VALUE 0x1C1430 Kw_Wu16 6.553500 FactHigh 0.00 6.553500 FORMAT "%8.6" /end CHARACTERISTIC
/begin CHARACTERISTIC Sig_volLiterCANOffset_C "Offset Umrechnung der Volumsmenge -> CAN" VALUE 0x1C1432 Kw_Ws16 65535.00 OneToOne -32768.00 32767.00 FORMAT "%8.2" /end CHARACTERISTIC
/begin CHARACTERISTIC Sig_volLiterCANScale_C "Skalierung Umrechnung der Volumsmenge SG -> CAN" VALUE 0x1C1434 Kw_Wu16 6.553500 FactHigh 0.00 6.553500 FORMAT "%8.6" /end CHARACTERISTIC
/begin CHARACTERISTIC Sig_volLiterDIAOffset_C "Offset Umrechnung der Volumsmenge SG -> DIA" VALUE 0x1C1436 Kw_Ws16 65535.00 OneToOne -32768.00 32767.00 FORMAT "%8.2" /end CHARACTERISTIC
/begin CHARACTERISTIC Sig_volLiterDIAScale_C "Skalierung Umrechnung der Volumsmenge SG -> DIA" VALUE 0x1C1438 Kw_Wu16 6.553500 FactHigh 0.00 6.553500 FORMAT "%8.6" /end CHARACTERISTIC
/begin CHARACTERISTIC Sig_VolperTmrDSMOffset_C "Offset für Luftmassen- Umrechnung ecu -> DSM" VALUE 0x1C13A8 Kw_Ws16 65535.00 OneToOne -32768.00 32767.00 FORMAT "%8.2" /end CHARACTERISTIC
/begin CHARACTERISTIC Sig_VolperTmrDSMScale_C "Steigung für Luftmassen-Umrechnung ecu -> DSM" VALUE 0x1C13AA Kw_Wu16 6.553500 FactHigh 0.00 6.553500 FORMAT "%8.6" /end CHARACTERISTIC
/begin CHARACTERISTIC Sig_volDSMOffset_C "Offset Umrechnung der Volumsmenge SG -> DSM" VALUE 0x1C13B4 Kw_Ws16 65535.00 OneToOne -32768.00 32767.00 FORMAT "%8.2" /end CHARACTERISTIC
/begin CHARACTERISTIC Sig_volDSMScale_C "Skalierung Umrechnung der Volumsmenge SG -> DSM" VALUE 0x1C13B6 Kw_Wu16 6.553500 FactHigh 0.00 6.553500 FORMAT "%8.6" /end CHARACTERISTIC
/begin CHARACTERISTIC Sig_vDSMOffset_C "Offset Umrechung SG->DSM für Fahrgeschwindigkeit" VALUE 0x1C13C0 Kw_Ws16 65535.00 OneToOne -32768.00 32767.00 FORMAT "%8.2" /end CHARACTERISTIC
/begin CHARACTERISTIC Sig_vDSMScale_C "Skalierung Umrechung SG->DSM für Fahrgeschwindigkeit" VALUE 0x1C13C2 Kw_Wu16 6.553500 FactHigh 0.00 6.553500 FORMAT "%8.6" /end CHARACTERISTIC
/begin CHARACTERISTIC Sig_wDSMOffset_C "Umrechnung fuer Additionsfaktor: dsm offset" VALUE 0x1C143A Kw_Ws16 65535.00 OneToOne -32768.00 32767.00 FORMAT "%8.2" /end CHARACTERISTIC
/begin CHARACTERISTIC Sig_wDSMScale_C "Umrechnung fuer Additionsfaktor: dsm scale" VALUE 0x1C143C Kw_Wu16 6.553500 FactHigh 0.00 6.553500 FORMAT "%8.6" /end CHARACTERISTIC
/begin CHARACTERISTIC Uacc_AdjValK2SigBlkVal_MAP "Kennfeld zur Auswahl der am Tester ausgegebenen Werte" MAP 0x1F191C Kf_Xs16_Ys16_Ws16 32766.00 OneToOne 0.00 32766.00 FORMAT "%8.2" EXTENDED_LIMITS -32768.00 32767.00
 /begin AXIS_DESCR STD_AXIS AdjVal_dispx_mp OneToOne 5 0.00 4.000 FORMAT "%5.3" EXTENDED_LIMITS 0.00 255.0 DEPOSIT ABSOLUTE /end AXIS_DESCR
 /begin AXIS_DESCR STD_AXIS AdjVal_actRout_mp OneToOne 25 0.00 25.00 FORMAT "%5.2" EXTENDED_LIMITS 0.00 255.0 DEPOSIT ABSOLUTE /end AXIS_DESCR
/end CHARACTERISTIC
/begin CHARACTERISTIC Uacc_AdjValOffset_C "Offset für den Abgleichwert" VAL_BLK 0x1F1A56 Kwb_Wu16 65535.00 OneToOne 0.00 65535.00 FORMAT "%8.2" NUMBER 25 /end CHARACTERISTIC
/begin CHARACTERISTIC Uacc_AdjValScale_C "Skalierungsfaktor für den Abgleichwert" VAL_BLK 0x1F1A88 Kwb_Wu16 6.553500 FactHigh 0.00 6.553500 FORMAT "%8.6" NUMBER 25 /end CHARACTERISTIC
/begin CHARACTERISTIC Uacc_AdjValTesterLength_C "Vom Tester unterstützte Größe des Abgleichswertes (Anzahl der Bytes des Abgleichswertes die der Tester auswerten kann)" VALUE 0x1F1ABA Kw_Wu8 255.0 OneToOne 0.00 255.0 FORMAT "%5.1" /end CHARACTERISTIC
/begin CHARACTERISTIC UAcc_AIRBGCodePos_C "Position des Funktionscodes für Airbag" VALUE 0x1F2695 Kw_Wu8 255.0 OneToOne 0.00 255.0 FORMAT "%5.1" /end CHARACTERISTIC
/begin CHARACTERISTIC Uacc_EOPDFormat_C "Format der übertragenen EVP-Daten" VAL_BLK 0x1F1ABC Kwb_Wu16 65535.00 OneToOne 0.00 65535.00 FORMAT "%8.2" NUMBER 25 /end CHARACTERISTIC
/begin CHARACTERISTIC Uacc_EOPDK2SigBlkVal_MAP "Applikation der EVP-Kanäle" MAP 0x1F1AEE Kf_Xs16_Ys16_Ws16 32766.00 OneToOne 0.00 32766.00 FORMAT "%8.2" EXTENDED_LIMITS -32768.00 32767.00
 /begin AXIS_DESCR STD_AXIS EOPD_dispx_mp OneToOne 5 0.00 4.000 FORMAT "%5.3" EXTENDED_LIMITS 0.00 255.0 DEPOSIT ABSOLUTE /end AXIS_DESCR
 /begin AXIS_DESCR STD_AXIS EOPD_actRout_mp OneToOne 25 0.00 25.00 FORMAT "%5.2" EXTENDED_LIMITS 0.00 255.0 DEPOSIT ABSOLUTE /end AXIS_DESCR
/end CHARACTERISTIC
/begin CHARACTERISTIC Uacc_EOPDOffset_C "Offset fuer Anpasswert Anzeige" VAL_BLK 0x1F1C28 Kwb_Wu16 65535.00 OneToOne 0.00 65535.00 FORMAT "%8.2" NUMBER 25 /end CHARACTERISTIC
/begin CHARACTERISTIC Uacc_EOPDScale_C "Faktor fuer Anpasswert Anzeige" VAL_BLK 0x1F1C5A Kwb_Wu16 6.553500 FactHigh 0.00 6.553500 FORMAT "%8.6" NUMBER 25 /end CHARACTERISTIC
/begin CHARACTERISTIC Uacc_EOPDTesterLength_C "Anzahl der EVP-Daten Bytes" VAL_BLK 0x1F1C8C Kwb_Wu8 255.0 OneToOne 0.00 255.0 FORMAT "%5.1" NUMBER 25 /end CHARACTERISTIC
/begin CHARACTERISTIC UACC_ESBFormular_C "Formeltabelle für Meßwerteblöcke" VAL_BLK 0x1F1CA8 Kwb_Wu8 255.0 OneToOne 0.00 255.0 FORMAT "%5.1" NUMBER 561 /end CHARACTERISTIC
/begin CHARACTERISTIC UACC_ESBNormVal_C "Normierwert für Meßwerteblöcke" VAL_BLK 0x1F1ED9 Kwb_Wu8 255.0 OneToOne 0.00 255.0 FORMAT "%5.1" NUMBER 561 /end CHARACTERISTIC
/begin CHARACTERISTIC UACC_ESBSigNr_C "Signalnummertabelle für Meßwertblöcke" VAL_BLK 0x1F210A Kwb_Wu16 65535.00 OneToOne 0.00 65535.00 FORMAT "%8.2" NUMBER 561 /end CHARACTERISTIC
/begin CHARACTERISTIC UAcc_FQTSCDCodePos_C "Kombisensor FQTS Codeposition innerhalb der Funktionscodierung" VALUE 0x1F2699 Kw_Wu8 255.0 OneToOne 0.00 255.0 FORMAT "%5.1" /end CHARACTERISTIC
/begin CHARACTERISTIC UAcc_LogReqAirSysTrgOfsLrn_C "Passwort zum Löschen der gelernten Offsetwerte in BPA, TVA, EGR und FMA" VALUE 0x1C147C Kw_Wu16 55535.00 OneToOne 10000.00 65535.00 FORMAT "%8.2" EXTENDED_LIMITS 0.00 65535.00 /end CHARACTERISTIC
/begin CHARACTERISTIC UAcc_LogReqEGRSCDTrgOfsLrn_C "Kennwort für EGR Steuerdas aktivieren" VALUE 0x1C147E Kw_Wu16 55535.00 OneToOne 10000.00 65535.00 FORMAT "%8.2" EXTENDED_LIMITS 0.00 65535.00 /end CHARACTERISTIC
/begin CHARACTERISTIC UAcc_LogReqPFltRgnRls_C "Login Passwort für Freigabe der gesperrten DPF-Regeneration durch Tester-login" VALUE 0x1C1480 Kw_Wu16 55535.00 OneToOne 10000.00 65535.00 FORMAT "%8.2" EXTENDED_LIMITS 0.00 65535.00 /end CHARACTERISTIC
/begin CHARACTERISTIC UAcc_LogReqPFltRgnShOff_C "Login Passwort für Sperre der DPF- Regeneration über VAG-Tester" VALUE 0x1C1482 Kw_Wu16 55535.00 OneToOne 10000.00 65535.00 FORMAT "%8.2" EXTENDED_LIMITS 0.00 65535.00 /end CHARACTERISTIC
/begin CHARACTERISTIC UAcc_LogReqPFltTrgOfsAdapt_C "Login Passwort für Aktivierung der Freigabe für die direkte Differenzdrucksensor-Adaption" VALUE 0x1C1484 Kw_Wu16 55535.00 OneToOne 10000.00 65535.00 FORMAT "%8.2" EXTENDED_LIMITS 0.00 65535.00 /end CHARACTERISTIC
/begin CHARACTERISTIC UAcc_LogReqPFltTrgRgn_C "Login Passwort für Aktivierung der Partikelfilterregeneration [-]" VALUE 0x1C1486 Kw_Wu16 55535.00 OneToOne 10000.00 65535.00 FORMAT "%8.2" EXTENDED_LIMITS 0.00 65535.00 /end CHARACTERISTIC
/begin CHARACTERISTIC UAcc_LogReqPWAAGAct_C "Passwort für Aktivierung ""Anhängersteuergerät verbaut""" VALUE 0x1C1488 Kw_Wu16 55535.00 OneToOne 10000.00 65535.00 FORMAT "%8.2" EXTENDED_LIMITS 0.00 65535.00 /end CHARACTERISTIC
/begin CHARACTERISTIC UAcc_LogReqPWAAGdeAct_C "Passwort für Deaktivierung ""verbautes Anhängersteuergerät""" VALUE 0x1C148A Kw_Wu16 55535.00 OneToOne 10000.00 65535.00 FORMAT "%8.2" EXTENDED_LIMITS 0.00 65535.00 /end CHARACTERISTIC
/begin CHARACTERISTIC UAcc_LogReqPWACCAct_C "Paßwort zum Aktivieren der ACC" VALUE 0x1C148C Kw_Wu16 55535.00 OneToOne 10000.00 65535.00 FORMAT "%8.2" EXTENDED_LIMITS 0.00 65535.00 /end CHARACTERISTIC
/begin CHARACTERISTIC UAcc_LogReqPWCrCtlAct_C "Paßwort zum Aktivieren der FGR" VALUE 0x1C1494 Kw_Wu16 55535.00 OneToOne 10000.00 65535.00 FORMAT "%8.2" EXTENDED_LIMITS 0.00 65535.00 /end CHARACTERISTIC
/begin CHARACTERISTIC UAcc_LogReqPWCrCtldeAct_C "Paßwort zum Deaktivieren der FGR" VALUE 0x1C1496 Kw_Wu16 55535.00 OneToOne 10000.00 65535.00 FORMAT "%8.2" EXTENDED_LIMITS 0.00 65535.00 /end CHARACTERISTIC
/begin CHARACTERISTIC UAcc_LogReqPWDSMRdyAcc_C "Paßwort für Login-Funktion ""Readinessbeschleunigung""" VALUE 0x1C1498 Kw_Wu16 55535.00 OneToOne 10000.00 65535.00 FORMAT "%8.2" EXTENDED_LIMITS 0.00 65535.00 /end CHARACTERISTIC
/begin CHARACTERISTIC UAcc_LogReqPWFlPpCDAct_C "Paßwort zum Aktivieren der KSK" VALUE 0x1C149A Kw_Wu16 55535.00 OneToOne 10000.00 65535.00 FORMAT "%8.2" EXTENDED_LIMITS 0.00 65535.00 /end CHARACTERISTIC
/begin CHARACTERISTIC UAcc_LogReqPWFlPpCDdeAct_C "Paßwort zum Deaktivieren der KSK" VALUE 0x1C149C Kw_Wu16 55535.00 OneToOne 10000.00 65535.00 FORMAT "%8.2" EXTENDED_LIMITS 0.00 65535.00 /end CHARACTERISTIC
/begin CHARACTERISTIC UAcc_LogReqPWFMARst_C "Paßwort für Login-Funktion ""Lernkennfeld der FMA löschen""" VALUE 0x1C149E Kw_Wu16 55535.00 OneToOne 10000.00 65535.00 FORMAT "%8.2" EXTENDED_LIMITS 0.00 65535.00 /end CHARACTERISTIC
/begin CHARACTERISTIC UAcc_LogReqPWMxSpdResetdeAct_C "Paßwort zum Deaktivieren der HGB" VALUE 0x1C14A2 Kw_Wu16 55535.00 OneToOne 10000.00 65535.00 FORMAT "%8.2" EXTENDED_LIMITS 0.00 65535.00 /end CHARACTERISTIC
/begin CHARACTERISTIC UAcc_LogReqPW_TAAReqResVal_C "Loginrequest Passwort zum löschen der eingelernten Korrekturwerte für TAA (Zähnchenlernen)" VALUE 0x1C14A4 Kw_Wu16 55535.00 OneToOne 10000.00 65535.00 FORMAT "%8.2" EXTENDED_LIMITS 0.00 65535.00 /end CHARACTERISTIC
/begin CHARACTERISTIC UAcc_Manufacturer_Ver_C "Herstelleränderungsstand" ASCII 0x1C1458 Ktx 255.0 defaultAscii 0.00 255.0 NUMBER 8 /end CHARACTERISTIC
/begin CHARACTERISTIC UAcc_OTSCodePos_C "Position des Funktionscodes für den Öltemperatursensors" VALUE 0x1F269A Kw_Wu8 255.0 OneToOne 0.00 255.0 FORMAT "%5.1" /end CHARACTERISTIC
/begin CHARACTERISTIC UAcc_Production_Group_HW_C "Baugruppe Hardware" ASCII 0x1C1461 Ktx 255.0 defaultAscii 0.00 255.0 NUMBER 3 /end CHARACTERISTIC
/begin CHARACTERISTIC UAcc_Production_Group_SW_C "Baugruppe Software" ASCII 0x1C1465 Ktx 255.0 defaultAscii 0.00 255.0 NUMBER 3 /end CHARACTERISTIC
/begin CHARACTERISTIC UACC_RSigBlkGrp_MAP "Lesesignal fuer Signalbloecke" MAP 0x1F269E Kf_Xs16_Ys16_Ws16 32766.00 OneToOne 0.00 32766.00 FORMAT "%8.2" EXTENDED_LIMITS -32768.00 32767.00
 /begin AXIS_DESCR STD_AXIS EngM_numCyl OneToOne 4 1.000 4.000 FORMAT "%5.3" EXTENDED_LIMITS 0.00 255.0 DEPOSIT ABSOLUTE /end AXIS_DESCR
 /begin AXIS_DESCR STD_AXIS EngM_numCyl OneToOne 255 1.000 255.0 FORMAT "%5.1" EXTENDED_LIMITS 0.00 255.0 DEPOSIT ABSOLUTE /end AXIS_DESCR
/end CHARACTERISTIC
/begin CHARACTERISTIC UACC_ShtrpApplSigBlk_MAP "Array für applikative Messwertblockausgabe bei Short Trip Diagnose" MAP 0x1F256C Kf_Xs16_Ys16_Ws16 32767.00 OneToOne 0.00 32767.00 FORMAT "%8.2" EXTENDED_LIMITS -32768.00 32767.00
 /begin AXIS_DESCR STD_AXIS EngM_numCyl OneToOne 4 1.000 4.000 FORMAT "%5.3" EXTENDED_LIMITS 0.00 255.0 DEPOSIT ABSOLUTE /end AXIS_DESCR
 /begin AXIS_DESCR STD_AXIS EngM_numCyl OneToOne 6 200.0 255.0 FORMAT "%5.1" EXTENDED_LIMITS 0.00 255.0 DEPOSIT ABSOLUTE /end AXIS_DESCR
/end CHARACTERISTIC
/begin CHARACTERISTIC UAcc_SortCode_HW_C "Sortenschlüssel Hardware" ASCII 0x1C1469 Ktx 255.0 defaultAscii 0.00 255.0 NUMBER 4 /end CHARACTERISTIC
/begin CHARACTERISTIC UAcc_SortCode_SW_C "Sortenschlüssel Software" ASCII 0x1C146E Ktx 255.0 defaultAscii 0.00 255.0 NUMBER 4 /end CHARACTERISTIC
/begin CHARACTERISTIC Uacc_stCANText_CA "Nummern der Texte die am VAG -Tester ausgegeben werden" VAL_BLK 0x1F25B4 Kwb_Wu8 255.0 OneToOne 0.00 255.0 FORMAT "%5.1" NUMBER 32 /end CHARACTERISTIC
/begin CHARACTERISTIC Uacc_stTOMskRxMsg_CA "Array zur Ausmaskierung der einzelnen ECUs (für Empfangsbotschaften)" VAL_BLK 0x1F25D4 Kwb_Wu32 4294967295.00 OneToOne 0.00 4294967295.00 FORMAT "%13.2" NUMBER 32 /end CHARACTERISTIC
/begin CHARACTERISTIC Uacc_stTOMskUsrMsg_CA "Array mit zur Ausmaskierung der einzelnen ECUs (für User-Botschafen)" VAL_BLK 0x1F2654 Kwb_Wu16 65535.00 OneToOne 0.00 65535.00 FORMAT "%8.2" NUMBER 32 /end CHARACTERISTIC
/begin CHARACTERISTIC Uacc_SupFunc_CA "Applikative Auswahlmöglichkeit der gewünschten Diagnosefunktionen via Datensatz" VAL_BLK 0x1F30A0 Kwb_Wu16 65535.00 OneToOne 0.00 65535.00 FORMAT "%8.2" NUMBER 20 /end CHARACTERISTIC
/begin CHARACTERISTIC UAcc_swtCodRcy_C "Schalter für die Aktivierung des Recovery nach der Varianten-Kodierung" VALUE 0x1F1918 Kw_Wu8 1.000 OneToOne 0.00 1.000 FORMAT "%5.3" EXTENDED_LIMITS 0.00 255.0 /end CHARACTERISTIC
/begin CHARACTERISTIC UAcc_TypeTestNum_C "Typprüfnummer" ASCII 0x1C1473 Ktx 255.0 defaultAscii 0.00 255.0 NUMBER 7 /end CHARACTERISTIC
/begin CHARACTERISTIC UAcc_vCodRcyMax_C "Fahrgeschwindigkeitsmax. für Ausführen der Recovery nach Varianten-Kodierung" VALUE 0x1F191A Kw_Ws16 655.3500 Vel -327.6800 327.6700 FORMAT "%8.4" /end CHARACTERISTIC
/begin CHARACTERISTIC UKey_stAdjChan_CA "Matrix zum sperren und entsperren der Anpassungskanäle" MAP 0x1F30C8 Kf_Xu8_Yu8_Wu8 255.0 OneToOne 0.00 255.0 FORMAT "%5.1"
 /begin AXIS_DESCR STD_AXIS UKey_stNumPassWD_mp OneToOne 10 0.00 255.0 FORMAT "%5.1" DEPOSIT ABSOLUTE /end AXIS_DESCR
 /begin AXIS_DESCR STD_AXIS UKey_stNumCannel_mp OneToOne 16 0.00 255.0 FORMAT "%5.1" DEPOSIT ABSOLUTE /end AXIS_DESCR
/end CHARACTERISTIC
/begin CHARACTERISTIC UKey_stPassWD_C "Array indem der Wert für jedes Passwort appliziert ist" VAL_BLK 0x1F3184 Kwb_Wu32 99999.0000000 OneToOne 0.00 99999.0000000 FORMAT "%13.7" EXTENDED_LIMITS 0.00 4294967295.00 NUMBER 10 /end CHARACTERISTIC
/begin CHARACTERISTIC UKey_UpLoadPassWD_C "Passwort fuer Readiness-Beschleunigung" VALUE 0x1F31AC Kw_Wu32 99999.0000000 OneToOne 0.00 99999.0000000 FORMAT "%13.7" EXTENDED_LIMITS 0.00 4294967295.00 /end CHARACTERISTIC
/begin CHARACTERISTIC USAp_numFuncCodeBits_C "Bitanzahl für Function Code" VALUE 0x1C14A7 Kw_Wu8 20.00 OneToOne 0.00 20.00 FORMAT "%5.2" EXTENDED_LIMITS 0.00 255.0 /end CHARACTERISTIC
/begin MEASUREMENT ACCCD_aBRK2TrnvrsFlt_mp "Messpunkt für PT1 Filter- Output für die Überbeschleunigung" SWORD TrnvrsAcc 1 100 -327.6800 327.6700 FORMAT "%8.4" ECU_ADDRESS 0x9FE72A /end MEASUREMENT
/begin MEASUREMENT ACCCD_aDes "Sollbeschleunigung vom ACC-SG" SWORD Acc 1 100 -32.76800 32.76700 FORMAT "%8.5" ECU_ADDRESS 0x7F959C /end MEASUREMENT
/begin MEASUREMENT ACCCD_aDevRaw_mp "Regelabweichnung aus ungefiltertem Sollwert und Fahrzeug-beschleunigung" SWORD Acc 1 100 -32.76800 32.76700 FORMAT "%8.5" ECU_ADDRESS 0x9FE730 /end MEASUREMENT
/begin MEASUREMENT ACCCD_aDev_mp "Beschleunigungsabweichung bei Reglereingang" SWORD Acc 1 100 -32.76800 32.76700 FORMAT "%8.5" ECU_ADDRESS 0x9FE732 /end MEASUREMENT
/begin MEASUREMENT ACCCD_aDiffLim_mp "Beschleunigungsunterschiede zwischen dem aktuellen Wert und dem Grenzwert" SWORD Acc 1 100 -32.76800 32.76700 FORMAT "%8.5" ECU_ADDRESS 0x9FE734 /end MEASUREMENT
/begin MEASUREMENT ACCCD_aDrag "vom ACC-SG geforderte und nach unten begrenzte Fahrzeugbeschleunigung" SWORD Acc 1 100 -32.76800 32.76700 FORMAT "%8.5" ECU_ADDRESS 0x7F959E /end MEASUREMENT
/begin MEASUREMENT ACCCD_aDragFlt_mp "Begrenzter und gefilterter Beschleunigungssollwert" SWORD Acc 1 100 -32.76800 32.76700 FORMAT "%8.5" ECU_ADDRESS 0x9FE736 /end MEASUREMENT
/begin MEASUREMENT ACCCD_aDragPre_mp "Begrezter Sollbeschleunigung" SWORD Acc 1 100 -32.76800 32.76700 FORMAT "%8.5" ECU_ADDRESS 0x9FE738 /end MEASUREMENT
/begin MEASUREMENT ACCCD_aDragRmp_mp "Sollbeschleunigung" SWORD Acc 1 100 -32.76800 32.76700 FORMAT "%8.5" ECU_ADDRESS 0x9FE73A /end MEASUREMENT
/begin MEASUREMENT ACCCD_aDrvDem "Fahrerwunschbeschleunigung" SWORD Acc 1 100 -32.76800 32.76700 FORMAT "%8.5" ECU_ADDRESS 0x7F95A0 /end MEASUREMENT
/begin MEASUREMENT ACCCD_aTol "Toleranz für Bremsfreigabe und für das Getriebe" SWORD Acc 1 100 -32.76800 32.76700 FORMAT "%8.5" ECU_ADDRESS 0x7F95A2 /end MEASUREMENT
/begin MEASUREMENT ACCCD_facAcc_mp "Verhältnis Längsbeschleunigung zur Erdbeschleunigung" SWORD Fact 1 100 -4.000000 3.999878 FORMAT "%8.6" ECU_ADDRESS 0x9FE72C /end MEASUREMENT
/begin MEASUREMENT ACCCD_facKiCorr_mp "Integralfaktor, Interpolationswert für I-Wert" SWORD Fact 1 100 -4.000000 3.999878 FORMAT "%8.6" ECU_ADDRESS 0x9FE73C /end MEASUREMENT
/begin MEASUREMENT ACCCD_facKiPosCorr_mp "Korrekturfaktor für Integralfaktor für Zugbetrieb" SWORD Fact 1 100 -4.000000 3.999878 FORMAT "%8.6" ECU_ADDRESS 0x9FE73E /end MEASUREMENT
/begin MEASUREMENT ACCCD_facKpCorr_mp "Integralfaktor, Interpolationswert für P-Wert" SWORD Fact 1 100 -4.000000 3.999878 FORMAT "%8.6" ECU_ADDRESS 0x9FE740 /end MEASUREMENT
/begin MEASUREMENT ACCCD_facKpPosCorr_mp "Korrekturfaktor für Proportionalfaktor für Zugbetrieb" SWORD Fact 1 100 -4.000000 3.999878 FORMAT "%8.6" ECU_ADDRESS 0x9FE742 /end MEASUREMENT
/begin MEASUREMENT ACCCD_frDrvDem_mp "Fahrerwunschmoment" SWORD Friction 1 100 -32768.00 32767.00 FORMAT "%8.2" ECU_ADDRESS 0x9FE744 /end MEASUREMENT
/begin MEASUREMENT ACCCD_frInertia_mp "rotarische Trägheitskräfte" SWORD Friction 1 100 -32768.00 32767.00 FORMAT "%8.2" ECU_ADDRESS 0x9FE746 /end MEASUREMENT
/begin MEASUREMENT ACCCD_frRoadFrc "Fahrbahnreibkraft bzw. -widerstand" SWORD Friction 1 100 -32768.00 32767.00 FORMAT "%8.2" ECU_ADDRESS 0x7F95A4 /end MEASUREMENT
/begin MEASUREMENT ACCCD_IKiBrk_mp "Integralfaktor, Basiswert für Zugbeteieb für I-Wert" ULONG Ki 1 100 0.00 999999.999767 FORMAT "%13.6" ECU_ADDRESS 0x9FE2F0 /end MEASUREMENT
/begin MEASUREMENT ACCCD_IKiPosCorr_mp "Integralfaktor für Regler, Basiswert für Zugbetrieb" ULONG Ki 1 100 0.00 999999.999767 FORMAT "%13.6" ECU_ADDRESS 0x9FE2F4 /end MEASUREMENT
/begin MEASUREMENT ACCCD_IKiPos_mp "Integralfaktor, Basiswert für Zugbeteieb für I-Wert" ULONG Ki 1 100 0.00 999999.999767 FORMAT "%13.6" ECU_ADDRESS 0x9FE2F8 /end MEASUREMENT
/begin MEASUREMENT ACCCD_IKi_mp "I-Verstärkung des PI-Reglers bei Kleinsignalen" ULONG Ki 1 100 0.00 999999.999767 FORMAT "%13.6" ECU_ADDRESS 0x9FE2FC /end MEASUREMENT
/begin MEASUREMENT ACCCD_lWhlRds "Reifenradius" UWORD Dia 1 100 0.00 6.553500 FORMAT "%8.6" ECU_ADDRESS 0x7F95A6 /end MEASUREMENT
/begin MEASUREMENT ACCCD_mOvrVeh "virtuelle Fahrzeugmasse" SWORD VehMass 1 100 -3276.800 3276.700 FORMAT "%8.3" ECU_ADDRESS 0x7F95A8 /end MEASUREMENT
/begin MEASUREMENT ACCCD_mVeh "Fahrzeugmasse" SWORD VehMass 1 100 -3276.800 3276.700 FORMAT "%8.3" ECU_ADDRESS 0x7F95AA /end MEASUREMENT
/begin MEASUREMENT ACCCD_phiRoad "Fahrbahnsteigungswinkel" SWORD AngleRad 1 100 -3.276800 3.276700 FORMAT "%8.6" ECU_ADDRESS 0x7F95AC /end MEASUREMENT
/begin MEASUREMENT ACCCD_phiRoad_mp "Meßpunkt nicht gefilterter Fahrbahnreibwinkel" SWORD AngleRad 1 100 -3.276800 3.276700 FORMAT "%8.6" ECU_ADDRESS 0x9FE72E /end MEASUREMENT
/begin MEASUREMENT ACCCD_PKpBrkLim_mp "Additiver P-Faktor bei Überschreitung des Verzögerungsgrenzwerts" SLONG Kp 1 100 -32768.0000000 32767.9999847 FORMAT "%13.7" ECU_ADDRESS 0x9FE300 /end MEASUREMENT
/begin MEASUREMENT ACCCD_PKpPosCorr_mp "Proportionalfaktor für Regler, Basiswert für Zugbetrieb" SLONG Kp 1 100 -32768.0000000 32767.9999847 FORMAT "%13.7" ECU_ADDRESS 0x9FE304 /end MEASUREMENT
/begin MEASUREMENT ACCCD_PKp_mp "P-Verstärkung des PI-Reglers bei Kleinsignalen" SLONG Kp 1 100 -32768.0000000 32767.9999847 FORMAT "%13.7" ECU_ADDRESS 0x9FE308 /end MEASUREMENT
/begin MEASUREMENT ACCCD_rMVeh "Massenverhältnis aus beladenem und unbeladenem Fahrzeug" SWORD Fact 1 100 -4.000000 3.999878 FORMAT "%8.6" ECU_ADDRESS 0x7F95AE /end MEASUREMENT
/begin MEASUREMENT ACCCD_stACC "Ausgewerteter empfangener Zustand des ACC-SG" UBYTE OneToOne 1 100 0.00 255.0 FORMAT "%5.1" ECU_ADDRESS 0x7F92B0 /end MEASUREMENT
/begin MEASUREMENT ACCCD_stACCBrk_mp "Zustand für die Erkennung des Bremsmomentes im ACC Modus" UBYTE OneToOne 1 100 0.00 255.0 FORMAT "%5.1" ECU_ADDRESS 0x9FF9B6 /end MEASUREMENT
/begin MEASUREMENT ACCCD_stACCnew "neuer gewünschter Zustand des ACC-Zustandsautomaten" UBYTE OneToOne 1 100 0.00 255.0 FORMAT "%5.1" ECU_ADDRESS 0x7F92B1 /end MEASUREMENT
/begin MEASUREMENT ACCCD_stAccOff_mp "GRA und ACC sind inaktiv" UBYTE OneToOne 1 100 0.00 255.0 FORMAT "%5.1" ECU_ADDRESS 0x9FF9B0 /end MEASUREMENT
/begin MEASUREMENT ACCCD_stAccRngX_mp "Berechleunigung außerhalb des erlaubten Bereiches" UBYTE OneToOne 1 100 0.00 255.0 FORMAT "%5.1" ECU_ADDRESS 0x9FF9B1 /end MEASUREMENT
/begin MEASUREMENT ACCCD_stACC_mp "Messpunkt für Motorsteuergerät ACC-kodiert" UBYTE OneToOne 1 100 0.00 255.0 FORMAT "%5.1" ECU_ADDRESS 0x9FF9AA /end MEASUREMENT
/begin MEASUREMENT ACCCD_stBrk "Ausgewerteter empfangener Zustand des Bremsboosters" UBYTE OneToOne 1 100 0.00 255.0 FORMAT "%5.1" ECU_ADDRESS 0x7F92B2 /end MEASUREMENT
/begin MEASUREMENT ACCCD_stBrkErr_mp "ACC-Sensor meldet Fehler" UBYTE OneToOne 1 100 0.00 255.0 FORMAT "%5.1" ECU_ADDRESS 0x7FDDCC /end MEASUREMENT
/begin MEASUREMENT ACCCD_stCorrectCoded_mp "Status of ACC/GRA Correctly coded" UBYTE OneToOne 1 100 0.00 255.0 FORMAT "%5.1" ECU_ADDRESS 0x9FF9AB /end MEASUREMENT
/begin MEASUREMENT ACCCD_stCrCtlCode_mp "Messpunkt für Status des FGR-Codestatus" UBYTE OneToOne 1 100 0.00 255.0 FORMAT "%5.1" ECU_ADDRESS 0x9FF9AC /end MEASUREMENT
/begin MEASUREMENT ACCCD_stGRAPlus_mp "Messpunkt für Motorsteuergerät GRA-plus-kodiert" UBYTE OneToOne 1 100 0.00 255.0 FORMAT "%5.1" ECU_ADDRESS 0x9FF9AD /end MEASUREMENT
/begin MEASUREMENT ACCCD_stGRA_mp "Messpunkt für Motorsteuergerät GRA-kodiert" UBYTE OneToOne 1 100 0.00 255.0 FORMAT "%5.1" ECU_ADDRESS 0x9FF9AE /end MEASUREMENT
/begin MEASUREMENT ACCCD_stGvnr_mp "Status des Beschleunigungsreglers" UBYTE OneToOne 1 100 0.00 255.0 FORMAT "%5.1" ECU_ADDRESS 0x9FF9B2 /end MEASUREMENT
/begin MEASUREMENT ACCCD_stNotGRANotACC_mp "Messpunkt für Motorsteuergerät weder GRA- noch ACC-kodiert" UBYTE OneToOne 1 100 0.00 255.0 FORMAT "%5.1" ECU_ADDRESS 0x9FF9AF /end MEASUREMENT
/begin MEASUREMENT ACCCD_stOvrRunCut "Unterdrückung der Schubabschaltung" UBYTE OneToOne 1 100 0.00 255.0 FORMAT "%5.1" ECU_ADDRESS 0x7F92B3 /end MEASUREMENT
/begin MEASUREMENT ACCCD_stSensErr_mp "Status des Sensorfehlers" UBYTE OneToOne 1 100 0.00 255.0 FORMAT "%5.1" ECU_ADDRESS 0x7FDDCD /end MEASUREMENT
/begin MEASUREMENT ACCCD_stTrqNegLim "Status der Schleppmomentenbegrenzung" UBYTE OneToOne 1 100 0.00 255.0 FORMAT "%5.1" ECU_ADDRESS 0x7F92B4 /end MEASUREMENT
/begin MEASUREMENT ACCCD_stTrqNegLimPre_mp "Zwischenwert für die Berechnung vom Status für das Erkennen auf Schleppmoment" UBYTE OneToOne 1 100 0.00 255.0 FORMAT "%5.1" ECU_ADDRESS 0x9FF9B3 /end MEASUREMENT
/begin MEASUREMENT ACCCD_stTrqNegLimReset_mp "Rücksetzten des Status für den Schleppmoment ACCCD_stTrqNegLim" UBYTE OneToOne 1 100 0.00 255.0 FORMAT "%5.1" ECU_ADDRESS 0x9FF9B4 /end MEASUREMENT
/begin MEASUREMENT ACCCD_stTrqNegLimSet_mp "Setzten des Status für den Schleppmoment ACCCD_stTrqNegLim" UBYTE OneToOne 1 100 0.00 255.0 FORMAT "%5.1" ECU_ADDRESS 0x9FF9B5 /end MEASUREMENT
/begin MEASUREMENT ACCCD_tiAccDragFlt_mp "Filterzeit für Beschleunigungssollwertfilterung" ULONG TimeDelay_s 1 100 0.0000010000000 4294.9673 FORMAT "%9.4" ECU_ADDRESS 0x9FE30C /end MEASUREMENT
/begin MEASUREMENT ACCCD_tiSwtOffRmp "Rampenzeit für die Rampe beim Erreichen des States INACTIVE im Falle ACC ist selektiert" UWORD Time_s 1 100 0.00 655.3500 FORMAT "%8.4" ECU_ADDRESS 0x7F95B0 /end MEASUREMENT
/begin MEASUREMENT ACCCD_trqBrk "ACC-Bremsmoment" SLONG TrqPrpHigh 1 100 -214748364.800 214748364.700 FORMAT "%13.3" ECU_ADDRESS 0x7F9CDC /end MEASUREMENT
/begin MEASUREMENT ACCCD_trqBrkOff "Abschaltschwelle für Bremse" SLONG TrqPrpHigh 1 100 -214748364.800 214748364.700 FORMAT "%13.3" ECU_ADDRESS 0x7F9CE0 /end MEASUREMENT
/begin MEASUREMENT ACCCD_trqBrkRaw "Rechnerisches Bremsmoment in Koordination" SLONG TrqPrpHigh 1 100 -214748364.800 214748364.700 FORMAT "%13.3" ECU_ADDRESS 0x7F9CE4 /end MEASUREMENT
/begin MEASUREMENT ACCCD_trqBrkRawMAP_mp "Meßpunkt für Interpolations" SWORD TrqPrp 1 100 -52428.80 52427.20 FORMAT "%8.2" ECU_ADDRESS 0x9FE748 /end MEASUREMENT
/begin MEASUREMENT ACCCD_trqBrkZero "Schwellenwert für den Bremsmoment im ACC-Modus" SLONG TrqPrpHigh 1 100 -214748364.800 214748364.700 FORMAT "%13.3" ECU_ADDRESS 0x7F9CE8 /end MEASUREMENT
/begin MEASUREMENT ACCCD_trqCtrlLimMax "Maximalgrenze des Reglerausgangs" SLONG TrqPrpHigh 1 100 -214748364.800 214748364.700 FORMAT "%13.3" ECU_ADDRESS 0x7F9CEC /end MEASUREMENT
/begin MEASUREMENT ACCCD_trqCtrlLimMin_mp "Minimalgrenze des Reglerausgangs" SLONG TrqPrpHigh 1 100 -214748364.800 214748364.700 FORMAT "%13.3" ECU_ADDRESS 0x9FE310 /end MEASUREMENT
/begin MEASUREMENT ACCCD_trqCutLim_mp "Meßgröße LSP der Hysterese, welche das wechselnde Aktivieren" SLONG TrqPrpHigh 1 100 -214748364.800 214748364.700 FORMAT "%13.3" ECU_ADDRESS 0x9FE324 /end MEASUREMENT
/begin MEASUREMENT ACCCD_trqDes "Ausgewertete empfangene Momentenanforderung des ACC-SG" SLONG TrqPrpHigh 1 100 -214748364.800 214748364.700 FORMAT "%13.3" ECU_ADDRESS 0x7F9CF0 /end MEASUREMENT
/begin MEASUREMENT ACCCD_trqDesRaw "ACC-Rohwert des Sollmoments" SLONG TrqPrpHigh 1 100 -214748364.800 214748364.700 FORMAT "%13.3" ECU_ADDRESS 0x7F9CF4 /end MEASUREMENT
/begin MEASUREMENT ACCCD_trqDev_mp "Meßgröße verfügbares Schleppmoment" SWORD TrqPrp 1 100 -52428.80 52427.20 FORMAT "%8.2" ECU_ADDRESS 0x9FE74A /end MEASUREMENT
/begin MEASUREMENT ACCCD_trqdiffRmpState_mp "ACC Brems-Moment-Anforderung -> Zustandsvariable der Rampe" SLONG TrqPrpHigh 1 100 -214748364.800 214748364.700 FORMAT "%13.3" ECU_ADDRESS 0x9FE2EC /end MEASUREMENT
/begin MEASUREMENT ACCCD_trqDragAct_mp "Meßgröße aktueller Schleppmomentenwert" SLONG TrqPrpHigh 1 100 -214748364.800 214748364.700 FORMAT "%13.3" ECU_ADDRESS 0x9FE328 /end MEASUREMENT
/begin MEASUREMENT ACCCD_trqDragAvailPre_mp "Der Messpunkt für die Zwischenberechnung des vorhandenen Drehmomentwertes" SLONG TrqPrpHigh 1 100 -214748364.800 214748364.700 FORMAT "%13.3" ECU_ADDRESS 0x9FE32C /end MEASUREMENT
/begin MEASUREMENT ACCCD_trqDragAvail_mp "Meßgröße verfügbares Schleppmoment" SLONG TrqPrpHigh 1 100 -214748364.800 214748364.700 FORMAT "%13.3" ECU_ADDRESS 0x9FE330 /end MEASUREMENT
/begin MEASUREMENT ACCCD_trqEng "ACC-Motorsollmoment" SLONG TrqPrpHigh 1 100 -214748364.800 214748364.700 FORMAT "%13.3" ECU_ADDRESS 0x7F9CF8 /end MEASUREMENT
/begin MEASUREMENT ACCCD_trqEngPre_mp "Der Messpunkt für die Zwischenberechnung des Motormomentes" SLONG TrqPrpHigh 1 100 -214748364.800 214748364.700 FORMAT "%13.3" ECU_ADDRESS 0x9FE334 /end MEASUREMENT
/begin MEASUREMENT ACCCD_trqGvnrOutI_mp "I-Glied des Beschleunigungsreglerausgangs" SLONG TrqPrpHigh 1 100 -214748364.800 214748364.700 FORMAT "%13.3" ECU_ADDRESS 0x9FE314 /end MEASUREMENT
/begin MEASUREMENT ACCCD_trqGvnrOutP_mp "P-Glied des Beschleunigungsreglerausgangs" SLONG TrqPrpHigh 1 100 -214748364.800 214748364.700 FORMAT "%13.3" ECU_ADDRESS 0x9FE318 /end MEASUREMENT
/begin MEASUREMENT ACCCD_trqGvnrOut_mp "Beschleunigungsreglerausgang" SLONG TrqPrpHigh 1 100 -214748364.800 214748364.700 FORMAT "%13.3" ECU_ADDRESS 0x9FE31C /end MEASUREMENT
/begin MEASUREMENT ACCCD_trqInitVal_mp "Initialisierungsmomentenwert für Reglerinitialisierung" SLONG TrqPrpHigh 1 100 -214748364.800 214748364.700 FORMAT "%13.3" ECU_ADDRESS 0x9FE320 /end MEASUREMENT
/begin MEASUREMENT ACCCD_trqLiLtdFlt "Gefiltertes Leerlaufreglermoment" SLONG TrqPrpHigh 1 100 -214748364.800 214748364.700 FORMAT "%13.3" ECU_ADDRESS 0x7F9CFC /end MEASUREMENT
/begin MEASUREMENT ACCCD_trqNoCutLim_mp "Meßgröße RSP der Hysterese, welche das wechselnde Aktivieren und Deaktivieren der Bremse verhindert" SLONG TrqPrpHigh 1 100 -214748364.800 214748364.700 FORMAT "%13.3" ECU_ADDRESS 0x9FE338 /end MEASUREMENT
/begin MEASUREMENT ACCCD_trqPreCtlVal "Vorsteuermomentenwert des Beschleunigungsreglers" SLONG TrqPrpHigh 1 100 -214748364.800 214748364.700 FORMAT "%13.3" ECU_ADDRESS 0x7F9D00 /end MEASUREMENT
/begin MEASUREMENT ACCCD_vDiffSum_mp "Geschwindigkeitsverlust durch Überbremsen" SWORD Vel 1 100 -327.6800 327.6700 FORMAT "%8.4" ECU_ADDRESS 0x9FE74C /end MEASUREMENT
/begin MEASUREMENT ACCD_p "entprellter Klimakompressordruck" SWORD PresAC_hPa 1 100 -65536.00 65534.00 FORMAT "%8.2" ECU_ADDRESS 0x7F95B2 /end MEASUREMENT
/begin MEASUREMENT ACCD_pPwmFlt_mp "phys. Kältemitteldruck ohne Fehlerbehandlung" SWORD PresAC_hPa 1 100 -65536.00 65534.00 FORMAT "%8.2" ECU_ADDRESS 0x9FE74E /end MEASUREMENT
/begin MEASUREMENT ACCD_rHWEOut_mp "Ausgang des Klimakompressors und des Testsignals vom Tester" UBYTE OneToOne 1 100 0.00 255.0 FORMAT "%5.1" ECU_ADDRESS 0x9FF9B7 /end MEASUREMENT
/begin MEASUREMENT ACCD_rPwmDcycIn_mp "Tastverhältnis Kältemitteldruck" SWORD DtyCyc 1 100 -327.6800 327.6700 FORMAT "%8.4" ECU_ADDRESS 0x9FE750 /end MEASUREMENT
/begin MEASUREMENT ACCD_stAC "Statusinformationen AC" UWORD OneToOne 1 100 0.00 65535.00 FORMAT "%8.2" ECU_ADDRESS 0x7F95B4 /end MEASUREMENT
/begin MEASUREMENT ACCD_stComprDig "rückgelesener Kompressorstatus" UBYTE OneToOne 1 100 0.00 255.0 FORMAT "%5.1" ECU_ADDRESS 0x7F92B5 /end MEASUREMENT
/begin MEASUREMENT ACCD_stComprON "Status Klimakompressor (EIN/AUS)" UBYTE OneToOne 1 100 0.00 255.0 FORMAT "%5.1" ECU_ADDRESS 0x7F92B6 /end MEASUREMENT
/begin MEASUREMENT ACCD_stMnSwtDebVal "entprellter Klimaanlagen-Hauptschalter" UBYTE OneToOne 1 100 0.00 255.0 FORMAT "%5.1" ECU_ADDRESS 0x7F92B7 /end MEASUREMENT
/begin MEASUREMENT ACCD_stMnSwtRawVal "Rohwert vom Zustand des Klimakompressor-Hauptschalters" UBYTE OneToOne 1 100 0.00 255.0 FORMAT "%5.1" ECU_ADDRESS 0x7F92B8 /end MEASUREMENT
/begin MEASUREMENT ACCD_stPDefVal "Status ob ACCD_p auf Vorgabewert geht" UBYTE OneToOne 1 100 0.00 255.0 FORMAT "%5.1" ECU_ADDRESS 0x7F92B9 /end MEASUREMENT
/begin MEASUREMENT ACCD_swtACPresent "Klimaanlage verbaut (Ja/Nein)" UBYTE OneToOne 1 100 0.00 255.0 FORMAT "%5.1" ECU_ADDRESS 0x7F92BA /end MEASUREMENT
/begin MEASUREMENT ACCD_swtACtype "Schalter gibt an, ob und wie Klimaanlage verbaut ist" UBYTE OneToOne 1 100 0.00 255.0 FORMAT "%5.1" ECU_ADDRESS 0x7F92BB /end MEASUREMENT
/begin MEASUREMENT ACCD_swtClimatronic "Climatronic im Fzg. verbaut? (JA/NEIN)" UBYTE OneToOne 1 100 0.00 255.0 FORMAT "%5.1" ECU_ADDRESS 0x7F92BC /end MEASUREMENT
/begin MEASUREMENT ACCD_trqCompr "AC Kompressorlast" SWORD Trq 1 100 -3276.800 3276.700 FORMAT "%8.3" ECU_ADDRESS 0x7F95B6 /end MEASUREMENT
/begin MEASUREMENT AccPed_dnDORmpVal_mp "Rampensteigung für Solldrehzahlerhöhung des Anfahrreglers" SWORD RmpEngN_2 1 100 -64000.00 63998.05 FORMAT "%8.2" ECU_ADDRESS 0x9FE752 /end MEASUREMENT
/begin MEASUREMENT AccPed_dnDOSetPRaw_mp "Rohwert der Solldrehzahlerhöhung des Anfahrreglers" SWORD EngN 1 100 -32768.00 32767.00 FORMAT "%8.2" ECU_ADDRESS 0x9FE754 /end MEASUREMENT
/begin MEASUREMENT AccPed_dnDOSetP_mp "Solldrehzahlerhöhung des Anfahrreglers" SWORD EngN 1 100 -32768.00 32767.00 FORMAT "%8.2" ECU_ADDRESS 0x9FE756 /end MEASUREMENT
/begin MEASUREMENT AccPed_facMapSel_mp "restlicher Ausgangswert der Kennlinie zur Gangauswahl" SWORD Fact 1 100 -4.000000 3.999878 FORMAT "%8.6" ECU_ADDRESS 0x9FE76E /end MEASUREMENT
/begin MEASUREMENT AccPed_facTrqDesSwtIn_mp "Intern gespeicherter Faktor der Transitionsfunktion" SWORD FactLow 1 100 -32.00000 31.99902 FORMAT "%8.5" ECU_ADDRESS 0x9FE770 /end MEASUREMENT
/begin MEASUREMENT AccPed_facTrqDesSwtOut_mp "Faktor zur Berechnung des Ausgangs der Transitionsfunktion" SWORD FactLow 1 100 -32.00000 31.99902 FORMAT "%8.5" ECU_ADDRESS 0x9FE772 /end MEASUREMENT
/begin MEASUREMENT AccPed_facTrqLeadSwtIn_mp "Intern gespeicherter Faktor der Transitionsfunktion (Lead-Pfad)" SWORD FactLow 1 100 -32.00000 31.99902 FORMAT "%8.5" ECU_ADDRESS 0x9FE774 /end MEASUREMENT
/begin MEASUREMENT AccPed_facTrqLeadSwtOut_mp "Faktor zur Berechnung des Ausgangs der Transitionsfunktion (Lead-Pfad)" SWORD FactLow 1 100 -32.00000 31.99902 FORMAT "%8.5" ECU_ADDRESS 0x9FE776 /end MEASUREMENT
/begin MEASUREMENT AccPed_nDOSetPDiff_mp "Abweichung der Solldrehzahl von der Motordrehzahl für den Anfahrregler" SWORD EngN 1 100 -32768.00 32767.00 FORMAT "%8.2" ECU_ADDRESS 0x9FE758 /end MEASUREMENT
/begin MEASUREMENT AccPed_nDOSetPLim_mp "Solldrehzahl des Anfahrreglers nach Begrenzung" SWORD EngN 1 100 -32768.00 32767.00 FORMAT "%8.2" ECU_ADDRESS 0x9FE75A /end MEASUREMENT
/begin MEASUREMENT AccPed_nDOSetP_mp "Solldrehzahl des Anfahrreglers" SWORD EngN 1 100 -32768.00 32767.00 FORMAT "%8.2" ECU_ADDRESS 0x9FE75C /end MEASUREMENT
/begin MEASUREMENT AccPed_nMin "Leerlaufsolldrehzahl PWG" SWORD EngN 1 100 -32768.00 32767.00 FORMAT "%8.2" ECU_ADDRESS 0x7F962A /end MEASUREMENT
/begin MEASUREMENT AccPed_nPWinNegDO_mp "Negative Fenstergrenze des Anfahr-Reglers" SWORD EngN 1 100 -32768.00 32767.00 FORMAT "%8.2" ECU_ADDRESS 0x9FE75E /end MEASUREMENT
/begin MEASUREMENT AccPed_nPWinPosDO_mp "Positive Fenstergrenze des Anfahr-Reglers" SWORD EngN 1 100 -32768.00 32767.00 FORMAT "%8.2" ECU_ADDRESS 0x9FE760 /end MEASUREMENT
/begin MEASUREMENT AccPed_numMapSel_mp "Faktor zur Berechnung des Ausgangs der Transitionsfunktion (Lead-Pfad)" UBYTE OneToOne 1 100 0.00 255.0 FORMAT "%5.1" ECU_ADDRESS 0x9FF9BC /end MEASUREMENT
/begin MEASUREMENT AccPed_numTrqAct_mp "Fahrverhaltennummer" UBYTE OneToOne 1 100 0.00 255.0 FORMAT "%5.1" ECU_ADDRESS 0x9FF9BD /end MEASUREMENT
/begin MEASUREMENT AccPed_numTrqVar_mp "Variante zur Auswahl des Fahrverhaltens" UBYTE OneToOne 1 100 0.00 255.0 FORMAT "%5.1" ECU_ADDRESS 0x9FF9BE /end MEASUREMENT
/begin MEASUREMENT AccPed_PKpDO_mp "Kleinsignalverstärkung des Anfahrreglers" SWORD KP_RPM2NM_2 1 100 -1.600000 1.599951 FORMAT "%8.6" ECU_ADDRESS 0x9FE762 /end MEASUREMENT
/begin MEASUREMENT AccPed_PKpNegDO_mp "Großsignalverstärkung für negative Werte des Anfahr-Reglers" SWORD KP_RPM2NM_2 1 100 -1.600000 1.599951 FORMAT "%8.6" ECU_ADDRESS 0x9FE764 /end MEASUREMENT
/begin MEASUREMENT AccPed_PKpPosDO_mp "Großsignalverstärkung für positive Werte des Anfahr-Reglers" SWORD KP_RPM2NM_2 1 100 -1.600000 1.599951 FORMAT "%8.6" ECU_ADDRESS 0x9FE766 /end MEASUREMENT
/begin MEASUREMENT AccPed_rAPP "Geänderter APP Wert, nach Berücksichtigung des Winter Fahrprogramms" SWORD Prc 1 100 -327.6800 327.6700 FORMAT "%8.4" ECU_ADDRESS 0x7F962C /end MEASUREMENT
/begin MEASUREMENT AccPed_rAPPUnFltWntrCurr_mp "Modifizierter Fahrerwunsch bei aktiviertem Winterfahrprogramm (abhängig von der Motordrehzahl und der Fahrpedalstellung)" SWORD Prc 1 100 -327.6800 327.6700 FORMAT "%8.4" ECU_ADDRESS 0x9FE778 /end MEASUREMENT
/begin MEASUREMENT AccPed_rAPPUnFlt_mp "Verstimmter Fahrpedalwert zur Bildung des Fahrerwunsches bei aktiviertem Winterfahrprogr. (abh.v.d. Motordrehzahl v. Fahrpedal)" SWORD Prc 1 100 -327.6800 327.6700 FORMAT "%8.4" ECU_ADDRESS 0x9FE77A /end MEASUREMENT
/begin MEASUREMENT AccPed_rAPPunLim_mp "APP-Wert ohne Begrenzung durch APP-Lebenderkennung" SWORD Prc 1 100 -327.6800 327.6700 FORMAT "%8.4" ECU_ADDRESS 0x9FE79A /end MEASUREMENT
/begin MEASUREMENT AccPed_rAPPWntrCurr_mp "Angepasste Fahrpedalwert für das aktuelle Winterfahrprogramm, abhängig von Motordrehzahl und Fahrpedalwert (DES-Pfad)" SWORD Prc 1 100 -327.6800 327.6700 FORMAT "%8.4" ECU_ADDRESS 0x9FE77C /end MEASUREMENT
/begin MEASUREMENT AccPed_rChkdVal "PWG-Stellung nach Überwachung" SWORD Prc 1 100 -327.6800 327.6700 FORMAT "%8.4" ECU_ADDRESS 0x7F962E /end MEASUREMENT
/begin MEASUREMENT AccPed_rChkdValByp_mp "Meßpunkt für Bypass Freischnitt" SWORD Prc 1 100 -327.6800 327.6700 FORMAT "%8.4" ECU_ADDRESS 0x9FE79C /end MEASUREMENT
/begin MEASUREMENT AccPed_rPla_mp "Begrenzter APP-Wert nach Plausibilitätsprüfung APP/Bremse" SWORD Prc 1 100 -327.6800 327.6700 FORMAT "%8.4" ECU_ADDRESS 0x9FE79E /end MEASUREMENT
/begin MEASUREMENT AccPed_rThresPrp "Schwelle zwischen Schub- und Zugbetrieb" SWORD Prc 1 100 -327.6800 327.6700 FORMAT "%8.4" ECU_ADDRESS 0x7F9630 /end MEASUREMENT
/begin MEASUREMENT AccPed_rThresPrpMin "Minimaler Antriebswert Fahrpedal" SWORD Prc 1 100 -327.6800 327.6700 FORMAT "%8.4" ECU_ADDRESS 0x7F9632 /end MEASUREMENT
/begin MEASUREMENT AccPed_rTrqDesSwtIn_mp "Intern gespeicherte Fahrpedalstellung der Transitionsfunktion" SWORD Prc 1 100 -327.6800 327.6700 FORMAT "%8.4" ECU_ADDRESS 0x9FE77E /end MEASUREMENT
/begin MEASUREMENT AccPed_rTrqDesSwtOut_mp "Aktualisierter Fahrpedalwert" SWORD Prc 1 100 -327.6800 327.6700 FORMAT "%8.4" ECU_ADDRESS 0x9FE780 /end MEASUREMENT
/begin MEASUREMENT AccPed_rTrqLeadSwtIn_mp "Intern gespeicherte Fahrpedalstellung der Transitionsfunktion (Lead-Pfad)" SWORD Prc 1 100 -327.6800 327.6700 FORMAT "%8.4" ECU_ADDRESS 0x9FE782 /end MEASUREMENT
/begin MEASUREMENT AccPed_rTrqLeadSwtOut_mp "Aktualisierter Fahrpedalwert (Lead-Pfad)" SWORD Prc 1 100 -327.6800 327.6700 FORMAT "%8.4" ECU_ADDRESS 0x9FE784 /end MEASUREMENT
/begin MEASUREMENT AccPed_rVnTrqEngActv_mp "Aktives V/n Verhaeltnis zur Gangauswahl ueber Kennlinie" SWORD VelToN 1 100 -0.3276800 0.3276700 FORMAT "%9.7" ECU_ADDRESS 0x9FE786 /end MEASUREMENT
/begin MEASUREMENT AccPed_rVnTrqEngPT1_mp "Zusaetzlich PT1 gefiltertes V/n Verhaeltnis" SWORD VelToN 1 100 -0.3276800 0.3276700 FORMAT "%9.7" ECU_ADDRESS 0x9FE788 /end MEASUREMENT
/begin MEASUREMENT AccPed_rZero "PWG-Stellung, unterhalb der Schubbetrieb gelten soll" SWORD Prc 1 100 -327.6800 327.6700 FORMAT "%8.4" ECU_ADDRESS 0x7F9634 /end MEASUREMENT
/begin MEASUREMENT AccPed_stAPPalive_mp "Status der APP-Lebenderkennung" UBYTE OneToOne 1 100 0.00 255.0 FORMAT "%5.1" ECU_ADDRESS 0x9FF9C3 /end MEASUREMENT
/begin MEASUREMENT AccPed_stBrk "Bremsinformation zur Plausiblitätsprüfung" UBYTE OneToOne 1 100 0.00 255.0 FORMAT "%5.1" ECU_ADDRESS 0x7F92ED /end MEASUREMENT
/begin MEASUREMENT AccPed_stClthPrtActv_mp "Status Kupplungsschutz aktiv" UBYTE OneToOne 1 100 0.00 255.0 FORMAT "%5.1" ECU_ADDRESS 0x9FF9B8 /end MEASUREMENT
/begin MEASUREMENT AccPed_stCoType "Status Mastershift (0:Konventionall 1:Mastershift)" UBYTE OneToOne 1 100 0.00 255.0 FORMAT "%5.1" ECU_ADDRESS 0x7F92EE /end MEASUREMENT
/begin MEASUREMENT AccPed_stDOActv "Status Anfahrregler aktiv" UBYTE OneToOne 1 100 0.00 255.0 FORMAT "%5.1" ECU_ADDRESS 0x7F92EF /end MEASUREMENT
/begin MEASUREMENT AccPed_stDODne_mp "Status Anfahrregelung abgeschlossen" UBYTE OneToOne 1 100 0.00 255.0 FORMAT "%5.1" ECU_ADDRESS 0x9FF9B9 /end MEASUREMENT
/begin MEASUREMENT AccPed_stDOStrtReq_mp "Status Anfahrregelung wird aktiviert" UBYTE OneToOne 1 100 0.00 255.0 FORMAT "%5.1" ECU_ADDRESS 0x9FF9BA /end MEASUREMENT
/begin MEASUREMENT AccPed_stError "Fehlerzustand in AccPed" UBYTE OneToOne 1 100 0.00 255.0 FORMAT "%5.1" ECU_ADDRESS 0x7F92F0 /end MEASUREMENT
/begin MEASUREMENT AccPed_stMisUse_mp "Status der Mißbrauchserkennung" UBYTE OneToOne 1 100 0.00 255.0 FORMAT "%5.1" ECU_ADDRESS 0x9FF9C4 /end MEASUREMENT
/begin MEASUREMENT AccPed_stNotDirect_mp "Status ""Rampe bei Heilung verwenden""" UBYTE OneToOne 1 100 0.00 255.0 FORMAT "%5.1" ECU_ADDRESS 0x9FF9C5 /end MEASUREMENT
/begin MEASUREMENT AccPed_stPlaAPPBrk "Status der Plausibilitätsprüfung APP/Bremse" UBYTE OneToOne 1 100 0.00 255.0 FORMAT "%5.1" ECU_ADDRESS 0x7F92F1 /end MEASUREMENT
/begin MEASUREMENT AccPed_stPlaAPPBrkDet_mp "Status der Erkennung auf Plausibilitätsverletzung APP/Bremse" UBYTE OneToOne 1 100 0.00 255.0 FORMAT "%5.1" ECU_ADDRESS 0x9FF9C6 /end MEASUREMENT
/begin MEASUREMENT AccPed_stPlaAPPBrkRst_mp "Status Rücksetzen einer Plausibilitätsverletzung APP/Bremse" UBYTE OneToOne 1 100 0.00 255.0 FORMAT "%5.1" ECU_ADDRESS 0x9FF9C7 /end MEASUREMENT
/begin MEASUREMENT AccPed_stPlausBrkRls_mp "Status der Überwachungsbedingungen für die Plausibilitätsprüfung Fahrpedalstellung - Bremse" UBYTE OneToOne 1 100 0.00 255.0 FORMAT "%5.1" ECU_ADDRESS 0x9FF9C8 /end MEASUREMENT
/begin MEASUREMENT AccPed_stPlausCheckReqd "Statusanzeige für erforderlichen Plausibilitätscheck zwischen AccPed und Bremse" UBYTE OneToOne 1 100 0.00 255.0 FORMAT "%5.1" ECU_ADDRESS 0x7F92F2 /end MEASUREMENT
/begin MEASUREMENT AccPed_stSport_mp "Status Mastershift (0: Konventionell 1:Mastershift)" UBYTE OneToOne 1 100 0.00 255.0 FORMAT "%5.1" ECU_ADDRESS 0x9FF9BF /end MEASUREMENT
/begin MEASUREMENT AccPed_stTipSlit_mp "Status ob der Wählhebel in Tipgasse-Position ist" UBYTE OneToOne 1 100 0.00 255.0 FORMAT "%5.1" ECU_ADDRESS 0x9FF9C0 /end MEASUREMENT
/begin MEASUREMENT AccPed_sttrqEng0Cold_mp "Status der Anfahrkennfeldauswahl" UBYTE OneToOne 1 100 0.00 255.0 FORMAT "%5.1" ECU_ADDRESS 0x9FF9C1 /end MEASUREMENT
/begin MEASUREMENT AccPed_stvDOReached_mp "Status Maximale Anfahrgeschwindigkeit erreicht" UBYTE OneToOne 1 100 0.00 255.0 FORMAT "%5.1" ECU_ADDRESS 0x9FF9BB /end MEASUREMENT
/begin MEASUREMENT AccPed_swtEPBEna "switch for the torque limitation" UBYTE OneToOne 1 100 0.00 255.0 FORMAT "%5.1" ECU_ADDRESS 0x7F92F3 /end MEASUREMENT
/begin MEASUREMENT AccPed_swtTrqTrans_mp "Schalter-Status der Transitionsfunktion  (0: AccPed_trqDesSwtInNew_mp ausgewählt 1: AccPed_trqDesSwtInFreeze_mp ausgewählt)" UBYTE OneToOne 1 100 0.00 255.0 FORMAT "%5.1" ECU_ADDRESS 0x9FF9C2 /end MEASUREMENT
/begin MEASUREMENT AccPed_trqDes "Fahrerwunsch Rohwert" SLONG TrqPrpHigh 1 100 -214748364.800 214748364.700 FORMAT "%13.3" ECU_ADDRESS 0x7F9D2C /end MEASUREMENT
/begin MEASUREMENT AccPed_trqDesDrvDem_mp "Rohwert Fahrerwunsch nach Überlagerung von Zug- und Schubbeitrag" SLONG TrqPrpHigh 1 100 -214748364.800 214748364.700 FORMAT "%13.3" ECU_ADDRESS 0x9FE33C /end MEASUREMENT
/begin MEASUREMENT AccPed_trqDesEngLow_mp "Wunschmoment für konventionellen Fahrmodus mit Automatikgetriebe und AWD aktiv" SLONG TrqPrpHigh 1 100 -214748364.800 214748364.700 FORMAT "%13.3" ECU_ADDRESS 0x9FE354 /end MEASUREMENT
/begin MEASUREMENT AccPed_trqDesEngNormal_mp "Wunschmoment für konventionellen Fahrmodus mit Automatikgetriebe" SLONG TrqPrpHigh 1 100 -214748364.800 214748364.700 FORMAT "%13.3" ECU_ADDRESS 0x9FE358 /end MEASUREMENT
/begin MEASUREMENT AccPed_trqDesEngSport_mp "Wunschmoment für konventionellen Fahrmodus mit Automatikgetriebe und Sportmodus" SLONG TrqPrpHigh 1 100 -214748364.800 214748364.700 FORMAT "%13.3" ECU_ADDRESS 0x9FE35C /end MEASUREMENT
/begin MEASUREMENT AccPed_trqDesEng_mp "Ausgangsmoment  für konventionellen Fahrmodus mit Automatikgetriebe" SLONG TrqPrpHigh 1 100 -214748364.800 214748364.700 FORMAT "%13.3" ECU_ADDRESS 0x9FE360 /end MEASUREMENT
/begin MEASUREMENT AccPed_trqDesOvrRun_mp "Fahrerwunsch Schubbetrieb für Sollwert" SLONG TrqPrpHigh 1 100 -214748364.800 214748364.700 FORMAT "%13.3" ECU_ADDRESS 0x9FE340 /end MEASUREMENT
/begin MEASUREMENT AccPed_trqDesPrpSport_mp "Ausgangsmoment für Mastershift (Sport Modus)" SLONG TrqPrpHigh 1 100 -214748364.800 214748364.700 FORMAT "%13.3" ECU_ADDRESS 0x9FE364 /end MEASUREMENT
/begin MEASUREMENT AccPed_trqDesPrp_mp "Ausgangsmoment für Mastershift" SLONG TrqPrpHigh 1 100 -214748364.800 214748364.700 FORMAT "%13.3" ECU_ADDRESS 0x9FE368 /end MEASUREMENT
/begin MEASUREMENT AccPed_trqDesPull "Fahrerwunsch Zugbetrieb für Sollwert" SLONG TrqPrpHigh 1 100 -214748364.800 214748364.700 FORMAT "%13.3" ECU_ADDRESS 0x7F9D30 /end MEASUREMENT
/begin MEASUREMENT AccPed_trqDesPullLim_mp "Fahrerwunsch Zugmoment nach Kupplungsschutz" SLONG TrqPrpHigh 1 100 -214748364.800 214748364.700 FORMAT "%13.3" ECU_ADDRESS 0x9FE344 /end MEASUREMENT
/begin MEASUREMENT AccPed_trqDesPullUnLim "Fahrerwunsch Zugmoment vor Kupplungsschutz" SLONG TrqPrpHigh 1 100 -214748364.800 214748364.700 FORMAT "%13.3" ECU_ADDRESS 0x7F9D34 /end MEASUREMENT
/begin MEASUREMENT AccPed_trqDesSwtOut_mp "Ausgangsmoment der Transitionsfunktion" SLONG TrqPrpHigh 1 100 -214748364.800 214748364.700 FORMAT "%13.3" ECU_ADDRESS 0x9FE36C /end MEASUREMENT
/begin MEASUREMENT AccPed_trqDesTransFreeze_mp "Eingang 2 der Transitionsfunktion" SLONG TrqPrpHigh 1 100 -214748364.800 214748364.700 FORMAT "%13.3" ECU_ADDRESS 0x9FE370 /end MEASUREMENT
/begin MEASUREMENT AccPed_trqDesTransNew_mp "Eingang 1 der Transitionsfunktion" SLONG TrqPrpHigh 1 100 -214748364.800 214748364.700 FORMAT "%13.3" ECU_ADDRESS 0x9FE374 /end MEASUREMENT
/begin MEASUREMENT AccPed_trqDesUnLim "Fahrerwunsch Sollwert vor Begrenzung" SLONG TrqPrpHigh 1 100 -214748364.800 214748364.700 FORMAT "%13.3" ECU_ADDRESS 0x7F9D38 /end MEASUREMENT
/begin MEASUREMENT AccPed_trqDOLimMax_mp "Obere Momentenbegrenzung des Anfahrreglers" SWORD Trq 1 100 -3276.800 3276.700 FORMAT "%8.3" ECU_ADDRESS 0x9FE768 /end MEASUREMENT
/begin MEASUREMENT AccPed_trqDOLimMin_mp "Untere Momentenbegrenzung des Anfahrreglers" SWORD Trq 1 100 -3276.800 3276.700 FORMAT "%8.3" ECU_ADDRESS 0x9FE76A /end MEASUREMENT
/begin MEASUREMENT AccPed_trqDO_mp "Unterstützendes Zugmoment des Anfahrreglers" SLONG TrqPrpHigh 1 100 -214748364.800 214748364.700 FORMAT "%13.3" ECU_ADDRESS 0x9FE348 /end MEASUREMENT
/begin MEASUREMENT AccPed_trqEngLim "Maximal zulässiger Zuganteil des Fahrerwunsches (Kupplungsschutz)" SLONG TrqPrpHigh 1 100 -214748364.800 214748364.700 FORMAT "%13.3" ECU_ADDRESS 0x7F9D3C /end MEASUREMENT
/begin MEASUREMENT AccPed_trqFrcMin_mp "Meßpunkt des minimalen Reibungsmoments" SLONG TrqPrpHigh 1 100 -214748364.800 214748364.700 FORMAT "%13.3" ECU_ADDRESS 0x9FE34C /end MEASUREMENT
/begin MEASUREMENT AccPed_trqInrDesEngLow_mp "Innere Wunschmoment für konventionellen Fahrmodus mit Automatikgetriebe und AWD aktiv" SWORD Trq 1 100 -3276.800 3276.700 FORMAT "%8.3" ECU_ADDRESS 0x9FE78A /end MEASUREMENT
/begin MEASUREMENT AccPed_trqInrDesEngNormal_mp "Innere Wunschmoment für konventionellen Fahrmodus mit Automatikgetriebe" SWORD Trq 1 100 -3276.800 3276.700 FORMAT "%8.3" ECU_ADDRESS 0x9FE78C /end MEASUREMENT
/begin MEASUREMENT AccPed_trqInrDesEngSport_mp "Innere Wunschmoment für konventionellen Fahrmodus mit Automatikgetriebe und Sportmodus" SWORD Trq 1 100 -3276.800 3276.700 FORMAT "%8.3" ECU_ADDRESS 0x9FE78E /end MEASUREMENT
/begin MEASUREMENT AccPed_trqInrDesEng_mp "Innere Ausgangsmoment  für konventionellen Fahrmodus mit Automatikgetriebe" SWORD Trq 1 100 -3276.800 3276.700 FORMAT "%8.3" ECU_ADDRESS 0x9FE790 /end MEASUREMENT
/begin MEASUREMENT AccPed_trqInrDesSig "Fahrerwunsch in innerem Moment" SWORD Trq 1 100 -3276.800 3276.700 FORMAT "%8.3" ECU_ADDRESS 0x7F9636 /end MEASUREMENT
/begin MEASUREMENT AccPed_trqInrDO_mp "Unterstützendes, indiziertes Motormoment des Anfahrreglers" SWORD Trq 1 100 -3276.800 3276.700 FORMAT "%8.3" ECU_ADDRESS 0x9FE76C /end MEASUREMENT
/begin MEASUREMENT AccPed_trqInrLeadEngLow_mp "Wunschmoment für konventionellen Fahrmodus mit Automatikgetriebe und AWD aktiv (Lead-Pfad)" SWORD Trq 1 100 -3276.800 3276.700 FORMAT "%8.3" ECU_ADDRESS 0x9FE792 /end MEASUREMENT
/begin MEASUREMENT AccPed_trqInrLeadEngNormal_mp "Wunschmoment für konventionellen Fahrmodus mit Automatikgetriebe (Lead-Pfad)" SWORD Trq 1 100 -3276.800 3276.700 FORMAT "%8.3" ECU_ADDRESS 0x9FE794 /end MEASUREMENT
/begin MEASUREMENT AccPed_trqInrLeadEngSport_mp "Innere Wunschmoment für konventionellen Fahrmodus mit Automatikgetriebe und Sportmodus (Lead-Pfad)" SWORD Trq 1 100 -3276.800 3276.700 FORMAT "%8.3" ECU_ADDRESS 0x9FE796 /end MEASUREMENT
/begin MEASUREMENT AccPed_trqInrLeadEng_mp "Innere Ausgangsmoment  für konventionellen Fahrmodus mit Automatikgetriebe (Lead-Pfad)" SWORD Trq 1 100 -3276.800 3276.700 FORMAT "%8.3" ECU_ADDRESS 0x9FE798 /end MEASUREMENT
/begin MEASUREMENT AccPed_trqLead "Vorhaltmoment des Fahrpedals (schneller Fahrerwunsch)" SLONG TrqPrpHigh 1 100 -214748364.800 214748364.700 FORMAT "%13.3" ECU_ADDRESS 0x7F9D40 /end MEASUREMENT
/begin MEASUREMENT AccPed_trqLeadByp_mp "Bypass - Label für AccPed_trqLead" SLONG TrqPrpHigh 1 100 -214748364.800 214748364.700 FORMAT "%13.3" ECU_ADDRESS 0x9FE378 /end MEASUREMENT
/begin MEASUREMENT AccPed_trqLeadDO_mp "Vorhaltepfad Fahrerwunschmoment nach Anfahrregler" SLONG TrqPrpHigh 1 100 -214748364.800 214748364.700 FORMAT "%13.3" ECU_ADDRESS 0x9FE37C /end MEASUREMENT
/begin MEASUREMENT AccPed_trqLeadDrvDem_mp "Rohwert Fahrerwunschvorhalt nach Überlagerung von Zug- und Schubbeitrag" SLONG TrqPrpHigh 1 100 -214748364.800 214748364.700 FORMAT "%13.3" ECU_ADDRESS 0x9FE380 /end MEASUREMENT
/begin MEASUREMENT AccPed_trqLeadEngLow_mp "Wunschmoment für konventionellen Fahrmodus mit Automatikgetriebe und AWD aktiv (Lead-Pfad)" SLONG TrqPrpHigh 1 100 -214748364.800 214748364.700 FORMAT "%13.3" ECU_ADDRESS 0x9FE384 /end MEASUREMENT
/begin MEASUREMENT AccPed_trqLeadEngNormal_mp "Wunschmoment für konventionellen Fahrmodus mit Automatikgetriebe (Lead-Pfad)" SLONG TrqPrpHigh 1 100 -214748364.800 214748364.700 FORMAT "%13.3" ECU_ADDRESS 0x9FE388 /end MEASUREMENT
/begin MEASUREMENT AccPed_trqLeadEngSport_mp "Wunschmoment für konventionellen Fahrmodus mit Automatikgetriebe (Lead-Pfad)" SLONG TrqPrpHigh 1 100 -214748364.800 214748364.700 FORMAT "%13.3" ECU_ADDRESS 0x9FE38C /end MEASUREMENT
/begin MEASUREMENT AccPed_trqLeadEng_mp "Ausgangsmoment  für konventionellen Fahrmodus mit Automatikgetriebe (Lead-Pfad)" SLONG TrqPrpHigh 1 100 -214748364.800 214748364.700 FORMAT "%13.3" ECU_ADDRESS 0x9FE390 /end MEASUREMENT
/begin MEASUREMENT AccPed_trqLeadOvrRun_mp "Fahrerwunsch Schubbetrieb für Vorhaltewert" SLONG TrqPrpHigh 1 100 -214748364.800 214748364.700 FORMAT "%13.3" ECU_ADDRESS 0x9FE394 /end MEASUREMENT
/begin MEASUREMENT AccPed_trqLeadPrpSport_mp "Ausgangsmoment für Mastershift (Lead-Pfad)" SLONG TrqPrpHigh 1 100 -214748364.800 214748364.700 FORMAT "%13.3" ECU_ADDRESS 0x9FE398 /end MEASUREMENT
/begin MEASUREMENT AccPed_trqLeadPrp_mp "Ausgangsmoment für Mastershift (Lead-Pfad)" SLONG TrqPrpHigh 1 100 -214748364.800 214748364.700 FORMAT "%13.3" ECU_ADDRESS 0x9FE39C /end MEASUREMENT
/begin MEASUREMENT AccPed_trqLeadPullUnLim_mp "Vorhaltepfad Zugmoment vor Kupplungsschutz" SLONG TrqPrpHigh 1 100 -214748364.800 214748364.700 FORMAT "%13.3" ECU_ADDRESS 0x9FE3A0 /end MEASUREMENT
/begin MEASUREMENT AccPed_trqLeadPull_mp "Fahrerwunsch Zugbetrieb für Vorhaltewert" SLONG TrqPrpHigh 1 100 -214748364.800 214748364.700 FORMAT "%13.3" ECU_ADDRESS 0x9FE3A4 /end MEASUREMENT
/begin MEASUREMENT AccPed_trqLeadSwtOut_mp "Ausgangsmoment der Transitionsfunktion (Lead-Pfad)" SLONG TrqPrpHigh 1 100 -214748364.800 214748364.700 FORMAT "%13.3" ECU_ADDRESS 0x9FE3A8 /end MEASUREMENT
/begin MEASUREMENT AccPed_trqLeadTransFreeze_mp "Eingang 2 der Transitionsfunktion (Lead-Pfad)" SLONG TrqPrpHigh 1 100 -214748364.800 214748364.700 FORMAT "%13.3" ECU_ADDRESS 0x9FE3AC /end MEASUREMENT
/begin MEASUREMENT AccPed_trqLeadTransNew_mp "Eingang 1 der Transitionsfunktion (Lead-Pfad)" SLONG TrqPrpHigh 1 100 -214748364.800 214748364.700 FORMAT "%13.3" ECU_ADDRESS 0x9FE3B0 /end MEASUREMENT
/begin MEASUREMENT AccPed_trqLeadUnLim_mp "Fahrerwunsch Vorhalt vor Begrenzung" SLONG TrqPrpHigh 1 100 -214748364.800 214748364.700 FORMAT "%13.3" ECU_ADDRESS 0x9FE3B4 /end MEASUREMENT
/begin MEASUREMENT AccPed_trqLiLtd_mp "Meßpunkt des LiGov Getriebeausgangsmoments" SLONG TrqPrpHigh 1 100 -214748364.800 214748364.700 FORMAT "%13.3" ECU_ADDRESS 0x9FE350 /end MEASUREMENT
/begin MEASUREMENT ACCtl_nEngSpdDiff_mp "Der Unterschied zwischen der Leerlaufdrehzahl und drehzahl" SWORD EngN 1 100 -32768.00 32767.00 FORMAT "%8.2" ECU_ADDRESS 0x9FE7A0 /end MEASUREMENT
/begin MEASUREMENT ACCtl_stACPressDem_mp "Abschaltanforderung durch Kältemitteldruck (vor Zeitbegrenzung)" UBYTE OneToOne 1 100 0.00 255.0 FORMAT "%5.1" ECU_ADDRESS 0x9FF9C9 /end MEASUREMENT
/begin MEASUREMENT ACCtl_stACRequest "Anforderung Leerlaufsolldrehzahlanhebung durch Klima" UBYTE OneToOne 1 100 0.00 255.0 FORMAT "%5.1" ECU_ADDRESS 0x7F92C5 /end MEASUREMENT
/begin MEASUREMENT ACCtl_stBitStructure "Status der verschiedenen Abschaltbedingungen" UWORD OneToOne 1 100 0.00 65535.00 FORMAT "%8.2" ECU_ADDRESS 0x7F95C2 /end MEASUREMENT
/begin MEASUREMENT ACCtl_stHys "Statusinformation zur Klimakompressoransteuerung" UWORD OneToOne 1 100 0.00 65535.00 FORMAT "%8.2" ECU_ADDRESS 0x7F95C4 /end MEASUREMENT
/begin MEASUREMENT ACCtl_stLIGovRel_mp "Status der Bedingung Differenz zwischen Drehzahl und Leerlaufsolldrehzahl größer als applizierbare Schwelle" UBYTE OneToOne 1 100 0.00 255.0 FORMAT "%5.1" ECU_ADDRESS 0x9FF9CA /end MEASUREMENT
/begin MEASUREMENT ACCtl_stLIGov_mp "Status der Bedingung Motordrehzahl kleiner als applizierbare" UBYTE OneToOne 1 100 0.00 255.0 FORMAT "%5.1" ECU_ADDRESS 0x9FF9CB /end MEASUREMENT
/begin MEASUREMENT ACCtl_stLogicOut "Status der aktiven Abschaltbedingungen für Klimakompressor" UBYTE OneToOne 1 100 0.00 255.0 FORMAT "%5.1" ECU_ADDRESS 0x7F92C6 /end MEASUREMENT
/begin MEASUREMENT ACCtl_stLogicReduction "Status der Klimakompressor Leistungsreduzierung" UBYTE OneToOne 1 100 0.00 255.0 FORMAT "%5.1" ECU_ADDRESS 0x7F92C7 /end MEASUREMENT
/begin MEASUREMENT ACCtl_stLowByte_mp "LowByte von ACCtl_stBitStructure" UBYTE OneToOne 1 100 0.00 255.0 FORMAT "%5.1" ECU_ADDRESS 0x7FDDCE /end MEASUREMENT
/begin MEASUREMENT ACCtl_stMinTimeSwitchOff_mp "Bitstatusleiste bei Deaktivierung der Mindesteinschaltdauer" UBYTE OneToOne 1 100 0.00 255.0 FORMAT "%5.1" ECU_ADDRESS 0x9FF9CD /end MEASUREMENT
/begin MEASUREMENT ACCtl_stTSCfreezeReduction_mp "Einfrieren der Klimakompressor-Leistungsreduzierung durch TSC" UBYTE OneToOne 1 100 0.00 255.0 FORMAT "%5.1" ECU_ADDRESS 0x9FF9CE /end MEASUREMENT
/begin MEASUREMENT ACCtl_stTSCfreeze_mp "Ausgangsstatus der zeitlichen Begrenzung für TSC (ehem. EGS) Eingriff" UBYTE OneToOne 1 100 0.00 255.0 FORMAT "%5.1" ECU_ADDRESS 0x9FF9CF /end MEASUREMENT
/begin MEASUREMENT ACCtl_stVehicleStand "Status von stillstehenden Fahrzeug" UBYTE OneToOne 1 100 0.00 255.0 FORMAT "%5.1" ECU_ADDRESS 0x7F92C8 /end MEASUREMENT
/begin MEASUREMENT ACCtl_stVehStand_mp "Fahrzeug im ""sicheren"" Stillstand" UBYTE OneToOne 1 100 0.00 255.0 FORMAT "%5.1" ECU_ADDRESS 0x9FF9D0 /end MEASUREMENT
/begin MEASUREMENT ACCtl_stVehStop_mp "Freischaltzustand der Abschaltbedingung für Anfahren für Klimaabschaltung" SWORD OneToOne 1 100 -32768.00 32767.00 FORMAT "%8.2" ECU_ADDRESS 0x9FF9CC /end MEASUREMENT
/begin MEASUREMENT ACCtl_tACOff_mp "Temperaturwert von dem Array Eng_tFld" SWORD Temp_Cels 1 100 -3549.940 3003.560 FORMAT "%8.3" ECU_ADDRESS 0x9FE7A2 /end MEASUREMENT
/begin MEASUREMENT ACCtl_tEngHys_mp "Temperaturwert von dem Array Eng_tFld" SWORD Temp_Cels 1 100 -3549.940 3003.560 FORMAT "%8.3" ECU_ADDRESS 0x9FE7A4 /end MEASUREMENT
/begin MEASUREMENT ACCtl_tiACOnDly_mp "Zeitverzögerung nach Motorstart für Freigabe des Klimakompressors bei eingeschalteter Klimaanlage" UWORD Time_ms 1 100 0.00 655350.0 FORMAT "%8.1" ECU_ADDRESS 0x9FE7A6 /end MEASUREMENT
/begin MEASUREMENT ACCtl_tiACStrtDly_mp "Zeitverzögerung nach Motorstart für Freigabe des Klimakompressors" UWORD Time_ms 1 100 0.00 655350.0 FORMAT "%8.1" ECU_ADDRESS 0x9FE7A8 /end MEASUREMENT
/begin MEASUREMENT ACCtl_tiDAmax_mp "	max Zeit für Abschalten AC beim Anfahren" UWORD Time_ms 1 100 0.00 655350.0 FORMAT "%8.1" ECU_ADDRESS 0x9FE7AA /end MEASUREMENT
/begin MEASUREMENT ACCtl_tiDAmin_mp "min Zeit für Abschalten AC beim Anfahren" UWORD Time_ms 1 100 0.00 655350.0 FORMAT "%8.1" ECU_ADDRESS 0x9FE7AC /end MEASUREMENT
/begin MEASUREMENT ACCtl_tiMinSwitchOn_mp "Minimale Einschaltdauer des Klimakompressors" UWORD Time_ms 1 100 0.00 655350.0 FORMAT "%8.1" ECU_ADDRESS 0x9FE7B0 /end MEASUREMENT
/begin MEASUREMENT ACCtl_tWTHi_mp "obere Hysteresschwelle für die Abschaltbedingung WASSERTEMPERATUR" SWORD Temp_Cels 1 100 -3549.940 3003.560 FORMAT "%8.3" ECU_ADDRESS 0x9FE7AE /end MEASUREMENT
/begin MEASUREMENT ACC_aDesGearbx_mp "Zwischenwert für die Berechnung des Beschleunigungssollwertes für das Getriebe" SWORD Acc 1 100 -32.76800 32.76700 FORMAT "%8.5" ECU_ADDRESS 0x9FE724 /end MEASUREMENT
/begin MEASUREMENT ACC_aDesTolMax_mp "Zwischenwert für die Berechnung des Beschleunigungssollwertes für das Getriebe" SWORD Acc 1 100 -32.76800 32.76700 FORMAT "%8.5" ECU_ADDRESS 0x9FE726 /end MEASUREMENT
/begin MEASUREMENT ACC_aDrag "Sollbeschleunigung für Bremse" SWORD Acc 1 100 -32.76800 32.76700 FORMAT "%8.5" ECU_ADDRESS 0x7F95B8 /end MEASUREMENT
/begin MEASUREMENT ACC_aSetBrkDem "to be translated" SWORD Acc 1 100 -32.76800 32.76700 FORMAT "%8.5" ECU_ADDRESS 0x7F95BA /end MEASUREMENT
/begin MEASUREMENT ACC_aSetGearbx "Gewünschter Beschleunigungssollwert für das Getriebe" SWORD Acc 1 100 -32.76800 32.76700 FORMAT "%8.5" ECU_ADDRESS 0x7F95BC /end MEASUREMENT
/begin MEASUREMENT ACC_dtrqBrkACCActvNeg_mp "Rampensteigung für die Berechnung des Bremsmoments im State ACTIVE und ENGFAULT" ULONG RmpTrqPrpHigh 1 100 0.00 6553599.99847 FORMAT "%13.5" ECU_ADDRESS 0x9FE2DC /end MEASUREMENT
/begin MEASUREMENT ACC_dtrqBrkACCActvPos_mp "Rampensteigung für die Berechnung des Bremsmoments im State ACTIVE und ENGFAULT" ULONG RmpTrqPrpHigh 1 100 0.00 6553599.99847 FORMAT "%13.5" ECU_ADDRESS 0x9FE2E0 /end MEASUREMENT
/begin MEASUREMENT ACC_rBrkDes "Anforderung Bremsstellgröße" SWORD Prc 1 100 -327.6800 327.6700 FORMAT "%8.4" ECU_ADDRESS 0x7F95BE /end MEASUREMENT
/begin MEASUREMENT ACC_stACCstop "Anhaltewunsch des ACC" UBYTE OneToOne 1 100 0.00 255.0 FORMAT "%5.1" ECU_ADDRESS 0x7F92BD /end MEASUREMENT
/begin MEASUREMENT ACC_stBattShutOff_mp "Zustand der Abschaltung durch Batteriespannung-Low" UBYTE OneToOne 1 100 0.00 255.0 FORMAT "%5.1" ECU_ADDRESS 0x9FF99C /end MEASUREMENT
/begin MEASUREMENT ACC_stBrkDyn "to be translated" UBYTE OneToOne 1 100 0.00 255.0 FORMAT "%5.1" ECU_ADDRESS 0x7F92BE /end MEASUREMENT
/begin MEASUREMENT ACC_stClthOpn_mp "Status des Kupplungszustand : Open oder Closed" UBYTE OneToOne 1 100 0.00 255.0 FORMAT "%5.1" ECU_ADDRESS 0x9FF99D /end MEASUREMENT
/begin MEASUREMENT ACC_stClth_mp "Status des Kupplungszustand" UBYTE OneToOne 1 100 0.00 255.0 FORMAT "%5.1" ECU_ADDRESS 0x9FF99E /end MEASUREMENT
/begin MEASUREMENT ACC_stCond1_mp "Status der Condition1 für VW-ACC oder GRA mit Beschleunigungsschnittstelle" UBYTE OneToOne 1 100 0.00 255.0 FORMAT "%5.1" ECU_ADDRESS 0x9FF99F /end MEASUREMENT
/begin MEASUREMENT ACC_stCond2_mp "Status der Condition2 für VW-ACC oder GRA mit Beschleunigungsschnittstelle" UBYTE OneToOne 1 100 0.00 255.0 FORMAT "%5.1" ECU_ADDRESS 0x9FF9A0 /end MEASUREMENT
/begin MEASUREMENT ACC_stCond3_mp "Status der Condition3 für VW-ACC oder GRA mit Beschleunigungsschnittstelle" UBYTE OneToOne 1 100 0.00 255.0 FORMAT "%5.1" ECU_ADDRESS 0x9FF9A1 /end MEASUREMENT
/begin MEASUREMENT ACC_stCond4_mp "Status der Condition4 für VW-ACC oder GRA mit Beschleuni-gungsschnittstelle" UBYTE OneToOne 1 100 0.00 255.0 FORMAT "%5.1" ECU_ADDRESS 0x9FF9A2 /end MEASUREMENT
/begin MEASUREMENT ACC_stCrCtl "Zustand ACC" UBYTE OneToOne 1 100 0.00 255.0 FORMAT "%5.1" ECU_ADDRESS 0x7F92BF /end MEASUREMENT
/begin MEASUREMENT ACC_stDriverBrkT1_mp "Entprellter Zustand  ""Fahrer bremst""" UBYTE OneToOne 1 100 0.00 255.0 FORMAT "%5.1" ECU_ADDRESS 0x9FF9A3 /end MEASUREMENT
/begin MEASUREMENT ACC_stDriverBrkT2_mp "Entprellter Zustand  ""Fahrer bremst""" UBYTE OneToOne 1 100 0.00 255.0 FORMAT "%5.1" ECU_ADDRESS 0x9FF9A4 /end MEASUREMENT
/begin MEASUREMENT ACC_stDrvBrk "Status Fahrer bremst" UBYTE OneToOne 1 100 0.00 255.0 FORMAT "%5.1" ECU_ADDRESS 0x7F92C0 /end MEASUREMENT
/begin MEASUREMENT ACC_stInactiveRmp "Status der Rampe im Zustand INACTIVE der State Machine" UBYTE OneToOne 1 100 0.00 255.0 FORMAT "%5.1" ECU_ADDRESS 0x7F92C1 /end MEASUREMENT
/begin MEASUREMENT ACC_stIRevShOff "Ir-reversible shut-off status - Audi ACC" UWORD OneToOne 1 100 0.00 65535.00 FORMAT "%8.2" ECU_ADDRESS 0x7F95C0 /end MEASUREMENT
/begin MEASUREMENT ACC_stLockCond1_mp "Status der LockCondition1 für VW-ACC oder GRA mit Beschleunigungsschnittstelle" UBYTE OneToOne 1 100 0.00 255.0 FORMAT "%5.1" ECU_ADDRESS 0x9FF9A5 /end MEASUREMENT
/begin MEASUREMENT ACC_stLockCond2_mp "Status der LockCondition2 für VW-ACC oder GRA mit Beschleunigungsschnittstelle" UBYTE OneToOne 1 100 0.00 255.0 FORMAT "%5.1" ECU_ADDRESS 0x9FF9A6 /end MEASUREMENT
/begin MEASUREMENT ACC_stOvrRun "Status der ACC Schuberkennung (0: kein Schub, 1: Schub)" UBYTE OneToOne 1 100 0.00 255.0 FORMAT "%5.1" ECU_ADDRESS 0x7F92C2 /end MEASUREMENT
/begin MEASUREMENT ACC_stSensAkn_mp "Status des ACC-Sensor-Handshake-Signals" UBYTE OneToOne 1 100 0.00 255.0 FORMAT "%5.1" ECU_ADDRESS 0x9FF9A7 /end MEASUREMENT
/begin MEASUREMENT ACC_stSoftBrkHold_mp "Haltemoment der Soft-Stop-Funktion aktiviert" UBYTE OneToOne 1 100 0.00 255.0 FORMAT "%5.1" ECU_ADDRESS 0x9FF9A8 /end MEASUREMENT
/begin MEASUREMENT ACC_stSoftBrk_mp "Soft-Stop Funktion aktiv" UBYTE OneToOne 1 100 0.00 255.0 FORMAT "%5.1" ECU_ADDRESS 0x9FF9A9 /end MEASUREMENT
/begin MEASUREMENT ACC_stState "Zustand der State-Machine" UBYTE OneToOne 1 100 0.00 255.0 FORMAT "%5.1" ECU_ADDRESS 0x7F92C3 /end MEASUREMENT
/begin MEASUREMENT ACC_swtActvBrkBstr "Schalter zur Auswahl von ACC mit oder ohne aktiven Bremsverstärker" UBYTE OneToOne 1 100 0.00 255.0 FORMAT "%5.1" ECU_ADDRESS 0x7F92C4 /end MEASUREMENT
/begin MEASUREMENT ACC_trqBrk "Gefordertes Summenradbremsmoment" SLONG TrqPrpHigh 1 100 -214748364.800 214748364.700 FORMAT "%13.3" ECU_ADDRESS 0x7F9D04 /end MEASUREMENT
/begin MEASUREMENT ACC_trqBrkDes "Gefordertes Summenradbremsmoment nach der Rampe" SLONG TrqPrpHigh 1 100 -214748364.800 214748364.700 FORMAT "%13.3" ECU_ADDRESS 0x7F9D08 /end MEASUREMENT
/begin MEASUREMENT ACC_trqBrkLowRes_mp "Eingangswert für die Berechnung des Tastverhältnis, um das Bremsmoment aufzubringen" SWORD TrqPrp 1 100 -52428.80 52427.20 FORMAT "%8.2" ECU_ADDRESS 0x9FE728 /end MEASUREMENT
/begin MEASUREMENT ACC_trqCAN "Anforderung Radbremsmoment" SLONG TrqPrpHigh 1 100 -214748364.800 214748364.700 FORMAT "%13.3" ECU_ADDRESS 0x7F9D0C /end MEASUREMENT
/begin MEASUREMENT ACC_trqDes "gewünschtes ACC-Moment" SLONG TrqPrpHigh 1 100 -214748364.800 214748364.700 FORMAT "%13.3" ECU_ADDRESS 0x7F9D10 /end MEASUREMENT
/begin MEASUREMENT ACC_trqDesMax "Maximales Summenradmoment im Zustand  ACC bremst " SLONG TrqPrpHigh 1 100 -214748364.800 214748364.700 FORMAT "%13.3" ECU_ADDRESS 0x7F9D14 /end MEASUREMENT
/begin MEASUREMENT ACC_trqEngOld_mp "Engine torque at the time of Override detection" SLONG TrqPrpHigh 1 100 -214748364.800 214748364.700 FORMAT "%13.3" ECU_ADDRESS 0x9FE2E4 /end MEASUREMENT
/begin MEASUREMENT ACC_trqLead "ACC-Vorhaltemoment" SLONG TrqPrpHigh 1 100 -214748364.800 214748364.700 FORMAT "%13.3" ECU_ADDRESS 0x7F9D18 /end MEASUREMENT
/begin MEASUREMENT ACC_trqSoftBrk_mp "Bremsmoment aus Soft-Stop Funktion" SLONG TrqPrpHigh 1 100 -214748364.800 214748364.700 FORMAT "%13.3" ECU_ADDRESS 0x9FE2E8 /end MEASUREMENT
/begin MEASUREMENT ACTrqC_swtTrqCalcType "Wert des Softwareschalters für Reibmomentberechnung" UBYTE OneToOne 1 100 0.00 255.0 FORMAT "%5.1" ECU_ADDRESS 0x7F92C9 /end MEASUREMENT
/begin MEASUREMENT ACTrqC_trqDes "Momentenforderung Klimakompressor" SWORD Trq 1 100 -3276.800 3276.700 FORMAT "%8.3" ECU_ADDRESS 0x7F95C6 /end MEASUREMENT
/begin MEASUREMENT ACTrqC_trqDyn_mp "Messpunkt für den dynamischen Momentenanforderungsanteil (Ausgang DT1)" SWORD Trq 1 100 -3276.800 3276.700 FORMAT "%8.3" ECU_ADDRESS 0x9FE7B2 /end MEASUREMENT
/begin MEASUREMENT ACTrqC_trqLead "Momentenvorhalt Klimakompressor" SWORD Trq 1 100 -3276.800 3276.700 FORMAT "%8.3" ECU_ADDRESS 0x7F95C8 /end MEASUREMENT
/begin MEASUREMENT ACTrqC_trqStat_mp "Momentenbedarf Klimakompressor im statischen Betrieb" SWORD Trq 1 100 -3276.800 3276.700 FORMAT "%8.3" ECU_ADDRESS 0x9FE7B4 /end MEASUREMENT
/begin MEASUREMENT AC_nACComp_mp "Messpunkt Drehzahl Klimakompressor" SWORD OneToOne 1 100 -32768.00 32767.00 FORMAT "%8.2" ECU_ADDRESS 0x9FE720 /end MEASUREMENT
/begin MEASUREMENT AC_pwrAdjVal_mp "Abgleichwert zur Berechnung der Klimaleistung" SWORD Fact 1 100 -4.000000 3.999878 FORMAT "%8.6" ECU_ADDRESS 0x9FE722 /end MEASUREMENT
/begin MEASUREMENT AC_pwrDes "Leistungsanforderung Wunsch Klimakompressor" SWORD Pwr 1 100 -308831.1 308821.7 FORMAT "%8.1" ECU_ADDRESS 0x7F95CA /end MEASUREMENT
/begin MEASUREMENT AC_pwrLead "Leistungsanforderung Vorhalt Klimakompressor" SWORD Pwr 1 100 -308831.1 308821.7 FORMAT "%8.1" ECU_ADDRESS 0x7F95CC /end MEASUREMENT
/begin MEASUREMENT ADCMon_ctQueueNSync_mp "Zähler zur Lebenderkennung der ereignissynchronen Queue" UWORD OneToOne 1 100 0.00 65535.00 FORMAT "%8.2" ECU_ADDRESS 0x9FE7B6 /end MEASUREMENT
/begin MEASUREMENT ADCMon_ctQueueTSync_mp "Zähler zur Lebenderkennung der zeitsynchronen Queue" UWORD OneToOne 1 100 0.00 65535.00 FORMAT "%8.2" ECU_ADDRESS 0x9FE7B8 /end MEASUREMENT
/begin MEASUREMENT ADCMon_stADCMon "Status der ADC-Überwachung" UWORD OneToOne 1 100 0.00 65535.00 FORMAT "%8.2" ECU_ADDRESS 0x7F95CE /end MEASUREMENT
/begin MEASUREMENT ADCMon_stQueue_mp "Wandlungsstatus der ADC-Queues" UBYTE OneToOne 1 100 0.00 255.0 FORMAT "%5.1" ECU_ADDRESS 0x9FF9D1 /end MEASUREMENT
/begin MEASUREMENT ADCMon_uRefRaw_mp "Rohwert der ADC-Referenzspannung" SWORD Volt 1 100 -160156.4 160151.5 FORMAT "%8.1" ECU_ADDRESS 0x9FE7BA /end MEASUREMENT
/begin MEASUREMENT ADCMon_uTstImpRaw_mp "Rohwert der ADC-Testimpulsspannung" SWORD Volt 1 100 -160156.4 160151.5 FORMAT "%8.1" ECU_ADDRESS 0x9FE7BC /end MEASUREMENT
/begin MEASUREMENT AddPCD_numStrkRem_mp "verbliebene Anzahl von Hüben der Additivpumpe" SWORD OneToOne 1 100 -32768.00 32767.00 FORMAT "%8.2" ECU_ADDRESS 0x9FF040 /end MEASUREMENT
/begin MEASUREMENT AddPCD_uTnkLvlRawVal "Analoger Leertankschalter - Rohwert" SWORD Volt 1 100 -160156.4 160151.5 FORMAT "%8.1" ECU_ADDRESS 0x7F9638 /end MEASUREMENT
/begin MEASUREMENT AddPmp_rAdd_mp "Konzentration des Additiv im Kraftstoff" UWORD mlToL_fine 1 100 0.00 65.53500 FORMAT "%8.5" ECU_ADDRESS 0x9FF042 /end MEASUREMENT
/begin MEASUREMENT AddPmp_volAddDia_mp "Laufend berechnete Additivmenge für Diagnose [ml]" UWORD volAdd_ml 1 100 0.00 6553.500 FORMAT "%8.3" ECU_ADDRESS 0x9FF044 /end MEASUREMENT
/begin MEASUREMENT AddPmp_volAddTotDia_mp "Absolute Additivmenge seit letzter Filterreinigung für Diagnose [ml]" SLONG volAdd_ml 1 100 -214748364.800 214748364.700 FORMAT "%13.3" ECU_ADDRESS 0x9FE4E4 /end MEASUREMENT
/begin MEASUREMENT AdjVal_actRout_mp "Messpunkt für die  ""eingangsgroesse_y"" von Uacc_AdjValK2SigBlkVal_MAP (aktuelle Testerroutine)" UBYTE OneToOne 1 100 0.00 255.0 FORMAT "%5.1" ECU_ADDRESS 0x9FFFD5 /end MEASUREMENT
/begin MEASUREMENT AdjVal_dispx_mp "Messpunkt für ""eingangsgroesse_x"" von Uacc_AdjValK2SigBlkVal_MAP (hat immer den Wert 0)" UBYTE OneToOne 1 100 0.00 255.0 FORMAT "%5.1" ECU_ADDRESS 0x9FFFD6 /end MEASUREMENT
/begin MEASUREMENT AFSCD_ctDebMaxPlSetyDrft_mp "Zähler für die Entprellung von Dfp_AFSCD_PlSetyDrft_mp.Max" ULONG OneToOne 1 100 0.00 4294967295.00 FORMAT "%13.2" ECU_ADDRESS 0x9FE3B8 /end MEASUREMENT
/begin MEASUREMENT AFSCD_ctDebMinPlSetyDrft_mp "Zähler für die Entprellung von Dfp_AFSCD_PlSetyDrft_mp.Min" ULONG OneToOne 1 100 0.00 4294967295.00 FORMAT "%13.2" ECU_ADDRESS 0x9FE3BC /end MEASUREMENT
/begin MEASUREMENT AFSCD_dmAirNorm "Normalisierte Luftmasse" SWORD AirMassPerTime 1 100 -3276.800 3276.700 FORMAT "%8.3" ECU_ADDRESS 0x7F95D0 /end MEASUREMENT
/begin MEASUREMENT AFSCD_dmAirPerTime "HFM Luftmassenstrom" SWORD AirMassPerTime 1 100 -3276.800 3276.700 FORMAT "%8.3" ECU_ADDRESS 0x7F95D2 /end MEASUREMENT
/begin MEASUREMENT AFSCD_dmAirPerTimeB1 "Ansaugluftmasse pro Zeit für Bank1[ kg/ h]" SWORD AirMassPerTime 1 100 -3276.800 3276.700 FORMAT "%8.3" ECU_ADDRESS 0x7F95D4 /end MEASUREMENT
/begin MEASUREMENT AFSCD_dmAirPerTimeB2 "Ansaugluftmasse pro Zeit für Bank2[ kg/ h]" SWORD AirMassPerTime 1 100 -3276.800 3276.700 FORMAT "%8.3" ECU_ADDRESS 0x7F95D6 /end MEASUREMENT
/begin MEASUREMENT AFSCD_dmAirPerTimeByp_mp "Bypass message für AFSCD_dmAirPerTime" SWORD AirMassPerTime 1 100 -3276.800 3276.700 FORMAT "%8.3" ECU_ADDRESS 0x9FE7C2 /end MEASUREMENT
/begin MEASUREMENT AFSCD_dmAirPerTimeHold "letzter gueltiger Wert der Luftmasse pro Zeiteinheit" SWORD AirMassPerTime 1 100 -3276.800 3276.700 FORMAT "%8.3" ECU_ADDRESS 0x7F95D8 /end MEASUREMENT
/begin MEASUREMENT AFSCD_dmAirPerTime_mp "MLt Luftmassenstrom n. Linearisierung + Mittelung" SWORD AirMassPerTime 1 100 -3276.800 3276.700 FORMAT "%8.3" ECU_ADDRESS 0x9FE7C4 /end MEASUREMENT
/begin MEASUREMENT AFSCD_dmAirRawPerTime "Rohwert der Luftmasse vom HFM" SWORD AirMassPerTime 1 100 -3276.800 3276.700 FORMAT "%8.3" ECU_ADDRESS 0x7F95DA /end MEASUREMENT
/begin MEASUREMENT AFSCD_dmCorrAirMass_mp "Korrigierte Luftmasse pro Zeit ( aus Ladedruck )" SWORD AirMassPerTime 1 100 -3276.800 3276.700 FORMAT "%8.3" ECU_ADDRESS 0x9FE7C6 /end MEASUREMENT
/begin MEASUREMENT AFSCD_dmPlsCor_mp "additive Luftmasse zur Pulsationskorrektur der Luftmasse pro Zeit" SWORD AirMassPerTime 1 100 -3276.800 3276.700 FORMAT "%8.3" ECU_ADDRESS 0x9FE7C8 /end MEASUREMENT
/begin MEASUREMENT AFSCD_facCorr_mp "Korrekturfaktor berechnet aus Lufttemperatur und Zylinderfüllungsgrad" SWORD Fact 1 100 -4.000000 3.999878 FORMAT "%8.6" ECU_ADDRESS 0x9FE7CA /end MEASUREMENT
/begin MEASUREMENT AFSCD_facPlsCor_mp "Pulsationskorrekturfaktor" SWORD Fact 1 100 -4.000000 3.999878 FORMAT "%8.6" ECU_ADDRESS 0x9FE7CC /end MEASUREMENT
/begin MEASUREMENT AFSCD_mAirPerCyl "angesaugte Luftmasse pro Zylinder" SWORD AirMassPerCyl 1 100 -3276.800 3276.700 FORMAT "%8.3" ECU_ADDRESS 0x7F95DC /end MEASUREMENT
/begin MEASUREMENT AFSCD_mAirPerCylB1 "Ansaugluftmasse pro Zylinder für Bank 1 [mg/stroke]" SWORD AirMassPerCyl 1 100 -3276.800 3276.700 FORMAT "%8.3" ECU_ADDRESS 0x7F95DE /end MEASUREMENT
/begin MEASUREMENT AFSCD_mAirPerCylB2 "Ansaugluftmasse pro Zylinder für Bank 2 [mg/stroke]" SWORD AirMassPerCyl 1 100 -3276.800 3276.700 FORMAT "%8.3" ECU_ADDRESS 0x7F95E0 /end MEASUREMENT
/begin MEASUREMENT AFSCD_mAirPerCylByp_mp "Bypass message für AFSCD_mAirPerCyl" SWORD AirMassPerCyl 1 100 -3276.800 3276.700 FORMAT "%8.3" ECU_ADDRESS 0x9FE7BE /end MEASUREMENT
/begin MEASUREMENT AFSCD_mAirPerCylFlt "PT1 gefilterte Luftmasse pro Zylinder" SWORD AirMassPerCyl 1 100 -3276.800 3276.700 FORMAT "%8.3" ECU_ADDRESS 0x7F95E2 /end MEASUREMENT
/begin MEASUREMENT AFSCD_mAirPerCylPlsCor "angesaugte pulsationskorrigierte Luftmasse pro Zylinder" SWORD AirMassPerCyl 1 100 -3276.800 3276.700 FORMAT "%8.3" ECU_ADDRESS 0x7F95E4 /end MEASUREMENT
/begin MEASUREMENT AFSCD_mAirPerCylPlsCorB1 "angesaugte pulsationskorrigierte Luftmasse pro Zylinder (Bank1)" SWORD AirMassPerCyl 1 100 -3276.800 3276.700 FORMAT "%8.3" ECU_ADDRESS 0x7F95E6 /end MEASUREMENT
/begin MEASUREMENT AFSCD_mAirPerCylPlsCorB2 "angesaugte pulsationskorrigierte Luftmasse pro Zylinder (Bank2)" SWORD AirMassPerCyl 1 100 -3276.800 3276.700 FORMAT "%8.3" ECU_ADDRESS 0x7F95E8 /end MEASUREMENT
/begin MEASUREMENT AFSCD_mAirPerCylPlsCorByp_mp "Bypass message für AFSCD_mAirPerCylPlsCor" SWORD AirMassPerCyl 1 100 -3276.800 3276.700 FORMAT "%8.3" ECU_ADDRESS 0x9FE7C0 /end MEASUREMENT
/begin MEASUREMENT AFSCD_mAirPerCylRaw "angesaugte Luftmasse pro Zylinder" SWORD AirMassPerCyl 1 100 -3276.800 3276.700 FORMAT "%8.3" ECU_ADDRESS 0x7F95EA /end MEASUREMENT
/begin MEASUREMENT AFSCD_mAirPerCylRawPlsCor "angesaugte pulsationskorrigierte Luftmasse pro Zylinder" SWORD AirMassPerCyl 1 100 -3276.800 3276.700 FORMAT "%8.3" ECU_ADDRESS 0x7F95EC /end MEASUREMENT
/begin MEASUREMENT AFSCD_mAirPerCyl_mp "Berechnete Luftmasse pro Zylinder" SWORD AirMassPerCyl 1 100 -3276.800 3276.700 FORMAT "%8.3" ECU_ADDRESS 0x9FE7CE /end MEASUREMENT
/begin MEASUREMENT AFSCD_mPlsCor_mp "additive Luftmasse zur Pulsationskorrektur der Luftmasse pro Zylinder" SWORD AirMassPerCyl 1 100 -3276.800 3276.700 FORMAT "%8.3" ECU_ADDRESS 0x9FE7D0 /end MEASUREMENT
/begin MEASUREMENT AFSCD_pCurr_mp "aktueller Druck für Ersatzwertbildung" SWORD Pres_hPa 1 100 -32768.00 32767.00 FORMAT "%8.2" ECU_ADDRESS 0x9FE7D2 /end MEASUREMENT
/begin MEASUREMENT AFSCD_qAirmThrSRCHiActv_mp "Mengenschwelle zur Unterdrueckung SRC HIGH(HFM5 1ms) Schwelle = f(n)" SWORD InjMass 1 100 -327.6800 327.6700 FORMAT "%8.4" ECU_ADDRESS 0x9FE7D4 /end MEASUREMENT
/begin MEASUREMENT AFSCD_rAirNorm "Verhältnis von normalisiertem Luftmassenstrom zu Sensorluftmassenstrom" SWORD Fact 1 100 -4.000000 3.999878 FORMAT "%8.6" ECU_ADDRESS 0x7F95EE /end MEASUREMENT
/begin MEASUREMENT AFSCD_rAirNormBefPT1_mp "ungefilterter Wert des normalisierten Luftmassenstroms" SWORD Fact 1 100 -4.000000 3.999878 FORMAT "%8.6" ECU_ADDRESS 0x9FE7D6 /end MEASUREMENT
/begin MEASUREMENT AFSCD_rAirThrHiPlHi_mp "Messpunkt mit der Information von AFSCD_rAirThrHiPlHi_C für Signals" SWORD Fact 1 100 -4.000000 3.999878 FORMAT "%8.6" ECU_ADDRESS 0x7FDDD0 /end MEASUREMENT
/begin MEASUREMENT AFSCD_rAirThrLoPlLo_mp "Messpunkt mit der Information von AFSCD_rAirThrLoPlLo_C für Signals" SWORD Fact 1 100 -4.000000 3.999878 FORMAT "%8.6" ECU_ADDRESS 0x7FDDD2 /end MEASUREMENT
/begin MEASUREMENT AFSCD_stDebSRCAirm_mp "Meßpunkt um den Wert des SRC vom Luftmassemesser sichtbar zu machen" SWORD OneToOne 1 100 -32768.00 32767.00 FORMAT "%8.2" ECU_ADDRESS 0x9FE7D8 /end MEASUREMENT
/begin MEASUREMENT AFSCD_stOffsTst "Status 'Test beendet' der Plausibilitätsprüfung der Offsetdrift" UBYTE OneToOne 1 100 0.00 255.0 FORMAT "%5.1" ECU_ADDRESS 0x7F92CA /end MEASUREMENT
/begin MEASUREMENT AFSCD_stPlSetyDrft_mp "Freigabestatus der Plausibilitätsprüfung der Empfindlichkeitsdrift" SWORD OneToOne 1 100 -32768.00 32767.00 FORMAT "%8.2" ECU_ADDRESS 0x7FDDD4 /end MEASUREMENT
/begin MEASUREMENT AFSCD_swtAirSys "Schalter fuer einzelnes/doppeltes Luftsystem" UBYTE OneToOne 1 100 0.00 255.0 FORMAT "%5.1" ECU_ADDRESS 0x7F92CB /end MEASUREMENT
/begin MEASUREMENT AFSCD_tCorrVal_mp "Korrekturfaktor ( aus Lufttemperatur )" SWORD Temp_Cels 1 100 -3549.940 3003.560 FORMAT "%8.3" ECU_ADDRESS 0x9FE7DA /end MEASUREMENT
/begin MEASUREMENT AFSCD_tiSwtOnCor_mp "Timerwert der ""Einschaltkorrektur""" SWORD Time_ms 1 100 -327680.0 327670.0 FORMAT "%8.1" ECU_ADDRESS 0x9FE7DC /end MEASUREMENT
/begin MEASUREMENT AFSCD_uRaw "Spannungsrohwert des Luftmassenmessers HFM" SWORD Volt 1 100 -160156.4 160151.5 FORMAT "%8.1" ECU_ADDRESS 0x7F95F0 /end MEASUREMENT
/begin MEASUREMENT AFSCD_uRawAvrgVal_mp "Mittelwert des aktuellen und letzten Spannungsrohwerts des Luftmassensensors" SWORD Volt 1 100 -160156.4 160151.5 FORMAT "%8.1" ECU_ADDRESS 0x9FE7DE /end MEASUREMENT
/begin MEASUREMENT AFSCD_uRawLast "Spannungsrohwert des Luftmassenmessers im letzten Zyklus" SWORD Volt 1 100 -160156.4 160151.5 FORMAT "%8.1" ECU_ADDRESS 0x7F95F2 /end MEASUREMENT
/begin MEASUREMENT AFVCD_stActrOut "Status der Luftfilterklappen- Endstufe" UBYTE OneToOne 1 100 0.00 255.0 FORMAT "%5.1" ECU_ADDRESS 0x7F92CC /end MEASUREMENT
/begin MEASUREMENT AFVCtl_stHysLogic_mp "Bitweiser Zustand aller Hysterese" ULONG OneToOne 1 100 0.00 4294967295.00 FORMAT "%13.2" ECU_ADDRESS 0x9FE3C0 /end MEASUREMENT
/begin MEASUREMENT AFVCtl_stLogic_mp "Luftfilterklappenansteuerungsstatus" UBYTE OneToOne 1 100 0.00 255.0 FORMAT "%5.1" ECU_ADDRESS 0x9FF9D2 /end MEASUREMENT
/begin MEASUREMENT AFVCtl_stOut "Luftfilterklappenansteuerungsstatus" UBYTE OneToOne 1 100 0.00 255.0 FORMAT "%5.1" ECU_ADDRESS 0x7F92CD /end MEASUREMENT
/begin MEASUREMENT AFVCtl_stPwrIndThres_mp "Temperaturzustand des Ansaugluftsystems unter der applizierbaren Schwelle von der Leistungsfunktion" UBYTE OneToOne 1 100 0.00 255.0 FORMAT "%5.1" ECU_ADDRESS 0x9FF9D3 /end MEASUREMENT
/begin MEASUREMENT AFVCtl_stSnowIndThres_mp "Temperaturzustand des Ansaugluftsystems unter der applizierbaren Schwelle von der Schneefunktion" UBYTE OneToOne 1 100 0.00 255.0 FORMAT "%5.1" ECU_ADDRESS 0x9FF9D4 /end MEASUREMENT
/begin MEASUREMENT AirbCD_st "Abschaltanforderungen für Airbag/Überrollbügel" UBYTE OneToOne 1 100 0.00 255.0 FORMAT "%5.1" ECU_ADDRESS 0x7F9301 /end MEASUREMENT
/begin MEASUREMENT AirbCD_stCrshInfoEEP_mp "Meßpunkt für  crash Signal ( EEPROM)" UBYTE OneToOne 1 100 0.00 255.0 FORMAT "%5.1" ECU_ADDRESS 0x9FF9D5 /end MEASUREMENT
/begin MEASUREMENT AirbCD_stCrshRst_mp "Reset Status des Airbags" UBYTE OneToOne 1 100 0.00 255.0 FORMAT "%5.1" ECU_ADDRESS 0x9FF9D6 /end MEASUREMENT
/begin MEASUREMENT AirbCD_stEngStop_mp "Status der Motorstillstandserkennung für Airbag" UBYTE OneToOne 1 100 0.00 255.0 FORMAT "%5.1" ECU_ADDRESS 0x9FF9D7 /end MEASUREMENT
/begin MEASUREMENT AirbCD_stEngStrtDet_mp "Null Erkennung" UBYTE OneToOne 1 100 0.00 255.0 FORMAT "%5.1" ECU_ADDRESS 0x9FF9D8 /end MEASUREMENT
/begin MEASUREMENT AirbCD_stEngZrDetEEP_mp "Meßpunkt für ein stehender Motor  (EEPROM" UBYTE OneToOne 1 100 0.00 255.0 FORMAT "%5.1" ECU_ADDRESS 0x9FF9D9 /end MEASUREMENT
/begin MEASUREMENT AirbCD_stEngZrDet_mp "Meßpunkt für  ein stehender Motor" UBYTE OneToOne 1 100 0.00 255.0 FORMAT "%5.1" ECU_ADDRESS 0x9FF9DA /end MEASUREMENT
/begin MEASUREMENT AirCtl_drAPP_mp "Gradient der Fahrpedalposition" SWORD PrcPerSec_20ms 1 100 -16384.00 16383.50 FORMAT "%8.2" ECU_ADDRESS 0x9FE832 /end MEASUREMENT
/begin MEASUREMENT AirCtl_facATParAd_mp "lufttemperaturabhängiger Faktor für Parameteradaption" SWORD Fact1 1 100 -256.0000 255.9922 FORMAT "%8.4" ECU_ADDRESS 0x9FE860 /end MEASUREMENT
/begin MEASUREMENT AirCtl_facGovRgnRmpEGR_mp "Rampenformung EGR für die Partikelfilter Regeneration" SWORD EGTSwt_S16 1 100 -2.000000 1.999939 FORMAT "%8.6" ECU_ADDRESS 0x9FE862 /end MEASUREMENT
/begin MEASUREMENT AirCtl_facGovRgnRmpTVA_mp "Rampenformung TVA für die Partikelfilter Regeneration" SWORD EGTSwt_S16 1 100 -2.000000 1.999939 FORMAT "%8.6" ECU_ADDRESS 0x9FE864 /end MEASUREMENT
/begin MEASUREMENT AirCtl_facGovRgnRmp_mp "Rampenformung für die Partikelfilter Regeneration" SWORD EGTSwt_S16 1 100 -2.000000 1.999939 FORMAT "%8.6" ECU_ADDRESS 0x9FE866 /end MEASUREMENT
/begin MEASUREMENT AirCtl_facILimCor_mp "Kennfeldausgang AirCtl_facILimCor_MAP" SWORD Fact 1 100 -4.000000 3.999878 FORMAT "%8.6" ECU_ADDRESS 0x9FE868 /end MEASUREMENT
/begin MEASUREMENT AirCtl_facLmbdRecCor_mp "Kennfeldausgang AirCtl_facLmbdRecCor_MAP" SWORD Fact 1 100 -4.000000 3.999878 FORMAT "%8.6" ECU_ADDRESS 0x9FE86A /end MEASUREMENT
/begin MEASUREMENT AirCtl_facLmbd_mp "Korrektur für reziproker Lambdawert" SWORD Fact 1 100 -4.000000 3.999878 FORMAT "%8.6" ECU_ADDRESS 0x9FE86C /end MEASUREMENT
/begin MEASUREMENT AirCtl_facNQParAd_mp "Faktor für Parameteradaption for ARF" SWORD Fact1 1 100 -256.0000 255.9922 FORMAT "%8.4" ECU_ADDRESS 0x9FE86E /end MEASUREMENT
/begin MEASUREMENT AirCtl_facParAd_mp "Gesamtfaktor für Parameteradaption für ARF" SWORD Fact1 1 100 -256.0000 255.9922 FORMAT "%8.4" ECU_ADDRESS 0x9FE870 /end MEASUREMENT
/begin MEASUREMENT AirCtl_facParRgn_mp "Rampe zur Parameterumschaltung für die Partikelfilter Regeneration" ULONG facRmpEGT32 1 100 0.00 262.143999939 FORMAT "%13.9" ECU_ADDRESS 0x9FE3D4 /end MEASUREMENT
/begin MEASUREMENT AirCtl_mAPCor_mp "Korrigierter Atmosphäarendruck" SWORD AirMassPerCyl 1 100 -3276.800 3276.700 FORMAT "%8.3" ECU_ADDRESS 0x9FE834 /end MEASUREMENT
/begin MEASUREMENT AirCtl_mCorAfterStart_mp "errechneter Korrekturwert der Verstellung in der Höhe nach Start" SWORD AirMassPerCyl 1 100 -3276.800 3276.700 FORMAT "%8.3" ECU_ADDRESS 0x9FE836 /end MEASUREMENT
/begin MEASUREMENT AirCtl_mDesBase_mp "stationärer Basissollwert für ARF" SWORD AirMassPerCyl 1 100 -3276.800 3276.700 FORMAT "%8.3" ECU_ADDRESS 0x9FE838 /end MEASUREMENT
/begin MEASUREMENT AirCtl_mDesCorr_mp "korrigierter Luftmassensollwert" SWORD AirMassPerCyl 1 100 -3276.800 3276.700 FORMAT "%8.3" ECU_ADDRESS 0x9FE83A /end MEASUREMENT
/begin MEASUREMENT AirCtl_mDesDyn_mp "dynamischer Anteil des Luftmassensollwerts für Abgasrückführung" SWORD AirMassPerCyl 1 100 -3276.800 3276.700 FORMAT "%8.3" ECU_ADDRESS 0x9FE83C /end MEASUREMENT
/begin MEASUREMENT AirCtl_mDesRgnCorr1_mp "Korrigierter Sollwert für die Regeneration" SWORD AirMassPerCyl 1 100 -3276.800 3276.700 FORMAT "%8.3" ARRAY_SIZE 3 ECU_ADDRESS 0x9FE814 /end MEASUREMENT
/begin MEASUREMENT AirCtl_mDesRgnCorr_mp "Luftmassensollwert im Regenerationsbetrieb" SWORD AirMassPerCyl 1 100 -3276.800 3276.700 FORMAT "%8.3" ARRAY_SIZE 3 ECU_ADDRESS 0x9FE81A /end MEASUREMENT
/begin MEASUREMENT AirCtl_mDesRgnVal_2_mp "Sollwert für die Regeneration mit Atmosphärendruckkorrektur für den Regenerationsbetrieb" SWORD AirMassPerCyl 1 100 -3276.800 3276.700 FORMAT "%8.3" ARRAY_SIZE 3 ECU_ADDRESS 0x9FE820 /end MEASUREMENT
/begin MEASUREMENT AirCtl_mDesRgnVal_3_mp "Sollwert für die Regeneration mit Lufttemperaturkorrektur für den Regenerationsbetrieb" SWORD AirMassPerCyl 1 100 -3276.800 3276.700 FORMAT "%8.3" ARRAY_SIZE 3 ECU_ADDRESS 0x9FE826 /end MEASUREMENT
/begin MEASUREMENT AirCtl_mDesRgn_mp "Luftmassesollwert im Regenerationsbetrieb ohne Korrektur" SWORD AirMassPerCyl 1 100 -3276.800 3276.700 FORMAT "%8.3" ARRAY_SIZE 3 ECU_ADDRESS 0x9FE82C /end MEASUREMENT
/begin MEASUREMENT AirCtl_mDesShtrp "Luftmassensollwert während ShortTrip Test AGR-Reglerabweichung" SWORD AirMassPerCyl 1 100 -3276.800 3276.700 FORMAT "%8.3" ECU_ADDRESS 0x7F963C /end MEASUREMENT
/begin MEASUREMENT AirCtl_mDesStat_mp "stationärer Luftmassensollwert" SWORD AirMassPerCyl 1 100 -3276.800 3276.700 FORMAT "%8.3" ECU_ADDRESS 0x9FE83E /end MEASUREMENT
/begin MEASUREMENT AirCtl_mDesVal "Luftmassensollwert" SWORD AirMassPerCyl 1 100 -3276.800 3276.700 FORMAT "%8.3" ECU_ADDRESS 0x7F963E /end MEASUREMENT
/begin MEASUREMENT AirCtl_mDesValByp_mp "Bypass-Label, Kopie von AirCtl_mDesVal" SWORD AirMassPerCyl 1 100 -3276.800 3276.700 FORMAT "%8.3" ECU_ADDRESS 0x9FE840 /end MEASUREMENT
/begin MEASUREMENT AirCtl_mDesVal_1_mp "stationärer Sollwert mit Abgleichkorrektur für ARF" SWORD AirMassPerCyl 1 100 -3276.800 3276.700 FORMAT "%8.3" ECU_ADDRESS 0x9FE842 /end MEASUREMENT
/begin MEASUREMENT AirCtl_mDesVal_2_mp "stationärer Sollwert mit Atmosphärendruckkorrektur für ARF" SWORD AirMassPerCyl 1 100 -3276.800 3276.700 FORMAT "%8.3" ECU_ADDRESS 0x9FE844 /end MEASUREMENT
/begin MEASUREMENT AirCtl_mDesVal_3_mp "stationärer Sollwert mit Lufttemperaturkorrektur für ARF" SWORD AirMassPerCyl 1 100 -3276.800 3276.700 FORMAT "%8.3" ECU_ADDRESS 0x9FE846 /end MEASUREMENT
/begin MEASUREMENT AirCtl_mDesVal_4_mp "stationärer Sollwert mit Kühlwassertemperaturkorrektur" SWORD AirMassPerCyl 1 100 -3276.800 3276.700 FORMAT "%8.3" ECU_ADDRESS 0x9FE848 /end MEASUREMENT
/begin MEASUREMENT AirCtl_mDesVal_5_mp "drehzahlabhängige Luftmassenkorrektur" SWORD AirMassPerCyl 1 100 -3276.800 3276.700 FORMAT "%8.3" ECU_ADDRESS 0x9FE84A /end MEASUREMENT
/begin MEASUREMENT AirCtl_mDesVal_mp "Ausgang Rampenschalter" SWORD AirMassPerCyl 1 100 -3276.800 3276.700 FORMAT "%8.3" ECU_ADDRESS 0x9FE84C /end MEASUREMENT
/begin MEASUREMENT AirCtl_mGovDev "Regelabweichung bei ARF" SWORD AirMassPerCyl 1 100 -3276.800 3276.700 FORMAT "%8.3" ECU_ADDRESS 0x7F9640 /end MEASUREMENT
/begin MEASUREMENT AirCtl_mGovDevHi "Positive Regelabweichung (CARB Mode6)" SWORD AirMassPerCyl 1 100 -3276.800 3276.700 FORMAT "%8.3" ECU_ADDRESS 0x7F9642 /end MEASUREMENT
/begin MEASUREMENT AirCtl_mGovDevLo "Negative Regelabweichung (CARB Mode6)" SWORD AirMassPerCyl 1 100 -3276.800 3276.700 FORMAT "%8.3" ECU_ADDRESS 0x7F9644 /end MEASUREMENT
/begin MEASUREMENT AirCtl_mMaxDevHi "Obere Grenze der Regelabweichung (CARB Mode6)" SWORD AirMassPerCyl 1 100 -3276.800 3276.700 FORMAT "%8.3" ECU_ADDRESS 0x7F9646 /end MEASUREMENT
/begin MEASUREMENT AirCtl_mMaxDevRgn_mp "Maximale Regelabweichung im Regenerationsmodus" SWORD AirMassPerCyl 1 100 -3276.800 3276.700 FORMAT "%8.3" ECU_ADDRESS 0x9FE8B8 /end MEASUREMENT
/begin MEASUREMENT AirCtl_mMaxDev_mp "Obergrenze für bleibende Regelabweichung" SWORD AirMassPerCyl 1 100 -3276.800 3276.700 FORMAT "%8.3" ECU_ADDRESS 0x7FDDD6 /end MEASUREMENT
/begin MEASUREMENT AirCtl_mMinDevLo "Untere Grenze der Regelabweichung (CARB Mode6)" SWORD AirMassPerCyl 1 100 -3276.800 3276.700 FORMAT "%8.3" ECU_ADDRESS 0x7F9648 /end MEASUREMENT
/begin MEASUREMENT AirCtl_mMinDevRgn_mp "Minimale Regelabweichung im Regenerationsmodus" SWORD AirMassPerCyl 1 100 -3276.800 3276.700 FORMAT "%8.3" ECU_ADDRESS 0x9FE8BA /end MEASUREMENT
/begin MEASUREMENT AirCtl_mMinDev_mp "Untergrenze für bleibende Regelabweichung" SWORD AirMassPerCyl 1 100 -3276.800 3276.700 FORMAT "%8.3" ECU_ADDRESS 0x7FDDD8 /end MEASUREMENT
/begin MEASUREMENT AirCtl_nOvrRunDel_mp "Schwelle zur Erkennung Schaltvorgang" SWORD EngN 1 100 -32768.00 32767.00 FORMAT "%8.2" ECU_ADDRESS 0x9FE8BC /end MEASUREMENT
/begin MEASUREMENT AirCtl_nOvrRun_mp "Schwelle zur Erkennung Schubbetrieb" SWORD EngN 1 100 -32768.00 32767.00 FORMAT "%8.2" ECU_ADDRESS 0x9FE8BE /end MEASUREMENT
/begin MEASUREMENT AirCtl_pCor "Lufttemperatur-korrigierter Atmosphärendruck" SWORD Pres_hPa 1 100 -32768.00 32767.00 FORMAT "%8.2" ECU_ADDRESS 0x7F964A /end MEASUREMENT
/begin MEASUREMENT AirCtl_qCtl "Einspritzmenge roh" SWORD InjMass 1 100 -327.6800 327.6700 FORMAT "%8.4" ECU_ADDRESS 0x7F964C /end MEASUREMENT
/begin MEASUREMENT AirCtl_qDes "Korrigierte Einspritzmenge" SWORD InjMass 1 100 -327.6800 327.6700 FORMAT "%8.4" ECU_ADDRESS 0x7F964E /end MEASUREMENT
/begin MEASUREMENT AirCtl_qGov "Korrigierte Einspritzmenge" SWORD InjMass 1 100 -327.6800 327.6700 FORMAT "%8.4" ECU_ADDRESS 0x7F9650 /end MEASUREMENT
/begin MEASUREMENT AirCtl_qGovOff_mp "untere Schwelle der Abschalthysterese" SWORD InjMass 1 100 -327.6800 327.6700 FORMAT "%8.4" ECU_ADDRESS 0x9FE872 /end MEASUREMENT
/begin MEASUREMENT AirCtl_qGovOn_mp "obere Schwelle der Abschalthysterese" SWORD InjMass 1 100 -327.6800 327.6700 FORMAT "%8.4" ECU_ADDRESS 0x9FE874 /end MEASUREMENT
/begin MEASUREMENT AirCtl_qMon "Korrigierte Einspritzmenge" SWORD InjMass 1 100 -327.6800 327.6700 FORMAT "%8.4" ECU_ADDRESS 0x7F9652 /end MEASUREMENT
/begin MEASUREMENT AirCtl_qRpOilCorr_mp "Meßpunkt für korrigierte Einspritzmenge für RME" SWORD InjMass 1 100 -327.6800 327.6700 FORMAT "%8.4" ECU_ADDRESS 0x9FE854 /end MEASUREMENT
/begin MEASUREMENT AirCtl_rCtl1_mp "Ergebnis der Addition von AirCtl_rCtlBase_MAP mit AirCtl_rTrmValCor_CUR" SWORD Prc 1 100 -327.6800 327.6700 FORMAT "%8.4" ECU_ADDRESS 0x9FE802 /end MEASUREMENT
/begin MEASUREMENT AirCtl_rCtl2_mp "Ergebnis der Addition von AirCtl_rCtl1_mp mit Korrekturwert" SWORD Prc 1 100 -327.6800 327.6700 FORMAT "%8.4" ECU_ADDRESS 0x9FE804 /end MEASUREMENT
/begin MEASUREMENT AirCtl_rCtl3_mp "Ergebnis der Korrektur von AirCtl_rCtl2_mp" SWORD Prc 1 100 -327.6800 327.6700 FORMAT "%8.4" ECU_ADDRESS 0x9FE806 /end MEASUREMENT
/begin MEASUREMENT AirCtl_rCtlBase_mp "Ermitteltes Grundtastverhältnis" SWORD Prc 1 100 -327.6800 327.6700 FORMAT "%8.4" ECU_ADDRESS 0x9FE808 /end MEASUREMENT
/begin MEASUREMENT AirCtl_rCtlCorRgnVal_mp "Ausgang der Korrekturkennfeldes für den Regenerationsbetrieb" SWORD Prc 1 100 -327.6800 327.6700 FORMAT "%8.4" ECU_ADDRESS 0x9FE80A /end MEASUREMENT
/begin MEASUREMENT AirCtl_rCtlCorr_mp "korrigierter Steuerwert für Luftmasse" SWORD Prc 1 100 -327.6800 327.6700 FORMAT "%8.4" ECU_ADDRESS 0x9FE80C /end MEASUREMENT
/begin MEASUREMENT AirCtl_rCtlCorVal_mp "Ausgang der ""Korrekturrampe""-Rampe" SWORD Prc 1 100 -327.6800 327.6700 FORMAT "%8.4" ECU_ADDRESS 0x9FE80E /end MEASUREMENT
/begin MEASUREMENT AirCtl_rCtlRgn1_mp "stationaerer Sollwert aus Regenerationskennfeld-1" SWORD Prc 1 100 -327.6800 327.6700 FORMAT "%8.4" ARRAY_SIZE 3 ECU_ADDRESS 0x9FE7E4 /end MEASUREMENT
/begin MEASUREMENT AirCtl_rCtlRgn2_mp "stationaerer Sollwert aus Regenerationskennfeld-2" SWORD Prc 1 100 -327.6800 327.6700 FORMAT "%8.4" ARRAY_SIZE 3 ECU_ADDRESS 0x9FE7EA /end MEASUREMENT
/begin MEASUREMENT AirCtl_rCtlRgnCorr1_mp "Korrigierter Sollwert für die Luftmasse für den  Regenerationsbetrieb" SWORD Prc 1 100 -327.6800 327.6700 FORMAT "%8.4" ARRAY_SIZE 3 ECU_ADDRESS 0x9FE7F0 /end MEASUREMENT
/begin MEASUREMENT AirCtl_rCtlRgnCorr_mp "Korrigierter Sollwert für die Luftmasse für den Regenerationsbetrieb" SWORD Prc 1 100 -327.6800 327.6700 FORMAT "%8.4" ARRAY_SIZE 3 ECU_ADDRESS 0x9FE7F6 /end MEASUREMENT
/begin MEASUREMENT AirCtl_rCtlRgn_mp "Steuerwert im Regenerationsbetrieb" SWORD Prc 1 100 -327.6800 327.6700 FORMAT "%8.4" ARRAY_SIZE 3 ECU_ADDRESS 0x9FE7FC /end MEASUREMENT
/begin MEASUREMENT AirCtl_rCtlVal "stationärer Steueranteil der Stellgröße" SWORD Prc 1 100 -327.6800 327.6700 FORMAT "%8.4" ECU_ADDRESS 0x7F9654 /end MEASUREMENT
/begin MEASUREMENT AirCtl_rCtlValByp_mp "Bypass message für AirCtl_rCtlVal" SWORD Prc 1 100 -327.6800 327.6700 FORMAT "%8.4" ECU_ADDRESS 0x9FE810 /end MEASUREMENT
/begin MEASUREMENT AirCtl_rCtlVal_mp "Ausgang Rampenschalter" SWORD Prc 1 100 -327.6800 327.6700 FORMAT "%8.4" ECU_ADDRESS 0x9FE812 /end MEASUREMENT
/begin MEASUREMENT AirCtl_rEGR "Stellgröße für das ARF-Ventil" SWORD Prc 1 100 -327.6800 327.6700 FORMAT "%8.4" ECU_ADDRESS 0x7F9656 /end MEASUREMENT
/begin MEASUREMENT AirCtl_rEGRByp_mp "Bypass-Label, Kopie von AirCtl_rEGR" SWORD Prc 1 100 -327.6800 327.6700 FORMAT "%8.4" ECU_ADDRESS 0x9FE8C0 /end MEASUREMENT
/begin MEASUREMENT AirCtl_rEGRNSGearChng_mp "EGR Wert für aktives Anti-Kaudern bei Gangwechsel" SWORD Prc 1 100 -327.6800 327.6700 FORMAT "%8.4" ECU_ADDRESS 0x9FE8C2 /end MEASUREMENT
/begin MEASUREMENT AirCtl_rEGRNSOvrRun_mp "EGR Wert für aktives Anti-Kaudern bei Schubbetrieb" SWORD Prc 1 100 -327.6800 327.6700 FORMAT "%8.4" ECU_ADDRESS 0x9FE8C4 /end MEASUREMENT
/begin MEASUREMENT AirCtl_rEGRPT1NS_mp "gefilterter AirCtl_rGovEGR Wert für Anti-Kaudern" SWORD Prc 1 100 -327.6800 327.6700 FORMAT "%8.4" ECU_ADDRESS 0x9FE8C6 /end MEASUREMENT
/begin MEASUREMENT AirCtl_RevThres_mp "ermittelter Schwellwert des Umdrehungszählers" SWORD OneToOne 1 100 -32768.00 32767.00 FORMAT "%8.2" ECU_ADDRESS 0x9FE84E /end MEASUREMENT
/begin MEASUREMENT AirCtl_rGovBrkCor_mp "Ausgang des Einspritzkennfeldes mit Anfahroffset" SWORD Prc 1 100 -327.6800 327.6700 FORMAT "%8.4" ECU_ADDRESS 0x9FE876 /end MEASUREMENT
/begin MEASUREMENT AirCtl_rGovEGR "Reglerstellgröße für Abgasrückführventil" SWORD Prc 1 100 -327.6800 327.6700 FORMAT "%8.4" ECU_ADDRESS 0x7F9658 /end MEASUREMENT
/begin MEASUREMENT AirCtl_rGovHys1_mp "Ausgang 1. Teil von Dreifachhysterese" SWORD Prc 1 100 -327.6800 327.6700 FORMAT "%8.4" ECU_ADDRESS 0x9FE878 /end MEASUREMENT
/begin MEASUREMENT AirCtl_rGovHys2_mp "Ausgang 2. Teil von Dreifachhysterese" SWORD Prc 1 100 -327.6800 327.6700 FORMAT "%8.4" ECU_ADDRESS 0x9FE87A /end MEASUREMENT
/begin MEASUREMENT AirCtl_rGovHysSw_mp "Ausgang Dreifachhysterese nach Auswahlschalter" SWORD Prc 1 100 -327.6800 327.6700 FORMAT "%8.4" ECU_ADDRESS 0x9FE87C /end MEASUREMENT
/begin MEASUREMENT AirCtl_rGovHys_mp "Ausgang Dreifachhysterese" SWORD Prc 1 100 -327.6800 327.6700 FORMAT "%8.4" ECU_ADDRESS 0x9FE87E /end MEASUREMENT
/begin MEASUREMENT AirCtl_rGovMax_mp "Maximum für Luftmassenregler" SWORD Prc 1 100 -327.6800 327.6700 FORMAT "%8.4" ECU_ADDRESS 0x9FE880 /end MEASUREMENT
/begin MEASUREMENT AirCtl_rGovMin_mp "Minimum für Luftmassenregelung" SWORD Prc 1 100 -327.6800 327.6700 FORMAT "%8.4" ECU_ADDRESS 0x9FE882 /end MEASUREMENT
/begin MEASUREMENT AirCtl_rGovOutByp_mp "Messpunkt für Bypass Freischnitt" SWORD Prc 1 100 -327.6800 327.6700 FORMAT "%8.4" ECU_ADDRESS 0x9FE884 /end MEASUREMENT
/begin MEASUREMENT AirCtl_rGovOut_mp "Ausgang des Reglers - Reglerstellgröße" SWORD Prc 1 100 -327.6800 327.6700 FORMAT "%8.4" ECU_ADDRESS 0x9FE886 /end MEASUREMENT
/begin MEASUREMENT AirCtl_rGovPre_mp "Ausgang des Luftmassenreglers" SWORD Prc 1 100 -327.6800 327.6700 FORMAT "%8.4" ECU_ADDRESS 0x9FE888 /end MEASUREMENT
/begin MEASUREMENT AirCtl_rGovQDes_mp "Ausgang Hauptkennfeld" SWORD Prc 1 100 -327.6800 327.6700 FORMAT "%8.4" ECU_ADDRESS 0x9FE88A /end MEASUREMENT
/begin MEASUREMENT AirCtl_rGovRgnEGR1_mp "EGR  Wert für Partikelfilter Regeneration 1" SWORD Prc 1 100 -327.6800 327.6700 FORMAT "%8.4" ECU_ADDRESS 0x9FE88C /end MEASUREMENT
/begin MEASUREMENT AirCtl_rGovRgnEGR2_mp "EGR Wert für Partikelfilter Regeneration 2" SWORD Prc 1 100 -327.6800 327.6700 FORMAT "%8.4" ECU_ADDRESS 0x9FE88E /end MEASUREMENT
/begin MEASUREMENT AirCtl_rGovRgnEGR_mp "Begrenzerausgang für Partikelfilter Regeneration" SWORD Prc 1 100 -327.6800 327.6700 FORMAT "%8.4" ARRAY_SIZE 2 ECU_ADDRESS 0x9FE858 /end MEASUREMENT
/begin MEASUREMENT AirCtl_rGovRgnMin_mp "Minimumwert der Luftmassenregelung während Regeneration" SWORD Prc 1 100 -327.6800 327.6700 FORMAT "%8.4" ECU_ADDRESS 0x9FE890 /end MEASUREMENT
/begin MEASUREMENT AirCtl_rGovRgnTVA1_mp "TVA Wert für Partikelfilter Regeneration 1" SWORD Prc 1 100 -327.6800 327.6700 FORMAT "%8.4" ECU_ADDRESS 0x9FE892 /end MEASUREMENT
/begin MEASUREMENT AirCtl_rGovRgnTVA2_mp "TVA  Wert für Partikelfilter Regeneration 2" SWORD Prc 1 100 -327.6800 327.6700 FORMAT "%8.4" ECU_ADDRESS 0x9FE894 /end MEASUREMENT
/begin MEASUREMENT AirCtl_rGovRgnTVA_mp "Begrenzerausgang für Partikelfilter Regeneration" SWORD Prc 1 100 -327.6800 327.6700 FORMAT "%8.4" ARRAY_SIZE 2 ECU_ADDRESS 0x9FE85C /end MEASUREMENT
/begin MEASUREMENT AirCtl_rGovStdEGR_mp "Standard Begrenzerausgang" SWORD Prc 1 100 -327.6800 327.6700 FORMAT "%8.4" ECU_ADDRESS 0x9FE896 /end MEASUREMENT
/begin MEASUREMENT AirCtl_rGovStdTVA_mp "Standard Begrenzerausgang" SWORD Prc 1 100 -327.6800 327.6700 FORMAT "%8.4" ECU_ADDRESS 0x9FE898 /end MEASUREMENT
/begin MEASUREMENT AirCtl_rGovTEngCor_mp "Ausgang Temperaturkorrekturkennfeld" SWORD Prc 1 100 -327.6800 327.6700 FORMAT "%8.4" ECU_ADDRESS 0x9FE89A /end MEASUREMENT
/begin MEASUREMENT AirCtl_rGovTVA "Reglerstellgröße für Drosselklappe" SWORD Prc 1 100 -327.6800 327.6700 FORMAT "%8.4" ECU_ADDRESS 0x7F965A /end MEASUREMENT
/begin MEASUREMENT AirCtl_rGovTVA1_mp "Begrenzerausgang Drosselklappe" SWORD Prc 1 100 -327.6800 327.6700 FORMAT "%8.4" ECU_ADDRESS 0x9FE89C /end MEASUREMENT
/begin MEASUREMENT AirCtl_rGovTVAByp_mp "Messpunkt für Bypass Freischnitt" SWORD Prc 1 100 -327.6800 327.6700 FORMAT "%8.4" ECU_ADDRESS 0x9FE89E /end MEASUREMENT
/begin MEASUREMENT AirCtl_rGovTVAPre_mp "TVA Tastverhältnis vor dem Luftmassenausgleichsregler" SWORD Prc 1 100 -327.6800 327.6700 FORMAT "%8.4" ECU_ADDRESS 0x9FE8A0 /end MEASUREMENT
/begin MEASUREMENT AirCtl_rGovTVAUnLim_mp "Unbegrenzte Reglerstellgröße für die Drosselklappe" SWORD Prc 1 100 -327.6800 327.6700 FORMAT "%8.4" ECU_ADDRESS 0x9FE8A2 /end MEASUREMENT
/begin MEASUREMENT AirCtl_rILimCor_mp "korrigierte I-Limitierung" SWORD Prc 1 100 -327.6800 327.6700 FORMAT "%8.4" ECU_ADDRESS 0x9FE8A4 /end MEASUREMENT
/begin MEASUREMENT AirCtl_rIMin_mp "minimaler I Anteil des Reglers" SWORD Prc 1 100 -327.6800 327.6700 FORMAT "%8.4" ECU_ADDRESS 0x9FE8A6 /end MEASUREMENT
/begin MEASUREMENT AirCtl_rLambdaLim_mp "Kennfeldausgang AirCtl_rLambdaLim_MAP" SWORD Prc 1 100 -327.6800 327.6700 FORMAT "%8.4" ECU_ADDRESS 0x9FE8A8 /end MEASUREMENT
/begin MEASUREMENT AirCtl_rLmbdRecCor_mp "korrigierter reziproker Lambdawert" SWORD lambdaRec 1 100 -3.276800 3.276700 FORMAT "%8.6" ECU_ADDRESS 0x9FE8AA /end MEASUREMENT
/begin MEASUREMENT AirCtl_rLmbdRec_mp "reziproker Lamdawert" SWORD lambdaRec 1 100 -3.276800 3.276700 FORMAT "%8.6" ECU_ADDRESS 0x9FE8AC /end MEASUREMENT
/begin MEASUREMENT AirCtl_rLmbd_mp "berechneter Lambdawert" SWORD lambda 1 100 -32.76800 32.76700 FORMAT "%8.5" ECU_ADDRESS 0x9FE8AE /end MEASUREMENT
/begin MEASUREMENT AirCtl_rOutDDyn_mp "Ausgang vom DT1-Glied oder 0.0 - in Abhängigkeit von Air_mGovDev" SWORD Prc 1 100 -327.6800 327.6700 FORMAT "%8.4" ECU_ADDRESS 0x9FE8B0 /end MEASUREMENT
/begin MEASUREMENT AirCtl_rOutD_mp "dynamisches Steuersignal - Ausgang DT1-Glied" SWORD Prc 1 100 -327.6800 327.6700 FORMAT "%8.4" ECU_ADDRESS 0x9FE8B2 /end MEASUREMENT
/begin MEASUREMENT AirCtl_rOutI_mp "Ausgang des Regler-I-Kanals bei der ARF" SWORD Prc 1 100 -327.6800 327.6700 FORMAT "%8.4" ECU_ADDRESS 0x9FE8B4 /end MEASUREMENT
/begin MEASUREMENT AirCtl_rOutP_mp "Ausgang des Regler-P-Kanals bei der ARF" SWORD Prc 1 100 -327.6800 327.6700 FORMAT "%8.4" ECU_ADDRESS 0x9FE8B6 /end MEASUREMENT
/begin MEASUREMENT AirCtl_rPT1EGR_mp "PT1 gefilterter Wert von AirCtl_rEGR" SWORD DtyCyc 1 100 -327.6800 327.6700 FORMAT "%8.4" ECU_ADDRESS 0x9FE7E0 /end MEASUREMENT
/begin MEASUREMENT AirCtl_rTVA "Sollposition des Regelklappen-Stellers" SWORD Prc 1 100 -327.6800 327.6700 FORMAT "%8.4" ECU_ADDRESS 0x7F965C /end MEASUREMENT
/begin MEASUREMENT AirCtl_rTVAByp_mp "Bypass-Label, Kopie von AirCtl_rTVA" SWORD Prc 1 100 -327.6800 327.6700 FORMAT "%8.4" ECU_ADDRESS 0x9FE8C8 /end MEASUREMENT
/begin MEASUREMENT AirCtl_rTVANSGearChng_mp "TVA Wert für aktives Anti-Kaudern bei Gangwechsel" SWORD Prc 1 100 -327.6800 327.6700 FORMAT "%8.4" ECU_ADDRESS 0x9FE8CA /end MEASUREMENT
/begin MEASUREMENT AirCtl_rTVANSOvrRun_mp "TVA Wert für aktives Anti-Kaudern bei Schubbetrieb" SWORD Prc 1 100 -327.6800 327.6700 FORMAT "%8.4" ECU_ADDRESS 0x9FE8CC /end MEASUREMENT
/begin MEASUREMENT AirCtl_rTVAPT1NS_mp "gefilterter AirCtl_rGovTVA Wert für Anti-Kaudern" SWORD Prc 1 100 -327.6800 327.6700 FORMAT "%8.4" ECU_ADDRESS 0x9FE8CE /end MEASUREMENT
/begin MEASUREMENT AirCtl_stActvNS "Status der Anti-Kaudern-Maßnahme" UBYTE OneToOne 1 100 0.00 255.0 FORMAT "%5.1" ECU_ADDRESS 0x7F92F5 /end MEASUREMENT
/begin MEASUREMENT AirCtl_stAirCtl "Anzeige der Abschaltursache in der ARF-Überwachung" SWORD OneToOne 1 100 -32768.00 32767.00 FORMAT "%8.2" ECU_ADDRESS 0x7F965E /end MEASUREMENT
/begin MEASUREMENT AirCtl_stAirCtlBits_mp "Anzeige der Abschaltursache in der ARF-Überwachung (bitorientiert)" ULONG OneToOne 1 100 0.00 4294967295.00 FORMAT "%13.2" ECU_ADDRESS 0x9FE3E0 /end MEASUREMENT
/begin MEASUREMENT AirCtl_stAirCtl_mp "Abschaltursache, die auf die  Abgas-Rückführ- und Drosselklappen-Regelung wirkt" UBYTE OneToOne 1 100 0.00 255.0 FORMAT "%5.1" ECU_ADDRESS 0x7FDDDA /end MEASUREMENT
/begin MEASUREMENT AirCtl_stBasAdj "Status der Grundeinstellung im Modul AirCtl; (höherpriore Abschaltanforderung)  (Diagnose)" UBYTE OneToOne 1 100 0.00 255.0 FORMAT "%5.1" ECU_ADDRESS 0x7F92F7 /end MEASUREMENT
/begin MEASUREMENT AirCtl_stBPDem "Status der Ladedruckanforderung" UBYTE OneToOne 1 100 0.00 255.0 FORMAT "%5.1" ECU_ADDRESS 0x7F92F6 /end MEASUREMENT
/begin MEASUREMENT AirCtl_stBypValvAirMass_mp "Abschaltanforderung für EGR Kühler Bypass von Luftmassensollwert" UBYTE OneToOne 1 100 0.00 255.0 FORMAT "%5.1" ECU_ADDRESS 0x9FF9DC /end MEASUREMENT
/begin MEASUREMENT AirCtl_stBypValvtAir_mp "Status der Ansauglufttemperatur" UBYTE OneToOne 1 100 0.00 255.0 FORMAT "%5.1" ECU_ADDRESS 0x9FF9DD /end MEASUREMENT
/begin MEASUREMENT AirCtl_stBypValvtClnt_mp "Abschaltanforderung für EGR Kühler Bypass von Kühlwassertemperatur" UBYTE OneToOne 1 100 0.00 255.0 FORMAT "%5.1" ECU_ADDRESS 0x9FF9DE /end MEASUREMENT
/begin MEASUREMENT AirCtl_stCBVAftRun_mp "Status der Stelleranforderung im Nachlauf" UBYTE OneToOne 1 100 0.00 255.0 FORMAT "%5.1" ECU_ADDRESS 0x9FF9DF /end MEASUREMENT
/begin MEASUREMENT AirCtl_stDebDef "Flag für Fehler Entprellbedingung" UBYTE OneToOne 1 100 0.00 255.0 FORMAT "%5.1" ECU_ADDRESS 0x7F92F8 /end MEASUREMENT
/begin MEASUREMENT AirCtl_stDebDefRgn_mp "Status, ob Regelabweichung Regenerationsbetrieb überwacht" UBYTE OneToOne 1 100 0.00 255.0 FORMAT "%5.1" ECU_ADDRESS 0x9FF9E5 /end MEASUREMENT
/begin MEASUREMENT AirCtl_stEGRClgBypVlv "Status des EGR-Kühler Bypass Ventils" UBYTE OneToOne 1 100 0.00 255.0 FORMAT "%5.1" ECU_ADDRESS 0x7F92F9 /end MEASUREMENT
/begin MEASUREMENT AirCtl_stEGRClgBypVlvByp_mp "Meßpunkt für Bypass Freischnitt" UBYTE OneToOne 1 100 0.00 255.0 FORMAT "%5.1" ECU_ADDRESS 0x9FF9E0 /end MEASUREMENT
/begin MEASUREMENT AirCtl_stEGRClg_mp "Status der Stelleranforderung nach Klemme 15 ein und im Schubbetrieb" UBYTE OneToOne 1 100 0.00 255.0 FORMAT "%5.1" ECU_ADDRESS 0x9FF9E1 /end MEASUREMENT
/begin MEASUREMENT AirCtl_stFlSel_mp "Kraftstoff Auswahlschalter Status" SWORD OneToOne 1 100 -32768.00 32767.00 FORMAT "%8.2" ECU_ADDRESS 0x9FE856 /end MEASUREMENT
/begin MEASUREMENT AirCtl_stGovHys "Status für Reglerabschaltung über Hysterese" UBYTE OneToOne 1 100 0.00 255.0 FORMAT "%5.1" ECU_ADDRESS 0x7F92FA /end MEASUREMENT
/begin MEASUREMENT AirCtl_stHealDefRgn_mp "Defektheilungsbedingungs Flag für den Regenerationsmouds" UBYTE OneToOne 1 100 0.00 255.0 FORMAT "%5.1" ECU_ADDRESS 0x9FF9E6 /end MEASUREMENT
/begin MEASUREMENT AirCtl_stHealDef_mp "Status, ob Heilung von erkannter bleibender Regelabweichung zulässig" UBYTE OneToOne 1 100 0.00 255.0 FORMAT "%5.1" ECU_ADDRESS 0x9FF9E7 /end MEASUREMENT
/begin MEASUREMENT AirCtl_stHighMsk_mp "Status der Übereinstimmung des EGT-Status mit entsprechender Maske" UBYTE OneToOne 1 100 0.00 255.0 FORMAT "%5.1" ECU_ADDRESS 0x9FF9E8 /end MEASUREMENT
/begin MEASUREMENT AirCtl_stHigh_mp "gewähle Kennlinie in Abhängigkeit von EGT_st" SWORD InjMass 1 100 -327.6800 327.6700 FORMAT "%8.4" ECU_ADDRESS 0x9FE8D0 /end MEASUREMENT
/begin MEASUREMENT AirCtl_stInjQntHyst_mp "Status der Einspritzmengenhysterese" UBYTE OneToOne 1 100 0.00 255.0 FORMAT "%5.1" ECU_ADDRESS 0x9FF9E9 /end MEASUREMENT
/begin MEASUREMENT AirCtl_stLmbdRecCor_mp "Statuswert des Rampenschalters für I-Limitierung" ULONG OneToOne 1 100 0.00 4294967295.00 FORMAT "%13.2" ECU_ADDRESS 0x9FE3D8 /end MEASUREMENT
/begin MEASUREMENT AirCtl_stMiddleMsk_mp "Status der Übereinstimmung des EGT-Status mit entsprechender Maske" UBYTE OneToOne 1 100 0.00 255.0 FORMAT "%5.1" ECU_ADDRESS 0x9FF9EA /end MEASUREMENT
/begin MEASUREMENT AirCtl_stMiddle_mp "gewähle Kennlinie in Abhängigkeit von EGT_st" SWORD InjMass 1 100 -327.6800 327.6700 FORMAT "%8.4" ECU_ADDRESS 0x9FE8D2 /end MEASUREMENT
/begin MEASUREMENT AirCtl_stMonAftShtrp_mp "Bitmaske der Abschaltursachen nach Short Trip Maske" ULONG OneToOne 1 100 0.00 4294967295.00 FORMAT "%13.2" ECU_ADDRESS 0x9FE3E4 /end MEASUREMENT
/begin MEASUREMENT AirCtl_stMonitor "Status: Abschaltfall der Regelung" UBYTE OneToOne 1 100 0.00 255.0 FORMAT "%5.1" ECU_ADDRESS 0x7F92FB /end MEASUREMENT
/begin MEASUREMENT AirCtl_stMonOvr_mp "Status der Schubbetrieberkennung" UBYTE OneToOne 1 100 0.00 255.0 FORMAT "%5.1" ECU_ADDRESS 0x9FF9EB /end MEASUREMENT
/begin MEASUREMENT AirCtl_stMonRsltBits_mp "Bitmaske der Abschaltursachen vor Eingriffe der Abgasnachbehandlung" ULONG OneToOne 1 100 0.00 4294967295.00 FORMAT "%13.2" ECU_ADDRESS 0x9FE3E8 /end MEASUREMENT
/begin MEASUREMENT AirCtl_stOvrRunAtcp "Status Erkennung des erwarteten Schubs" UBYTE OneToOne 1 100 0.00 255.0 FORMAT "%5.1" ECU_ADDRESS 0x7F92FC /end MEASUREMENT
/begin MEASUREMENT AirCtl_stRmpCtlBase_mp "Bitleiste zum Anzeigen der ausgewählten Rampeneingänge in der Basis Steuerwertberechnung" UBYTE OneToOne 1 100 0.00 255.0 FORMAT "%5.1" ECU_ADDRESS 0x9FF9E2 /end MEASUREMENT
/begin MEASUREMENT AirCtl_stRmpCtl_mp "Codierung des gewählten Rampenschalterausgangs" ULONG OneToOne 1 100 0.00 4294967295.00 FORMAT "%13.2" ECU_ADDRESS 0x9FE3C4 /end MEASUREMENT
/begin MEASUREMENT AirCtl_stRmpDesBase_mp "Bitleiste zum Anzeigen der ausgewählten Rampeneingänge in der Basis Sollwertberechnung" UBYTE OneToOne 1 100 0.00 255.0 FORMAT "%5.1" ECU_ADDRESS 0x9FF9E3 /end MEASUREMENT
/begin MEASUREMENT AirCtl_stRmpDes_mp "Codierung des gewählten Rampenschalterausgangs" ULONG OneToOne 1 100 0.00 4294967295.00 FORMAT "%13.2" ECU_ADDRESS 0x9FE3CC /end MEASUREMENT
/begin MEASUREMENT AirCtl_stRmpGov_mp "Statuswort für den gewählten Rampenschalters" ULONG OneToOne 1 100 0.00 4294967295.00 FORMAT "%13.2" ECU_ADDRESS 0x9FE3DC /end MEASUREMENT
/begin MEASUREMENT AirCtl_stStartTmr_mp "Statusbits der Schaltbedingungen" UBYTE OneToOne 1 100 0.00 255.0 FORMAT "%5.1" ECU_ADDRESS 0x9FF9DB /end MEASUREMENT
/begin MEASUREMENT AirCtl_stTimerOn_mp "Status für Timerstart" UBYTE OneToOne 1 100 0.00 255.0 FORMAT "%5.1" ECU_ADDRESS 0x9FF9EC /end MEASUREMENT
/begin MEASUREMENT AirCtl_swtAPCor "Schalter für add./mult. Atmosphärendruckkorrektur" UBYTE OneToOne 1 100 0.00 255.0 FORMAT "%5.1" ECU_ADDRESS 0x7F92FD /end MEASUREMENT
/begin MEASUREMENT AirCtl_swtATCor "Schalter für add./mult. Lufttemperaturkorrektur" UBYTE OneToOne 1 100 0.00 255.0 FORMAT "%5.1" ECU_ADDRESS 0x7F92FE /end MEASUREMENT
/begin MEASUREMENT AirCtl_swtGov "Schalter für Reglerabschaltung" UBYTE OneToOne 1 100 0.00 255.0 FORMAT "%5.1" ECU_ADDRESS 0x7F92FF /end MEASUREMENT
/begin MEASUREMENT AirCtl_swtLdDet_mp "Drosselklappenwert nach negativen Lastwechsel eingefroren (1=aktiv)" UBYTE OneToOne 1 100 0.00 255.0 FORMAT "%5.1" ECU_ADDRESS 0x9FF9E4 /end MEASUREMENT
/begin MEASUREMENT AirCtl_swtTrm "Schalter für add./mult. Abgleichkorrektur" UBYTE OneToOne 1 100 0.00 255.0 FORMAT "%5.1" ECU_ADDRESS 0x7F9300 /end MEASUREMENT
/begin MEASUREMENT AirCtl_tiBPAHold_mp "ermittelte Einfrierzeit für den Ladedruckregler" SWORD Time_ms 1 100 -327680.0 327670.0 FORMAT "%8.1" ECU_ADDRESS 0x9FE7E2 /end MEASUREMENT
/begin MEASUREMENT AirCtl_tiCtlValRgnPT1Cor_mp "Zeitkonstante für Dämpfung der Drosselklappe" ULONG TimeDelay_s 1 100 0.0000010000000 4294.9673 FORMAT "%9.4" ECU_ADDRESS 0x9FE3C8 /end MEASUREMENT
/begin MEASUREMENT AirCtl_tiDesValRgnPT1Cor_mp "Zeitkonstante für Dämpfung der Drosselklappe" ULONG TimeDelay_s 1 100 0.0000010000000 4294.9673 FORMAT "%9.4" ECU_ADDRESS 0x9FE3D0 /end MEASUREMENT
/begin MEASUREMENT AirCtl_tiDlyTimer_mp "Zeit für Verzögerungstimer" ULONG Time_ms 1 100 0.00 42949672950.0 FORMAT "%13.1" ECU_ADDRESS 0x9FE3EC /end MEASUREMENT
/begin MEASUREMENT AirCtl_tiStrtDelay_mp "Zeit, in der die Regelung nach Startabwurf abgeschaltet bleibt" UWORD Time_ms 1 100 0.00 655350.0 FORMAT "%8.1" ECU_ADDRESS 0x9FE8D4 /end MEASUREMENT
/begin MEASUREMENT AirCtl_tRevThres_mp "Temperaturwert von dem Array Eng_tFld" SWORD Temp_Cels 1 100 -3549.940 3003.560 FORMAT "%8.3" ECU_ADDRESS 0x9FE850 /end MEASUREMENT
/begin MEASUREMENT AirCtl_TrmValLim "Abgleichwert für Luftmassensoll- und steuerwert" SWORD AirMassPerCyl 1 100 -3276.800 3276.700 FORMAT "%8.3" ECU_ADDRESS 0x7F963A /end MEASUREMENT
/begin MEASUREMENT AirCtl_TrmVal_mp "Abgleichwert für ARF" SWORD AirMassPerCyl 1 100 -3276.800 3276.700 FORMAT "%8.3" ECU_ADDRESS 0x9FE852 /end MEASUREMENT
/begin MEASUREMENT AirCtl_trqCrCtlHys_mp "Eingangswert der AirCtl_trqCrCtloff Hysterese" SLONG Trq 1 100 -214748364.800 214748364.700 FORMAT "%13.3" ECU_ADDRESS 0x9FE3F0 /end MEASUREMENT
/begin MEASUREMENT AirCtl_tStrtDelay_mp "Temperaturwert von dem Array Eng_tFld" SWORD Temp_Cels 1 100 -3549.940 3003.560 FORMAT "%8.3" ECU_ADDRESS 0x9FE8D6 /end MEASUREMENT
/begin MEASUREMENT AirSys_stCmpntActv "Statusvariable für Endstufenabschaltung" UWORD OneToOne 1 100 0.00 65535.00 FORMAT "%8.2" ECU_ADDRESS 0x7F9660 /end MEASUREMENT
/begin MEASUREMENT AirSys_stTstDem "Statusvariable für Stellertest bei Diagnoseeingriff" UWORD OneToOne 1 100 0.00 65535.00 FORMAT "%8.2" ECU_ADDRESS 0x7F9662 /end MEASUREMENT
/begin MEASUREMENT AltCD_ctPeriod "letzter Wert des HW-Zählers" UBYTE OneToOne 1 100 0.00 255.0 FORMAT "%5.1" ECU_ADDRESS 0x7F9302 /end MEASUREMENT
/begin MEASUREMENT AltCD_ctPlausErr "Wert des Fehlerzählers" UBYTE OneToOne 1 100 0.00 255.0 FORMAT "%5.1" ECU_ADDRESS 0x7F9303 /end MEASUREMENT
/begin MEASUREMENT AltCD_dcycAltLoad "gemessenes Tastverhältnis des Generatorlastsignals" SWORD DtyCyc 1 100 -327.6800 327.6700 FORMAT "%8.4" ECU_ADDRESS 0x7F9664 /end MEASUREMENT
/begin MEASUREMENT AltCD_rAltLoad "Linearisiertes und fehlerentprelltes Generatorlastsignals" SWORD Prc 1 100 -327.6800 327.6700 FORMAT "%8.4" ECU_ADDRESS 0x7F9666 /end MEASUREMENT
/begin MEASUREMENT AltCD_rAltLoadUnFlt "Generatorlast (mit kurzer Filterzeitkonstante gefiltert)" SWORD Prc 1 100 -327.6800 327.6700 FORMAT "%8.4" ECU_ADDRESS 0x7F9668 /end MEASUREMENT
/begin MEASUREMENT AltCD_stAltProvDef "Status ob Generator vorläufig defekt ist" UBYTE OneToOne 1 100 0.00 255.0 FORMAT "%5.1" ECU_ADDRESS 0x7F9304 /end MEASUREMENT
/begin MEASUREMENT AltCD_stErr_mp "Fehlerinformation der PWM-Erfassung" UBYTE OneToOne 1 100 0.00 255.0 FORMAT "%5.1" ECU_ADDRESS 0x9FF9EE /end MEASUREMENT
/begin MEASUREMENT AltCD_stPwrStgExc_mp "Endstufenfehlerinformation der Generatorerregung" UWORD OneToOne 1 100 0.00 65535.00 FORMAT "%8.2" ECU_ADDRESS 0x9FE8DC /end MEASUREMENT
/begin MEASUREMENT AltCD_stWrite_mp "Status des Beschreibens des Buffers" UBYTE OneToOne 1 100 0.00 255.0 FORMAT "%5.1" ECU_ADDRESS 0x9FF9EF /end MEASUREMENT
/begin MEASUREMENT AltCD_tiActPer_mp "Aktuelle Periode PWM-in Generatorlastsignal" UWORD Period_ms 1 100 0.00 6553.500 FORMAT "%8.3" ECU_ADDRESS 0x9FE8DE /end MEASUREMENT
/begin MEASUREMENT AltCD_tiHighTimeCurrent_mp "aktueller Wert der Hightime" SLONG Time_PwmHigh 1 100 -214748364.800 214748364.700 FORMAT "%13.3" ECU_ADDRESS 0x9FE3F4 /end MEASUREMENT
/begin MEASUREMENT Alt_dcycAlt "Tastverhältnis für Generatorerregung" SWORD DtyCyc 1 100 -327.6800 327.6700 FORMAT "%8.4" ECU_ADDRESS 0x7F966A /end MEASUREMENT
/begin MEASUREMENT Alt_facDemandEEP_mp "Limitierter EEPROM Abgleichwert von ALT_PWR_DEMAND" SWORD Fact 1 100 -4.000000 3.999878 FORMAT "%8.6" ECU_ADDRESS 0x9FE8DA /end MEASUREMENT
/begin MEASUREMENT Alt_pwrDes "mechanischer Leistungsbedarf des Generators" SWORD Pwr 1 100 -308831.1 308821.7 FORMAT "%8.1" ECU_ADDRESS 0x7F966C /end MEASUREMENT
/begin MEASUREMENT Alt_pwrLead "Vorhaltleistung des Generators" SWORD Pwr 1 100 -308831.1 308821.7 FORMAT "%8.1" ECU_ADDRESS 0x7F966E /end MEASUREMENT
/begin MEASUREMENT Alt_stAltExc_mp "Status der Statemachine" UBYTE OneToOne 1 100 0.00 255.0 FORMAT "%5.1" ECU_ADDRESS 0x9FF9ED /end MEASUREMENT
/begin MEASUREMENT Alt_stTrqInprec "Ersatzwert für Generatorleistung wird verwendet" UBYTE OneToOne 1 100 0.00 255.0 FORMAT "%5.1" ECU_ADDRESS 0x7F9305 /end MEASUREMENT
/begin MEASUREMENT Alt_swtPwrCan "Schalter für Generatorleistung über CAN" UBYTE OneToOne 1 100 0.00 255.0 FORMAT "%5.1" ECU_ADDRESS 0x7F9306 /end MEASUREMENT
/begin MEASUREMENT Alt_swtPwrDetCan "Generatorleistung über CAN BEM Botschaft (=1) oder PWM/BSG Botschaft (=0)" UBYTE OneToOne 1 100 0.00 255.0 FORMAT "%5.1" ECU_ADDRESS 0x7F9307 /end MEASUREMENT
/begin MEASUREMENT Alt_tiBEMLdResp "Lastreaktionszeit Generator" UWORD Time_s 1 100 0.00 655.3500 FORMAT "%8.4" ECU_ADDRESS 0x7F9670 /end MEASUREMENT
/begin MEASUREMENT Alt_tiExcdly_mp "Verzögerungszeit der Generatorerregung" SWORD Time_ms 1 100 -327680.0 327670.0 FORMAT "%8.1" ECU_ADDRESS 0x9FE8D8 /end MEASUREMENT
/begin MEASUREMENT AOHtCD_dvolFlConsum "Aktueller Zuheizerverbrauch in l/h" SWORD FlConsum_l_h 1 100 -327.6800 327.6700 FORMAT "%8.4" ECU_ADDRESS 0x7F95F4 /end MEASUREMENT
/begin MEASUREMENT AOHtCD_stUsrSwtDebVal "Status von Zuheizer Fahrerschalter (entprellt)" UBYTE OneToOne 1 100 0.00 255.0 FORMAT "%5.1" ECU_ADDRESS 0x7F92CE /end MEASUREMENT
/begin MEASUREMENT AOHtCD_stUsrSwtRawVal "Status von Zuheizer Fahrerschalter (Rohwert)" UBYTE OneToOne 1 100 0.00 255.0 FORMAT "%5.1" ECU_ADDRESS 0x7F92CF /end MEASUREMENT
/begin MEASUREMENT AOHtCD_swtHeater12Ena "Message, ob Schalterwert Zuheizer 1 und 2 aktiviert (=1) oder deaktiviert (=0) sind" UBYTE OneToOne 1 100 0.00 255.0 FORMAT "%5.1" ECU_ADDRESS 0x7F92D0 /end MEASUREMENT
/begin MEASUREMENT AOHtCD_tiPerAvrg_mp "Periodentime aus der HWK" SLONG Time_ms 1 100 -21474836480.0 21474836470.0 FORMAT "%13.1" ECU_ADDRESS 0x9FE3F8 /end MEASUREMENT
/begin MEASUREMENT AOHtCD_volFlConsum "Aktueller Zuheizerverbrauch in ul" SWORD FlConsum_ul_1 1 100 -32.76800 32.76700 FORMAT "%8.5" ECU_ADDRESS 0x7F95F6 /end MEASUREMENT
/begin MEASUREMENT AOHt_nMin "Minimum Leerlaufsolldrehzahlanforderung durch Zuheizer" SWORD EngN 1 100 -32768.00 32767.00 FORMAT "%8.2" ECU_ADDRESS 0x7F95F8 /end MEASUREMENT
/begin MEASUREMENT AOHt_nMin_mp "Minimale Leerlaudsolldrehzahlanforderung durch Zuheizer vor PT1" SWORD EngN 1 100 -32768.00 32767.00 FORMAT "%8.2" ECU_ADDRESS 0x9FE8E0 /end MEASUREMENT
/begin MEASUREMENT AOHt_NumRly_mp "Anzahl aktiver Heitzelemente" SWORD OneToOne 1 100 -32768.00 32767.00 FORMAT "%8.2" ECU_ADDRESS 0x7FDDDC /end MEASUREMENT
/begin MEASUREMENT AOHt_rOff_mp "Meßpunkt der Generatorlast Abschaltschwelle" SWORD Prc 1 100 -327.6800 327.6700 FORMAT "%8.4" ECU_ADDRESS 0x9FE8E2 /end MEASUREMENT
/begin MEASUREMENT AOHt_rOn_mp "Meßpunkt der Generatorlast Zuschaltschwelle" SWORD Prc 1 100 -327.6800 327.6700 FORMAT "%8.4" ECU_ADDRESS 0x9FE8E4 /end MEASUREMENT
/begin MEASUREMENT AOHt_stHt1Out "Messages an Komponententreiber  Zuheizer 1 (Ein/Aus)" UBYTE OneToOne 1 100 0.00 255.0 FORMAT "%5.1" ECU_ADDRESS 0x7F92D1 /end MEASUREMENT
/begin MEASUREMENT AOHt_stHt2Out "Messages an Komponententreiber  Zuheizer 2 (Ein/Aus)" UBYTE OneToOne 1 100 0.00 255.0 FORMAT "%5.1" ECU_ADDRESS 0x7F92D2 /end MEASUREMENT
/begin MEASUREMENT AOHt_stHt3Out "Messages an Komponententreiber  Zuheizer 3 (Ein/Aus)" UBYTE OneToOne 1 100 0.00 255.0 FORMAT "%5.1" ECU_ADDRESS 0x7F92D3 /end MEASUREMENT
/begin MEASUREMENT AOHt_stOK "Statusbereitschaft zum Einschalten der Zusatzheizung" UBYTE OneToOne 1 100 0.00 255.0 FORMAT "%5.1" ECU_ADDRESS 0x7F92D4 /end MEASUREMENT
/begin MEASUREMENT AOHt_stShutOff_mp "Überblick auf alle Abschaltbedingungen" UWORD OneToOne 1 100 0.00 65535.00 FORMAT "%8.2" ECU_ADDRESS 0x7FDDDE /end MEASUREMENT
/begin MEASUREMENT AOHt_swtACEngOff "Motor AUS trotz AC Anforderung" UBYTE OneToOne 1 100 0.00 255.0 FORMAT "%5.1" ECU_ADDRESS 0x7F92D5 /end MEASUREMENT
/begin MEASUREMENT AOHt_swtHtEngOff "Motor AUS trotz Kühlwasserheizungsanfordern" UBYTE OneToOne 1 100 0.00 255.0 FORMAT "%5.1" ECU_ADDRESS 0x7F92D6 /end MEASUREMENT
/begin MEASUREMENT AOHt_swtHtShOff "Kühlwasserheizung-Abschaltung mit Klimakompressor oder Kühlwasserheizungs Anforderung" UBYTE OneToOne 1 100 0.00 255.0 FORMAT "%5.1" ECU_ADDRESS 0x7F92D7 /end MEASUREMENT
/begin MEASUREMENT AOHt_tAir_mp "verwendete Lufttemperatur" SWORD Temp_Cels 1 100 -3549.940 3003.560 FORMAT "%8.3" ECU_ADDRESS 0x9FE8E6 /end MEASUREMENT
/begin MEASUREMENT AOHt_tCltOff_mp "Wassertemperatur Aus-Schwelle für das nächste Heizelement" SWORD Temp_Cels 1 100 -3549.940 3003.560 FORMAT "%8.3" ECU_ADDRESS 0x9FE8E8 /end MEASUREMENT
/begin MEASUREMENT AOHt_tCltOn_mp "Wassertemperatur Ein-Schwelle für das nächste Heizelement" SWORD Temp_Cels 1 100 -3549.940 3003.560 FORMAT "%8.3" ECU_ADDRESS 0x9FE8EA /end MEASUREMENT
/begin MEASUREMENT AOHt_tEngHys_mp "Schalter der Temperaturwert des Arrays auswählt" SWORD Temp_Cels 1 100 -3549.940 3003.560 FORMAT "%8.3" ECU_ADDRESS 0x9FE8EC /end MEASUREMENT
/begin MEASUREMENT APPCD_BegCo_mp "Veralteter Testmesspunkt, nicht beachten!" UWORD OneToOne 1 100 0.00 65535.00 FORMAT "%8.2" ECU_ADDRESS 0x9FE8F0 /end MEASUREMENT
/begin MEASUREMENT APPCD_cntDebPWGDrft_mp "PWG-Drift Fehlerzähler" UBYTE OneToOne 1 100 0.00 255.0 FORMAT "%5.1" ECU_ADDRESS 0x9FF9F0 /end MEASUREMENT
/begin MEASUREMENT APPCD_drAPP1UnFlt "Differenz der Fahrpedal 1 Position ungefilterter Wert" SWORD Prc_D20ms 1 100 -16384.00 16383.50 FORMAT "%8.2" ECU_ADDRESS 0x7F95FA /end MEASUREMENT
/begin MEASUREMENT APPCD_drAPPPrefill "Differenz des ungefilterten PWGs" SWORD Prc_D4ms 1 100 -81920.00 81917.50 FORMAT "%8.2" ECU_ADDRESS 0x7F95FC /end MEASUREMENT
/begin MEASUREMENT APPCD_EndCo_mp "Veralteter Testmesspunkt, nicht beachten!" UWORD OneToOne 1 100 0.00 65535.00 FORMAT "%8.2" ECU_ADDRESS 0x9FE8F2 /end MEASUREMENT
/begin MEASUREMENT APPCD_rAPP1UnFlt "Fahrpedal 1 position ungefilterter Rohwert" SWORD Prc 1 100 -327.6800 327.6700 FORMAT "%8.4" ECU_ADDRESS 0x7F95FE /end MEASUREMENT
/begin MEASUREMENT APPCD_rAPP1UnFltShtrp "Fahrpedal 1 position ungefilterter Rohwert bei Short Trip" SWORD Prc 1 100 -327.6800 327.6700 FORMAT "%8.4" ECU_ADDRESS 0x7F9600 /end MEASUREMENT
/begin MEASUREMENT APPCD_rAPPPrefill "ungefilterte Pedalwert" SWORD Prc 1 100 -327.6800 327.6700 FORMAT "%8.4" ECU_ADDRESS 0x7F9602 /end MEASUREMENT
/begin MEASUREMENT APPCD_rFlt "gefiltertes Pedalwertgebersignal" SWORD Prc 1 100 -327.6800 327.6700 FORMAT "%8.4" ECU_ADDRESS 0x7F9604 /end MEASUREMENT
/begin MEASUREMENT APPCD_rKDThres "Pedalwertschwelle für die Kick down lern Variable bezüglich einer Referenzspannung in  %" UWORD Prc 1 100 0.00 655.3500 FORMAT "%8.4" ECU_ADDRESS 0x7F9606 /end MEASUREMENT
/begin MEASUREMENT APPCD_rLinAPP1_mp "linearisierter Spannungswert von APP1" SWORD Prc 1 100 -327.6800 327.6700 FORMAT "%8.4" ECU_ADDRESS 0x9FE8F4 /end MEASUREMENT
/begin MEASUREMENT APPCD_rRawAPP1 "Pedalwertgeber 1 Position bezüglich Uref in %" UWORD Prc 1 100 0.00 655.3500 FORMAT "%8.4" ECU_ADDRESS 0x7F9608 /end MEASUREMENT
/begin MEASUREMENT APPCD_rRawAPP2 "Pedalwertgeber 2 Position bezüglich Uref in %" UWORD Prc 1 100 0.00 655.3500 FORMAT "%8.4" ECU_ADDRESS 0x7F960A /end MEASUREMENT
/begin MEASUREMENT APPCD_stAPP12def_mp "Messpunkt für unentprellten Gleichlauffehler APP1/APP2" UBYTE OneToOne 1 100 0.00 255.0 FORMAT "%5.1" ECU_ADDRESS 0x9FF9F1 /end MEASUREMENT
/begin MEASUREMENT APPCD_stDiaPWGDrft "Status für Diagnose PWG-Drift." UBYTE OneToOne 1 100 0.00 255.0 FORMAT "%5.1" ECU_ADDRESS 0x7F92D8 /end MEASUREMENT
/begin MEASUREMENT APPCD_stErr1_mp "Fehlerzustand von APP1/2 Signal" UWORD OneToOne 1 100 0.00 65535.00 FORMAT "%8.2" ECU_ADDRESS 0x9FE8F6 /end MEASUREMENT
/begin MEASUREMENT APPCD_stErrSensSig_mp "Fehlerzustand von APP1/2 Signal" UWORD OneToOne 1 100 0.00 65535.00 FORMAT "%8.2" ECU_ADDRESS 0x9FE8F8 /end MEASUREMENT
/begin MEASUREMENT APPCD_stKickDown "Kick Down Zustand des Fahrpedals" UBYTE OneToOne 1 100 0.00 255.0 FORMAT "%5.1" ECU_ADDRESS 0x7F92D9 /end MEASUREMENT
/begin MEASUREMENT APPCD_stLimp "Status Notfahrbetrieb APP" UBYTE OneToOne 1 100 0.00 255.0 FORMAT "%5.1" ECU_ADDRESS 0x7F92DA /end MEASUREMENT
/begin MEASUREMENT APPCD_stLowIdlSwtVal "Status Leergasschalter" UBYTE OneToOne 1 100 0.00 255.0 FORMAT "%5.1" ECU_ADDRESS 0x7F92DB /end MEASUREMENT
/begin MEASUREMENT APPCD_stPrefillErr "zeigt den Status vom Fid (0: Fid nicht verriegelt, 1: Fid verriegelt)" UBYTE OneToOne 1 100 0.00 255.0 FORMAT "%5.1" ECU_ADDRESS 0x7F92DC /end MEASUREMENT
/begin MEASUREMENT APPCD_stPWGDrftErr_mp "Fehlerbedingungszustand für PWG-Drift" UBYTE OneToOne 1 100 0.00 255.0 FORMAT "%5.1" ECU_ADDRESS 0x9FF9F2 /end MEASUREMENT
/begin MEASUREMENT APPCD_stPWGDrftOk_mp "Ok-Bedingungszustand für PWG-Drift" UBYTE OneToOne 1 100 0.00 255.0 FORMAT "%5.1" ECU_ADDRESS 0x9FF9F3 /end MEASUREMENT
/begin MEASUREMENT APPCD_stRawKickDown "Kickdown Rohwert" UBYTE OneToOne 1 100 0.00 255.0 FORMAT "%5.1" ECU_ADDRESS 0x7F92DD /end MEASUREMENT
/begin MEASUREMENT APPCD_stSigSrc "Status der ausgewaehlten Signalquelle APP" UBYTE OneToOne 1 100 0.00 255.0 FORMAT "%5.1" ECU_ADDRESS 0x7F92DE /end MEASUREMENT
/begin MEASUREMENT APPCD_stSwitchSig "Status der Schalterstellungen 1 für Diagnose" UBYTE OneToOne 1 100 0.00 255.0 FORMAT "%5.1" ECU_ADDRESS 0x7F92DF /end MEASUREMENT
/begin MEASUREMENT APPCD_stTempErr_mp "Messpunkt für vorläufigen APP-Fehler" UBYTE OneToOne 1 100 0.00 255.0 FORMAT "%5.1" ECU_ADDRESS 0x9FF9F4 /end MEASUREMENT
/begin MEASUREMENT APPCD_swtPrefillEna "zeigt ob die Prefill Funktion aktiviert oder deaktiviert ist" UBYTE OneToOne 1 100 0.00 255.0 FORMAT "%5.1" ECU_ADDRESS 0x7F92E0 /end MEASUREMENT
/begin MEASUREMENT APPCD_swtType "Auswahl zwischen Doppelanalog- und Poti/Schalter-PWG" UBYTE OneToOne 1 100 0.00 255.0 FORMAT "%5.1" ECU_ADDRESS 0x7F92E1 /end MEASUREMENT
/begin MEASUREMENT APPCD_uAPPunJit_mp "Messpunkt der  APP Rohspannung vor Entjitterung" SWORD Volt 1 100 -160156.4 160151.5 FORMAT "%8.1" ECU_ADDRESS 0x9FE8FA /end MEASUREMENT
/begin MEASUREMENT APPCD_uDiffMax_mp "Maximal zulässige Differenz der Rohspannungen" SWORD Volt 1 100 -160156.4 160151.5 FORMAT "%8.1" ECU_ADDRESS 0x9FE8FC /end MEASUREMENT
/begin MEASUREMENT APPCD_uKickDownHighAPP_mp "Kick-Down Schwellwert hoch" SWORD Volt 1 100 -160156.4 160151.5 FORMAT "%8.1" ECU_ADDRESS 0x9FE8FE /end MEASUREMENT
/begin MEASUREMENT APPCD_uKickDownLowAPP_mp "untere Kick-Down Schwellwert" SWORD Volt 1 100 -160156.4 160151.5 FORMAT "%8.1" ECU_ADDRESS 0x9FE900 /end MEASUREMENT
/begin MEASUREMENT APPCD_uKickDownThres_mp "Gelernter Kick-Down-Schwellwert" SWORD Volt 1 100 -160156.4 160151.5 FORMAT "%8.1" ECU_ADDRESS 0x9FE902 /end MEASUREMENT
/begin MEASUREMENT APPCD_uRawAPP1 "Fahrpedal 1 Position Rohwert" SWORD Volt 1 100 -160156.4 160151.5 FORMAT "%8.1" ECU_ADDRESS 0x7F960C /end MEASUREMENT
/begin MEASUREMENT APPCD_uRawAPP1half_mp "Halbierte APP1 Rohspannung" SWORD Volt 1 100 -160156.4 160151.5 FORMAT "%8.1" ECU_ADDRESS 0x9FE904 /end MEASUREMENT
/begin MEASUREMENT APPCD_uRawAPP2 "Fahrpedal 2 Position Rohwert" SWORD Volt 1 100 -160156.4 160151.5 FORMAT "%8.1" ECU_ADDRESS 0x7F960E /end MEASUREMENT
/begin MEASUREMENT APPCD_uRawAPP2dbl_mp "Verdoppelte APP2 Rohspannung" SWORD Volt 1 100 -160156.4 160151.5 FORMAT "%8.1" ECU_ADDRESS 0x9FE906 /end MEASUREMENT
/begin MEASUREMENT APPCD_uRawAPPPre_mp "ausgewaehlte Rohspannung APP" SWORD Volt 1 100 -160156.4 160151.5 FORMAT "%8.1" ECU_ADDRESS 0x9FE8EE /end MEASUREMENT
/begin MEASUREMENT APPCD_uRawDiff_mp "Betrag der Differenz der Rohspannungen von APP1 und APP2" SWORD Volt 1 100 -160156.4 160151.5 FORMAT "%8.1" ECU_ADDRESS 0x9FE908 /end MEASUREMENT
/begin MEASUREMENT APPCD_uRaw_mp "Messpunkt der ausgewaehlten APP Rohspannung" SWORD Volt 1 100 -160156.4 160151.5 FORMAT "%8.1" ECU_ADDRESS 0x9FE90A /end MEASUREMENT
/begin MEASUREMENT APSCD_BpsAllowed_mp "Wahlschalter - Atmosphaerendruck gemessen (wenn verbaut) od. gerechnet von Ladedrucksensor" UWORD OneToOne 1 100 0.00 65535.00 FORMAT "%8.2" ECU_ADDRESS 0x9FE90C /end MEASUREMENT
/begin MEASUREMENT APSCD_pCorVal_mp "Korrekturwert fuer Atmosphaerendruck von Ladedrucksensor" SWORD Pres_hPa 1 100 -32768.00 32767.00 FORMAT "%8.2" ECU_ADDRESS 0x9FE90E /end MEASUREMENT
/begin MEASUREMENT APSCD_pLinVal "Rohwert Atmosphärendruck über ADC" SWORD Pres_hPa 1 100 -32768.00 32767.00 FORMAT "%8.2" ECU_ADDRESS 0x7F9610 /end MEASUREMENT
/begin MEASUREMENT APSCD_pSensorVal "Atmosphaerendruck Sensorwert" SWORD Pres_hPa 1 100 -32768.00 32767.00 FORMAT "%8.2" ECU_ADDRESS 0x7F9612 /end MEASUREMENT
/begin MEASUREMENT APSCD_pVal "Atmosphärendruck" SWORD Pres_hPa 1 100 -32768.00 32767.00 FORMAT "%8.2" ECU_ADDRESS 0x7F9614 /end MEASUREMENT
/begin MEASUREMENT APSCD_pValByp_mp "Bypass Wert für Atmosphärendruck" SWORD Pres_hPa 1 100 -32768.00 32767.00 FORMAT "%8.2" ECU_ADDRESS 0x9FE910 /end MEASUREMENT
/begin MEASUREMENT APSCD_stSensorInst "Status, ob Atmosphärendrucksensor eingebaut ist (0 == nicht eingebaut)" UBYTE OneToOne 1 100 0.00 255.0 FORMAT "%5.1" ECU_ADDRESS 0x7F92E2 /end MEASUREMENT
/begin MEASUREMENT APSCD_uRaw "Rohspannung ADC-Signal Atmosphärendruck" SWORD Volt 1 100 -160156.4 160151.5 FORMAT "%8.1" ECU_ADDRESS 0x7F9616 /end MEASUREMENT
/begin MEASUREMENT ARnMon_stARnMon_mp "Zustand des After Run Monitors" UBYTE OneToOne 1 100 0.00 255.0 FORMAT "%5.1" ECU_ADDRESS 0x9FF9F5 /end MEASUREMENT
/begin MEASUREMENT ARnMon_stT15DebVal_mp "Zustand der Hardware-entprellten Klemme 15" UBYTE OneToOne 1 100 0.00 255.0 FORMAT "%5.1" ECU_ADDRESS 0x9FF9F6 /end MEASUREMENT
/begin MEASUREMENT ASDdc_dActGearFac_mp "Faktoren aus Kennlinie zur Berechnung der Turbinendrehzahl" SWORD VelToN 1 100 -0.3276800 0.3276700 FORMAT "%9.7" ECU_ADDRESS 0x9FE912 /end MEASUREMENT
/begin MEASUREMENT ASDdc_dfacRmp "negative Steigung der Abschaltrampe (positiven Gradienten gibt es nicht)" ULONG Rmp_Fact16 1 100 0.00 1023999.99976 FORMAT "%13.5" ECU_ADDRESS 0x7F9D1C /end MEASUREMENT
/begin MEASUREMENT ASDdc_dnAvrg_mp "Drehzahlgradient DT1 Glied Ausgang" SWORD rev_acc 1 100 -32768.00 32767.00 FORMAT "%8.2" ECU_ADDRESS 0x9FE914 /end MEASUREMENT
/begin MEASUREMENT ASDdc_dnIntegOutNeg_mp "Ausgang des Integrators bei Beendigung des negativen Lastschlages" SWORD rev_acc 1 100 -32768.00 32767.00 FORMAT "%8.2" ECU_ADDRESS 0x9FE916 /end MEASUREMENT
/begin MEASUREMENT ASDdc_dnIntegOutPos_mp "Ausgang des Integrators bei Beendigung des positiven Lastschlages" SWORD rev_acc 1 100 -32768.00 32767.00 FORMAT "%8.2" ECU_ADDRESS 0x9FE918 /end MEASUREMENT
/begin MEASUREMENT ASDdc_dnTrbn_mp "Änderung der Turbinendrehzahl" SWORD EngN 1 100 -32768.00 32767.00 FORMAT "%8.2" ECU_ADDRESS 0x9FE91A /end MEASUREMENT
/begin MEASUREMENT ASDdc_dtrqInrDesSlow_mp "Wunschmomentänderung" SWORD RmpTrqdHigh 1 100 -48000.00 47998.54 FORMAT "%8.2" ECU_ADDRESS 0x9FE954 /end MEASUREMENT
/begin MEASUREMENT ASDdc_facNegRmpState_mp "Gewichtungsfaktor von der Rampenfunktion" SWORD Fact 1 100 -4.000000 3.999878 FORMAT "%8.6" ECU_ADDRESS 0x9FE91C /end MEASUREMENT
/begin MEASUREMENT ASDdc_facRmpOvrRun "Abschaltfaktor bei Schub" SWORD Fact 1 100 -4.000000 3.999878 FORMAT "%8.6" ECU_ADDRESS 0x7F9618 /end MEASUREMENT
/begin MEASUREMENT ASDdc_KdCurr_mp "Aktueller Parameter Kd des Störungsreglers" FLOAT32_IEEE ASD_GvrnDT1Kd_float 1 100 -1.00000000 100.000000 FORMAT "%10.6" ECU_ADDRESS 0x9FE3FC /end MEASUREMENT
/begin MEASUREMENT ASDdc_nAvrg_mp "Motordrehzahl für die Parametersatzauswahl beim ASDdc" SWORD EngN 1 100 -32768.00 32767.00 FORMAT "%8.2" ECU_ADDRESS 0x9FE956 /end MEASUREMENT
/begin MEASUREMENT ASDdc_nDeltaLead_mp "ungefilterte Reglereingangsdrehzahl" SWORD EngN 1 100 -32768.00 32767.00 FORMAT "%8.2" ECU_ADDRESS 0x9FE91E /end MEASUREMENT
/begin MEASUREMENT ASDdc_nDeltaPT1_mp "gefilterte Reglereingangsdrehzahl" SWORD EngN 1 100 -32768.00 32767.00 FORMAT "%8.2" ECU_ADDRESS 0x9FE920 /end MEASUREMENT
/begin MEASUREMENT ASDdc_nInitPT1FltOn_mp "Initialisierungswert der Zieldrehzahl für DT1-Filter" SWORD EngN 1 100 -32768.00 32767.00 FORMAT "%8.2" ECU_ADDRESS 0x9FE922 /end MEASUREMENT
/begin MEASUREMENT ASDdc_nSlipN_mp "Schlupfdrehzahl" SWORD EngN 1 100 -32768.00 32767.00 FORMAT "%8.2" ECU_ADDRESS 0x9FE924 /end MEASUREMENT
/begin MEASUREMENT ASDdc_nSPNOfs_mp "Offsetdrehzahl für Bildung des Sollwertes" SWORD EngN 1 100 -32768.00 32767.00 FORMAT "%8.2" ECU_ADDRESS 0x9FE926 /end MEASUREMENT
/begin MEASUREMENT ASDdc_nSPPT1_mp "Sollwert für Drehzahlregler Ausgang PT1 Filter" SWORD EngN 1 100 -32768.00 32767.00 FORMAT "%8.2" ECU_ADDRESS 0x9FE928 /end MEASUREMENT
/begin MEASUREMENT ASDdc_nTrbnSpdCANFlt_mp "über CAN gefilterte Turbinendrehzahl" SWORD EngN 1 100 -32768.00 32767.00 FORMAT "%8.2" ECU_ADDRESS 0x9FE92A /end MEASUREMENT
/begin MEASUREMENT ASDdc_nTrbnSpdReplVal_mp "Turbinendrehzahl - Ersatzwert" SWORD EngN 1 100 -32768.00 32767.00 FORMAT "%8.2" ECU_ADDRESS 0x9FE92C /end MEASUREMENT
/begin MEASUREMENT ASDdc_nTrbn_mp "Turbinendrehzahl" SWORD EngN 1 100 -32768.00 32767.00 FORMAT "%8.2" ECU_ADDRESS 0x9FE92E /end MEASUREMENT
/begin MEASUREMENT ASDdc_stActGear_mp "Ganginformation für Lastschlagdämpfung bei offener Wandlerkupplung" SBYTE OneToOne 1 100 -128.0 127.0 FORMAT "%5.1" ECU_ADDRESS 0x9FF9F7 /end MEASUREMENT
/begin MEASUREMENT ASDdc_stBitFrame_mp "Statusbitleiste für Parameterauswahl" ULONG OneToOne 1 100 0.00 4294967295.00 FORMAT "%13.2" ECU_ADDRESS 0x9FE404 /end MEASUREMENT
/begin MEASUREMENT ASDdc_stBlkTmr "Retriggung für Lastschlagerkennung gesperrt" UBYTE OneToOne 1 100 0.00 255.0 FORMAT "%5.1" ECU_ADDRESS 0x7F92E3 /end MEASUREMENT
/begin MEASUREMENT ASDdc_stCluPS_mp "Kupplungs PS aktiv/nicht aktiv" UBYTE OneToOne 1 100 0.00 255.0 FORMAT "%5.1" ECU_ADDRESS 0x9FFA03 /end MEASUREMENT
/begin MEASUREMENT ASDdc_stDisable "Zustand Schubabschaltung ASDdc" UBYTE OneToOne 1 100 0.00 255.0 FORMAT "%5.1" ECU_ADDRESS 0x7F92E4 /end MEASUREMENT
/begin MEASUREMENT ASDdc_stExitLdRevl_mp "Statuswort fuer Beendigung Lastschlagregelung" UWORD OneToOne 1 100 0.00 65535.00 FORMAT "%8.2" ECU_ADDRESS 0x9FE930 /end MEASUREMENT
/begin MEASUREMENT ASDdc_stExtInt "Status von ext. Eingriff" UBYTE OneToOne 1 100 0.00 255.0 FORMAT "%5.1" ECU_ADDRESS 0x7F92E5 /end MEASUREMENT
/begin MEASUREMENT ASDdc_stGenCondNGvnr_mp "Status der generellen Bedingungen des Drehzahlreglers" UWORD OneToOne 1 100 0.00 65535.00 FORMAT "%8.2" ECU_ADDRESS 0x9FE932 /end MEASUREMENT
/begin MEASUREMENT ASDdc_stGrip_mp "Kraftschluss und Nulldurchgang des Störungsreglers - Vergleich zwischen dem tatsächlichen und dem benötigten Zustand" UBYTE OneToOne 1 100 0.00 255.0 FORMAT "%5.1" ECU_ADDRESS 0x9FFA04 /end MEASUREMENT
/begin MEASUREMENT ASDdc_stIFreeze_mp "Status I-Anteil eingefroren" UBYTE OneToOne 1 100 0.00 255.0 FORMAT "%5.1" ECU_ADDRESS 0x9FF9F8 /end MEASUREMENT
/begin MEASUREMENT ASDdc_stJstEntNegRun_mp "wurde nicht zu diesem Zeitpunkt erstmalig der negative Run Zustand (NEG_RUN_ST) erreicht" UBYTE OneToOne 1 100 0.00 255.0 FORMAT "%5.1" ECU_ADDRESS 0x9FF9F9 /end MEASUREMENT
/begin MEASUREMENT ASDdc_stJstEntPosRun_mp "wurde nicht zu diesem Zeitpunkt erstmalig der positive Run Zustand (POS_RUN_ST) erreicht" UBYTE OneToOne 1 100 0.00 255.0 FORMAT "%5.1" ECU_ADDRESS 0x9FF9FA /end MEASUREMENT
/begin MEASUREMENT ASDdc_stLdRevlDet_mp "Statuswort fuer Lastschlagerkennung" UWORD OneToOne 1 100 0.00 65535.00 FORMAT "%8.2" ECU_ADDRESS 0x9FE934 /end MEASUREMENT
/begin MEASUREMENT ASDdc_stNewNegByp_mp "Meßpunkt für Bypass Freischnitt" UBYTE OneToOne 1 100 0.00 255.0 FORMAT "%5.1" ECU_ADDRESS 0x9FF9FB /end MEASUREMENT
/begin COMPU_METHOD Acc "Fahrzeugbeschleunigung" RAT_FUNC "%6.5" "[m/s^2]" COEFFS 0 1000 0 0 0 1 /end COMPU_METHOD
/begin COMPU_METHOD AirMassPerCyl "Luftmasse pro Zylinder" RAT_FUNC "%6.3" "[mg/Hub Luft]" COEFFS 0 10 0 0 0 1 /end COMPU_METHOD
/begin COMPU_METHOD AirMassPerTime "Luftmasse pro Zeit" RAT_FUNC "%6.3" "[Kg/h Luft]" COEFFS 0 10 0 0 0 1 /end COMPU_METHOD
/begin COMPU_METHOD AngleRad "Winkelanzeige in Radians" RAT_FUNC "%7.6" "[rad]" COEFFS 0 10000 0 0 0 1 /end COMPU_METHOD
/begin COMPU_METHOD ASD_GvrnDT1Kd_float "Differentialverstärkung Kd (Motordrehzahl EngN zu Motormoment Trq)" RAT_FUNC "%6.2" "(Nm/rpm)^0.5" COEFFS 0 1 0 0 0 1 /end COMPU_METHOD
/begin COMPU_METHOD Calory1 "Umrechnung für Energie" RAT_FUNC "%6.5" "[kJ/g]" COEFFS 0 1000 0 0 0 1 /end COMPU_METHOD
/begin COMPU_METHOD Can "Umrechnungsfaktor für CAN-bezogene Größen" RAT_FUNC "%6.5" "[-]" COEFFS 0 1000 0 0 0 1 /end COMPU_METHOD
/begin COMPU_METHOD Can1 "Umsetzungsfaktor fuer CAN verwandte Groeßen" RAT_FUNC "%7.6" "[-]" COEFFS 0 10000 0 0 0 1 /end COMPU_METHOD
/begin COMPU_METHOD _CNV_R_R_RATIONALFU_0_CM "The entity name was generated by DDS!" RAT_FUNC "%6.3" "U/min" COEFFS 0. 1. 0. 0. 0. 40. /end COMPU_METHOD
/begin COMPU_METHOD _CNV_R_R_RATIONALFU_1_CM "The entity name was generated by DDS!" RAT_FUNC "%6.3" "Nm" COEFFS 0. 1. 0. 0. 0. 5. /end COMPU_METHOD
/begin COMPU_METHOD _CNV_R_R_RATIONALFU_3_CM "The entity name was generated by DDS!" RAT_FUNC "%6.3" "-" COEFFS 0. 1. 0. 0. 0. 1. /end COMPU_METHOD
/begin COMPU_METHOD _CNV_R_R_RATIONALFU_4_CM "The entity name was generated by DDS!" RAT_FUNC "%6.3" "kg/m3" COEFFS 0. 1. 0. 0. 0. 7.8125e-003 /end COMPU_METHOD
/begin COMPU_METHOD _CNV_R_R_RATIONALFU_5_CM "The entity name was generated by DDS!" RAT_FUNC "%6.3" "(U/min)/(km/h)" COEFFS 0. 1. 0. 0. 0. 7.8125e-003 /end COMPU_METHOD
/begin COMPU_METHOD _CNV_R_R_RATIONALFU_6_CM "The entity name was generated by DDS!" RAT_FUNC "%6.3" "s" COEFFS 0. 1. 0. 0. 0. 0.1 /end COMPU_METHOD
/begin COMPU_METHOD _CNV_R_R_RATIONALFU_7_CM "The entity name was generated by DDS!" RAT_FUNC "%6.3" "%" COEFFS 0. 1. 0. 0. 0. 0.390625 /end COMPU_METHOD
/begin COMPU_METHOD _CNV_R_R_RATIONALFU_9_CM "The entity name was generated by DDS!" RAT_FUNC "%6.3" "°C" COEFFS 0. 1. 48. 0. 0. 0.75 /end COMPU_METHOD
/begin COMPU_METHOD _CNV_R_R_RATIONALFU_10_CM "The entity name was generated by DDS!" RAT_FUNC "%6.3" "°" COEFFS 0. 1. 0. 0. 0. 4.375e-002 /end COMPU_METHOD
/begin COMPU_METHOD CoeffA "Koeffizient A in der Parabel dTrq = A * Trq^2 + Trq" RAT_FUNC "%6.4" "1/(s*Nm)" COEFFS 0 204.8 0 0 0 1 /end COMPU_METHOD
/begin COMPU_METHOD Curr "Strom" RAT_FUNC "%6.2" "[mA]" COEFFS 0 1 0 0 0 1 /end COMPU_METHOD
/begin COMPU_METHOD Dia "Durchmesser des Rades" RAT_FUNC "%7.6" "[m]" COEFFS 0 10000 0 0 0 1 /end COMPU_METHOD
/begin COMPU_METHOD dTrqPrp_20ms "Anstieg Vortriebsmoment im 20 ms Raster" RAT_FUNC "%6.1" "[Nm/s]" COEFFS 0 0.0125 0 0 0 1 /end COMPU_METHOD
/begin COMPU_METHOD DtyCyc "Tastverhaeltnis" RAT_FUNC "%6.4" "[%]" COEFFS 0 100 0 0 0 1 /end COMPU_METHOD
/begin COMPU_METHOD dVel_20ms "Anstieg Fahrgeschwindigkeit im 20 ms Raster" RAT_FUNC "%6.3" "[(km/h)/s]" COEFFS 0 2 0 0 0 1 /end COMPU_METHOD
/begin COMPU_METHOD EGTSwt_S16 "Faktor (0...1) für sint16 Type mit 0.000061 Auflösung" RAT_FUNC "%7.6" "-" COEFFS 0 16384 0 0 0 1 /end COMPU_METHOD
/begin COMPU_METHOD EngN "Motordrehzahl" RAT_FUNC "%6.2" "[rpm]" COEFFS 0 1 0 0 0 1 /end COMPU_METHOD
/begin COMPU_METHOD facRmpEGT32 "Faktor für EGT Rampe  (32bit Normiert)" RAT_FUNC "%10.9" "[-]" COEFFS 0 16384000 0 0 0 1 /end COMPU_METHOD
/begin COMPU_METHOD Fact "Faktor mit Auflösung 1 / 8192, hauptsächlich für einen Faktorenbereich 0...1 verwendet" RAT_FUNC "%6.5" "[-]" COEFFS 0 8192 0 0 0 1 /end COMPU_METHOD
/begin COMPU_METHOD Fact1 "Faktor mit Auflösung 0,01 (100 mal höherer Bereich als Fact)" RAT_FUNC "%6.4" "[-]" COEFFS 0 128 0 0 0 1 /end COMPU_METHOD
/begin COMPU_METHOD FactHigh "Faktor mit Auflösung 1/4096, hauptsächlich für einen Faktorenbereich 0.1...10 verwendet" RAT_FUNC "%7.6" "[-]" COEFFS 0 10000 0 0 0 1 /end COMPU_METHOD
/begin COMPU_METHOD FactLow "Faktor mit Auflösung 1/1024, hauptsächlich für einen Faktorenbereich 1...50 verwendet" RAT_FUNC "%6.5" "[-]" COEFFS 0 1024 0 0 0 1 /end COMPU_METHOD
/begin COMPU_METHOD FlConsum_l_h "Kraftstoffverbrauch" RAT_FUNC "%6.4" "[l/h]" COEFFS 0 100 0 0 0 1 /end COMPU_METHOD
/begin COMPU_METHOD FlConsum_ul_1 "Verbrauchsintegral (in Mikroliter pro 20ms) mit genauerer Auflösung" RAT_FUNC "%6.5" "[ul]" COEFFS 0 1000 0 0 0 1 /end COMPU_METHOD
/begin COMPU_METHOD Friction "Friktion oder Widerstand in [N]" RAT_FUNC "%6.2" "[Kgm/s^2]" COEFFS 0 1 0 0 0 1 /end COMPU_METHOD
/begin COMPU_METHOD InjMass "Einspritzmenge" RAT_FUNC "%6.4" "[mg/hub]" COEFFS 0 100 0 0 0 1 /end COMPU_METHOD
/begin COMPU_METHOD Ki "Integrale Verstärkung Ki (gleiche Einheit/Umrechnungsregel an Ein- und Ausgang)" RAT_FUNC "%6.5" "[1/s]" COEFFS 0 4294.967296 0 0 0 1 /end COMPU_METHOD
/begin COMPU_METHOD Kp "proportionale Verstärkung Kp (gleiche Einheit/Umrechnungsregel an Ein- und Ausgang)" RAT_FUNC "%7.6" "[1/1]" COEFFS 0 65536 0 0 0 1 /end COMPU_METHOD
/begin COMPU_METHOD KP_RPM2NM_2 "Verstärkungsfaktor zur Anpassung von 16 Bit an 32 Bit Werte (mit KP_RPM2NM_2_NRM schieben)" RAT_FUNC "%7.6" "[Nm/rpm]" COEFFS 0 20480 0 0 0 1 /end COMPU_METHOD
/begin COMPU_METHOD lambda "Lambda" RAT_FUNC "%6.5" "[-]" COEFFS 0 1000 0 0 0 1 /end COMPU_METHOD
/begin COMPU_METHOD lambdaRec "Kehrwert von Lambda" RAT_FUNC "%7.6" "[-]" COEFFS 0 10000 0 0 0 1 /end COMPU_METHOD
/begin COMPU_METHOD mlToL_fine "Umrechnungsformel von ml auf L (kleine Auflösung)" RAT_FUNC "%6.5" "[ml/l]" COEFFS 0 1000 0 0 0 1 /end COMPU_METHOD
/begin COMPU_METHOD OneToOne "eins zu eins (physikalischer Wert ist gleich dem internen Wert)" RAT_FUNC "%6.2" "[-]" COEFFS 0 1 0 0 0 1 /end COMPU_METHOD
/begin COMPU_METHOD Period_ms "Periodendauer in ms" RAT_FUNC "%6.3" "[ms]" COEFFS 0 10 0 0 0 1 /end COMPU_METHOD
/begin COMPU_METHOD Prc "Prozent, gleiche interne Auflösung wie Fact, aber Darstellung in Prozent (0...100%)" RAT_FUNC "%6.4" "[%]" COEFFS 0 100 0 0 0 1 /end COMPU_METHOD
/begin COMPU_METHOD PrcPerSec_20ms "Prozentänderung pro Sekunde für 20ms-Tasks" RAT_FUNC "%6.3" "[%/s]" COEFFS 0 2 0 0 0 1 /end COMPU_METHOD
/begin COMPU_METHOD Prc_D20ms "Prozent (0...100%/s) fuer 20ms - Task" RAT_FUNC "%6.3" "[%/s]" COEFFS 0 2 0 0 0 1 /end COMPU_METHOD
/begin COMPU_METHOD Prc_D4ms "Prozent fuer 4ms - Task" RAT_FUNC "%6.2" "[%/s]" COEFFS 0 0.4 0 0 0 1 /end COMPU_METHOD
/begin COMPU_METHOD PresAC_hPa "Druck (Klimatisierung) angezeigt in [hPa]" RAT_FUNC "%6.2" "[hPa]" COEFFS 0 0.5 0 0 0 1 /end COMPU_METHOD
/begin COMPU_METHOD Pres_hPa "Druck (angezeigt in [hPa])" RAT_FUNC "%6.2" "[hPa]" COEFFS 0 1 0 0 0 1 /end COMPU_METHOD
/begin COMPU_METHOD Pwr "Leistung" RAT_FUNC "%6.2" "[W]" COEFFS 0 0.10610329539459 0 0 0 1 /end COMPU_METHOD
/begin COMPU_METHOD rev_acc "Drehzahlbeschleunigung" RAT_FUNC "%6.2" "[rmp/s]" COEFFS 0 1 0 0 0 1 /end COMPU_METHOD
/begin COMPU_METHOD RmpEngN_2 "Umrechnung für Anfahrregler" RAT_FUNC "%6.2" "[rpm/s]" COEFFS 0 0.512 0 0 0 1 /end COMPU_METHOD
/begin COMPU_METHOD RmpTrqdHigh "Rampengradient für Momente mit großen Steigungen" RAT_FUNC "%6.2" "[Nm/s]" COEFFS 0 0.682666666666667 0 0 0 1 /end COMPU_METHOD
/begin COMPU_METHOD RmpTrqPrpHigh "Rampenanstieg für Vortriebsmoment [Nm/s]" RAT_FUNC "%6.4" "[Nm/s]" COEFFS 0 655.36 0 0 0 1 /end COMPU_METHOD
/begin COMPU_METHOD Rmp_Fact16 "Rampenfaktorgradient" RAT_FUNC "%6.5" "[1/s]" COEFFS 0 4194.304 0 0 0 1 /end COMPU_METHOD
/begin COMPU_METHOD SigDatatyp "verbale Umrechnung für die auswahl eines Datentyps eines frei applizierbaren Signals" TAB_VERB "%6.3" "" COMPU_TAB_REF SigDatatyp /end COMPU_METHOD
/begin COMPU_VTAB SigDatatyp "verbale Umrechnung für die auswahl eines Datentyps eines frei applizierbaren Signals" TAB_VERB 6 0 "SIG_SINT16" 1 "SIG_UINT16" 2 "SIG_SINT8" 3 "SIG_UINT8 or SIG_BOOL" 4 "SIG_SINT32" 5 "SIG_UINT32" /end COMPU_VTAB
/begin COMPU_METHOD Temp_Cels "Temperatur dargestellt in °C (gleiche interne Darstellung wie Temp_Kelv)" RAT_FUNC "%6.1" "[deg C]" COEFFS 0 10 2731.4 0 0 1 /end COMPU_METHOD
/begin COMPU_METHOD TimeDelay_s "Zeitkonstante T1 (in s) für PT1, DT1, etc." RAT_FUNC "%9.3" "[s]" COEFFS 0 0 1 0 0.00023283064365387 0 /end COMPU_METHOD
/begin COMPU_METHOD Time_ms "Zeit in ms für Fehlerentprellung (DSM) und SW-Timer" RAT_FUNC "%6.1" "[ms]" COEFFS 0 0.1 0 0 0 1 /end COMPU_METHOD
/begin COMPU_METHOD Time_PwmHigh "Periodenzeit von der HWE (Tio_PwmGetAvrg)" RAT_FUNC "%6.3" "[us]" COEFFS 0 10 0 0 0 1 /end COMPU_METHOD
/begin COMPU_METHOD Time_s "Zeit in s für Fehlerentprellung (DSM) und SW-Timer" RAT_FUNC "%6.4" "[s]" COEFFS 0 100 0 0 0 1 /end COMPU_METHOD
/begin COMPU_METHOD TrnvrsAcc "Umrechnung für Querbeschleunigung" RAT_FUNC "%6.4" "[g]" COEFFS 0 100 0 0 0 1 /end COMPU_METHOD
/begin COMPU_METHOD Trq "Motormoment" RAT_FUNC "%6.3" "[Nm]" COEFFS 0 10 0 0 0 1 /end COMPU_METHOD
/begin COMPU_METHOD TrqPrp "Vortriebsmoment" RAT_FUNC "%6.2" "[Nm]" COEFFS 0 0.625 0 0 0 1 /end COMPU_METHOD
/begin COMPU_METHOD TrqPrpHigh "vortriebsmoment" RAT_FUNC "%6.3" "[Nm]" COEFFS 0 10 0 0 0 1 /end COMPU_METHOD
/begin COMPU_METHOD VehMass "Fahrzeugmasse in Kg" RAT_FUNC "%6.3" "[Kg]" COEFFS 0 10 0 0 0 1 /end COMPU_METHOD
/begin COMPU_METHOD Vel "Fahrzeuggeschwindigkeit, gleiche interne Auflösung wie Vel_SI" RAT_FUNC "%6.4" "[km/h]" COEFFS 0 100 0 0 0 1 /end COMPU_METHOD
/begin COMPU_METHOD VelToN "Verhältnis Fahrzeuggeschwindigkeit zu Motordrehzahl v/n" RAT_FUNC "%8.7" "[(km/h)/rpm]" COEFFS 0 100000 0 0 0 1 /end COMPU_METHOD
/begin COMPU_METHOD volAdd_ml "Additivvolumen [ml]" RAT_FUNC "%6.3" "[ml]" COEFFS 0 10 0 0 0 1 /end COMPU_METHOD
/begin COMPU_METHOD Volt "Spannung in V (von ADC)" RAT_FUNC "%6.2" "[mV]" COEFFS 0 0.2046 0 0 0 1 /end COMPU_METHOD
/begin COMPU_METHOD defaultAscii "" RAT_FUNC "%6.2" "" COEFFS 0 1 0 0 0 1 /end COMPU_METHOD
/begin RECORD_LAYOUT Kf_Xs16_Ys16_Ws16 NO_AXIS_PTS_X 1 SWORD NO_AXIS_PTS_Y 2 SWORD AXIS_PTS_X 3 SWORD INDEX_INCR DIRECT AXIS_PTS_Y 4 SWORD INDEX_INCR DIRECT FNC_VALUES 5 SWORD COLUMN_DIR DIRECT /end RECORD_LAYOUT
/begin RECORD_LAYOUT Kf_Xu8_Yu8_Wu8 NO_AXIS_PTS_X 1 UBYTE NO_AXIS_PTS_Y 2 UBYTE AXIS_PTS_X 3 UBYTE INDEX_INCR DIRECT AXIS_PTS_Y 4 UBYTE INDEX_INCR DIRECT FNC_VALUES 5 UBYTE COLUMN_DIR DIRECT /end RECORD_LAYOUT
/begin RECORD_LAYOUT Ktx FNC_VALUES 1 UBYTE COLUMN_DIR DIRECT /end RECORD_LAYOUT
/begin RECORD_LAYOUT Kwb_Ws16 FNC_VALUES 1 SWORD COLUMN_DIR DIRECT /end RECORD_LAYOUT
/begin RECORD_LAYOUT Kwb_Wu16 FNC_VALUES 1 UWORD COLUMN_DIR DIRECT /end RECORD_LAYOUT
/begin RECORD_LAYOUT Kwb_Wu32 FNC_VALUES 1 ULONG COLUMN_DIR DIRECT /end RECORD_LAYOUT
/begin RECORD_LAYOUT Kwb_Wu8 FNC_VALUES 1 UBYTE COLUMN_DIR DIRECT /end RECORD_LAYOUT
/begin RECORD_LAYOUT Kw_Ws16 FNC_VALUES 1 SWORD COLUMN_DIR DIRECT /end RECORD_LAYOUT
/begin RECORD_LAYOUT Kw_Wu16 FNC_VALUES 1 UWORD COLUMN_DIR DIRECT /end RECORD_LAYOUT
/begin RECORD_LAYOUT Kw_Wu32 FNC_VALUES 1 ULONG COLUMN_DIR DIRECT /end RECORD_LAYOUT
/begin RECORD_LAYOUT Kw_Wu8 FNC_VALUES 1 UBYTE COLUMN_DIR DIRECT /end RECORD_LAYOUT
/begin RECORD_LAYOUT _REC_AXS_1_u1 AXIS_PTS_X 1 UBYTE INDEX_INCR DIRECT /end RECORD_LAYOUT
/begin RECORD_LAYOUT _REC_CUR_20_u1_u1 FNC_VALUES 1 UBYTE COLUMN_DIR DIRECT /end RECORD_LAYOUT
/begin RECORD_LAYOUT _REC_VAL_20_u1 FNC_VALUES 1 UBYTE COLUMN_DIR DIRECT /end RECORD_LAYOUT
/begin RECORD_LAYOUT _REC_AXS_1_u2 AXIS_PTS_X 1 UWORD INDEX_INCR DIRECT /end RECORD_LAYOUT
/begin RECORD_LAYOUT _REC_CUR_20_u2_u2 FNC_VALUES 1 UWORD COLUMN_DIR DIRECT /end RECORD_LAYOUT
/begin RECORD_LAYOUT _REC_MAP_20_u1_u1_u1 FNC_VALUES 1 UBYTE COLUMN_DIR DIRECT /end RECORD_LAYOUT
/begin RECORD_LAYOUT _REC_VAL_20_s2 FNC_VALUES 1 SWORD COLUMN_DIR DIRECT /end RECORD_LAYOUT
/begin FUNCTION sig_dsm "Signale für Umweltbedingungen im Fehlerspeicher"
 /begin DEF_CHARACTERISTIC Sig_Byte2DSMOffset_C Sig_Byte2DSMScale_C Sig_Byte3DSMOffset_C Sig_Byte3DSMScale_C Sig_Carb_drDSMOffset_C Sig_Carb_drDSMScale_C Sig_Carb_lDSMOffset_C Sig_Carb_lDSMScale_C Sig_Carb_lrDSMOffset_C Sig_Carb_lrDSMScale_C Sig_Carb_mAirTimDSMOffset_C Sig_Carb_mAirTimDSMScale_C Sig_Carb_nDSMOffset_C Sig_Carb_nDSMScale_C Sig_Carb_pDSMOffset_C Sig_Carb_pDSMScale_C Sig_Carb_rDSMOffset_C Sig_Carb_rDSMScale_C Sig_Carb_rNegDSMOffset_C Sig_Carb_rNegDSMScale_C Sig_Carb_tDSMOffset_C Sig_Carb_tDSMScale_C Sig_Carb_tHighM1DSMOffset_C Sig_Carb_tHighM1DSMScale_C Sig_Carb_uBattDSMOffset_C Sig_Carb_uBattDSMScale_C Sig_Carb_uDSMOffset_C Sig_Carb_uDSMScale_C Sig_Carb_vDSMOffset_C Sig_Carb_vDSMScale_C Sig_CnsmpDSMOffset_C Sig_CnsmpDSMScale_C Sig_FactDSMOffset_C Sig_FactDSMScale_C Sig_HighByteDSMOffset_C Sig_HighByteDSMScale_C Sig_LowByteDSMOffset_C Sig_LowByteDSMScale_C Sig_MLperLDSMOffset_C Sig_MLperLDSMScale_C Sig_NoUnitDSMOffset_C Sig_NoUnitDSMScale_C Sig_NoUnitIIDSMOffset_C Sig_NoUnitIIDSMScale_C Sig_O2diffDSMOffset_C Sig_O2diffDSMScale_C Sig_OnOffDSMOffset_C Sig_OnOffDSMScale_C Sig_OneToOneDSMOffset_C Sig_OneToOneDSMScale_C Sig_VolperTmrDSMOffset_C Sig_VolperTmrDSMScale_C Sig_aDSMOffset_C Sig_aDSMScale_C Sig_dcycDSMOffset_C Sig_dcycDSMScale_C Sig_dcycNegDSMOffset_C Sig_dcycNegDSMScale_C Sig_dcycNeghighresDSMOffset_C Sig_dcycNeghighresDSMScale_C Sig_dmASMODDSMOffset_C Sig_dmASMODDSMScale_C Sig_dqDSMOffset_C Sig_dqDSMScale_C Sig_dvolDSMOffset_C Sig_dvolDSMScale_C Sig_fas1CANOffset_C Sig_fas1CANScale_C Sig_fas1DIAOffset_C Sig_fas1DIAScale_C Sig_fas1DSMOffset_C Sig_fas1DSMScale_C Sig_fas2CANOffset_C Sig_fas2CANScale_C Sig_fas2DIAOffset_C Sig_fas2DIAScale_C Sig_fas2DSMOffset_C Sig_fas2DSMScale_C Sig_fas3CANOffset_C Sig_fas3CANScale_C Sig_fas3DIAOffset_C Sig_fas3DIAScale_C Sig_fas3DSMOffset_C Sig_fas3DSMScale_C Sig_fas4DSMOffset_C Sig_fas4DSMScale_C Sig_lDSMOffset_C Sig_lDSMScale_C Sig_lLvl2DSMOffset_C Sig_lLvl2DSMScale_C Sig_lLvlDSMOffset_C Sig_lLvlDSMScale_C Sig_mAirCylDSMOffset_C Sig_mAirCylDSMScale_C Sig_mAirCylGovDSMOffset_C Sig_mAirCylGovDSMScale_C Sig_mAirDSMOffset_C Sig_mAirDSMScale_C Sig_mAirTimDSMOffset_C Sig_mAirTimDSMScale_C Sig_mAshDSMOffset_C Sig_mAshDSMScale_C Sig_mDSMScale_C Sig_mSotDSMOffset_C Sig_mSotDSMScale_C Sig_nASMODDSMOffset_C Sig_nASMODDSMScale_C Sig_nCmpTstDSMOffset_C Sig_nCmpTstDSMScale_C Sig_nDSMOffset_C Sig_nDSMScale_C Sig_pACDSMOffset_C Sig_pACDSMScale_C Sig_pASMODDSMOffset_C Sig_pASMODDSMScale_C Sig_pDSMOffset_C Sig_pDSMScale_C Sig_pDiffDSMOffset_C Sig_pDiffDSMScale_C Sig_pEgrDSMOffset_C Sig_pEgrDSMScale_C Sig_phi2CANOffset_C Sig_phi2CANScale_C Sig_phi2DIAOffset_C Sig_phi2DIAScale_C Sig_phi2DSMOffset_C Sig_phi2DSMScale_C Sig_phiDSMOffset_C Sig_phiDSMScale_C Sig_phiHResolDSMOffset_C Sig_phiHResolDSMScale_C Sig_pwrDSMOffset_C Sig_pwrDSMScale_C Sig_qDSMOffset_C Sig_qDSMScale_C Sig_qNegDSMOffset_C Sig_qNegDSMScale_C Sig_qdiffDSMOffset_C Sig_qdiffDSMScale_C Sig_qdiffSysDSMOffset_C Sig_qdiffSysDSMScale_C Sig_rDSMOffset_C Sig_rDSMScale_C Sig_rNegDSMOffset_C Sig_rNegDSMScale_C Sig_ratioDSMOffset_C Sig_ratioDSMScale_C Sig_resDSMOffset_C Sig_resDSMScale_C Sig_strokeDSMOffset_C Sig_strokeDSMScale_C Sig_tASMODDSMOffset_C Sig_tASMODDSMScale_C Sig_tDSMOffset_C Sig_tDSMScale_C Sig_tExhaustDSMOffset_C Sig_tExhaustDSMScale_C Sig_tiDSMOffset_C Sig_tiDSMScale_C Sig_tiGlwDSMOffset_C Sig_tiGlwDSMScale_C Sig_tiHourDSMOffset_C Sig_tiHourDSMScale_C Sig_tisecondDSMOffset_C Sig_tisecondDSMScale_C Sig_tiusDSMOffset_C Sig_tiusDSMScale_C Sig_trqDSMOffset_C Sig_trqDSMScale_C Sig_trqhighDSMOffset_C Sig_trqhighDSMScale_C Sig_uBattDSMOffset_C Sig_uBattDSMScale_C Sig_uDSMOffset_C Sig_uDSMScale_C Sig_vDSMOffset_C Sig_vDSMScale_C Sig_volDSMOffset_C Sig_volDSMScale_C Sig_volHighDSMOffset_C Sig_volHighDSMScale_C Sig_wDSMOffset_C Sig_wDSMScale_C Signals_adFreeApplic1_C Signals_adFreeApplic2_C Signals_adFreeApplic3_C Signals_adFreeApplic4_C Signals_numTypFreeApplic1_C Signals_numTypFreeApplic2_C Signals_numTypFreeApplic3_C Signals_numTypFreeApplic4_C /end DEF_CHARACTERISTIC
/end FUNCTION
/begin FUNCTION signals "Bereitstellung von applizierbaren Signalen und ihrer Umrechnung" /begin SUB_FUNCTION sig_can sig_dia sig_dsm signals_Co /end SUB_FUNCTION /end FUNCTION
/begin FUNCTION signals_Co "Bereitstellung von applizierbaren Signalen und ihrer Umrechnung"
 /begin DEF_CHARACTERISTIC SigTst_ACEn_C SigTst_AFVEn_C SigTst_AOHtCDHt1En_C SigTst_AOHtCDHt2En_C SigTst_ENGMENG2En_C SigTst_ENGMENGEn_C SigTst_ENGMGEAR1En_C SigTst_ENGMGEAR2En_C SigTst_ENGMGEAREn_C SigTst_EngMEn_C SigTst_PFltLmpEn_C SigTst_PSPEn_C SigTst_WDALEn_C Sig_LimLowDigital_C Sig_LimLowPwm_C Sig_LimLown_C Sig_LimUpDigital_C Sig_LimUpPwm_C Sig_LimUpn_C Sig_facArrhCANOffset_C Sig_facArrhCANScale_C Sig_facArrhDIAOffset_C Sig_facArrhDIAScale_C Sig_facArrhDSMOffset_C Sig_facArrhDSMScale_C Sig_pPFltCANOffset_C Sig_pPFltCANScale_C Sig_pPFltDIAOffset_C Sig_pPFltDIAScale_C Sig_pPFltDSMOffset_C Sig_pPFltDSMScale_C Sig_rLmbdCANOffset_C Sig_rLmbdCANScale_C Sig_rLmbdDIAOffset_C Sig_rLmbdDIAScale_C Sig_rLmbdDSMOffset_C Sig_rLmbdDSMScale_C Sig_volLiterCANOffset_C Sig_volLiterCANScale_C Sig_volLiterDIAOffset_C Sig_volLiterDIAScale_C Sig_volLiterDSMOffset_C Sig_volLiterDSMScale_C signals_TmrBehaviour_C signals_TstDemMaxEngN_C signals_TstDemMaxVSSCDV_C signals_tiTstDemHeal_C signals_tiTstDemMax_C /end DEF_CHARACTERISTIC
/end FUNCTION
/begin FUNCTION signals_TstDem "Monitors the tester request for actuator test" /begin DEF_CHARACTERISTIC SigTst_ENGMENG1En_C /end DEF_CHARACTERISTIC /end FUNCTION
/begin FUNCTION uacc_adjval "Motorspezifische Abgleichwerte (KW2000)"
 /begin DEF_CHARACTERISTIC Uacc_AdjValK2SigBlkVal_MAP Uacc_AdjValOffset_C Uacc_AdjValScale_C Uacc_AdjValTesterLength_C /end DEF_CHARACTERISTIC
/end FUNCTION
/begin FUNCTION uacc_eopd "Eingabe von Prozessdaten"
 /begin DEF_CHARACTERISTIC Uacc_EOPDFormat_C Uacc_EOPDK2SigBlkVal_MAP Uacc_EOPDOffset_C Uacc_EOPDScale_C Uacc_EOPDTesterLength_C /end DEF_CHARACTERISTIC
/end FUNCTION
/begin FUNCTION uacc_evalsigblk "Auswertung eines Meßwerteblocks"
 /begin DEF_CHARACTERISTIC UACC_ESBFormular_C UACC_ESBNormVal_C UACC_ESBSigNr_C UACC_ShtrpApplSigBlk_MAP UAcc_Manufacturer_Ver_C UAcc_Production_Group_HW_C UAcc_Production_Group_SW_C UAcc_SortCode_HW_C UAcc_SortCode_SW_C UAcc_TypeTestNum_C Uacc_stCANText_CA Uacc_stTOMskRxMsg_CA Uacc_stTOMskUsrMsg_CA /end DEF_CHARACTERISTIC
/end FUNCTION
/begin FUNCTION uacc_funccode "Funktionscodierung mittels Servicetester"
 /begin DEF_CHARACTERISTIC UAcc_AIRBGCodePos_C UAcc_FQTSCDCodePos_C UAcc_OTSCodePos_C Uacc_SupFunc_CA /end DEF_CHARACTERISTIC
/end FUNCTION
/begin FUNCTION uacc_logreq "Loginfunktion zum Freischalten und Sperren von Steuergerätezusatzfunktionen"
 /begin DEF_CHARACTERISTIC UAcc_LogReqAirSysTrgOfsLrn_C UAcc_LogReqEGRSCDTrgOfsLrn_C UAcc_LogReqPFltRgnRls_C UAcc_LogReqPFltRgnShOff_C UAcc_LogReqPFltTrgOfsAdapt_C UAcc_LogReqPFltTrgRgn_C UAcc_LogReqPWAAGAct_C UAcc_LogReqPWAAGdeAct_C UAcc_LogReqPWACCAct_C UAcc_LogReqPWCrCtlAct_C UAcc_LogReqPWCrCtldeAct_C UAcc_LogReqPWDSMRdyAcc_C UAcc_LogReqPWFMARst_C UAcc_LogReqPWFlPpCDAct_C UAcc_LogReqPWFlPpCDdeAct_C UAcc_LogReqPWMxSpdResetdeAct_C UAcc_LogReqPW_TAAReqResVal_C /end DEF_CHARACTERISTIC
/end FUNCTION
/begin FUNCTION uacc_rsignalblock "Lesen eines Meßwerteblocks" /begin DEF_CHARACTERISTIC UACC_RSigBlkGrp_MAP /end DEF_CHARACTERISTIC /end FUNCTION
/begin FUNCTION uacc_writecode "Funktion für das Schreiben der Variantenkodierung" /begin DEF_CHARACTERISTIC UAcc_swtCodRcy_C UAcc_vCodRcyMax_C USAp_numFuncCodeBits_C /end DEF_CHARACTERISTIC /end FUNCTION
/begin FUNCTION ukey_custom "Passwort zur Freischaltung der Anpassungskanäle" /begin DEF_CHARACTERISTIC UKey_UpLoadPassWD_C UKey_stAdjChan_CA UKey_stPassWD_C /end DEF_CHARACTERISTIC /end FUNCTION
/begin FUNCTION zzzfct_NotTreeLab "Labels, die nicht im Applikationsbaum definiert sind."
 /begin DEF_CHARACTERISTIC ACCCD_swtGvnrOutI_C BasAdj_rVSA_C CrCCD_stPanelVer_C Eng_agPwrStgMax_C_VW Eng_bEnaDispGearAct_C_VW Eng_densAir8_A_VW Eng_nHysSdwn_C_VW Eng_nMaxSdwnReq_C_VW Eng_nMaxSdwn_T_VW Eng_nMaxSup_C_VW Eng_nMinSdwnAcc_C_VW Eng_nMinSup_M_VW Eng_nQuoSpdRev8_A_VW Eng_noCycGearDisp_C_VW Eng_noGear8_A_VW Eng_noGearConv8_A_VW Eng_noGearDispCmu_T_VW Eng_noGearMax_C_VW Eng_rAcePedMaxGearReq_C_VW Eng_rRevSpd_T_VW Eng_stAccAct_C_VW Eng_stEnaSdwnRegPmt_C_VW Eng_tCo6_A_VW Eng_tiDlyBrk_C_VW Eng_tiDlyPu_C_VW Eng_tiWaitCluOp_C_VW Eng_tiWaitDisp_C_VW Eng_tiWaitInc2GearReq_C_VW Eng_tiWaitSdwnKd_C_VW Eng_tiWaitTogGearAct_C_VW Eng_tiWaitTogGearReq_C_VW Eng_tiWaitTogNegGearReq_C_VW Eng_tqIdRed_M_VW Eng_tqMaxClu_T_VW K2RDI_DiaNum_C Prp_factAPPThres_C Prp_swtCANrAPP_C /end DEF_CHARACTERISTIC
/end FUNCTION
/end MODULE
/end PROJECT
