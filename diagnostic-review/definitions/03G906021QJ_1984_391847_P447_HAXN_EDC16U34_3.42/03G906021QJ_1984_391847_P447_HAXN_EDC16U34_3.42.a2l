ASAP2_VERSION 1 3
/begin PROJECT X447 "EDC16U34"
/begin HEADER "" VERSION "VAA1" PROJECT_NO X447 /end HEADER
/begin MODULE DIM ""
/begin MOD_COMMON "" BYTE_ORDER MSB_FIRST ALIGNMENT_BYTE 1 ALIGNMENT_WORD 2 ALIGNMENT_LONG 4 ALIGNMENT_FLOAT32_IEEE 4 /end MOD_COMMON
/begin CHARACTERISTIC DSM_CDCDfp_FrmMngLICHT1TO_C "CARB spezifischer Fehlercode fuer Fehlerpfad Dfp_FrmMngLICHT1TO" VAL_BLK 0x1CE10C Kwb_Wu16 65535.00 OneToOne 0.00 65535.00 FORMAT "%8.2" NUMBER 4 /end CHARACTERISTIC
/begin CHARACTERISTIC DSM_CDCDfp_FrmMngLICHT2TO_C "CARB spezifischer Fehlercode fuer Fehlerpfad Dfp_FrmMngLICHT2TO" VAL_BLK 0x1CE114 Kwb_Wu16 65535.00 OneToOne 0.00 65535.00 FORMAT "%8.2" NUMBER 4 /end CHARACTERISTIC
/begin CHARACTERISTIC DSM_CDCDfp_FrmMngWIPERTO_C "CARB spezifischer Fehlercode fuer Fehlerpfad Dfp_FrmMngWIPERTO" VAL_BLK 0x1CE1AC Kwb_Wu16 65535.00 OneToOne 0.00 65535.00 FORMAT "%8.2" NUMBER 4 /end CHARACTERISTIC
/begin CHARACTERISTIC DSM_CDKDfp_FrmMngLICHT1TO_C "Kundenspezifischer Fehlercode fuer Fehlerpfad Dfp_FrmMngLICHT1TO" VAL_BLK 0x1CED0C Kwb_Wu16 65535.00 OneToOne 0.00 65535.00 FORMAT "%8.2" NUMBER 4 /end CHARACTERISTIC
/begin CHARACTERISTIC DSM_ClaDfp_FrmMngLICHT1TO_C "Fehlerklasse fuer Fehlerpfad Dfp_FrmMngLICHT1TO" VALUE 0x1CF378 Kw_Wu8 20.00 OneToOne 0.00 20.00 FORMAT "%5.2" EXTENDED_LIMITS 0.00 255.0 /end CHARACTERISTIC
/begin CHARACTERISTIC DSM_EnvDfp_FrmMngLICHT1TO_C "Fehlerpfad spezifische Umweltbedingungen fuer Fehlerpfad Dfp_FrmMngLICHT1TO" VAL_BLK 0x1D00EC Kwb_Wu16 1152.00000000 SigName 0.00 1152.00000000 FORMAT "%13.8" NUMBER 8 /end CHARACTERISTIC
/begin CHARACTERISTIC DSM_FMKDfp_FrmMngLICHT1TO_C "Ausblendbedingungen fuer Fehlerpfad Dfp_FrmMngLICHT1TO" VALUE 0x1CD9F8 Kw_Wu8 255.0 OneToOne 0.00 255.0 FORMAT "%5.1" /end CHARACTERISTIC
/begin CHARACTERISTIC FrmMng_aACC_Offset_C "Can-Umrechnungsparameter Offset für Beschleunigung" VALUE 0x1D78A0 Kw_Ws16 65.53500 Acc -32.76800 32.76700 FORMAT "%8.5" /end CHARACTERISTIC
/begin CHARACTERISTIC FrmMng_facAACC_Slope_C "Can-Umrechnungsparameter Steigung für beschleunigung" VALUE 0x1D78A2 Kw_Ws16 7.999878 Fact -4.000000 3.999878 FORMAT "%8.6" /end CHARACTERISTIC
/begin CHARACTERISTIC FrmMng_dAC1ID_C "Botschaftsidentifier CAN-Botschaft AC1" VALUE 0x1C0D28 Kw_Wu32 536870911.000 OneToOne 0.00 536870911.000 FORMAT "%13.3" EXTENDED_LIMITS 0.00 4294967295.00 /end CHARACTERISTIC
/begin CHARACTERISTIC FrmMng_AC1IDType_C "ID Typ standard oder extended" VALUE 0x1C0D2C Kw_Wu8 0.00 OneToOne 1.000 1.000 FORMAT "%5.3" EXTENDED_LIMITS 0.00 255.0 READ_ONLY /end CHARACTERISTIC
/begin CHARACTERISTIC FrmMng_AC1NumCAN_C "Auf welchen CAN die Botschaft ist" VALUE 0x1C0D2D Kw_Wu8 2.000 OneToOne 0.00 2.000 FORMAT "%5.3" EXTENDED_LIMITS 0.00 255.0 READ_ONLY /end CHARACTERISTIC
/begin CHARACTERISTIC FrmMng_AC1NumMsgPos_C "Message Buffer der verwendet wird" VALUE 0x1C0D2E Kw_Wu8 15.00 OneToOne 0.00 15.00 FORMAT "%5.2" EXTENDED_LIMITS 0.00 255.0 READ_ONLY /end CHARACTERISTIC
/begin CHARACTERISTIC FrmMng_AC1OpMode_C "Richtung transmit/receive" VALUE 0x1C0D2F Kw_Wu8 1.000 OneToOne 0.00 1.000 FORMAT "%5.3" EXTENDED_LIMITS 0.00 255.0 READ_ONLY /end CHARACTERISTIC
/begin CHARACTERISTIC FrmMng_dAC1SchedMesgLen_C "Applizierbare Botschaftlänge für AC1" VALUE 0x1C0D30 Kw_Wu8 8.000 OneToOne 0.00 8.000 FORMAT "%5.3" EXTENDED_LIMITS 0.00 255.0 /end CHARACTERISTIC
/begin CHARACTERISTIC FrmMng_AC1IntrEna_C "Interrupt enabled oder nicht" VALUE 0x1C0D31 Kw_Wu8 1.000 OneToOne 0.00 1.000 FORMAT "%5.3" EXTENDED_LIMITS 0.00 255.0 READ_ONLY /end CHARACTERISTIC
/begin CHARACTERISTIC FrmMng_AC1Mul_C "message Buffer ist multiplexed oder nicht" VALUE 0x1C0D32 Kw_Wu8 2.000 OneToOne 0.00 2.000 FORMAT "%5.3" EXTENDED_LIMITS 0.00 255.0 READ_ONLY /end CHARACTERISTIC
/begin CHARACTERISTIC FrmMng_AC1SchedMode_C "CAN Message Schedule Mode fuer RX und TX" VALUE 0x1C0D34 Kw_Wu8 160.0 OneToOne 16.00 176.0 FORMAT "%5.1" EXTENDED_LIMITS 0.00 255.0 READ_ONLY /end CHARACTERISTIC
/begin CHARACTERISTIC FrmMng_AC1Sched_C "Frequenz vom Transfer abhaengig vom Opmode" VALUE 0x1C0D35 Kw_Wu8 254.0 OneToOne 1.000 255.0 FORMAT "%5.1" EXTENDED_LIMITS 0.00 255.0 READ_ONLY /end CHARACTERISTIC
/begin CHARACTERISTIC FrmMng_AC1Strt_C "Message-Transfer-Aktivierung relativ zur Startzeit" VALUE 0x1C0D36 Kw_Wu8 255.0 OneToOne 0.00 255.0 FORMAT "%5.1" READ_ONLY /end CHARACTERISTIC
/begin CHARACTERISTIC FrmMng_AC1TOTmp_C "Timeout" VALUE 0x1C0D37 Kw_Wu8 5100. TimeCAN_TO_ms 20.00 5120. FORMAT "%5.0" /end CHARACTERISTIC
/begin CHARACTERISTIC FrmMng_dACC1ID_C "Identifier der ACC1-Botschaft" VALUE 0x1C0D38 Kw_Wu32 536870911.000 OneToOne 0.00 536870911.000 FORMAT "%13.3" EXTENDED_LIMITS 0.00 4294967295.00 /end CHARACTERISTIC
/begin CHARACTERISTIC FrmMng_ACC1IDType_C "ID Typ standard oder extended" VALUE 0x1C0D3C Kw_Wu8 0.00 OneToOne 1.000 1.000 FORMAT "%5.3" EXTENDED_LIMITS 0.00 255.0 READ_ONLY /end CHARACTERISTIC
/begin CHARACTERISTIC FrmMng_ACC1NumCAN_C "Auf welchen CAN die Botschaft ist" VALUE 0x1C0D3D Kw_Wu8 2.000 OneToOne 0.00 2.000 FORMAT "%5.3" EXTENDED_LIMITS 0.00 255.0 READ_ONLY /end CHARACTERISTIC
/begin CHARACTERISTIC FrmMng_ACC1NumMsgPos_C "Message Buffer der verwendet wird" VALUE 0x1C0D3E Kw_Wu8 15.00 OneToOne 0.00 15.00 FORMAT "%5.2" EXTENDED_LIMITS 0.00 255.0 READ_ONLY /end CHARACTERISTIC
/begin CHARACTERISTIC FrmMng_ACC1OpMode_C "Richtung transmit/receive" VALUE 0x1C0D3F Kw_Wu8 1.000 OneToOne 0.00 1.000 FORMAT "%5.3" EXTENDED_LIMITS 0.00 255.0 READ_ONLY /end CHARACTERISTIC
/begin CHARACTERISTIC FrmMng_dACC1SchedMesgLen_C "Applizierbare Botschaftslänge für ACC1 (Audi - ACC)" VALUE 0x1C0D40 Kw_Wu8 8.000 OneToOne 0.00 8.000 FORMAT "%5.3" EXTENDED_LIMITS 0.00 255.0 /end CHARACTERISTIC
/begin CHARACTERISTIC FrmMng_ACC1IntrEna_C "Interrupt enabled oder nicht" VALUE 0x1C0D41 Kw_Wu8 1.000 OneToOne 0.00 1.000 FORMAT "%5.3" EXTENDED_LIMITS 0.00 255.0 READ_ONLY /end CHARACTERISTIC
/begin CHARACTERISTIC FrmMng_ACC1Mul_C "message Buffer ist multiplexed oder nicht" VALUE 0x1C0D42 Kw_Wu8 2.000 OneToOne 0.00 2.000 FORMAT "%5.3" EXTENDED_LIMITS 0.00 255.0 /end CHARACTERISTIC
/begin CHARACTERISTIC FrmMng_ACC1TOTmp_C "Timeout" VALUE 0x1D8070 Kw_Wu8 5100. TimeCAN_TO_ms 20.00 5120. FORMAT "%5.0" /end CHARACTERISTIC
/begin CHARACTERISTIC FrmMng_dACCAID_C "Identifier der ACCA-Botschaft" VALUE 0x1C0D44 Kw_Wu32 536870911.000 OneToOne 0.00 536870911.000 FORMAT "%13.3" EXTENDED_LIMITS 0.00 4294967295.00 /end CHARACTERISTIC
/begin CHARACTERISTIC FrmMng_ACCAIDType_C "ID Typ standard oder extended" VALUE 0x1C0D48 Kw_Wu8 0.00 OneToOne 1.000 1.000 FORMAT "%5.3" EXTENDED_LIMITS 0.00 255.0 READ_ONLY /end CHARACTERISTIC
/begin CHARACTERISTIC FrmMng_ACCANumCAN_C "Auf welchen CAN die Botschaft ist" VALUE 0x1C0D49 Kw_Wu8 2.000 OneToOne 0.00 2.000 FORMAT "%5.3" EXTENDED_LIMITS 0.00 255.0 READ_ONLY /end CHARACTERISTIC
/begin CHARACTERISTIC FrmMng_ACCANumMsgPos_C "Message Buffer der verwendet wird" VALUE 0x1C0D4A Kw_Wu8 15.00 OneToOne 0.00 15.00 FORMAT "%5.2" EXTENDED_LIMITS 0.00 255.0 READ_ONLY /end CHARACTERISTIC
/begin CHARACTERISTIC FrmMng_ACCAOpMode_C "Richtung transmit/receive" VALUE 0x1C0D4B Kw_Wu8 1.000 OneToOne 0.00 1.000 FORMAT "%5.3" EXTENDED_LIMITS 0.00 255.0 READ_ONLY /end CHARACTERISTIC
/begin CHARACTERISTIC FrmMng_dACCASchedMesgLen_C "applizierbare Botschaftslänge für ACCA" VALUE 0x1C0D4C Kw_Wu8 8.000 OneToOne 0.00 8.000 FORMAT "%5.3" EXTENDED_LIMITS 0.00 255.0 /end CHARACTERISTIC
/begin CHARACTERISTIC FrmMng_ACCAIntrEna_C "Interrupt enabled oder nicht" VALUE 0x1C0D4D Kw_Wu8 1.000 OneToOne 0.00 1.000 FORMAT "%5.3" EXTENDED_LIMITS 0.00 255.0 READ_ONLY /end CHARACTERISTIC
/begin CHARACTERISTIC FrmMng_ACCAMul_C "message Buffer ist multiplexed oder nicht" VALUE 0x1C0D4E Kw_Wu8 2.000 OneToOne 0.00 2.000 FORMAT "%5.3" EXTENDED_LIMITS 0.00 255.0 /end CHARACTERISTIC
/begin CHARACTERISTIC FrmMng_ACCASchedMode_C "CAN Message Schedule Mode fuer RX und TX" VALUE 0x1C0D50 Kw_Wu8 160.0 OneToOne 16.00 176.0 FORMAT "%5.1" EXTENDED_LIMITS 0.00 255.0 READ_ONLY /end CHARACTERISTIC
/begin CHARACTERISTIC FrmMng_ACCASched_C "Frequenz vom Transfer abhaengig vom Opmode" VALUE 0x1C0D51 Kw_Wu8 254.0 OneToOne 1.000 255.0 FORMAT "%5.1" EXTENDED_LIMITS 0.00 255.0 READ_ONLY /end CHARACTERISTIC
/begin CHARACTERISTIC FrmMng_ACCAStrt_C "Message-Transfer-Aktivierung relativ zur Startzeit" VALUE 0x1C0D52 Kw_Wu8 255.0 OneToOne 0.00 255.0 FORMAT "%5.1" READ_ONLY /end CHARACTERISTIC
/begin CHARACTERISTIC FrmMng_ACCATOTmp_C "Timeout" VALUE 0x1C0D53 Kw_Wu8 5100. TimeCAN_TO_ms 20.00 5120. FORMAT "%5.0" /end CHARACTERISTIC
/begin CHARACTERISTIC FrmMng_dACCSysID_C "Botschaftsidentifier CAN-Botschaft ACC System" VALUE 0x1C0D54 Kw_Wu32 536870911.000 OneToOne 0.00 536870911.000 FORMAT "%13.3" EXTENDED_LIMITS 0.00 4294967295.00 /end CHARACTERISTIC
/begin CHARACTERISTIC FrmMng_ACCSysIDType_C "ID Typ standard oder extended" VALUE 0x1C0D58 Kw_Wu8 0.00 OneToOne 1.000 1.000 FORMAT "%5.3" EXTENDED_LIMITS 0.00 255.0 READ_ONLY /end CHARACTERISTIC
/begin CHARACTERISTIC FrmMng_ACCSysNumCAN_C "Auf welchen CAN die Botschaft ist" VALUE 0x1C0D59 Kw_Wu8 2.000 OneToOne 0.00 2.000 FORMAT "%5.3" EXTENDED_LIMITS 0.00 255.0 READ_ONLY /end CHARACTERISTIC
/begin CHARACTERISTIC FrmMng_ACCSysNumMsgPos_C "Message Buffer der verwendet wird" VALUE 0x1C0D5A Kw_Wu8 15.00 OneToOne 0.00 15.00 FORMAT "%5.2" EXTENDED_LIMITS 0.00 255.0 READ_ONLY /end CHARACTERISTIC
/begin CHARACTERISTIC FrmMng_ACCSysOpMode_C "Richtung transmit/receive" VALUE 0x1C0D5B Kw_Wu8 1.000 OneToOne 0.00 1.000 FORMAT "%5.3" EXTENDED_LIMITS 0.00 255.0 READ_ONLY /end CHARACTERISTIC
/begin CHARACTERISTIC FrmMng_dACCSysSchedMesgLen_C "applizierbare Botschaftslänge für ACCSys" VALUE 0x1C0D5C Kw_Wu8 8.000 OneToOne 0.00 8.000 FORMAT "%5.3" EXTENDED_LIMITS 0.00 255.0 /end CHARACTERISTIC
/begin CHARACTERISTIC FrmMng_ACCSysIntrEna_C "Interrupt enabled oder nicht" VALUE 0x1C0D5D Kw_Wu8 1.000 OneToOne 0.00 1.000 FORMAT "%5.3" EXTENDED_LIMITS 0.00 255.0 READ_ONLY /end CHARACTERISTIC
/begin CHARACTERISTIC FrmMng_ACCSysMul_C "message Buffer ist multiplexed oder nicht" VALUE 0x1C0D5E Kw_Wu8 2.000 OneToOne 0.00 2.000 FORMAT "%5.3" EXTENDED_LIMITS 0.00 255.0 /end CHARACTERISTIC
/begin CHARACTERISTIC FrmMng_ACCSystemSchedMode_C "CAN Message Schedule Mode fuer RX und TX" VALUE 0x1C0D60 Kw_Wu8 160.0 OneToOne 16.00 176.0 FORMAT "%5.1" EXTENDED_LIMITS 0.00 255.0 READ_ONLY /end CHARACTERISTIC
/begin CHARACTERISTIC FrmMng_ACCSystemSched_C "Frequenz vom Transfer abhaengig vom Opmode" VALUE 0x1C0D61 Kw_Wu8 254.0 OneToOne 1.000 255.0 FORMAT "%5.1" EXTENDED_LIMITS 0.00 255.0 READ_ONLY /end CHARACTERISTIC
/begin CHARACTERISTIC FrmMng_ACCSystemStrt_C "Message-Transfer-Aktivierung relativ zur Startzeit" VALUE 0x1C0D62 Kw_Wu8 255.0 OneToOne 0.00 255.0 FORMAT "%5.1" READ_ONLY /end CHARACTERISTIC
/begin CHARACTERISTIC FrmMng_ACCSystemTOTmp_C "Timeout" VALUE 0x1C0D63 Kw_Wu8 5100. TimeCAN_TO_ms 20.00 5120. FORMAT "%5.0" /end CHARACTERISTIC
/begin CHARACTERISTIC FrmMng_aCtlDvt_Offset_C "Can-Umrechnungsparameter Steigung für Zulässige regelabweichung" VALUE 0x1D78A4 Kw_Ws16 65.53500 Acc -32.76800 32.76700 FORMAT "%8.5" /end CHARACTERISTIC
/begin CHARACTERISTIC FrmMng_facACtlDvt_Slope_C "Can-Umrechnungsparameter Steigung für Zulässige regelabweichung" VALUE 0x1D78A6 Kw_Ws16 7.999878 Fact -4.000000 3.999878 FORMAT "%8.6" /end CHARACTERISTIC
/begin CHARACTERISTIC FrmMng_aDes_Offset_C "Can-Umrechnungsparameter Offset für Sollbeschleunigung" VALUE 0x1D78A8 Kw_Ws16 65.53500 Acc -32.76800 32.76700 FORMAT "%8.5" /end CHARACTERISTIC
/begin CHARACTERISTIC FrmMng_facADes_Slope_C "Can-Umrechnungsparameter Steigung für Sollbeschleunigung" VALUE 0x1D78AA Kw_Ws16 7.999878 Fact -4.000000 3.999878 FORMAT "%8.6" /end CHARACTERISTIC
/begin CHARACTERISTIC FrmMng_tiAdpPT1_C "PT1 Filterzeit für die Reibmomnetendifferenzbildung" VALUE 0x1D7B08 Kw_Wu32 4294.9673 TimeDelay_s 0.0000010000000 4294.9673 FORMAT "%9.4" /end CHARACTERISTIC
/begin CHARACTERISTIC FrmMng_dAIRBG1ID_C "Botschaftsidentifier CAN-Botschaft AIRBG1" VALUE 0x1C0D64 Kw_Wu32 536870911.000 OneToOne 0.00 536870911.000 FORMAT "%13.3" EXTENDED_LIMITS 0.00 4294967295.00 /end CHARACTERISTIC
/begin CHARACTERISTIC FrmMng_AIRBG1IDType_C "ID Typ standard oder extended" VALUE 0x1C0D68 Kw_Wu8 0.00 OneToOne 1.000 1.000 FORMAT "%5.3" EXTENDED_LIMITS 0.00 255.0 READ_ONLY /end CHARACTERISTIC
/begin CHARACTERISTIC FrmMng_AIRBG1NumCAN_C "Auf welchen CAN die Botschaft ist" VALUE 0x1C0D69 Kw_Wu8 2.000 OneToOne 0.00 2.000 FORMAT "%5.3" EXTENDED_LIMITS 0.00 255.0 READ_ONLY /end CHARACTERISTIC
/begin CHARACTERISTIC FrmMng_AIRBG1NumMsgPos_C "Message Buffer der verwendet wird" VALUE 0x1C0D6A Kw_Wu8 15.00 OneToOne 0.00 15.00 FORMAT "%5.2" EXTENDED_LIMITS 0.00 255.0 READ_ONLY /end CHARACTERISTIC
/begin CHARACTERISTIC FrmMng_AIRBG1OpMode_C "Richtung transmit/receive" VALUE 0x1C0D6B Kw_Wu8 1.000 OneToOne 0.00 1.000 FORMAT "%5.3" EXTENDED_LIMITS 0.00 255.0 READ_ONLY /end CHARACTERISTIC
/begin CHARACTERISTIC FrmMng_dAIRBG1SchedMesgLen_C "Applizierbare Botschaftlänge für AIRBG1" VALUE 0x1C0D6C Kw_Wu8 8.000 OneToOne 0.00 8.000 FORMAT "%5.3" EXTENDED_LIMITS 0.00 255.0 /end CHARACTERISTIC
/begin CHARACTERISTIC FrmMng_AIRBG1IntrEna_C "Interrupt enabled oder nicht" VALUE 0x1C0D6D Kw_Wu8 1.000 OneToOne 0.00 1.000 FORMAT "%5.3" EXTENDED_LIMITS 0.00 255.0 READ_ONLY /end CHARACTERISTIC
/begin CHARACTERISTIC FrmMng_AIRBG1Mul_C "message Buffer ist multiplexed oder nicht" VALUE 0x1C0D6E Kw_Wu8 2.000 OneToOne 0.00 2.000 FORMAT "%5.3" EXTENDED_LIMITS 0.00 255.0 READ_ONLY /end CHARACTERISTIC
/begin CHARACTERISTIC FrmMng_AIRBG1SchedMode_C "CAN Message Schedule Mode fuer RX und TX" VALUE 0x1C0D70 Kw_Wu8 160.0 OneToOne 16.00 176.0 FORMAT "%5.1" EXTENDED_LIMITS 0.00 255.0 READ_ONLY /end CHARACTERISTIC
/begin CHARACTERISTIC FrmMng_AIRBG1Sched_C "Frequenz vom Transfer abhaengig vom Opmode" VALUE 0x1C0D71 Kw_Wu8 254.0 OneToOne 1.000 255.0 FORMAT "%5.1" EXTENDED_LIMITS 0.00 255.0 READ_ONLY /end CHARACTERISTIC
/begin CHARACTERISTIC FrmMng_AIRBG1Strt_C "Message-Transfer-Aktivierung relativ zur Startzeit" VALUE 0x1C0D72 Kw_Wu8 255.0 OneToOne 0.00 255.0 FORMAT "%5.1" READ_ONLY /end CHARACTERISTIC
/begin CHARACTERISTIC FrmMng_AIRBG1TOTmp_C "Timeout" VALUE 0x1C0D73 Kw_Wu8 5100. TimeCAN_TO_ms 20.00 5120. FORMAT "%5.0" /end CHARACTERISTIC
/begin CHARACTERISTIC FrmMng_aLong_Offset_C "Can-Umrechnungsparameter Offset für Längsbeschleunigung" VALUE 0x1D791A Kw_Ws16 65.53500 Acc -32.76800 32.76700 FORMAT "%8.5" /end CHARACTERISTIC
/begin CHARACTERISTIC FrmMng_facALong_Slope_C "Can-Umrechnungsparameter Steingung für Längsbeschleunigung" VALUE 0x1D791C Kw_Ws16 7.999878 Fact -4.000000 3.999878 FORMAT "%8.6" /end CHARACTERISTIC
/begin CHARACTERISTIC FrmMng_aTrnvrs_Offset_C "Offset Umrechung CAN -> SG für Querbeschelunigung" VALUE 0x1D791E Kw_Ws16 655.3500 TrnvrsAcc -327.6800 327.6700 FORMAT "%8.4" /end CHARACTERISTIC
/begin CHARACTERISTIC FrmMng_facATrnvrs_Slope_C "Steigung fuer Umwandlung von Querbeschleunigung" VALUE 0x1D7920 Kw_Ws16 7.999878 Fact -4.000000 3.999878 FORMAT "%8.6" /end CHARACTERISTIC
/begin CHARACTERISTIC FrmMng_aVeh_Offset_C "Can-Umrechnungsparameter Offset für Fahrzeugbeschleunigung" VALUE 0x1D7922 Kw_Ws16 65.53500 Acc -32.76800 32.76700 FORMAT "%8.5" /end CHARACTERISTIC
/begin CHARACTERISTIC FrmMng_facAVeh_Slope_C "Can-Umrechnungsparameter Steingung für Fahrzeugbeschleunigung" VALUE 0x1D7924 Kw_Ws16 7.999878 Fact -4.000000 3.999878 FORMAT "%8.6" /end CHARACTERISTIC
/begin CHARACTERISTIC FrmMng_dAWD1ID_C "Message Identifier der CAN Botschaft Allrad1" VALUE 0x1C0D74 Kw_Wu32 536870911.000 OneToOne 0.00 536870911.000 FORMAT "%13.3" EXTENDED_LIMITS 0.00 4294967295.00 /end CHARACTERISTIC
/begin CHARACTERISTIC FrmMng_AWD1IDType_C "ID Typ standard oder extended" VALUE 0x1C0D78 Kw_Wu8 0.00 OneToOne 1.000 1.000 FORMAT "%5.3" EXTENDED_LIMITS 0.00 255.0 READ_ONLY /end CHARACTERISTIC
/begin CHARACTERISTIC FrmMng_AWD1NumCAN_C "Auf welchen CAN die Botschaft ist" VALUE 0x1C0D79 Kw_Wu8 2.000 OneToOne 0.00 2.000 FORMAT "%5.3" EXTENDED_LIMITS 0.00 255.0 READ_ONLY /end CHARACTERISTIC
/begin CHARACTERISTIC FrmMng_AWD1NumMsgPos_C "Message Buffer der verwendet wird" VALUE 0x1C0D7A Kw_Wu8 15.00 OneToOne 0.00 15.00 FORMAT "%5.2" EXTENDED_LIMITS 0.00 255.0 READ_ONLY /end CHARACTERISTIC
/begin CHARACTERISTIC FrmMng_AWD1OpMode_C "Richtung transmit/receive" VALUE 0x1C0D7B Kw_Wu8 1.000 OneToOne 0.00 1.000 FORMAT "%5.3" EXTENDED_LIMITS 0.00 255.0 READ_ONLY /end CHARACTERISTIC
/begin CHARACTERISTIC FrmMng_dAWD1SchedMesgLen_C "Applizierbare Botschaftlänge für AWD1" VALUE 0x1C0D7C Kw_Wu8 8.000 OneToOne 0.00 8.000 FORMAT "%5.3" EXTENDED_LIMITS 0.00 255.0 /end CHARACTERISTIC
/begin CHARACTERISTIC FrmMng_AWD1IntrEna_C "Interrupt enabled oder nicht" VALUE 0x1C0D7D Kw_Wu8 1.000 OneToOne 0.00 1.000 FORMAT "%5.3" EXTENDED_LIMITS 0.00 255.0 READ_ONLY /end CHARACTERISTIC
/begin CHARACTERISTIC FrmMng_AWD1Mul_C "message Buffer ist multiplexed oder nicht" VALUE 0x1C0D7E Kw_Wu8 2.000 OneToOne 0.00 2.000 FORMAT "%5.3" EXTENDED_LIMITS 0.00 255.0 READ_ONLY /end CHARACTERISTIC
/begin CHARACTERISTIC FrmMng_AWD1SchedMode_C "CAN Message Schedule Mode fuer RX und TX" VALUE 0x1C0D80 Kw_Wu8 160.0 OneToOne 16.00 176.0 FORMAT "%5.1" EXTENDED_LIMITS 0.00 255.0 READ_ONLY /end CHARACTERISTIC
/begin CHARACTERISTIC FrmMng_AWD1Sched_C "Frequenz vom Transfer abhaengig vom Opmode" VALUE 0x1C0D81 Kw_Wu8 254.0 OneToOne 1.000 255.0 FORMAT "%5.1" EXTENDED_LIMITS 0.00 255.0 READ_ONLY /end CHARACTERISTIC
/begin CHARACTERISTIC FrmMng_AWD1Strt_C "Message-Transfer-Aktivierung relativ zur Startzeit" VALUE 0x1C0D82 Kw_Wu8 255.0 OneToOne 0.00 255.0 FORMAT "%5.1" READ_ONLY /end CHARACTERISTIC
/begin CHARACTERISTIC FrmMng_AWD1TOTmp_C "Timeout" VALUE 0x1C0D83 Kw_Wu8 5100. TimeCAN_TO_ms 20.00 5120. FORMAT "%5.0" /end CHARACTERISTIC
/begin CHARACTERISTIC FrmMng_dBEM1ID_C "CAN Botschafts-ID für BEM1-Botschaft" VALUE 0x1C0D84 Kw_Wu32 536870911.000 OneToOne 0.00 536870911.000 FORMAT "%13.3" EXTENDED_LIMITS 0.00 4294967295.00 /end CHARACTERISTIC
/begin CHARACTERISTIC FrmMng_BEM1IDType_C "ID Typ standard oder extended" VALUE 0x1C0D88 Kw_Wu8 0.00 OneToOne 1.000 1.000 FORMAT "%5.3" EXTENDED_LIMITS 0.00 255.0 READ_ONLY /end CHARACTERISTIC
/begin CHARACTERISTIC FrmMng_BEM1NumCAN_C "Auf welchen CAN die Botschaft ist" VALUE 0x1C0D89 Kw_Wu8 2.000 OneToOne 0.00 2.000 FORMAT "%5.3" EXTENDED_LIMITS 0.00 255.0 READ_ONLY /end CHARACTERISTIC
/begin CHARACTERISTIC FrmMng_BEM1NumMsgPos_C "Message Buffer der verwendet wird" VALUE 0x1C0D8A Kw_Wu8 15.00 OneToOne 0.00 15.00 FORMAT "%5.2" EXTENDED_LIMITS 0.00 255.0 READ_ONLY /end CHARACTERISTIC
/begin CHARACTERISTIC FrmMng_BEM1OpMode_C "Richtung transmit/receive" VALUE 0x1C0D8B Kw_Wu8 1.000 OneToOne 0.00 1.000 FORMAT "%5.3" EXTENDED_LIMITS 0.00 255.0 READ_ONLY /end CHARACTERISTIC
/begin CHARACTERISTIC FrmMng_dBEM1SchedMesgLen_C "CAN Botschaftslänge fü BEM1-Botschaft" VALUE 0x1C0D8C Kw_Wu8 8.000 OneToOne 0.00 8.000 FORMAT "%5.3" EXTENDED_LIMITS 0.00 255.0 /end CHARACTERISTIC
/begin CHARACTERISTIC FrmMng_BEM1IntrEna_C "Interrupt enabled oder nicht" VALUE 0x1C0D8D Kw_Wu8 1.000 OneToOne 0.00 1.000 FORMAT "%5.3" EXTENDED_LIMITS 0.00 255.0 READ_ONLY /end CHARACTERISTIC
/begin CHARACTERISTIC FrmMng_BEM1Mul_C "message Buffer ist multiplexed oder nicht" VALUE 0x1C0D8E Kw_Wu8 2.000 OneToOne 0.00 2.000 FORMAT "%5.3" EXTENDED_LIMITS 0.00 255.0 /end CHARACTERISTIC
/begin CHARACTERISTIC FrmMng_BEM1SchedMode_C "CAN Message Schedule Mode fuer RX und TX" VALUE 0x1C0D90 Kw_Wu8 160.0 OneToOne 16.00 176.0 FORMAT "%5.1" EXTENDED_LIMITS 0.00 255.0 READ_ONLY /end CHARACTERISTIC
/begin CHARACTERISTIC FrmMng_BEM1Sched_C "Frequenz vom Transfer abhaengig vom Opmode" VALUE 0x1C0D91 Kw_Wu8 254.0 OneToOne 1.000 255.0 FORMAT "%5.1" EXTENDED_LIMITS 0.00 255.0 READ_ONLY /end CHARACTERISTIC
/begin CHARACTERISTIC FrmMng_BEM1Strt_C "Message-Transfer-Aktivierung relativ zur Startzeit" VALUE 0x1C0D92 Kw_Wu8 255.0 OneToOne 0.00 255.0 FORMAT "%5.1" READ_ONLY /end CHARACTERISTIC
/begin CHARACTERISTIC FrmMng_BEM1TOTmp_C "Timeout" VALUE 0x1C0D93 Kw_Wu8 5100. TimeCAN_TO_ms 20.00 5120. FORMAT "%5.0" /end CHARACTERISTIC
/begin CHARACTERISTIC FrmMng_dBRK1ID_C "Botschaftsidentifier CAN-Botschaft BRK1" VALUE 0x1C0D94 Kw_Wu32 536870911.000 OneToOne 0.00 536870911.000 FORMAT "%13.3" EXTENDED_LIMITS 0.00 4294967295.00 /end CHARACTERISTIC
/begin CHARACTERISTIC FrmMng_BRK1IDType_C "ID Typ standard oder extended" VALUE 0x1C0D98 Kw_Wu8 0.00 OneToOne 1.000 1.000 FORMAT "%5.3" EXTENDED_LIMITS 0.00 255.0 READ_ONLY /end CHARACTERISTIC
/begin CHARACTERISTIC FrmMng_BRK1NumCAN_C "Auf welchen CAN die Botschaft ist" VALUE 0x1C0D99 Kw_Wu8 2.000 OneToOne 0.00 2.000 FORMAT "%5.3" EXTENDED_LIMITS 0.00 255.0 READ_ONLY /end CHARACTERISTIC
/begin CHARACTERISTIC FrmMng_BRK1NumMsgPos_C "Message Buffer der verwendet wird" VALUE 0x1C0D9A Kw_Wu8 15.00 OneToOne 0.00 15.00 FORMAT "%5.2" EXTENDED_LIMITS 0.00 255.0 READ_ONLY /end CHARACTERISTIC
/begin CHARACTERISTIC FrmMng_BRK1OpMode_C "Richtung transmit/receive" VALUE 0x1C0D9B Kw_Wu8 1.000 OneToOne 0.00 1.000 FORMAT "%5.3" EXTENDED_LIMITS 0.00 255.0 READ_ONLY /end CHARACTERISTIC
/begin CHARACTERISTIC FrmMng_dBRK1SchedMesgLen_C "Applizierbare Botschaftlänge für BRK1" VALUE 0x1C0D9C Kw_Wu8 8.000 OneToOne 0.00 8.000 FORMAT "%5.3" EXTENDED_LIMITS 0.00 255.0 /end CHARACTERISTIC
/begin CHARACTERISTIC FrmMng_BRK1IntrEna_C "Interrupt enabled oder nicht" VALUE 0x1C0D9D Kw_Wu8 1.000 OneToOne 0.00 1.000 FORMAT "%5.3" EXTENDED_LIMITS 0.00 255.0 READ_ONLY /end CHARACTERISTIC
/begin CHARACTERISTIC FrmMng_BRK1Mul_C "message Buffer ist multiplexed oder nicht" VALUE 0x1C0D9E Kw_Wu8 2.000 OneToOne 0.00 2.000 FORMAT "%5.3" EXTENDED_LIMITS 0.00 255.0 READ_ONLY /end CHARACTERISTIC
/begin CHARACTERISTIC FrmMng_BRK1SchedMode_C "CAN Message Schedule Mode fuer RX und TX" VALUE 0x1C0DA0 Kw_Wu8 160.0 OneToOne 16.00 176.0 FORMAT "%5.1" EXTENDED_LIMITS 0.00 255.0 READ_ONLY /end CHARACTERISTIC
/begin CHARACTERISTIC FrmMng_BRK1Sched_C "Frequenz vom Transfer abhaengig vom Opmode" VALUE 0x1C0DA1 Kw_Wu8 254.0 OneToOne 1.000 255.0 FORMAT "%5.1" EXTENDED_LIMITS 0.00 255.0 READ_ONLY /end CHARACTERISTIC
/begin CHARACTERISTIC FrmMng_BRK1Strt_C "Message-Transfer-Aktivierung relativ zur Startzeit" VALUE 0x1C0DA2 Kw_Wu8 255.0 OneToOne 0.00 255.0 FORMAT "%5.1" READ_ONLY /end CHARACTERISTIC
/begin CHARACTERISTIC FrmMng_BRK1TOTmp_C "Timeout" VALUE 0x1C0DA3 Kw_Wu8 5100. TimeCAN_TO_ms 20.00 5120. FORMAT "%5.0" /end CHARACTERISTIC
/begin CHARACTERISTIC FrmMng_dBRK2ID_C "Botschaftsidentifier CAN-Botschaft BRK2" VALUE 0x1C0DA4 Kw_Wu32 536870911.000 OneToOne 0.00 536870911.000 FORMAT "%13.3" EXTENDED_LIMITS 0.00 4294967295.00 /end CHARACTERISTIC
/begin CHARACTERISTIC FrmMng_BRK2IDType_C "ID Typ standard oder extended" VALUE 0x1C0DA8 Kw_Wu8 0.00 OneToOne 1.000 1.000 FORMAT "%5.3" EXTENDED_LIMITS 0.00 255.0 READ_ONLY /end CHARACTERISTIC
/begin CHARACTERISTIC FrmMng_BRK2NumCAN_C "Auf welchen CAN die Botschaft ist" VALUE 0x1C0DA9 Kw_Wu8 2.000 OneToOne 0.00 2.000 FORMAT "%5.3" EXTENDED_LIMITS 0.00 255.0 READ_ONLY /end CHARACTERISTIC
/begin CHARACTERISTIC FrmMng_BRK2NumMsgPos_C "Message Buffer der verwendet wird" VALUE 0x1C0DAA Kw_Wu8 15.00 OneToOne 0.00 15.00 FORMAT "%5.2" EXTENDED_LIMITS 0.00 255.0 READ_ONLY /end CHARACTERISTIC
/begin CHARACTERISTIC FrmMng_BRK2OpMode_C "Richtung transmit/receive" VALUE 0x1C0DAB Kw_Wu8 1.000 OneToOne 0.00 1.000 FORMAT "%5.3" EXTENDED_LIMITS 0.00 255.0 READ_ONLY /end CHARACTERISTIC
/begin CHARACTERISTIC FrmMng_dBRK2SchedMesgLen_C "Applizierbare Botschaftlänge für BRK2" VALUE 0x1C0DAC Kw_Wu8 8.000 OneToOne 0.00 8.000 FORMAT "%5.3" EXTENDED_LIMITS 0.00 255.0 /end CHARACTERISTIC
/begin CHARACTERISTIC FrmMng_BRK2IntrEna_C "Interrupt enabled oder nicht" VALUE 0x1C0DAD Kw_Wu8 1.000 OneToOne 0.00 1.000 FORMAT "%5.3" EXTENDED_LIMITS 0.00 255.0 READ_ONLY /end CHARACTERISTIC
/begin CHARACTERISTIC FrmMng_BRK2Mul_C "message Buffer ist multiplexed oder nicht" VALUE 0x1C0DAE Kw_Wu8 2.000 OneToOne 0.00 2.000 FORMAT "%5.3" EXTENDED_LIMITS 0.00 255.0 READ_ONLY /end CHARACTERISTIC
/begin CHARACTERISTIC FrmMng_BRK2SchedMode_C "CAN Message Schedule Mode fuer RX und TX" VALUE 0x1C0DB0 Kw_Wu8 160.0 OneToOne 16.00 176.0 FORMAT "%5.1" EXTENDED_LIMITS 0.00 255.0 READ_ONLY /end CHARACTERISTIC
/begin CHARACTERISTIC FrmMng_BRK2Sched_C "Frequenz vom Transfer abhaengig vom Opmode" VALUE 0x1C0DB1 Kw_Wu8 254.0 OneToOne 1.000 255.0 FORMAT "%5.1" EXTENDED_LIMITS 0.00 255.0 READ_ONLY /end CHARACTERISTIC
/begin CHARACTERISTIC FrmMng_BRK2Strt_C "Message-Transfer-Aktivierung relativ zur Startzeit" VALUE 0x1C0DB2 Kw_Wu8 255.0 OneToOne 0.00 255.0 FORMAT "%5.1" READ_ONLY /end CHARACTERISTIC
/begin CHARACTERISTIC FrmMng_BRK2TOTmp_C "Timeout" VALUE 0x1C0DB3 Kw_Wu8 5100. TimeCAN_TO_ms 20.00 5120. FORMAT "%5.0" /end CHARACTERISTIC
/begin CHARACTERISTIC FrmMng_dBRK8ID_C "Botschaftsidentifier CAN-Botschaft BRK8" VALUE 0x1C0DB4 Kw_Wu32 536870911.000 OneToOne 0.00 536870911.000 FORMAT "%13.3" EXTENDED_LIMITS 0.00 4294967295.00 /end CHARACTERISTIC
/begin CHARACTERISTIC FrmMng_BRK8IDType_C "ID Typ standard oder extended" VALUE 0x1C0DB8 Kw_Wu8 0.00 OneToOne 1.000 1.000 FORMAT "%5.3" EXTENDED_LIMITS 0.00 255.0 READ_ONLY /end CHARACTERISTIC
/begin CHARACTERISTIC FrmMng_BRK8NumCAN_C "Auf welchen CAN die Botschaft ist" VALUE 0x1C0DB9 Kw_Wu8 2.000 OneToOne 0.00 2.000 FORMAT "%5.3" EXTENDED_LIMITS 0.00 255.0 READ_ONLY /end CHARACTERISTIC
/begin CHARACTERISTIC FrmMng_BRK8NumMsgPos_C "Message Buffer der verwendet wird" VALUE 0x1C0DBA Kw_Wu8 15.00 OneToOne 0.00 15.00 FORMAT "%5.2" EXTENDED_LIMITS 0.00 255.0 READ_ONLY /end CHARACTERISTIC
/begin CHARACTERISTIC FrmMng_BRK8OpMode_C "Richtung transmit/receive" VALUE 0x1C0DBB Kw_Wu8 1.000 OneToOne 0.00 1.000 FORMAT "%5.3" EXTENDED_LIMITS 0.00 255.0 READ_ONLY /end CHARACTERISTIC
/begin CHARACTERISTIC FrmMng_dBRK8SchedMesgLen_C "Applizierbare Botschaftlänge für BRK8" VALUE 0x1C0DBC Kw_Wu8 8.000 OneToOne 0.00 8.000 FORMAT "%5.3" EXTENDED_LIMITS 0.00 255.0 /end CHARACTERISTIC
/begin CHARACTERISTIC FrmMng_BRK8IntrEna_C "Interrupt enabled oder nicht" VALUE 0x1C0DBD Kw_Wu8 1.000 OneToOne 0.00 1.000 FORMAT "%5.3" EXTENDED_LIMITS 0.00 255.0 READ_ONLY /end CHARACTERISTIC
/begin CHARACTERISTIC FrmMng_BRK8Mul_C "message Buffer ist multiplexed oder nicht" VALUE 0x1C0DBE Kw_Wu8 2.000 OneToOne 0.00 2.000 FORMAT "%5.3" EXTENDED_LIMITS 0.00 255.0 READ_ONLY /end CHARACTERISTIC
/begin CHARACTERISTIC FrmMng_BRK8SchedMode_C "CAN Message Schedule Mode fuer RX und TX" VALUE 0x1C0DC0 Kw_Wu8 160.0 OneToOne 16.00 176.0 FORMAT "%5.1" EXTENDED_LIMITS 0.00 255.0 READ_ONLY /end CHARACTERISTIC
/begin CHARACTERISTIC FrmMng_BRK8Sched_C "Frequenz vom Transfer abhaengig vom Opmode" VALUE 0x1C0DC1 Kw_Wu8 254.0 OneToOne 1.000 255.0 FORMAT "%5.1" EXTENDED_LIMITS 0.00 255.0 READ_ONLY /end CHARACTERISTIC
/begin CHARACTERISTIC FrmMng_BRK8Strt_C "Message-Transfer-Aktivierung relativ zur Startzeit" VALUE 0x1C0DC2 Kw_Wu8 255.0 OneToOne 0.00 255.0 FORMAT "%5.1" READ_ONLY /end CHARACTERISTIC
/begin CHARACTERISTIC FrmMng_BRK8TOTmp_C "Timeout" VALUE 0x1C0DC3 Kw_Wu8 5100. TimeCAN_TO_ms 20.00 5120. FORMAT "%5.0" /end CHARACTERISTIC
/begin CHARACTERISTIC FrmMng_BRK_ENABLEMASK_C "Bitmaske für Statusbits in FrmMng_stBrk" VALUE 0x1D7926 Kw_Wu8 255.0 OneToOne 0.00 255.0 FORMAT "%5.1" /end CHARACTERISTIC
/begin CHARACTERISTIC FrmMng_BUF1MsgID_C "Botschaftsidentifier CAN-Botschaft BUF1" VALUE 0x1C0DC4 Kw_Wu32 536870911.000 OneToOne 0.00 536870911.000 FORMAT "%13.3" EXTENDED_LIMITS 0.00 4294967295.00 READ_ONLY /end CHARACTERISTIC
/begin CHARACTERISTIC FrmMng_BUF1IDType_C "ID Typ standard oder extended" VALUE 0x1C0DC8 Kw_Wu8 0.00 OneToOne 1.000 1.000 FORMAT "%5.3" EXTENDED_LIMITS 0.00 255.0 READ_ONLY /end CHARACTERISTIC
/begin CHARACTERISTIC FrmMng_BUF1NumCAN_C "Auf welchen CAN die Botschaft ist" VALUE 0x1C0DC9 Kw_Wu8 2.000 OneToOne 0.00 2.000 FORMAT "%5.3" EXTENDED_LIMITS 0.00 255.0 READ_ONLY /end CHARACTERISTIC
/begin CHARACTERISTIC FrmMng_BUF1NumMsgPos_C "Message Buffer der verwendet wird" VALUE 0x1C0DCA Kw_Wu8 15.00 OneToOne 0.00 15.00 FORMAT "%5.2" EXTENDED_LIMITS 0.00 255.0 READ_ONLY /end CHARACTERISTIC
/begin CHARACTERISTIC FrmMng_BUF1OpMode_C "Richtung transmit/receive" VALUE 0x1C0DCB Kw_Wu8 1.000 OneToOne 0.00 1.000 FORMAT "%5.3" EXTENDED_LIMITS 0.00 255.0 READ_ONLY /end CHARACTERISTIC
/begin CHARACTERISTIC FrmMng_dBuf1Len_cu8 "Laenge der Messagedaten in Byte" VALUE 0x1C0DCC Kw_Wu8 8.000 OneToOne 0.00 8.000 FORMAT "%5.3" EXTENDED_LIMITS 0.00 255.0 READ_ONLY /end CHARACTERISTIC
/begin CHARACTERISTIC FrmMng_BUF1IntrEna_C "Interrupt enabled oder nicht" VALUE 0x1C0DCD Kw_Wu8 1.000 OneToOne 0.00 1.000 FORMAT "%5.3" EXTENDED_LIMITS 0.00 255.0 READ_ONLY /end CHARACTERISTIC
/begin CHARACTERISTIC FrmMng_BUF1Mul_C "message Buffer ist multiplexed oder nicht" VALUE 0x1C0DCE Kw_Wu8 2.000 OneToOne 0.00 2.000 FORMAT "%5.3" EXTENDED_LIMITS 0.00 255.0 READ_ONLY /end CHARACTERISTIC
/begin CHARACTERISTIC FrmMng_dCCTLID_C "Botschaftsidentifier CAN-Botschaft CCTL" VALUE 0x1C0DD0 Kw_Wu32 536870911.000 OneToOne 0.00 536870911.000 FORMAT "%13.3" EXTENDED_LIMITS 0.00 4294967295.00 /end CHARACTERISTIC
/begin CHARACTERISTIC FrmMng_CCTLIDType_C "ID Typ standard oder extended" VALUE 0x1C0DD4 Kw_Wu8 0.00 OneToOne 1.000 1.000 FORMAT "%5.3" EXTENDED_LIMITS 0.00 255.0 READ_ONLY /end CHARACTERISTIC
/begin CHARACTERISTIC FrmMng_CCTLNumCAN_C "Auf welchen CAN die Botschaft ist" VALUE 0x1C0DD5 Kw_Wu8 2.000 OneToOne 0.00 2.000 FORMAT "%5.3" EXTENDED_LIMITS 0.00 255.0 READ_ONLY /end CHARACTERISTIC
/begin CHARACTERISTIC FrmMng_CCTLNumMsgPos_C "Message Buffer der verwendet wird" VALUE 0x1C0DD6 Kw_Wu8 15.00 OneToOne 0.00 15.00 FORMAT "%5.2" EXTENDED_LIMITS 0.00 255.0 READ_ONLY /end CHARACTERISTIC
/begin CHARACTERISTIC FrmMng_CCTLOpMode_C "Richtung transmit/receive" VALUE 0x1C0DD7 Kw_Wu8 1.000 OneToOne 0.00 1.000 FORMAT "%5.3" EXTENDED_LIMITS 0.00 255.0 READ_ONLY /end CHARACTERISTIC
/begin CHARACTERISTIC FrmMng_CCTLIntrEna_C "Interrupt enabled oder nicht" VALUE 0x1C0DD9 Kw_Wu8 1.000 OneToOne 0.00 1.000 FORMAT "%5.3" EXTENDED_LIMITS 0.00 255.0 READ_ONLY /end CHARACTERISTIC
/begin CHARACTERISTIC FrmMng_CCTLMul_C "message Buffer ist multiplexed oder nicht" VALUE 0x1C0DDA Kw_Wu8 2.000 OneToOne 0.00 2.000 FORMAT "%5.3" EXTENDED_LIMITS 0.00 255.0 READ_ONLY /end CHARACTERISTIC
/begin CHARACTERISTIC FrmMng_CCTLSchedMode_C "CAN Message Schedule Mode fuer RX und TX" VALUE 0x1C0DDC Kw_Wu8 160.0 OneToOne 16.00 176.0 FORMAT "%5.1" EXTENDED_LIMITS 0.00 255.0 READ_ONLY /end CHARACTERISTIC
/begin CHARACTERISTIC FrmMng_CCTLSched_C "Frequenz vom Transfer abhaengig vom Opmode" VALUE 0x1C0DDD Kw_Wu8 254.0 OneToOne 1.000 255.0 FORMAT "%5.1" EXTENDED_LIMITS 0.00 255.0 READ_ONLY /end CHARACTERISTIC
/begin CHARACTERISTIC FrmMng_CCTLStrt_C "Message-Transfer-Aktivierung relativ zur Startzeit" VALUE 0x1C0DDE Kw_Wu8 255.0 OneToOne 0.00 255.0 FORMAT "%5.1" READ_ONLY /end CHARACTERISTIC
/begin CHARACTERISTIC FrmMng_CCTLTOTmp_C "Timeout" VALUE 0x1C0DDF Kw_Wu8 5100. TimeCAN_TO_ms 20.00 5120. FORMAT "%5.0" /end CHARACTERISTIC
/begin CHARACTERISTIC FrmMng_dCHRGR1ID_C "Botschaftsidentifier CAN-Botschaft CHRGR1" VALUE 0x1C0DE0 Kw_Wu32 536870911.000 OneToOne 0.00 536870911.000 FORMAT "%13.3" EXTENDED_LIMITS 0.00 4294967295.00 /end CHARACTERISTIC
/begin CHARACTERISTIC FrmMng_CHRGR1IDType_C "ID Typ standard oder extended" VALUE 0x1C0DE4 Kw_Wu8 0.00 OneToOne 1.000 1.000 FORMAT "%5.3" EXTENDED_LIMITS 0.00 255.0 READ_ONLY /end CHARACTERISTIC
/begin CHARACTERISTIC FrmMng_CHRGR1NumCAN_C "Auf welchen CAN die Botschaft ist" VALUE 0x1C0DE5 Kw_Wu8 2.000 OneToOne 0.00 2.000 FORMAT "%5.3" EXTENDED_LIMITS 0.00 255.0 READ_ONLY /end CHARACTERISTIC
/begin CHARACTERISTIC FrmMng_CHRGR1NumMsgPos_C "Message Buffer der verwendet wird" VALUE 0x1C0DE6 Kw_Wu8 15.00 OneToOne 0.00 15.00 FORMAT "%5.2" EXTENDED_LIMITS 0.00 255.0 READ_ONLY /end CHARACTERISTIC
/begin CHARACTERISTIC FrmMng_CHRGR1OpMode_C "Richtung transmit/receive" VALUE 0x1C0DE7 Kw_Wu8 1.000 OneToOne 0.00 1.000 FORMAT "%5.3" EXTENDED_LIMITS 0.00 255.0 READ_ONLY /end CHARACTERISTIC
/begin CHARACTERISTIC FrmMng_dCHRGR1SchedMesgLen_C "Applizierbare Botschaftlänge für CHRGR1" VALUE 0x1C0DE8 Kw_Wu8 8.000 OneToOne 0.00 8.000 FORMAT "%5.3" EXTENDED_LIMITS 0.00 255.0 /end CHARACTERISTIC
/begin CHARACTERISTIC FrmMng_CHRGR1IntrEna_C "Interrupt enabled oder nicht" VALUE 0x1C0DE9 Kw_Wu8 1.000 OneToOne 0.00 1.000 FORMAT "%5.3" EXTENDED_LIMITS 0.00 255.0 READ_ONLY /end CHARACTERISTIC
/begin CHARACTERISTIC FrmMng_CHRGR1Mul_C "message Buffer ist multiplexed oder nicht" VALUE 0x1C0DEA Kw_Wu8 2.000 OneToOne 0.00 2.000 FORMAT "%5.3" EXTENDED_LIMITS 0.00 255.0 READ_ONLY /end CHARACTERISTIC
/begin CHARACTERISTIC FrmMng_CHRGR1SchedMode_C "CAN Message Schedule Mode fuer RX und TX" VALUE 0x1C0DEC Kw_Wu8 160.0 OneToOne 16.00 176.0 FORMAT "%5.1" EXTENDED_LIMITS 0.00 255.0 READ_ONLY /end CHARACTERISTIC
/begin CHARACTERISTIC FrmMng_CHRGR1Sched_C "Frequenz vom Transfer abhaengig vom Opmode" VALUE 0x1C0DED Kw_Wu8 254.0 OneToOne 1.000 255.0 FORMAT "%5.1" EXTENDED_LIMITS 0.00 255.0 READ_ONLY /end CHARACTERISTIC
/begin CHARACTERISTIC FrmMng_CHRGR1Strt_C "Message-Transfer-Aktivierung relativ zur Startzeit" VALUE 0x1C0DEE Kw_Wu8 255.0 OneToOne 0.00 255.0 FORMAT "%5.1" READ_ONLY /end CHARACTERISTIC
/begin CHARACTERISTIC FrmMng_CHRGR1TOTmp_C "Timeout" VALUE 0x1C0DEF Kw_Wu8 5100. TimeCAN_TO_ms 20.00 5120. FORMAT "%5.0" /end CHARACTERISTIC
/begin CHARACTERISTIC FrmMng_dCHRGR2ID_C "Botschaftsidentifier CAN-Botschaft CHRGR2" VALUE 0x1C0DF0 Kw_Wu32 536870911.000 OneToOne 0.00 536870911.000 FORMAT "%13.3" EXTENDED_LIMITS 0.00 4294967295.00 /end CHARACTERISTIC
/begin CHARACTERISTIC FrmMng_CHRGR2IDType_C "ID Typ standard oder extended" VALUE 0x1C0DF4 Kw_Wu8 0.00 OneToOne 1.000 1.000 FORMAT "%5.3" EXTENDED_LIMITS 0.00 255.0 READ_ONLY /end CHARACTERISTIC
/begin CHARACTERISTIC FrmMng_CHRGR2NumCAN_C "Auf welchen CAN die Botschaft ist" VALUE 0x1C0DF5 Kw_Wu8 2.000 OneToOne 0.00 2.000 FORMAT "%5.3" EXTENDED_LIMITS 0.00 255.0 READ_ONLY /end CHARACTERISTIC
/begin CHARACTERISTIC FrmMng_CHRGR2NumMsgPos_C "Message Buffer der verwendet wird" VALUE 0x1C0DF6 Kw_Wu8 15.00 OneToOne 0.00 15.00 FORMAT "%5.2" EXTENDED_LIMITS 0.00 255.0 READ_ONLY /end CHARACTERISTIC
/begin CHARACTERISTIC FrmMng_CHRGR2OpMode_C "Richtung transmit/receive" VALUE 0x1C0DF7 Kw_Wu8 1.000 OneToOne 0.00 1.000 FORMAT "%5.3" EXTENDED_LIMITS 0.00 255.0 READ_ONLY /end CHARACTERISTIC
/begin CHARACTERISTIC FrmMng_dCHRGR2SchedMesgLen_C "Applizierbare Botschaftlänge für CHRGR2" VALUE 0x1C0DF8 Kw_Wu8 8.000 OneToOne 0.00 8.000 FORMAT "%5.3" EXTENDED_LIMITS 0.00 255.0 /end CHARACTERISTIC
/begin CHARACTERISTIC FrmMng_CHRGR2IntrEna_C "Interrupt enabled oder nicht" VALUE 0x1C0DF9 Kw_Wu8 1.000 OneToOne 0.00 1.000 FORMAT "%5.3" EXTENDED_LIMITS 0.00 255.0 READ_ONLY /end CHARACTERISTIC
/begin CHARACTERISTIC FrmMng_CHRGR2Mul_C "message Buffer ist multiplexed oder nicht" VALUE 0x1C0DFA Kw_Wu8 2.000 OneToOne 0.00 2.000 FORMAT "%5.3" EXTENDED_LIMITS 0.00 255.0 READ_ONLY /end CHARACTERISTIC
/begin CHARACTERISTIC FrmMng_CHRGR2SchedMode_C "CAN Message Schedule Mode fuer RX und TX" VALUE 0x1C0DFC Kw_Wu8 160.0 OneToOne 16.00 176.0 FORMAT "%5.1" EXTENDED_LIMITS 0.00 255.0 READ_ONLY /end CHARACTERISTIC
/begin CHARACTERISTIC FrmMng_CHRGR2Sched_C "Frequenz vom Transfer abhaengig vom Opmode" VALUE 0x1C0DFD Kw_Wu8 254.0 OneToOne 1.000 255.0 FORMAT "%5.1" EXTENDED_LIMITS 0.00 255.0 READ_ONLY /end CHARACTERISTIC
/begin CHARACTERISTIC FrmMng_CHRGR2Strt_C "Message-Transfer-Aktivierung relativ zur Startzeit" VALUE 0x1C0DFE Kw_Wu8 255.0 OneToOne 0.00 255.0 FORMAT "%5.1" READ_ONLY /end CHARACTERISTIC
/begin CHARACTERISTIC FrmMng_CHRGR2TOTmp_C "Timeout" VALUE 0x1C0DFF Kw_Wu8 5100. TimeCAN_TO_ms 20.00 5120. FORMAT "%5.0" /end CHARACTERISTIC
/begin CHARACTERISTIC FrmMng_ctMulEng2_C "Multiplexzähler Botschaft Motor2" VALUE 0x1D7B0C Kw_Wu16 65535.00 OneToOne 0.00 65535.00 FORMAT "%8.2" /end CHARACTERISTIC
/begin CHARACTERISTIC FrmMng_ctMulEng5_C "Multiplexzähler Botschaft Motor5" VALUE 0x1D7B0E Kw_Wu16 65535.00 OneToOne 0.00 65535.00 FORMAT "%8.2" /end CHARACTERISTIC
/begin CHARACTERISTIC FrmMng_daACCGradMax_Offset_C "Can-Umrechnungsparameter Offset für Maximaler Anderungsgradient" VALUE 0x1D78AC Kw_Ws16 655.3500 RmpAccCan -327.6800 327.6700 FORMAT "%8.4" /end CHARACTERISTIC
/begin CHARACTERISTIC FrmMng_facDaACCGradMax_Slope_C "Can-Umrechnungsparameter Steigung für Maximaler Anderungsgradient" VALUE 0x1D78AE Kw_Ws16 7.999878 Fact -4.000000 3.999878 FORMAT "%8.6" /end CHARACTERISTIC
/begin CHARACTERISTIC FrmMng_dAirIndSys_C "Luftansaugsystem" VALUE 0x1D7B10 Kw_Wu8 1.000 OneToOne 0.00 1.000 FORMAT "%5.3" EXTENDED_LIMITS 0.00 255.0 /end CHARACTERISTIC
/begin CHARACTERISTIC FrmMng_DebAAGCNTDef_C "Entprellzeit Timeout-Fehler für AAG" VALUE 0x1D79B4 Kw_Wu16 655350.0 Time_ms 0.00 655350.0 FORMAT "%8.1" /end CHARACTERISTIC
/begin CHARACTERISTIC FrmMng_DebAAGCNTOk_C "Heilzeit Timeout-Fehler für AAG" VALUE 0x1D79B6 Kw_Wu16 655350.0 Time_ms 0.00 655350.0 FORMAT "%8.1" /end CHARACTERISTIC
/begin CHARACTERISTIC FrmMng_DebAAGTODef_C "Entprellzeit Timeout-Fehler für AAG" VALUE 0x1D79B8 Kw_Wu16 655350.0 Time_ms 0.00 655350.0 FORMAT "%8.1" /end CHARACTERISTIC
/begin CHARACTERISTIC FrmMng_DebAAGTOOk_C "Heilzeit Timeout-Fehler für AAG" VALUE 0x1D79BA Kw_Wu16 655350.0 Time_ms 0.00 655350.0 FORMAT "%8.1" /end CHARACTERISTIC
/begin CHARACTERISTIC FrmMng_DebAC1DLCDef_C "Entprellzeit für DLC-Fehler der Botschaft-AC1" VALUE 0x1D788E Kw_Wu16 655350.0 Time_ms 0.00 655350.0 FORMAT "%8.1" /end CHARACTERISTIC
/begin CHARACTERISTIC FrmMng_DebAC1DLCOk_C "Heilungszeit für DLC-Fehler der Botschaft-AC1" VALUE 0x1D7890 Kw_Wu16 655350.0 Time_ms 0.00 655350.0 FORMAT "%8.1" /end CHARACTERISTIC
/begin CHARACTERISTIC FrmMng_DebAC1TODef_C "Zeit bis AC1Time Out Fehler defekt" VALUE 0x1D7892 Kw_Wu16 655350.0 Time_ms 0.00 655350.0 FORMAT "%8.1" /end CHARACTERISTIC
/begin CHARACTERISTIC FrmMng_DebAC1TOOk_C "Zeit bis Fehler AC1 Time Out geheilt" VALUE 0x1D7894 Kw_Wu16 655350.0 Time_ms 0.00 655350.0 FORMAT "%8.1" /end CHARACTERISTIC
/begin CHARACTERISTIC FrmMng_DebACCCNTDef_C "Entprellzeit für Botschaftszähler-Fehler ACC Botschaft" VALUE 0x1D78B0 Kw_Wu16 655350.0 Time_ms 0.00 655350.0 FORMAT "%8.1" /end CHARACTERISTIC
/begin CHARACTERISTIC FrmMng_DebACCCNTOk_C "Heilzeit für Botschaftszähler-Fehler ACC Botschaft" VALUE 0x1D78B2 Kw_Wu16 655350.0 Time_ms 0.00 655350.0 FORMAT "%8.1" /end CHARACTERISTIC
/begin CHARACTERISTIC FrmMng_DebACCCSDef_C "Fehlerentprell-Ereignisse  für ACC-System Checksummenfehler" VALUE 0x1D78B4 Kw_Wu16 65535.00 OneToOne 0.00 65535.00 FORMAT "%8.2" /end CHARACTERISTIC
/begin CHARACTERISTIC FrmMng_DebACCCSOk_C "Fehlerheilungs-Ereignisse  für ACC-System Checksummenfehler" VALUE 0x1D78B6 Kw_Wu16 65535.00 OneToOne 0.00 65535.00 FORMAT "%8.2" READ_ONLY /end CHARACTERISTIC
/begin CHARACTERISTIC FrmMng_DebACCDLCDef_C "Entprellzeit für DLC-Fehler der Botschaft-ACC" VALUE 0x1D78B8 Kw_Wu16 655350.0 Time_ms 0.00 655350.0 FORMAT "%8.1" /end CHARACTERISTIC
/begin CHARACTERISTIC FrmMng_DebACCDLCOk_C "Heilungszeit für DLC-Fehler der Botschaft-ACC" VALUE 0x1D78BA Kw_Wu16 655350.0 Time_ms 0.00 655350.0 FORMAT "%8.1" /end CHARACTERISTIC
/begin CHARACTERISTIC FrmMng_DebACCTODef_C "Zeit bis ACC-System Time Out Fehler defekt" VALUE 0x1D78BC Kw_Wu16 655350.0 Time_ms 0.00 655350.0 FORMAT "%8.1" /end CHARACTERISTIC
/begin CHARACTERISTIC FrmMng_DebACCTOOk_C "Zeit bis ACC-System Fehler Time Out Fehler geheilt" VALUE 0x1D78BE Kw_Wu16 655350.0 Time_ms 0.00 655350.0 FORMAT "%8.1" /end CHARACTERISTIC
/begin CHARACTERISTIC FrmMng_DebAIRBGCNTDef_C "Entprellzeit für Botschaftszähler-Fehler Airbag Botschaft" VALUE 0x1D78CC Kw_Wu16 655350.0 Time_ms 0.00 655350.0 FORMAT "%8.1" /end CHARACTERISTIC
/begin CHARACTERISTIC FrmMng_DebAIRBGCNTOk_C "Heilzeit für Botschaftszähler-Fehler Airbag Botschaft" VALUE 0x1D78CE Kw_Wu16 655350.0 Time_ms 0.00 655350.0 FORMAT "%8.1" /end CHARACTERISTIC
/begin CHARACTERISTIC FrmMng_DebAIRBGCSDef_C "Fehlerentprell-Ereignisse für AIRBAG-System Checksummenfehler" VALUE 0x1D78D0 Kw_Wu16 65535.00 OneToOne 0.00 65535.00 FORMAT "%8.2" /end CHARACTERISTIC
/begin CHARACTERISTIC FrmMng_DebAIRBGCSOk_C "Fehlerheilungs-Ereignisse für AIRBAG-System Checksummenfehler" VALUE 0x1D78D2 Kw_Wu16 65535.00 OneToOne 0.00 65535.00 FORMAT "%8.2" /end CHARACTERISTIC
/begin CHARACTERISTIC FrmMng_DebAIRBGDLCDef_C "Entprellzeit für DLC-Fehler der Botschaft-AIRBG1" VALUE 0x1D78D4 Kw_Wu16 655350.0 Time_ms 0.00 655350.0 FORMAT "%8.1" /end CHARACTERISTIC
/begin CHARACTERISTIC FrmMng_DebAIRBGDLCOk_C "Heilungszeit für DLC-Fehler der Botschaft-AIRBG1" VALUE 0x1D78D6 Kw_Wu16 655350.0 Time_ms 0.00 655350.0 FORMAT "%8.1" /end CHARACTERISTIC
/begin CHARACTERISTIC FrmMng_DebAIRBGTODef_C "Zeit bis AIRBGTO Fehler defekt" VALUE 0x1D78D8 Kw_Wu16 655350.0 Time_ms 0.00 655350.0 FORMAT "%8.1" /end CHARACTERISTIC
/begin CHARACTERISTIC FrmMng_DebAIRBGTOOk_C "Zeit bis Fehler AIRBGTO geheilt" VALUE 0x1D78DA Kw_Wu16 655350.0 Time_ms 0.00 655350.0 FORMAT "%8.1" /end CHARACTERISTIC
/begin CHARACTERISTIC FrmMng_DebAWD1CNTDef_C "Entprellzeit für Botschaftszähler-Fehler Allrad1 Botschaft" VALUE 0x1D78EC Kw_Wu16 655350.0 Time_ms 0.00 655350.0 FORMAT "%8.1" /end CHARACTERISTIC
/begin CHARACTERISTIC FrmMng_DebAWD1CNTOk_C "Heilzeit für Botschaftszähler-Fehler Allrad 1 Botschaft" VALUE 0x1D78EE Kw_Wu16 655350.0 Time_ms 0.00 655350.0 FORMAT "%8.1" /end CHARACTERISTIC
/begin CHARACTERISTIC FrmMng_DebAWD1DLCDef_C "Entprellzeit für DLC-Fehler der Botschaft-AWD1" VALUE 0x1D78F0 Kw_Wu16 655350.0 Time_ms 0.00 655350.0 FORMAT "%8.1" /end CHARACTERISTIC
/begin CHARACTERISTIC FrmMng_DebAWD1DLCOk_C "Heilungszeit für DLC-Fehler der Botschaft-AWD1" VALUE 0x1D78F2 Kw_Wu16 655350.0 Time_ms 0.00 655350.0 FORMAT "%8.1" /end CHARACTERISTIC
/begin CHARACTERISTIC FrmMng_DebAWD1TODef_C "Entprellzeit für CAN Botschaft Allrad1 Fehler defekt" VALUE 0x1D78F4 Kw_Wu16 655350.0 Time_ms 0.00 655350.0 FORMAT "%8.1" /end CHARACTERISTIC
/begin CHARACTERISTIC FrmMng_DebAWD1TOOk_C "Entprellzeit für CAN Botschaft Allrad1 Fehler geheilt" VALUE 0x1D78F6 Kw_Wu16 655350.0 Time_ms 0.00 655350.0 FORMAT "%8.1" /end CHARACTERISTIC
/begin CHARACTERISTIC FrmMng_DebBEM1CNTDef_C "Entprellzeit für Botschaftszähler-Fehler BEM1 Botschaft" VALUE 0x1D7900 Kw_Wu16 655350.0 Time_ms 0.00 655350.0 FORMAT "%8.1" /end CHARACTERISTIC
/begin CHARACTERISTIC FrmMng_DebBEM1CNTOk_C "Heilzeit für Botschaftszähler-Fehler BEM1 Botschaft" VALUE 0x1D7902 Kw_Wu16 655350.0 Time_ms 0.00 655350.0 FORMAT "%8.1" /end CHARACTERISTIC
/begin CHARACTERISTIC FrmMng_DebBEM1CSDef_C "Fehlerentprell-Ereignisse für BEM1  Checksummenfehler" VALUE 0x1D7904 Kw_Wu16 65535.00 OneToOne 0.00 65535.00 FORMAT "%8.2" /end CHARACTERISTIC
/begin CHARACTERISTIC FrmMng_DebBEM1CSOk_C "Fehlerheilungs-Ereignisse für BEM1 Checksummenfehler" VALUE 0x1D7906 Kw_Wu16 65535.00 OneToOne 0.00 65535.00 FORMAT "%8.2" READ_ONLY /end CHARACTERISTIC
/begin CHARACTERISTIC FrmMng_DebBEM1DLCDef_C "Entprellzeit für DLC-Fehler der Botschaft-BEM1" VALUE 0x1D7908 Kw_Wu16 655350.0 Time_ms 0.00 655350.0 FORMAT "%8.1" /end CHARACTERISTIC
/begin CHARACTERISTIC FrmMng_DebBEM1DLCOk_C "Heilungszeit für DLC-Fehler der Botschaft-BEM1" VALUE 0x1D790A Kw_Wu16 655350.0 Time_ms 0.00 655350.0 FORMAT "%8.1" /end CHARACTERISTIC
/begin CHARACTERISTIC FrmMng_DebBEM1TODef_C "Entprellzeit für Timeout von BEM1-Botschaft" VALUE 0x1D790C Kw_Wu16 655350.0 Time_ms 0.00 655350.0 FORMAT "%8.1" /end CHARACTERISTIC
/begin CHARACTERISTIC FrmMng_DebBEM1TOOk_C "Heilungszeit für Timeout von BEM1-Botschaft" VALUE 0x1D790E Kw_Wu16 655350.0 Time_ms 0.00 655350.0 FORMAT "%8.1" /end CHARACTERISTIC
/begin CHARACTERISTIC FrmMng_DebBRK1CNTDef_C "Entprellzeit für Botschaftszähler-Fehler Bremse 1 Botschaft" VALUE 0x1D7928 Kw_Wu16 655350.0 Time_ms 0.00 655350.0 FORMAT "%8.1" /end CHARACTERISTIC
/begin CHARACTERISTIC FrmMng_DebBRK1CNTOk_C "Heilzeit für Botschaftszähler-Fehler Bremse 1 Botschaft" VALUE 0x1D792A Kw_Wu16 655350.0 Time_ms 0.00 655350.0 FORMAT "%8.1" /end CHARACTERISTIC
/begin CHARACTERISTIC FrmMng_DebBRK1CSDef_C "Fehlerentprell-Ereignisse für BRK8  Checksummenfehler" VALUE 0x1D792C Kw_Wu16 65535.00 OneToOne 0.00 65535.00 FORMAT "%8.2" /end CHARACTERISTIC
/begin CHARACTERISTIC FrmMng_DebBRK1CSOk_C "Fehlerheilungs-Ereignisse für BRK1 Checksummenfehler" VALUE 0x1D792E Kw_Wu16 65535.00 OneToOne 0.00 65535.00 FORMAT "%8.2" READ_ONLY /end CHARACTERISTIC
/begin CHARACTERISTIC FrmMng_DebBRK1DLCDef_C "Entprellzeit für DLC-Fehler der Botschaft-BRK1" VALUE 0x1D7930 Kw_Wu16 655350.0 Time_ms 0.00 655350.0 FORMAT "%8.1" /end CHARACTERISTIC
/begin CHARACTERISTIC FrmMng_DebBRK1DLCOk_C "Heilungszeit für DLC-Fehler der Botschaft-BRK1" VALUE 0x1D7932 Kw_Wu16 655350.0 Time_ms 0.00 655350.0 FORMAT "%8.1" /end CHARACTERISTIC
/begin CHARACTERISTIC FrmMng_DebBRK1TODef_C "Zeit bis BRK1TO Fehler defekt" VALUE 0x1D7934 Kw_Wu16 655350.0 Time_ms 0.00 655350.0 FORMAT "%8.1" /end CHARACTERISTIC
/begin CHARACTERISTIC FrmMng_DebBRK1TOOk_C "Zeit bis Fehler BRK1TO geheilt" VALUE 0x1D7936 Kw_Wu16 655350.0 Time_ms 0.00 655350.0 FORMAT "%8.1" /end CHARACTERISTIC
/begin CHARACTERISTIC FrmMng_DebBRK2CNTDef_C "Entprellzeit für Botschaftszähler-Fehler Bremse 2 Botschaft" VALUE 0x1D7938 Kw_Wu16 655350.0 Time_ms 0.00 655350.0 FORMAT "%8.1" /end CHARACTERISTIC
/begin CHARACTERISTIC FrmMng_DebBRK2CNTOk_C "Heilzeit für Botschaftszähler-Fehler Bremse 2 Botschaft" VALUE 0x1D793A Kw_Wu16 655350.0 Time_ms 0.00 655350.0 FORMAT "%8.1" /end CHARACTERISTIC
/begin CHARACTERISTIC FrmMng_DebBRK2DLCDef_C "Entprellzeit für DLC-Fehler der Botschaft-BRK2" VALUE 0x1D793C Kw_Wu16 655350.0 Time_ms 0.00 655350.0 FORMAT "%8.1" /end CHARACTERISTIC
/begin CHARACTERISTIC FrmMng_DebBRK2DLCOk_C "Heilungszeit für DLC-Fehler der Botschaft-BRK2" VALUE 0x1D793E Kw_Wu16 655350.0 Time_ms 0.00 655350.0 FORMAT "%8.1" /end CHARACTERISTIC
/begin CHARACTERISTIC FrmMng_DebBRK2TODef_C "Zeit bis BRK2 TO Fehler defekt" VALUE 0x1D7940 Kw_Wu16 655350.0 Time_ms 0.00 655350.0 FORMAT "%8.1" /end CHARACTERISTIC
/begin CHARACTERISTIC FrmMng_DebBRK2TOOk_C "Zeit bis Fehler BRK2 TO  geheilt" VALUE 0x1D7942 Kw_Wu16 655350.0 Time_ms 0.00 655350.0 FORMAT "%8.1" /end CHARACTERISTIC
/begin CHARACTERISTIC FrmMng_DebBRK8CNTDef_C "Entprellzeit für Botschaftszähler-Fehler Bremse 8 Botschaft" VALUE 0x1D7944 Kw_Wu16 655350.0 Time_ms 0.00 655350.0 FORMAT "%8.1" /end CHARACTERISTIC
/begin CHARACTERISTIC FrmMng_DebBRK8CNTOk_C "Heilzeit für Botschaftszähler-Fehler Bremse 8 Botschaft" VALUE 0x1D7946 Kw_Wu16 655350.0 Time_ms 0.00 655350.0 FORMAT "%8.1" /end CHARACTERISTIC
/begin CHARACTERISTIC FrmMng_DebBRK8CSDef_C "Fehlerentprell-Ereignisse für BRK8  Checksummenfehler" VALUE 0x1D7948 Kw_Wu16 65535.00 OneToOne 0.00 65535.00 FORMAT "%8.2" /end CHARACTERISTIC
/begin CHARACTERISTIC FrmMng_DebBRK8CSOk_C "Fehlerheilungs-Ereignisse für BRK8 Checksummenfehler" VALUE 0x1D794A Kw_Wu16 65535.00 OneToOne 0.00 65535.00 FORMAT "%8.2" READ_ONLY /end CHARACTERISTIC
/begin CHARACTERISTIC FrmMng_DebBRK8DLCDef_C "Entprellzeit für DLC-Fehler der Botschaft-BRK8" VALUE 0x1D794C Kw_Wu16 655350.0 Time_ms 0.00 655350.0 FORMAT "%8.1" /end CHARACTERISTIC
/begin CHARACTERISTIC FrmMng_DebBRK8DLCOk_C "Heilungszeit für DLC-Fehler der Botschaft-BRK8" VALUE 0x1D794E Kw_Wu16 655350.0 Time_ms 0.00 655350.0 FORMAT "%8.1" /end CHARACTERISTIC
/begin CHARACTERISTIC FrmMng_DebBRK8TODef_C "Zeit bis BRK8 TO Fehler defekt" VALUE 0x1D7950 Kw_Wu16 655350.0 Time_ms 0.00 655350.0 FORMAT "%8.1" /end CHARACTERISTIC
/begin CHARACTERISTIC FrmMng_DebBRK8TOOk_C "Zeit bis Fehler BRK8 TO geheilt" VALUE 0x1D7952 Kw_Wu16 655350.0 Time_ms 0.00 655350.0 FORMAT "%8.1" /end CHARACTERISTIC
/begin CHARACTERISTIC FrmMng_DebBSG3TODef_C "Zeit bis BSG3TO Fehler defekt" VALUE 0x1D799E Kw_Wu16 655350.0 Time_ms 0.00 655350.0 FORMAT "%8.1" /end CHARACTERISTIC
/begin CHARACTERISTIC FrmMng_DebBSG3TOOk_C "Zeit bis Fehler BSG3TO geheilt" VALUE 0x1D79A0 Kw_Wu16 655350.0 Time_ms 0.00 655350.0 FORMAT "%8.1" /end CHARACTERISTIC
/begin CHARACTERISTIC FrmMng_DebCCTLCNTDef_C "Entprellzeit für Botschaftszähler-Fehler Cruise Control Botschaft" VALUE 0x1D7878 Kw_Wu16 655350.0 Time_ms 0.00 655350.0 FORMAT "%8.1" /end CHARACTERISTIC
/begin CHARACTERISTIC FrmMng_DebCCTLCNTOk_C "Heilzeit für Botschaftszähler-Fehler Cruise Control Botschaft" VALUE 0x1D787A Kw_Wu16 655350.0 Time_ms 0.00 655350.0 FORMAT "%8.1" /end CHARACTERISTIC
/begin CHARACTERISTIC FrmMng_DebCCTLCSDef_C "Zeit bis CCTLCS Fehler defekt" VALUE 0x1D787C Kw_Wu16 65535.00 OneToOne 0.00 65535.00 FORMAT "%8.2" /end CHARACTERISTIC
/begin CHARACTERISTIC FrmMng_DebCCTLCSOk_C "Zeit bis CCTLCS Fehler geheilt" VALUE 0x1D787E Kw_Wu16 65535.00 OneToOne 0.00 65535.00 FORMAT "%8.2" READ_ONLY /end CHARACTERISTIC
/begin CHARACTERISTIC FrmMng_DebCCTLTODef_C "Zeit bis CCTLTO Fehler defekt" VALUE 0x1D7884 Kw_Wu16 655350.0 Time_ms 0.00 655350.0 FORMAT "%8.1" /end CHARACTERISTIC
/begin CHARACTERISTIC FrmMng_DebCCTLTOOk_C "Zeit bis Fehler CCTLTO geheilt" VALUE 0x1D7886 Kw_Wu16 655350.0 Time_ms 0.00 655350.0 FORMAT "%8.1" /end CHARACTERISTIC
/begin CHARACTERISTIC FrmMng_DebDIA1DLCDef_C "Entprellzeit für DLC-Fehler der Botschaft-DIA1" VALUE 0x1D79BC Kw_Wu16 655350.0 Time_ms 0.00 655350.0 FORMAT "%8.1" /end CHARACTERISTIC
/begin CHARACTERISTIC FrmMng_DebDIA1DLCOk_C "Heilungszeit für DLC-Fehler der Botschaft-DIA1" VALUE 0x1D79BE Kw_Wu16 655350.0 Time_ms 0.00 655350.0 FORMAT "%8.1" /end CHARACTERISTIC
/begin CHARACTERISTIC FrmMng_DebDIA1TODef_C "Entprellzeit für Tiomeoutfehler von DIA1-Botschaft" VALUE 0x1D79C0 Kw_Wu16 655350.0 Time_ms 0.00 655350.0 FORMAT "%8.1" /end CHARACTERISTIC
/begin CHARACTERISTIC FrmMng_DebDIA1TOOk_C "Heilungszeit für Timeoutfehler von DIA1-Botschaft" VALUE 0x1D79C2 Kw_Wu16 655350.0 Time_ms 0.00 655350.0 FORMAT "%8.1" /end CHARACTERISTIC
/begin CHARACTERISTIC FrmMng_DebDSP1CNTDef_C "Zeit bis DPS1CNT Fehler defekt" VALUE 0x1D7960 Kw_Wu16 655350.0 Time_ms 0.00 655350.0 FORMAT "%8.1" /end CHARACTERISTIC
/begin CHARACTERISTIC FrmMng_DebDSP1CNTOk_C "Zeit bis Fehler DSP1CNT geheilt" VALUE 0x1D7962 Kw_Wu16 655350.0 Time_ms 0.00 655350.0 FORMAT "%8.1" /end CHARACTERISTIC
/begin CHARACTERISTIC FrmMng_DebDSP1DLCDef_C "Entprellzeit für DLC-Fehler der Botschaft-DSP1" VALUE 0x1D7964 Kw_Wu16 655350.0 Time_ms 0.00 655350.0 FORMAT "%8.1" /end CHARACTERISTIC
/begin CHARACTERISTIC FrmMng_DebDSP1DLCOk_C "Heilungszeit für DLC-Fehler der Botschaft-DSP1" VALUE 0x1D7966 Kw_Wu16 655350.0 Time_ms 0.00 655350.0 FORMAT "%8.1" /end CHARACTERISTIC
/begin CHARACTERISTIC FrmMng_DebDSP1TODef_C "Zeit bis DPS1TO Fehler defekt" VALUE 0x1D7968 Kw_Wu16 655350.0 Time_ms 0.00 655350.0 FORMAT "%8.1" /end CHARACTERISTIC
/begin CHARACTERISTIC FrmMng_DebDSP1TOOk_C "Zeit bis Fehler DSP1TO geheilt" VALUE 0x1D796A Kw_Wu16 655350.0 Time_ms 0.00 655350.0 FORMAT "%8.1" /end CHARACTERISTIC
/begin CHARACTERISTIC FrmMng_DebDSP2DLCDef_C "Entprellzeit für DLC-Fehler der Botschaft-DSP2" VALUE 0x1D796C Kw_Wu16 655350.0 Time_ms 0.00 655350.0 FORMAT "%8.1" /end CHARACTERISTIC
/begin CHARACTERISTIC FrmMng_DebDSP2DLCOk_C "Heilungszeit für DLC-Fehler der Botschaft-DSP2" VALUE 0x1D796E Kw_Wu16 655350.0 Time_ms 0.00 655350.0 FORMAT "%8.1" /end CHARACTERISTIC
/begin CHARACTERISTIC FrmMng_DebDSP2TODef_C "Zeit bis DPS2TO Fehler defekt" VALUE 0x1D7970 Kw_Wu16 655350.0 Time_ms 0.00 655350.0 FORMAT "%8.1" /end CHARACTERISTIC
/begin CHARACTERISTIC FrmMng_DebDSP2TOOk_C "Zeit bis Fehler DSP2TO geheilt" VALUE 0x1D7972 Kw_Wu16 655350.0 Time_ms 0.00 655350.0 FORMAT "%8.1" /end CHARACTERISTIC
/begin CHARACTERISTIC FrmMng_DebDSP3DLCDef_C "Entprellzeit für DLC-Fehler der Botschaft-DSP3" VALUE 0x1D7974 Kw_Wu16 655350.0 Time_ms 0.00 655350.0 FORMAT "%8.1" /end CHARACTERISTIC
/begin CHARACTERISTIC FrmMng_DebDSP3DLCOk_C "Heilungszeit für DLC-Fehler der Botschaft-DSP3" VALUE 0x1D7976 Kw_Wu16 655350.0 Time_ms 0.00 655350.0 FORMAT "%8.1" /end CHARACTERISTIC
/begin CHARACTERISTIC FrmMng_DebDSP3TODef_C "Zeit bis DPS3 TO Fehler defekt" VALUE 0x1D7978 Kw_Wu16 655350.0 Time_ms 0.00 655350.0 FORMAT "%8.1" /end CHARACTERISTIC
/begin CHARACTERISTIC FrmMng_DebDSP3TOOk_C "Zeit bis Fehler DSP3 TO geheilt" VALUE 0x1D797A Kw_Wu16 655350.0 Time_ms 0.00 655350.0 FORMAT "%8.1" /end CHARACTERISTIC
/begin CHARACTERISTIC FrmMng_DebEPB1CNTDef_C "Fehlerentprellzeit CNT-Fehler EPB1 -Botschaft" VALUE 0x1D798A Kw_Wu16 655350.0 Time_ms 0.00 655350.0 FORMAT "%8.1" /end CHARACTERISTIC
/begin CHARACTERISTIC FrmMng_DebEPB1CNTOk_C "Heilzeit CNT-Fehler EPB1 -Botschaft" VALUE 0x1D798C Kw_Wu16 655350.0 Time_ms 0.00 655350.0 FORMAT "%8.1" /end CHARACTERISTIC
/begin CHARACTERISTIC FrmMng_DebEPB1CSDef_C "Fehlerentprellzeit für EPB1Checksummenfehler" VALUE 0x1D798E Kw_Wu16 65535.00 OneToOne 0.00 65535.00 FORMAT "%8.2" /end CHARACTERISTIC
/begin CHARACTERISTIC FrmMng_DebEPB1CSOk_C "Heilzeit für EPB1 ChecksummenfehlerEPB1" VALUE 0x1D7990 Kw_Wu16 65535.00 OneToOne 0.00 65535.00 FORMAT "%8.2" READ_ONLY /end CHARACTERISTIC
/begin CHARACTERISTIC FrmMng_DebEPB1DLCDef_C "Entprellzeit DLC-Fehler für EPB1-Botschaft" VALUE 0x1D7992 Kw_Wu16 655350.0 Time_ms 0.00 655350.0 FORMAT "%8.1" /end CHARACTERISTIC
/begin CHARACTERISTIC FrmMng_DebEPB1DLCOk_C "Heilzeit DLC-Fehler für EPB1-Botschaft" VALUE 0x1D7994 Kw_Wu16 655350.0 Time_ms 0.00 655350.0 FORMAT "%8.1" /end CHARACTERISTIC
/begin CHARACTERISTIC FrmMng_DebEPB1TODef_C "Entprellzeit Timeout-Fehler EPB1 -Botschaft" VALUE 0x1D7996 Kw_Wu16 655350.0 Time_ms 0.00 655350.0 FORMAT "%8.1" /end CHARACTERISTIC
/begin CHARACTERISTIC FrmMng_DebEPB1TOOk_C "Heilzeit Timeout-Fehler EPB1 -Botschaft" VALUE 0x1D7998 Kw_Wu16 655350.0 Time_ms 0.00 655350.0 FORMAT "%8.1" /end CHARACTERISTIC
/begin CHARACTERISTIC FrmMng_DebESCUTODef_C "Zeit bis ESCUTO Fehler defekt" VALUE 0x1D79A6 Kw_Wu16 655350.0 Time_ms 0.00 655350.0 FORMAT "%8.1" /end CHARACTERISTIC
/begin CHARACTERISTIC FrmMng_DebESCUTOOk_C "Zeit bis Fehler ESCUTO geheilt" VALUE 0x1D79A8 Kw_Wu16 655350.0 Time_ms 0.00 655350.0 FORMAT "%8.1" /end CHARACTERISTIC
/begin CHARACTERISTIC FrmMng_DebGW1DLCDef_C "Entprellzeit für DLC-Fehler der Botschaft-GW1" VALUE 0x1D79C4 Kw_Wu16 655350.0 Time_ms 0.00 655350.0 FORMAT "%8.1" /end CHARACTERISTIC
/begin CHARACTERISTIC FrmMng_DebGW1DLCOk_C "Heilungszeit für DLC-Fehler der Botschaft-GW1" VALUE 0x1D79C6 Kw_Wu16 655350.0 Time_ms 0.00 655350.0 FORMAT "%8.1" /end CHARACTERISTIC
/begin CHARACTERISTIC FrmMng_DebGW1TODef_C "Entprellzeit für Tiomeoutfehler von GW1-Botschaft" VALUE 0x1D79C8 Kw_Wu16 655350.0 Time_ms 0.00 655350.0 FORMAT "%8.1" /end CHARACTERISTIC
/begin CHARACTERISTIC FrmMng_DebGW1TOOk_C "Heilungszeit für Timeoutfehler von BGW1-Botschaft" VALUE 0x1D79CA Kw_Wu16 655350.0 Time_ms 0.00 655350.0 FORMAT "%8.1" /end CHARACTERISTIC
/begin CHARACTERISTIC FrmMng_DebILMCNTDef_C "Entprellzeit Timeout-Fehler für AAG" VALUE 0x1D79CC Kw_Wu16 655350.0 Time_ms 0.00 655350.0 FORMAT "%8.1" /end CHARACTERISTIC
/begin CHARACTERISTIC FrmMng_DebILMCNTOk_C "Heilzeit Timeout-Fehler für AAG" VALUE 0x1D79CE Kw_Wu16 655350.0 Time_ms 0.00 655350.0 FORMAT "%8.1" /end CHARACTERISTIC
/begin CHARACTERISTIC FrmMng_DebILMTODef_C "Entprellzeit Timeout-Fehler für ILM" VALUE 0x1D79D0 Kw_Wu16 655350.0 Time_ms 0.00 655350.0 FORMAT "%8.1" /end CHARACTERISTIC
/begin CHARACTERISTIC FrmMng_DebILMTOOk_C "Heilzeit Timeout-Fehler für ILM" VALUE 0x1D79D2 Kw_Wu16 655350.0 Time_ms 0.00 655350.0 FORMAT "%8.1" /end CHARACTERISTIC
/begin CHARACTERISTIC FrmMng_DebLICHT1TODef_C "Zeit bis LICHT1TO Fehler defekt" VALUE 0x1D79D4 Kw_Wu16 655350.0 Time_ms 0.00 655350.0 FORMAT "%8.1" /end CHARACTERISTIC
/begin CHARACTERISTIC FrmMng_DebLICHT1TOOk_C "Zeit bis Fehler LICHT1TO geheilt" VALUE 0x1D79D6 Kw_Wu16 655350.0 Time_ms 0.00 655350.0 FORMAT "%8.1" /end CHARACTERISTIC
/begin CHARACTERISTIC FrmMng_DebLICHT2TODef_C "Zeit bis LICHT2TO Fehler defekt" VALUE 0x1D79D8 Kw_Wu16 655350.0 Time_ms 0.00 655350.0 FORMAT "%8.1" /end CHARACTERISTIC
/begin CHARACTERISTIC FrmMng_DebLICHT2TOOk_C "Zeit bis Fehler LICHT2TO geheilt" VALUE 0x1D79DA Kw_Wu16 655350.0 Time_ms 0.00 655350.0 FORMAT "%8.1" /end CHARACTERISTIC
/begin CHARACTERISTIC FrmMng_tiDebCrCtlNeg_C "Debouncing Zeit für den crctl zerschmettern Info-Aufdeckung" VALUE 0x1D78DC Kw_Wu16 2000.000 TimeDeb 0.00 2000.000 FORMAT "%8.3" EXTENDED_LIMITS 0.00 655350.0 /end CHARACTERISTIC
/begin CHARACTERISTIC FrmMng_tiDebCrCtlPos_C "Debouncing Zeit für den crctl zerschmettern Info-Aufdeckung" VALUE 0x1D78DE Kw_Wu16 2000.000 TimeDeb 0.00 2000.000 FORMAT "%8.3" EXTENDED_LIMITS 0.00 655350.0 /end CHARACTERISTIC
/begin CHARACTERISTIC FrmMng_tiDebNeg_C "Entprellzeit für Erkennung eines sicheren Crashes Aus" VALUE 0x1D78E0 Kw_Wu16 2000.000 TimeDeb 0.00 2000.000 FORMAT "%8.3" EXTENDED_LIMITS 0.00 655350.0 /end CHARACTERISTIC
/begin CHARACTERISTIC FrmMng_tiDebPos_C "Entprellzeit für Erkennung eines Sicheren Crashes Ein" VALUE 0x1D78E2 Kw_Wu16 2000.000 TimeDeb 0.00 2000.000 FORMAT "%8.3" EXTENDED_LIMITS 0.00 655350.0 /end CHARACTERISTIC
/begin CHARACTERISTIC FrmMng_DebStIgnTODef_C "Zeit bis StIgn-TO (ZAS1) Fehler defekt" VALUE 0x1D7A24 Kw_Wu16 655350.0 Time_ms 0.00 655350.0 FORMAT "%8.1" /end CHARACTERISTIC
/begin CHARACTERISTIC FrmMng_DebStIgnTOOk_C "Zeit bis Fehler StIgn-TO (ZAS1) geheilt" VALUE 0x1D7A26 Kw_Wu16 655350.0 Time_ms 0.00 655350.0 FORMAT "%8.1" /end CHARACTERISTIC
/begin CHARACTERISTIC FrmMng_DebTSC1CNTDef_C "Entprellzeit für Botschaftszähler-Fehler Getriebe 1 Botschaft" VALUE 0x1D7A40 Kw_Wu16 655350.0 Time_ms 0.00 655350.0 FORMAT "%8.1" /end CHARACTERISTIC
/begin CHARACTERISTIC FrmMng_DebTSC1CNTOk_C "Heilzeit für Botschaftszähler-Fehler Getriebe 1 Botschaft" VALUE 0x1D7A42 Kw_Wu16 655350.0 Time_ms 0.00 655350.0 FORMAT "%8.1" /end CHARACTERISTIC
/begin CHARACTERISTIC FrmMng_DebTSC1TODef_C "Zeit bis EGS1TO Fehler defekt" VALUE 0x1D7A48 Kw_Wu16 655350.0 Time_ms 0.00 655350.0 FORMAT "%8.1" /end CHARACTERISTIC
/begin CHARACTERISTIC FrmMng_DebTSC1TOOk_C "Zeit bis Fehler EGS1TO geheilt" VALUE 0x1D7A4A Kw_Wu16 655350.0 Time_ms 0.00 655350.0 FORMAT "%8.1" /end CHARACTERISTIC
/begin CHARACTERISTIC FrmMng_DebTSC2CNTDef_C "Entprellzeit für Botschaftszähler-Fehler Getriebe 2 Botschaft" VALUE 0x1D7A4C Kw_Wu16 655350.0 Time_ms 0.00 655350.0 FORMAT "%8.1" /end CHARACTERISTIC
/begin CHARACTERISTIC FrmMng_DebTSC2CNTOk_C "Heilzeit für Botschaftszähler-Fehler Getriebe 2 Botschaft" VALUE 0x1D7A4E Kw_Wu16 655350.0 Time_ms 0.00 655350.0 FORMAT "%8.1" /end CHARACTERISTIC
/begin CHARACTERISTIC FrmMng_DebTSC2TODef_C "Zeit bis EGS2TO Fehler defekt" VALUE 0x1D7A54 Kw_Wu16 655350.0 Time_ms 0.00 655350.0 FORMAT "%8.1" /end CHARACTERISTIC
/begin CHARACTERISTIC FrmMng_DebTSC2TOOk_C "Zeit bis Fehler EGS2TO geheilt" VALUE 0x1D7A56 Kw_Wu16 655350.0 Time_ms 0.00 655350.0 FORMAT "%8.1" /end CHARACTERISTIC
/begin CHARACTERISTIC FrmMng_DebTSC3CNTDef_C "Entprellzeit für Botschaftszähler-Fehler Getriebe 3" VALUE 0x1D7A58 Kw_Wu16 655350.0 Time_ms 0.00 655350.0 FORMAT "%8.1" /end CHARACTERISTIC
/begin CHARACTERISTIC FrmMng_DebTSC3CNTOk_C "Heilzeit für Botschaftszähler-Fehler Getriebe 3 Botschaft" VALUE 0x1D7A5A Kw_Wu16 655350.0 Time_ms 0.00 655350.0 FORMAT "%8.1" /end CHARACTERISTIC
/begin CHARACTERISTIC FrmMng_DebTSC3TODef_C "Zeit bis TSC3Time Out Fehler defekt" VALUE 0x1D7A64 Kw_Wu16 655350.0 Time_ms 0.00 655350.0 FORMAT "%8.1" /end CHARACTERISTIC
/begin CHARACTERISTIC FrmMng_DebTSC3TOOk_C "Zeit bis Fehler TSC3 Time Out geheilt" VALUE 0x1D7A66 Kw_Wu16 655350.0 Time_ms 0.00 655350.0 FORMAT "%8.1" /end CHARACTERISTIC
/begin CHARACTERISTIC FrmMng_DebWIPERTODef_C "Zeit bis WIPERTO Fehler defekt" VALUE 0x1D79DC Kw_Wu16 655350.0 Time_ms 0.00 655350.0 FORMAT "%8.1" /end CHARACTERISTIC
/begin CHARACTERISTIC FrmMng_DebWIPERTOOk_C "Zeit bis Fehler WIPERTO geheilt" VALUE 0x1D79DE Kw_Wu16 655350.0 Time_ms 0.00 655350.0 FORMAT "%8.1" /end CHARACTERISTIC
/begin CHARACTERISTIC FrmMng_dDIA1ID_C "CAN-Botschafts ID für Diagnose1-Botschaft" VALUE 0x1C0E00 Kw_Wu32 536870911.000 OneToOne 0.00 536870911.000 FORMAT "%13.3" EXTENDED_LIMITS 0.00 4294967295.00 /end CHARACTERISTIC
/begin CHARACTERISTIC FrmMng_DIA1IDType_C "ID Typ standard oder extended" VALUE 0x1C0E04 Kw_Wu8 0.00 OneToOne 1.000 1.000 FORMAT "%5.3" EXTENDED_LIMITS 0.00 255.0 READ_ONLY /end CHARACTERISTIC
/begin CHARACTERISTIC FrmMng_DIA1NumCAN_C "Auf welchen CAN die Botschaft ist" VALUE 0x1C0E05 Kw_Wu8 2.000 OneToOne 0.00 2.000 FORMAT "%5.3" EXTENDED_LIMITS 0.00 255.0 READ_ONLY /end CHARACTERISTIC
/begin CHARACTERISTIC FrmMng_DIA1NumMsgPos_C "Message Buffer der verwendet wird" VALUE 0x1C0E06 Kw_Wu8 15.00 OneToOne 0.00 15.00 FORMAT "%5.2" EXTENDED_LIMITS 0.00 255.0 READ_ONLY /end CHARACTERISTIC
/begin CHARACTERISTIC FrmMng_DIA1OpMode_C "Richtung transmit/receive" VALUE 0x1C0E07 Kw_Wu8 1.000 OneToOne 0.00 1.000 FORMAT "%5.3" EXTENDED_LIMITS 0.00 255.0 READ_ONLY /end CHARACTERISTIC
/begin CHARACTERISTIC FrmMng_dDIA1SchedMesgLen_C "CAN Botschaftslänge für Diagnose1-Botschaft" VALUE 0x1C0E08 Kw_Wu8 8.000 OneToOne 0.00 8.000 FORMAT "%5.3" EXTENDED_LIMITS 0.00 255.0 /end CHARACTERISTIC
/begin CHARACTERISTIC FrmMng_DIA1IntrEna_C "Interrupt enabled oder nicht" VALUE 0x1C0E09 Kw_Wu8 1.000 OneToOne 0.00 1.000 FORMAT "%5.3" EXTENDED_LIMITS 0.00 255.0 READ_ONLY /end CHARACTERISTIC
/begin CHARACTERISTIC FrmMng_DIA1Mul_C "message Buffer ist multiplexed oder nicht" VALUE 0x1C0E0A Kw_Wu8 2.000 OneToOne 0.00 2.000 FORMAT "%5.3" EXTENDED_LIMITS 0.00 255.0 /end CHARACTERISTIC
/begin CHARACTERISTIC FrmMng_DIA1SchedMode_C "CAN Message Schedule Mode fuer RX und TX" VALUE 0x1C0E0C Kw_Wu8 160.0 OneToOne 16.00 176.0 FORMAT "%5.1" EXTENDED_LIMITS 0.00 255.0 READ_ONLY /end CHARACTERISTIC
/begin CHARACTERISTIC FrmMng_DIA1Sched_C "Frequenz vom Transfer abhaengig vom Opmode" VALUE 0x1C0E0D Kw_Wu8 254.0 OneToOne 1.000 255.0 FORMAT "%5.1" EXTENDED_LIMITS 0.00 255.0 READ_ONLY /end CHARACTERISTIC
/begin CHARACTERISTIC FrmMng_DIA1Strt_C "Message-Transfer-Aktivierung relativ zur Startzeit" VALUE 0x1C0E0E Kw_Wu8 255.0 OneToOne 0.00 255.0 FORMAT "%5.1" READ_ONLY /end CHARACTERISTIC
/begin CHARACTERISTIC FrmMng_DIA1TOTmp_C "Timeout" VALUE 0x1C0E0F Kw_Wu8 5100. TimeCAN_TO_ms 20.00 5120. FORMAT "%5.0" /end CHARACTERISTIC
/begin CHARACTERISTIC FrmMng_dMulinfo2_0_C "Multiplex Info 0, Botschaft Motor2" VALUE 0x1D7B1C Kw_Wu8 33.00 OneToOne 12.00 45.00 FORMAT "%5.2" EXTENDED_LIMITS 0.00 255.0 /end CHARACTERISTIC
/begin CHARACTERISTIC FrmMng_dMulinfo2_1_C "Multiplex Info 1, Botschaft Motor2" VALUE 0x1D7B1D Kw_Wu8 63.00 OneToOne 0.00 63.00 FORMAT "%5.2" EXTENDED_LIMITS 0.00 255.0 /end CHARACTERISTIC
/begin CHARACTERISTIC FrmMng_dMulinfo2_2_C "Multiplex Info 2, Botschaft Motor2" VALUE 0x1D7B1E Kw_Wu8 63.00 OneToOne 0.00 63.00 FORMAT "%5.2" EXTENDED_LIMITS 0.00 255.0 /end CHARACTERISTIC
/begin CHARACTERISTIC FrmMng_dnLI_C "Weite des Drehzahlintervalls" VALUE 0x1D7B2C Kw_Ws16 6000.000 EngN 0.00 6000.000 FORMAT "%8.3" EXTENDED_LIMITS -32768.00 32767.00 /end CHARACTERISTIC
/begin CHARACTERISTIC FrmMng_dNrVlv_C "Anzahl der Ventile" VALUE 0x1D7F38 Kw_Wu8 7.000 OneToOne 0.00 7.000 FORMAT "%5.3" EXTENDED_LIMITS 0.00 255.0 /end CHARACTERISTIC
/begin CHARACTERISTIC FrmMng_dOilload_C "Bewertungsfaktor Verschleißindex" VALUE 0x1D7F3A Kw_Wu16 6.296875 Fact1 0.00 6.296875 FORMAT "%8.6" EXTENDED_LIMITS 0.00 511.9922 /end CHARACTERISTIC
/begin CHARACTERISTIC FrmMng_dSlpFillCrv_C "Steigung der Befüllungskennlinie" VALUE 0x1D7F44 Kw_Wu16 0.2550049 RatVolLength 0.00 0.2550049 FORMAT "%9.7" EXTENDED_LIMITS 0.00 7.999878 /end CHARACTERISTIC
/begin CHARACTERISTIC FrmMng_dSootTurbo_C "Bewertungsfaktor Ruß oder Turbo" VALUE 0x1D7F4C Kw_Wu16 6.296875 Fact1 0.00 6.296875 FORMAT "%8.6" EXTENDED_LIMITS 0.00 511.9922 /end CHARACTERISTIC
/begin CHARACTERISTIC FrmMng_dDSP1ID_C "Botschaftsidentifier CAN-Botschaft DSP1" VALUE 0x1C0E10 Kw_Wu32 536870911.000 OneToOne 0.00 536870911.000 FORMAT "%13.3" EXTENDED_LIMITS 0.00 4294967295.00 /end CHARACTERISTIC
/begin CHARACTERISTIC FrmMng_DSP1IDType_C "ID Typ standard oder extended" VALUE 0x1C0E14 Kw_Wu8 0.00 OneToOne 1.000 1.000 FORMAT "%5.3" EXTENDED_LIMITS 0.00 255.0 READ_ONLY /end CHARACTERISTIC
/begin CHARACTERISTIC FrmMng_DSP1NumCAN_C "Auf welchen CAN die Botschaft ist" VALUE 0x1C0E15 Kw_Wu8 2.000 OneToOne 0.00 2.000 FORMAT "%5.3" EXTENDED_LIMITS 0.00 255.0 READ_ONLY /end CHARACTERISTIC
/begin CHARACTERISTIC FrmMng_DSP1NumMsgPos_C "Message Buffer der verwendet wird" VALUE 0x1C0E16 Kw_Wu8 15.00 OneToOne 0.00 15.00 FORMAT "%5.2" EXTENDED_LIMITS 0.00 255.0 READ_ONLY /end CHARACTERISTIC
/begin CHARACTERISTIC FrmMng_DSP1OpMode_C "Richtung transmit/receive" VALUE 0x1C0E17 Kw_Wu8 1.000 OneToOne 0.00 1.000 FORMAT "%5.3" EXTENDED_LIMITS 0.00 255.0 READ_ONLY /end CHARACTERISTIC
/begin CHARACTERISTIC FrmMng_dDSP1SchedMesgLen_C "Applizierbare Botschaftslänge für DSP1" VALUE 0x1C0E18 Kw_Wu8 8.000 OneToOne 0.00 8.000 FORMAT "%5.3" EXTENDED_LIMITS 0.00 255.0 /end CHARACTERISTIC
/begin CHARACTERISTIC FrmMng_DSP1IntrEna_C "Interrupt enabled oder nicht" VALUE 0x1C0E19 Kw_Wu8 1.000 OneToOne 0.00 1.000 FORMAT "%5.3" EXTENDED_LIMITS 0.00 255.0 READ_ONLY /end CHARACTERISTIC
/begin CHARACTERISTIC FrmMng_DSP1Mul_C "message Buffer ist multiplexed oder nicht" VALUE 0x1C0E1A Kw_Wu8 2.000 OneToOne 0.00 2.000 FORMAT "%5.3" EXTENDED_LIMITS 0.00 255.0 READ_ONLY /end CHARACTERISTIC
/begin CHARACTERISTIC FrmMng_DSP1SchedMode_C "CAN Message Schedule Mode RX und TX" VALUE 0x1C0E1C Kw_Wu8 160.0 OneToOne 16.00 176.0 FORMAT "%5.1" EXTENDED_LIMITS 0.00 255.0 READ_ONLY /end CHARACTERISTIC
/begin CHARACTERISTIC FrmMng_DSP1Sched_C "Frequenz vom Transfer abhaengig vom Opmode" VALUE 0x1C0E1D Kw_Wu8 254.0 OneToOne 1.000 255.0 FORMAT "%5.1" EXTENDED_LIMITS 0.00 255.0 READ_ONLY /end CHARACTERISTIC
/begin CHARACTERISTIC FrmMng_DSP1Strt_C "Message-Transfer-Aktivierung relativ zur Startzeit" VALUE 0x1C0E1E Kw_Wu8 255.0 OneToOne 0.00 255.0 FORMAT "%5.1" READ_ONLY /end CHARACTERISTIC
/begin CHARACTERISTIC FrmMng_DSP1TOTmp_C "bei fehlender Botschaft: Anzahl der Taskdurchläufe bis zum erkennen eines vorläufigen Timeouts" VALUE 0x1C0E1F Kw_Wu8 5100. TimeCAN_TO_ms 20.00 5120. FORMAT "%5.0" /end CHARACTERISTIC
/begin CHARACTERISTIC FrmMng_dDSP2ID_C "Botschaftsidentifier CAN-Botschaft DSP2" VALUE 0x1C0E20 Kw_Wu32 536870911.000 OneToOne 0.00 536870911.000 FORMAT "%13.3" EXTENDED_LIMITS 0.00 4294967295.00 /end CHARACTERISTIC
/begin CHARACTERISTIC FrmMng_DSP2IDType_C "ID Typ standard oder extended" VALUE 0x1C0E24 Kw_Wu8 0.00 OneToOne 1.000 1.000 FORMAT "%5.3" EXTENDED_LIMITS 0.00 255.0 READ_ONLY /end CHARACTERISTIC
/begin CHARACTERISTIC FrmMng_DSP2NumCAN_C "Auf welchen CAN die Botschaft ist" VALUE 0x1C0E25 Kw_Wu8 2.000 OneToOne 0.00 2.000 FORMAT "%5.3" EXTENDED_LIMITS 0.00 255.0 READ_ONLY /end CHARACTERISTIC
/begin CHARACTERISTIC FrmMng_DSP2NumMsgPos_C "Message Buffer der verwendet wird" VALUE 0x1C0E26 Kw_Wu8 15.00 OneToOne 0.00 15.00 FORMAT "%5.2" EXTENDED_LIMITS 0.00 255.0 READ_ONLY /end CHARACTERISTIC
/begin CHARACTERISTIC FrmMng_DSP2OpMode_C "Richtung transmit/receive" VALUE 0x1C0E27 Kw_Wu8 1.000 OneToOne 0.00 1.000 FORMAT "%5.3" EXTENDED_LIMITS 0.00 255.0 READ_ONLY /end CHARACTERISTIC
/begin CHARACTERISTIC FrmMng_dDSP2SchedMesgLen_C "Applizierbare Botschaftslänge für DSP2" VALUE 0x1C0E28 Kw_Wu8 8.000 OneToOne 0.00 8.000 FORMAT "%5.3" EXTENDED_LIMITS 0.00 255.0 /end CHARACTERISTIC
/begin CHARACTERISTIC FrmMng_DSP2IntrEna_C "Interrupt enabled oder nicht" VALUE 0x1C0E29 Kw_Wu8 1.000 OneToOne 0.00 1.000 FORMAT "%5.3" EXTENDED_LIMITS 0.00 255.0 READ_ONLY /end CHARACTERISTIC
/begin CHARACTERISTIC FrmMng_DSP2Mul_C "message Buffer ist mulitpledxed oder not" VALUE 0x1C0E2A Kw_Wu8 2.000 OneToOne 0.00 2.000 FORMAT "%5.3" EXTENDED_LIMITS 0.00 255.0 READ_ONLY /end CHARACTERISTIC
/begin CHARACTERISTIC FrmMng_DSP2SchedMode_C "CAN Message Schedule Mode fuer RX und TX" VALUE 0x1C0E2C Kw_Wu8 160.0 OneToOne 16.00 176.0 FORMAT "%5.1" EXTENDED_LIMITS 0.00 255.0 READ_ONLY /end CHARACTERISTIC
/begin CHARACTERISTIC FrmMng_DSP2Sched_C "Frequenz vom Transfer abhaengig vom Opmode" VALUE 0x1C0E2D Kw_Wu8 254.0 OneToOne 1.000 255.0 FORMAT "%5.1" EXTENDED_LIMITS 0.00 255.0 READ_ONLY /end CHARACTERISTIC
/begin CHARACTERISTIC FrmMng_DSP2Strt_C "Message-Transfer-Aktivierung relativ zur Startzeit" VALUE 0x1C0E2E Kw_Wu8 255.0 OneToOne 0.00 255.0 FORMAT "%5.1" READ_ONLY /end CHARACTERISTIC
/begin CHARACTERISTIC FrmMng_DSP2TOTmp_C "bei fehlender Botschaft: Anzahl der Taskdurchläufe bis zum erkennen eines vorläufigen Timeouts" VALUE 0x1C0E2F Kw_Wu8 5100. TimeCAN_TO_ms 20.00 5120. FORMAT "%5.0" /end CHARACTERISTIC
/begin CHARACTERISTIC FrmMng_dDSP3ID_C "Botschaftsidentifier CAN-Botschaft DSP3" VALUE 0x1C0E30 Kw_Wu32 536870911.000 OneToOne 0.00 536870911.000 FORMAT "%13.3" EXTENDED_LIMITS 0.00 4294967295.00 /end CHARACTERISTIC
/begin CHARACTERISTIC FrmMng_DSP3IDType_C "ID Typ standard oder extended" VALUE 0x1C0E34 Kw_Wu8 0.00 OneToOne 1.000 1.000 FORMAT "%5.3" EXTENDED_LIMITS 0.00 255.0 READ_ONLY /end CHARACTERISTIC
/begin CHARACTERISTIC FrmMng_DSP3NumCAN_C "Auf welchen CAN die Botschaft ist" VALUE 0x1C0E35 Kw_Wu8 2.000 OneToOne 0.00 2.000 FORMAT "%5.3" EXTENDED_LIMITS 0.00 255.0 READ_ONLY /end CHARACTERISTIC
/begin CHARACTERISTIC FrmMng_DSP3NumMsgPos_C "Message Buffer der verwendet wird" VALUE 0x1C0E36 Kw_Wu8 15.00 OneToOne 0.00 15.00 FORMAT "%5.2" EXTENDED_LIMITS 0.00 255.0 READ_ONLY /end CHARACTERISTIC
/begin CHARACTERISTIC FrmMng_DSP3OpMode_C "Richtung transmit/receive" VALUE 0x1C0E37 Kw_Wu8 1.000 OneToOne 0.00 1.000 FORMAT "%5.3" EXTENDED_LIMITS 0.00 255.0 READ_ONLY /end CHARACTERISTIC
/begin CHARACTERISTIC FrmMng_dDSP3SchedMesgLen_C "Applizierbare Botschaftslänge für DSP3" VALUE 0x1C0E38 Kw_Wu8 8.000 OneToOne 0.00 8.000 FORMAT "%5.3" EXTENDED_LIMITS 0.00 255.0 /end CHARACTERISTIC
/begin CHARACTERISTIC FrmMng_DSP3IntrEna_C "Interrupt enabled oder nicht" VALUE 0x1C0E39 Kw_Wu8 1.000 OneToOne 0.00 1.000 FORMAT "%5.3" EXTENDED_LIMITS 0.00 255.0 READ_ONLY /end CHARACTERISTIC
/begin CHARACTERISTIC FrmMng_DSP3Mul_C "message Buffer ist mulitpledxed oder not" VALUE 0x1C0E3A Kw_Wu8 2.000 OneToOne 0.00 2.000 FORMAT "%5.3" EXTENDED_LIMITS 0.00 255.0 /end CHARACTERISTIC
/begin CHARACTERISTIC FrmMng_DSP3SchedMode_C "CAN Message Schedule Mode fuer RX und TX" VALUE 0x1C0E3C Kw_Wu8 160.0 OneToOne 16.00 176.0 FORMAT "%5.1" EXTENDED_LIMITS 0.00 255.0 READ_ONLY /end CHARACTERISTIC
/begin CHARACTERISTIC FrmMng_DSP3Sched_C "Frequenz vom Transfer abhaengig vom Opmode" VALUE 0x1C0E3D Kw_Wu8 254.0 OneToOne 1.000 255.0 FORMAT "%5.1" EXTENDED_LIMITS 0.00 255.0 READ_ONLY /end CHARACTERISTIC
/begin CHARACTERISTIC FrmMng_DSP3Strt_C "Message-Transfer-Aktivierung relativ zur Startzeit" VALUE 0x1C0E3E Kw_Wu8 255.0 OneToOne 0.00 255.0 FORMAT "%5.1" READ_ONLY /end CHARACTERISTIC
/begin CHARACTERISTIC FrmMng_DSP3TOTmp_C "bei fehlender Botschaft: Anzahl der Taskdurchläufe bis zum erkennen eines vorläufigen Timeouts" VALUE 0x1C0E3F Kw_Wu8 5100. TimeCAN_TO_ms 20.00 5120. FORMAT "%5.0" /end CHARACTERISTIC
/begin CHARACTERISTIC FrmMng_dTrqReso_C "Index für Hang und ausgeglichen für Umwandlung von kann in physische Werte" VALUE 0x1D8044 Kw_Wu8 3.000 OneToOne 0.00 3.000 FORMAT "%5.3" EXTENDED_LIMITS 0.00 255.0 /end CHARACTERISTIC
/begin CHARACTERISTIC FrmMng_dTrq_Offset_C "Offset Umrechung SG->CAN für Momentengradienten" VALUE 0x1D7A78 Kw_Ws16 65535.00 TrqPerSec -32768.00 32767.00 FORMAT "%8.2" /end CHARACTERISTIC
/begin CHARACTERISTIC FrmMng_facDTrq_Slope_C "Steigung Umrechung SG->CAN für Momentengradienten" VALUE 0x1D7A7A Kw_Ws16 511.9922 Fact1 -256.0000 255.9922 FORMAT "%8.4" /end CHARACTERISTIC
/begin CHARACTERISTIC FrmMng_dENG1ID_C "Botschaftsidentifier CAN-Botschaft ENG1" VALUE 0x1C0E40 Kw_Wu32 536870911.000 OneToOne 0.00 536870911.000 FORMAT "%13.3" EXTENDED_LIMITS 0.00 4294967295.00 /end CHARACTERISTIC
/begin CHARACTERISTIC FrmMng_ENG1IDType_C "ID Typ standard oder extended" VALUE 0x1C0E44 Kw_Wu8 0.00 OneToOne 1.000 1.000 FORMAT "%5.3" EXTENDED_LIMITS 0.00 255.0 READ_ONLY /end CHARACTERISTIC
/begin CHARACTERISTIC FrmMng_ENG1NumCAN_C "Auf welchen CAN die Botschaft ist" VALUE 0x1C0E45 Kw_Wu8 2.000 OneToOne 0.00 2.000 FORMAT "%5.3" EXTENDED_LIMITS 0.00 255.0 READ_ONLY /end CHARACTERISTIC
/begin CHARACTERISTIC FrmMng_ENG1NumMsgPos_C "Message Buffer der verwendet wird" VALUE 0x1C0E46 Kw_Wu8 15.00 OneToOne 0.00 15.00 FORMAT "%5.2" EXTENDED_LIMITS 0.00 255.0 READ_ONLY /end CHARACTERISTIC
/begin CHARACTERISTIC FrmMng_ENG1OpMode_C "Richtung transmit/receive" VALUE 0x1C0E47 Kw_Wu8 1.000 OneToOne 0.00 1.000 FORMAT "%5.3" EXTENDED_LIMITS 0.00 255.0 READ_ONLY /end CHARACTERISTIC
/begin CHARACTERISTIC FrmMng_dENG1SchedMesgLen_C "Applizierbare Botschaftlänge für ENG1" VALUE 0x1C0E48 Kw_Wu8 8.000 OneToOne 0.00 8.000 FORMAT "%5.3" EXTENDED_LIMITS 0.00 255.0 /end CHARACTERISTIC
/begin CHARACTERISTIC FrmMng_ENG1IntrEna_C "Interrupt enabled oder nicht" VALUE 0x1C0E49 Kw_Wu8 1.000 OneToOne 0.00 1.000 FORMAT "%5.3" EXTENDED_LIMITS 0.00 255.0 READ_ONLY /end CHARACTERISTIC
/begin CHARACTERISTIC FrmMng_ENG1Mul_C "message Buffer ist multiplexed oder nicht" VALUE 0x1C0E4A Kw_Wu8 2.000 OneToOne 0.00 2.000 FORMAT "%5.3" EXTENDED_LIMITS 0.00 255.0 READ_ONLY /end CHARACTERISTIC
/begin CHARACTERISTIC FrmMng_dENG2ID_C "Botschaftsidentifier CAN-Botschaft ENG2" VALUE 0x1C0E4C Kw_Wu32 536870911.000 OneToOne 0.00 536870911.000 FORMAT "%13.3" EXTENDED_LIMITS 0.00 4294967295.00 /end CHARACTERISTIC
/begin CHARACTERISTIC FrmMng_ENG2IDType_C "ID Typ standard oder extended" VALUE 0x1C0E50 Kw_Wu8 0.00 OneToOne 1.000 1.000 FORMAT "%5.3" EXTENDED_LIMITS 0.00 255.0 READ_ONLY /end CHARACTERISTIC
/begin CHARACTERISTIC FrmMng_ENG2NumCAN_C "Auf welchen CAN die Botschaft ist" VALUE 0x1C0E51 Kw_Wu8 2.000 OneToOne 0.00 2.000 FORMAT "%5.3" EXTENDED_LIMITS 0.00 255.0 READ_ONLY /end CHARACTERISTIC
/begin CHARACTERISTIC FrmMng_ENG2NumMsgPos_C "Message Buffer der verwendet wird" VALUE 0x1C0E52 Kw_Wu8 15.00 OneToOne 0.00 15.00 FORMAT "%5.2" EXTENDED_LIMITS 0.00 255.0 READ_ONLY /end CHARACTERISTIC
/begin CHARACTERISTIC FrmMng_ENG2OpMode_C "Richtung transmit/receive" VALUE 0x1C0E53 Kw_Wu8 1.000 OneToOne 0.00 1.000 FORMAT "%5.3" EXTENDED_LIMITS 0.00 255.0 READ_ONLY /end CHARACTERISTIC
/begin CHARACTERISTIC FrmMng_dENG2SchedMesgLen_C "Applizierbare Botschaftlänge für ENG2" VALUE 0x1C0E54 Kw_Wu8 8.000 OneToOne 0.00 8.000 FORMAT "%5.3" EXTENDED_LIMITS 0.00 255.0 /end CHARACTERISTIC
/begin CHARACTERISTIC FrmMng_ENG2IntrEna_C "Interrupt enabled oder nicht" VALUE 0x1C0E55 Kw_Wu8 1.000 OneToOne 0.00 1.000 FORMAT "%5.3" EXTENDED_LIMITS 0.00 255.0 READ_ONLY /end CHARACTERISTIC
/begin CHARACTERISTIC FrmMng_ENG2Mul_C "message Buffer ist multiplexed oder nicht" VALUE 0x1C0E56 Kw_Wu8 2.000 OneToOne 0.00 2.000 FORMAT "%5.3" EXTENDED_LIMITS 0.00 255.0 READ_ONLY /end CHARACTERISTIC
/begin CHARACTERISTIC FrmMng_dENG3ID_C "Botschaftsidentifier CAN-Botschaft ENG3" VALUE 0x1C0E58 Kw_Wu32 536870911.000 OneToOne 0.00 536870911.000 FORMAT "%13.3" EXTENDED_LIMITS 0.00 4294967295.00 /end CHARACTERISTIC
/begin CHARACTERISTIC FrmMng_ENG3IDType_C "ID Typ standard oder extended" VALUE 0x1C0E5C Kw_Wu8 0.00 OneToOne 1.000 1.000 FORMAT "%5.3" EXTENDED_LIMITS 0.00 255.0 READ_ONLY /end CHARACTERISTIC
/begin CHARACTERISTIC FrmMng_ENG3NumCAN_C "Auf welchen CAN die Botschaft ist" VALUE 0x1C0E5D Kw_Wu8 2.000 OneToOne 0.00 2.000 FORMAT "%5.3" EXTENDED_LIMITS 0.00 255.0 READ_ONLY /end CHARACTERISTIC
/begin CHARACTERISTIC FrmMng_ENG3NumMsgPos_C "Message Buffer der verwendet wird" VALUE 0x1C0E5E Kw_Wu8 15.00 OneToOne 0.00 15.00 FORMAT "%5.2" EXTENDED_LIMITS 0.00 255.0 READ_ONLY /end CHARACTERISTIC
/begin CHARACTERISTIC FrmMng_ENG3OpMode_C "Richtung transmit/receive" VALUE 0x1C0E5F Kw_Wu8 1.000 OneToOne 0.00 1.000 FORMAT "%5.3" EXTENDED_LIMITS 0.00 255.0 READ_ONLY /end CHARACTERISTIC
/begin CHARACTERISTIC FrmMng_dENG3SchedMesgLen_C "Applizierbare Botschaftlänge für ENG3" VALUE 0x1C0E60 Kw_Wu8 8.000 OneToOne 0.00 8.000 FORMAT "%5.3" EXTENDED_LIMITS 0.00 255.0 /end CHARACTERISTIC
/begin CHARACTERISTIC FrmMng_ENG3IntrEna_C "Interrupt enabled oder nicht" VALUE 0x1C0E61 Kw_Wu8 1.000 OneToOne 0.00 1.000 FORMAT "%5.3" EXTENDED_LIMITS 0.00 255.0 READ_ONLY /end CHARACTERISTIC
/begin CHARACTERISTIC FrmMng_ENG3Mul_C "message Buffer ist multiplexed oder nicht" VALUE 0x1C0E62 Kw_Wu8 2.000 OneToOne 0.00 2.000 FORMAT "%5.3" EXTENDED_LIMITS 0.00 255.0 READ_ONLY /end CHARACTERISTIC
/begin CHARACTERISTIC FrmMng_dENG5ID_C "Botschaftsidentifier CAN-Botschaft ENG5" VALUE 0x1C0E64 Kw_Wu32 536870911.000 OneToOne 0.00 536870911.000 FORMAT "%13.3" EXTENDED_LIMITS 0.00 4294967295.00 /end CHARACTERISTIC
/begin CHARACTERISTIC FrmMng_ENG5IDType_C "ID Typ standard oder extended" VALUE 0x1C0E68 Kw_Wu8 0.00 OneToOne 1.000 1.000 FORMAT "%5.3" EXTENDED_LIMITS 0.00 255.0 READ_ONLY /end CHARACTERISTIC
/begin CHARACTERISTIC FrmMng_ENG5NumCAN_C "Auf welchen CAN die Botschaft ist" VALUE 0x1C0E69 Kw_Wu8 2.000 OneToOne 0.00 2.000 FORMAT "%5.3" EXTENDED_LIMITS 0.00 255.0 READ_ONLY /end CHARACTERISTIC
/begin CHARACTERISTIC FrmMng_ENG5NumMsgPos_C "Message Buffer der verwendet wird" VALUE 0x1C0E6A Kw_Wu8 15.00 OneToOne 0.00 15.00 FORMAT "%5.2" EXTENDED_LIMITS 0.00 255.0 READ_ONLY /end CHARACTERISTIC
/begin CHARACTERISTIC FrmMng_ENG5OpMode_C "Richtung transmit/receive" VALUE 0x1C0E6B Kw_Wu8 1.000 OneToOne 0.00 1.000 FORMAT "%5.3" EXTENDED_LIMITS 0.00 255.0 READ_ONLY /end CHARACTERISTIC
/begin CHARACTERISTIC FrmMng_dENG5SchedMesgLen_C "Applizierbare Botschaftlänge für ENG5" VALUE 0x1C0E6C Kw_Wu8 8.000 OneToOne 0.00 8.000 FORMAT "%5.3" EXTENDED_LIMITS 0.00 255.0 /end CHARACTERISTIC
/begin CHARACTERISTIC FrmMng_ENG5IntrEna_C "Interrupt enabled oder nicht" VALUE 0x1C0E6D Kw_Wu8 1.000 OneToOne 0.00 1.000 FORMAT "%5.3" EXTENDED_LIMITS 0.00 255.0 READ_ONLY /end CHARACTERISTIC
/begin CHARACTERISTIC FrmMng_ENG5Mul_C "message Buffer ist multiplexed oder nicht" VALUE 0x1C0E6E Kw_Wu8 2.000 OneToOne 0.00 2.000 FORMAT "%5.3" EXTENDED_LIMITS 0.00 255.0 READ_ONLY /end CHARACTERISTIC
/begin CHARACTERISTIC FrmMng_dENG6ID_C "Botschaftsidentifier CAN-Botschaft ENG6" VALUE 0x1C0E70 Kw_Wu32 536870911.000 OneToOne 0.00 536870911.000 FORMAT "%13.3" EXTENDED_LIMITS 0.00 4294967295.00 /end CHARACTERISTIC
/begin CHARACTERISTIC FrmMng_ENG6IDType_C "ID Typ standard oder extended" VALUE 0x1C0E74 Kw_Wu8 0.00 OneToOne 1.000 1.000 FORMAT "%5.3" EXTENDED_LIMITS 0.00 255.0 READ_ONLY /end CHARACTERISTIC
/begin CHARACTERISTIC FrmMng_ENG6NumCAN_C "Auf welchen CAN die Botschaft ist" VALUE 0x1C0E75 Kw_Wu8 2.000 OneToOne 0.00 2.000 FORMAT "%5.3" EXTENDED_LIMITS 0.00 255.0 READ_ONLY /end CHARACTERISTIC
/begin CHARACTERISTIC FrmMng_ENG6NumMsgPos_C "Message Buffer der verwendet wird" VALUE 0x1C0E76 Kw_Wu8 15.00 OneToOne 0.00 15.00 FORMAT "%5.2" EXTENDED_LIMITS 0.00 255.0 READ_ONLY /end CHARACTERISTIC
/begin CHARACTERISTIC FrmMng_ENG6OpMode_C "Richtung transmit/receive" VALUE 0x1C0E77 Kw_Wu8 1.000 OneToOne 0.00 1.000 FORMAT "%5.3" EXTENDED_LIMITS 0.00 255.0 READ_ONLY /end CHARACTERISTIC
/begin CHARACTERISTIC FrmMng_dENG6SchedMesgLen_C "Applizierbare Botschaftlänge für ENG6" VALUE 0x1C0E78 Kw_Wu8 8.000 OneToOne 0.00 8.000 FORMAT "%5.3" EXTENDED_LIMITS 0.00 255.0 /end CHARACTERISTIC
/begin CHARACTERISTIC FrmMng_ENG6IntrEna_C "Interrupt enabled oder nicht" VALUE 0x1C0E79 Kw_Wu8 1.000 OneToOne 0.00 1.000 FORMAT "%5.3" EXTENDED_LIMITS 0.00 255.0 READ_ONLY /end CHARACTERISTIC
/begin CHARACTERISTIC FrmMng_ENG6Mul_C "message Buffer ist multiplexed oder nicht" VALUE 0x1C0E7A Kw_Wu8 2.000 OneToOne 0.00 2.000 FORMAT "%5.3" EXTENDED_LIMITS 0.00 255.0 READ_ONLY /end CHARACTERISTIC
/begin CHARACTERISTIC FrmMng_dENG7ID_C "Botschaftsidentifier CAN-Botschaft ENG7" VALUE 0x1C0E7C Kw_Wu32 536870911.000 OneToOne 0.00 536870911.000 FORMAT "%13.3" EXTENDED_LIMITS 0.00 4294967295.00 /end CHARACTERISTIC
/begin CHARACTERISTIC FrmMng_ENG7IDType_C "ID Typ standard oder extended" VALUE 0x1C0E80 Kw_Wu8 0.00 OneToOne 1.000 1.000 FORMAT "%5.3" EXTENDED_LIMITS 0.00 255.0 READ_ONLY /end CHARACTERISTIC
/begin CHARACTERISTIC FrmMng_ENG7NumCAN_C "Auf welchen CAN die Botschaft ist" VALUE 0x1C0E81 Kw_Wu8 2.000 OneToOne 0.00 2.000 FORMAT "%5.3" EXTENDED_LIMITS 0.00 255.0 READ_ONLY /end CHARACTERISTIC
/begin CHARACTERISTIC FrmMng_ENG7NumMsgPos_C "Message Buffer der verwendet wird" VALUE 0x1C0E82 Kw_Wu8 15.00 OneToOne 0.00 15.00 FORMAT "%5.2" EXTENDED_LIMITS 0.00 255.0 READ_ONLY /end CHARACTERISTIC
/begin CHARACTERISTIC FrmMng_ENG7OpMode_C "Richtung transmit/receive" VALUE 0x1C0E83 Kw_Wu8 1.000 OneToOne 0.00 1.000 FORMAT "%5.3" EXTENDED_LIMITS 0.00 255.0 READ_ONLY /end CHARACTERISTIC
/begin CHARACTERISTIC FrmMng_dENG7SchedMesgLen_C "Applizierbare Botschaftlänge für ENG7" VALUE 0x1C0E84 Kw_Wu8 8.000 OneToOne 0.00 8.000 FORMAT "%5.3" EXTENDED_LIMITS 0.00 255.0 /end CHARACTERISTIC
/begin CHARACTERISTIC FrmMng_ENG7IntrEna_C "Interrupt enabled oder nicht" VALUE 0x1C0E85 Kw_Wu8 1.000 OneToOne 0.00 1.000 FORMAT "%5.3" EXTENDED_LIMITS 0.00 255.0 READ_ONLY /end CHARACTERISTIC
/begin CHARACTERISTIC FrmMng_ENG7Mul_C "message Buffer ist multiplexed oder nicht" VALUE 0x1C0E86 Kw_Wu8 2.000 OneToOne 0.00 2.000 FORMAT "%5.3" EXTENDED_LIMITS 0.00 255.0 READ_ONLY /end CHARACTERISTIC
/begin CHARACTERISTIC FrmMng_dENGACTR1ID_C "Botschaftsidentifier CAN-Botschaft ENGACTR1" VALUE 0x1C0E88 Kw_Wu32 536870911.000 OneToOne 0.00 536870911.000 FORMAT "%13.3" EXTENDED_LIMITS 0.00 4294967295.00 /end CHARACTERISTIC
/begin CHARACTERISTIC FrmMng_ENGACTR1IDType_C "ID Typ standard oder extended" VALUE 0x1C0E8C Kw_Wu8 0.00 OneToOne 1.000 1.000 FORMAT "%5.3" EXTENDED_LIMITS 0.00 255.0 READ_ONLY /end CHARACTERISTIC
/begin CHARACTERISTIC FrmMng_ENGACTR1NumCAN_C "Auf welchen CAN die Botschaft ist" VALUE 0x1C0E8D Kw_Wu8 2.000 OneToOne 0.00 2.000 FORMAT "%5.3" EXTENDED_LIMITS 0.00 255.0 READ_ONLY /end CHARACTERISTIC
/begin CHARACTERISTIC FrmMng_ENGACTR1NumMsgPos_C "Message Buffer der verwendet wird" VALUE 0x1C0E8E Kw_Wu8 15.00 OneToOne 0.00 15.00 FORMAT "%5.2" EXTENDED_LIMITS 0.00 255.0 READ_ONLY /end CHARACTERISTIC
/begin CHARACTERISTIC FrmMng_ENGACTR1OpMode_C "Richtung transmit/receive" VALUE 0x1C0E8F Kw_Wu8 1.000 OneToOne 0.00 1.000 FORMAT "%5.3" EXTENDED_LIMITS 0.00 255.0 READ_ONLY /end CHARACTERISTIC
/begin CHARACTERISTIC FrmMng_dENGACTR1SchedMesgLen_C "Applizierbare Botschaftlänge für EngActr1" VALUE 0x1C0E90 Kw_Wu8 8.000 OneToOne 0.00 8.000 FORMAT "%5.3" EXTENDED_LIMITS 0.00 255.0 /end CHARACTERISTIC
/begin CHARACTERISTIC FrmMng_ENGACTR1IntrEna_C "Interrupt enabled oder nicht" VALUE 0x1C0E91 Kw_Wu8 1.000 OneToOne 0.00 1.000 FORMAT "%5.3" EXTENDED_LIMITS 0.00 255.0 READ_ONLY /end CHARACTERISTIC
/begin CHARACTERISTIC FrmMng_ENGACTR1Mul_C "message Buffer ist multiplexed oder nicht" VALUE 0x1C0E92 Kw_Wu8 2.000 OneToOne 0.00 2.000 FORMAT "%5.3" EXTENDED_LIMITS 0.00 255.0 READ_ONLY /end CHARACTERISTIC
/begin CHARACTERISTIC FrmMng_dENGBRKID_C "Botschaftsidentifier CAN-Botschaft ENGBRK" VALUE 0x1C0E94 Kw_Wu32 536870911.000 OneToOne 0.00 536870911.000 FORMAT "%13.3" EXTENDED_LIMITS 0.00 4294967295.00 /end CHARACTERISTIC
/begin CHARACTERISTIC FrmMng_ENGBRKIDType_C "ID Typ standard oder extended" VALUE 0x1C0E98 Kw_Wu8 0.00 OneToOne 1.000 1.000 FORMAT "%5.3" EXTENDED_LIMITS 0.00 255.0 READ_ONLY /end CHARACTERISTIC
/begin CHARACTERISTIC FrmMng_ENGBRKNumCAN_C "Auf welchen CAN die Botschaft ist" VALUE 0x1C0E99 Kw_Wu8 2.000 OneToOne 0.00 2.000 FORMAT "%5.3" EXTENDED_LIMITS 0.00 255.0 READ_ONLY /end CHARACTERISTIC
/begin CHARACTERISTIC FrmMng_ENGBRKNumMsgPos_C "Message Buffer der verwendet wird" VALUE 0x1C0E9A Kw_Wu8 15.00 OneToOne 0.00 15.00 FORMAT "%5.2" EXTENDED_LIMITS 0.00 255.0 READ_ONLY /end CHARACTERISTIC
/begin CHARACTERISTIC FrmMng_ENGBRKOpMode_C "Richtung transmit/receive" VALUE 0x1C0E9B Kw_Wu8 1.000 OneToOne 0.00 1.000 FORMAT "%5.3" EXTENDED_LIMITS 0.00 255.0 READ_ONLY /end CHARACTERISTIC
/begin CHARACTERISTIC FrmMng_dENGBRKSchedMesgLen_C "Applizierbare Botschaftlänge für ENGBRK" VALUE 0x1C0E9C Kw_Wu8 8.000 OneToOne 0.00 8.000 FORMAT "%5.3" EXTENDED_LIMITS 0.00 255.0 /end CHARACTERISTIC
/begin CHARACTERISTIC FrmMng_ENGBRKIntrEna_C "Interrupt enabled oder nicht" VALUE 0x1C0E9D Kw_Wu8 1.000 OneToOne 0.00 1.000 FORMAT "%5.3" EXTENDED_LIMITS 0.00 255.0 READ_ONLY /end CHARACTERISTIC
/begin CHARACTERISTIC FrmMng_ENGBRKMul_C "message Buffer ist multiplexed oder nicht" VALUE 0x1C0E9E Kw_Wu8 2.000 OneToOne 0.00 2.000 FORMAT "%5.3" EXTENDED_LIMITS 0.00 255.0 READ_ONLY /end CHARACTERISTIC
/begin CHARACTERISTIC FrmMng_dENGDISPID_C "Botschaftsidentifier CAN-Botschaft ENGDISP" VALUE 0x1C0EA0 Kw_Wu32 536870911.000 OneToOne 0.00 536870911.000 FORMAT "%13.3" EXTENDED_LIMITS 0.00 4294967295.00 /end CHARACTERISTIC
/begin CHARACTERISTIC FrmMng_ENGDISPIDType_C "ID Typ standard oder extended" VALUE 0x1C0EA4 Kw_Wu8 0.00 OneToOne 1.000 1.000 FORMAT "%5.3" EXTENDED_LIMITS 0.00 255.0 READ_ONLY /end CHARACTERISTIC
/begin CHARACTERISTIC FrmMng_ENGDISPNumCAN_C "Auf welchen CAN die Botschaft ist" VALUE 0x1C0EA5 Kw_Wu8 2.000 OneToOne 0.00 2.000 FORMAT "%5.3" EXTENDED_LIMITS 0.00 255.0 READ_ONLY /end CHARACTERISTIC
/begin CHARACTERISTIC FrmMng_ENGDISPNumMsgPos_C "Message Buffer der verwendet wird" VALUE 0x1C0EA6 Kw_Wu8 15.00 OneToOne 0.00 15.00 FORMAT "%5.2" EXTENDED_LIMITS 0.00 255.0 READ_ONLY /end CHARACTERISTIC
/begin CHARACTERISTIC FrmMng_ENGDISPOpMode_C "Richtung transmit/receive" VALUE 0x1C0EA7 Kw_Wu8 1.000 OneToOne 0.00 1.000 FORMAT "%5.3" EXTENDED_LIMITS 0.00 255.0 READ_ONLY /end CHARACTERISTIC
/begin CHARACTERISTIC FrmMng_dENGDISPSchedMesgLen_C "Applizierbare Botschaftlänge für ENGDISP" VALUE 0x1C0EA8 Kw_Wu8 8.000 OneToOne 0.00 8.000 FORMAT "%5.3" EXTENDED_LIMITS 0.00 255.0 /end CHARACTERISTIC
/begin CHARACTERISTIC FrmMng_ENGDISPIntrEna_C "Interrupt enabled oder nicht" VALUE 0x1C0EA9 Kw_Wu8 1.000 OneToOne 0.00 1.000 FORMAT "%5.3" EXTENDED_LIMITS 0.00 255.0 READ_ONLY /end CHARACTERISTIC
/begin CHARACTERISTIC FrmMng_ENGDISPMul_C "message Buffer ist multiplexed oder nicht" VALUE 0x1C0EAA Kw_Wu8 2.000 OneToOne 0.00 2.000 FORMAT "%5.3" EXTENDED_LIMITS 0.00 255.0 READ_ONLY /end CHARACTERISTIC
/begin CHARACTERISTIC FrmMng_dENGFLXID_C "Botschaftsidentifier CAN-Botschaft ENGFLX" VALUE 0x1C0EAC Kw_Wu32 536870911.000 OneToOne 0.00 536870911.000 FORMAT "%13.3" EXTENDED_LIMITS 0.00 4294967295.00 /end CHARACTERISTIC
/begin CHARACTERISTIC FrmMng_ENGFLXIDType_C "ID Typ standard oder extended" VALUE 0x1C0EB0 Kw_Wu8 0.00 OneToOne 1.000 1.000 FORMAT "%5.3" EXTENDED_LIMITS 0.00 255.0 READ_ONLY /end CHARACTERISTIC
/begin CHARACTERISTIC FrmMng_ENGFLXNumCAN_C "Auf welchen CAN die Botschaft ist" VALUE 0x1C0EB1 Kw_Wu8 2.000 OneToOne 0.00 2.000 FORMAT "%5.3" EXTENDED_LIMITS 0.00 255.0 READ_ONLY /end CHARACTERISTIC
/begin CHARACTERISTIC FrmMng_ENGFLXNumMsgPos_C "Message Buffer der verwendet wird" VALUE 0x1C0EB2 Kw_Wu8 15.00 OneToOne 0.00 15.00 FORMAT "%5.2" EXTENDED_LIMITS 0.00 255.0 READ_ONLY /end CHARACTERISTIC
/begin CHARACTERISTIC FrmMng_ENGFLXOpMode_C "Richtung transmit/receive" VALUE 0x1C0EB3 Kw_Wu8 1.000 OneToOne 0.00 1.000 FORMAT "%5.3" EXTENDED_LIMITS 0.00 255.0 READ_ONLY /end CHARACTERISTIC
/begin CHARACTERISTIC FrmMng_dENGFLXSchedMesgLen_C "Applizierbare Botschaftlänge für ENGFLX" VALUE 0x1C0EB4 Kw_Wu8 8.000 OneToOne 0.00 8.000 FORMAT "%5.3" EXTENDED_LIMITS 0.00 255.0 /end CHARACTERISTIC
/begin CHARACTERISTIC FrmMng_ENGFLXIntrEna_C "Interrupt enabled oder nicht" VALUE 0x1C0EB5 Kw_Wu8 1.000 OneToOne 0.00 1.000 FORMAT "%5.3" EXTENDED_LIMITS 0.00 255.0 READ_ONLY /end CHARACTERISTIC
/begin CHARACTERISTIC FrmMng_ENGFLXMul_C "message Buffer ist multiplexed oder nicht" VALUE 0x1C0EB6 Kw_Wu8 2.000 OneToOne 0.00 2.000 FORMAT "%5.3" EXTENDED_LIMITS 0.00 255.0 READ_ONLY /end CHARACTERISTIC
/begin CHARACTERISTIC FrmMng_dENGSLVID_C "Botschaftsidentifier CAN-Botschaft ENGSLV" VALUE 0x1C0EB8 Kw_Wu32 536870911.000 OneToOne 0.00 536870911.000 FORMAT "%13.3" EXTENDED_LIMITS 0.00 4294967295.00 /end CHARACTERISTIC
/begin CHARACTERISTIC FrmMng_ENGSLVIDType_C "ID Typ standard oder extended" VALUE 0x1C0EBC Kw_Wu8 0.00 OneToOne 1.000 1.000 FORMAT "%5.3" EXTENDED_LIMITS 0.00 255.0 READ_ONLY /end CHARACTERISTIC
/begin CHARACTERISTIC FrmMng_ENGSLVNumCAN_C "Auf welchem CAN die Botschaft ist" VALUE 0x1C0EBD Kw_Wu8 2.000 OneToOne 0.00 2.000 FORMAT "%5.3" EXTENDED_LIMITS 0.00 255.0 READ_ONLY /end CHARACTERISTIC
/begin CHARACTERISTIC FrmMng_ENGSLVNumMsgPos_C "Message Buffer der verwendet wird" VALUE 0x1C0EBE Kw_Wu8 15.00 OneToOne 0.00 15.00 FORMAT "%5.2" EXTENDED_LIMITS 0.00 255.0 READ_ONLY /end CHARACTERISTIC
/begin CHARACTERISTIC FrmMng_ENGSLVOpMode_C "Richtung transmit/receive" VALUE 0x1C0EBF Kw_Wu8 1.000 OneToOne 0.00 1.000 FORMAT "%5.3" EXTENDED_LIMITS 0.00 255.0 READ_ONLY /end CHARACTERISTIC
/begin CHARACTERISTIC FrmMng_dENGSLVSchedMesgLen_C "Applizierbare Botschaftslänge für ENGSLV" VALUE 0x1C0EC0 Kw_Wu8 8.000 OneToOne 0.00 8.000 FORMAT "%5.3" EXTENDED_LIMITS 0.00 255.0 /end CHARACTERISTIC
/begin CHARACTERISTIC FrmMng_ENGSLVIntrEna_C "Interrupt enabled oder nicht" VALUE 0x1C0EC1 Kw_Wu8 1.000 OneToOne 0.00 1.000 FORMAT "%5.3" EXTENDED_LIMITS 0.00 255.0 READ_ONLY /end CHARACTERISTIC
/begin CHARACTERISTIC FrmMng_ENGSLVMul_C "message Buffer ist multiplexed oder nicht" VALUE 0x1C0EC2 Kw_Wu8 2.000 OneToOne 0.00 2.000 FORMAT "%5.3" EXTENDED_LIMITS 0.00 255.0 READ_ONLY /end CHARACTERISTIC
/begin CHARACTERISTIC FrmMng_dENGTRQ1ID_C "Botschaftsidentifier CAN-Botschaft ENGTRQ1" VALUE 0x1C0EC4 Kw_Wu32 536870911.000 OneToOne 0.00 536870911.000 FORMAT "%13.3" EXTENDED_LIMITS 0.00 4294967295.00 /end CHARACTERISTIC
/begin CHARACTERISTIC FrmMng_ENGTRQ1IDType_C "ID Typ standard oder extended" VALUE 0x1C0EC8 Kw_Wu8 0.00 OneToOne 1.000 1.000 FORMAT "%5.3" EXTENDED_LIMITS 0.00 255.0 READ_ONLY /end CHARACTERISTIC
/begin CHARACTERISTIC FrmMng_ENGTRQ1NumCAN_C "Auf welchen CAN die Botschaft ist" VALUE 0x1C0EC9 Kw_Wu8 2.000 OneToOne 0.00 2.000 FORMAT "%5.3" EXTENDED_LIMITS 0.00 255.0 READ_ONLY /end CHARACTERISTIC
/begin CHARACTERISTIC FrmMng_ENGTRQ1NumMsgPos_C "Message Buffer der verwendet wird" VALUE 0x1C0ECA Kw_Wu8 15.00 OneToOne 0.00 15.00 FORMAT "%5.2" EXTENDED_LIMITS 0.00 255.0 READ_ONLY /end CHARACTERISTIC
/begin CHARACTERISTIC FrmMng_ENGTRQ1OpMode_C "Richtung transmit/receive" VALUE 0x1C0ECB Kw_Wu8 1.000 OneToOne 0.00 1.000 FORMAT "%5.3" EXTENDED_LIMITS 0.00 255.0 READ_ONLY /end CHARACTERISTIC
/begin CHARACTERISTIC FrmMng_dENGTRQ1SchedMesgLen_C "Applizierbare Botschaftlänge für ENGTRQ1" VALUE 0x1C0ECC Kw_Wu8 8.000 OneToOne 0.00 8.000 FORMAT "%5.3" EXTENDED_LIMITS 0.00 255.0 /end CHARACTERISTIC
/begin CHARACTERISTIC FrmMng_ENGTRQ1IntrEna_C "Interrupt enabled oder nicht" VALUE 0x1C0ECD Kw_Wu8 1.000 OneToOne 0.00 1.000 FORMAT "%5.3" EXTENDED_LIMITS 0.00 255.0 READ_ONLY /end CHARACTERISTIC
/begin CHARACTERISTIC FrmMng_ENGTRQ1Mul_C "message Buffer ist multiplexed oder nicht" VALUE 0x1C0ECE Kw_Wu8 2.000 OneToOne 0.00 2.000 FORMAT "%5.3" EXTENDED_LIMITS 0.00 255.0 READ_ONLY /end CHARACTERISTIC
/begin CHARACTERISTIC FrmMng_dENGTRQ2ID_C "Botschaftsidentifier CAN-Botschaft ENGTRQ2" VALUE 0x1C0ED0 Kw_Wu32 536870911.000 OneToOne 0.00 536870911.000 FORMAT "%13.3" EXTENDED_LIMITS 0.00 4294967295.00 /end CHARACTERISTIC
/begin CHARACTERISTIC FrmMng_ENGTRQ2IDType_C "ID Typ standard oder extended" VALUE 0x1C0ED4 Kw_Wu8 0.00 OneToOne 1.000 1.000 FORMAT "%5.3" EXTENDED_LIMITS 0.00 255.0 READ_ONLY /end CHARACTERISTIC
/begin CHARACTERISTIC FrmMng_ENGTRQ2NumCAN_C "Auf welchen CAN die Botschaft ist" VALUE 0x1C0ED5 Kw_Wu8 2.000 OneToOne 0.00 2.000 FORMAT "%5.3" EXTENDED_LIMITS 0.00 255.0 READ_ONLY /end CHARACTERISTIC
/begin CHARACTERISTIC FrmMng_ENGTRQ2NumMsgPos_C "Message Buffer der verwendet wird" VALUE 0x1C0ED6 Kw_Wu8 15.00 OneToOne 0.00 15.00 FORMAT "%5.2" EXTENDED_LIMITS 0.00 255.0 READ_ONLY /end CHARACTERISTIC
/begin CHARACTERISTIC FrmMng_ENGTRQ2OpMode_C "Richtung transmit/receive" VALUE 0x1C0ED7 Kw_Wu8 1.000 OneToOne 0.00 1.000 FORMAT "%5.3" EXTENDED_LIMITS 0.00 255.0 READ_ONLY /end CHARACTERISTIC
/begin CHARACTERISTIC FrmMng_dENGTRQ2SchedMesgLen_C "Applizierbare Botschaftlänge für ENGTRQ2" VALUE 0x1C0ED8 Kw_Wu8 8.000 OneToOne 0.00 8.000 FORMAT "%5.3" EXTENDED_LIMITS 0.00 255.0 /end CHARACTERISTIC
/begin CHARACTERISTIC FrmMng_ENGTRQ2IntrEna_C "Interrupt enabled oder nicht" VALUE 0x1C0ED9 Kw_Wu8 1.000 OneToOne 0.00 1.000 FORMAT "%5.3" EXTENDED_LIMITS 0.00 255.0 READ_ONLY /end CHARACTERISTIC
/begin CHARACTERISTIC FrmMng_ENGTRQ2Mul_C "message Buffer ist multiplexed oder nicht" VALUE 0x1C0EDA Kw_Wu8 2.000 OneToOne 0.00 2.000 FORMAT "%5.3" EXTENDED_LIMITS 0.00 255.0 READ_ONLY /end CHARACTERISTIC
/begin CHARACTERISTIC FrmMng_dENGTRQ3ID_C "Botschaftsidentifier CAN-Botschaft ENGTRQ3" VALUE 0x1C0EDC Kw_Wu32 536870911.000 OneToOne 0.00 536870911.000 FORMAT "%13.3" EXTENDED_LIMITS 0.00 4294967295.00 /end CHARACTERISTIC
/begin CHARACTERISTIC FrmMng_ENGTRQ3IDType_C "ID Typ standard oder extended" VALUE 0x1C0EE0 Kw_Wu8 0.00 OneToOne 1.000 1.000 FORMAT "%5.3" EXTENDED_LIMITS 0.00 255.0 READ_ONLY /end CHARACTERISTIC
/begin CHARACTERISTIC FrmMng_ENGTRQ3NumCAN_C "Auf welchen CAN die Botschaft ist" VALUE 0x1C0EE1 Kw_Wu8 2.000 OneToOne 0.00 2.000 FORMAT "%5.3" EXTENDED_LIMITS 0.00 255.0 READ_ONLY /end CHARACTERISTIC
/begin CHARACTERISTIC FrmMng_ENGTRQ3NumMsgPos_C "Message Buffer der verwendet wird" VALUE 0x1C0EE2 Kw_Wu8 15.00 OneToOne 0.00 15.00 FORMAT "%5.2" EXTENDED_LIMITS 0.00 255.0 READ_ONLY /end CHARACTERISTIC
/begin CHARACTERISTIC FrmMng_ENGTRQ3OpMode_C "Richtung transmit/receive" VALUE 0x1C0EE3 Kw_Wu8 1.000 OneToOne 0.00 1.000 FORMAT "%5.3" EXTENDED_LIMITS 0.00 255.0 READ_ONLY /end CHARACTERISTIC
/begin CHARACTERISTIC FrmMng_dENGTRQ3SchedMesgLen_C "Applizierbare Botschaftlänge für ENGTRQ3" VALUE 0x1C0EE4 Kw_Wu8 8.000 OneToOne 0.00 8.000 FORMAT "%5.3" EXTENDED_LIMITS 0.00 255.0 /end CHARACTERISTIC
/begin CHARACTERISTIC FrmMng_ENGTRQ3IntrEna_C "Interrupt enabled oder nicht" VALUE 0x1C0EE5 Kw_Wu8 1.000 OneToOne 0.00 1.000 FORMAT "%5.3" EXTENDED_LIMITS 0.00 255.0 READ_ONLY /end CHARACTERISTIC
/begin CHARACTERISTIC FrmMng_ENGTRQ3Mul_C "message Buffer ist multiplexed oder nicht" VALUE 0x1C0EE6 Kw_Wu8 2.000 OneToOne 0.00 2.000 FORMAT "%5.3" EXTENDED_LIMITS 0.00 255.0 READ_ONLY /end CHARACTERISTIC
/begin CHARACTERISTIC FrmMng_dEPB1ID_C "Identifier der EPB1-Botschaft" VALUE 0x1C0EF4 Kw_Wu32 536870911.000 OneToOne 0.00 536870911.000 FORMAT "%13.3" EXTENDED_LIMITS 0.00 4294967295.00 /end CHARACTERISTIC
/begin CHARACTERISTIC FrmMng_EPB1IDType_C "ID type extended oder standard" VALUE 0x1C0EF8 Kw_Wu8 0.00 OneToOne 1.000 1.000 FORMAT "%5.3" EXTENDED_LIMITS 0.00 255.0 READ_ONLY /end CHARACTERISTIC
/begin CHARACTERISTIC FrmMng_EPB1NumCAN_C "Auf welchen CAN die Botschaft ist" VALUE 0x1C0EF9 Kw_Wu8 2.000 OneToOne 0.00 2.000 FORMAT "%5.3" EXTENDED_LIMITS 0.00 255.0 READ_ONLY /end CHARACTERISTIC
/begin CHARACTERISTIC FrmMng_EPB1NumMsgPos_C "Message Buffer der verwendet wird" VALUE 0x1C0EFA Kw_Wu8 15.00 OneToOne 0.00 15.00 FORMAT "%5.2" EXTENDED_LIMITS 0.00 255.0 READ_ONLY /end CHARACTERISTIC
/begin CHARACTERISTIC FrmMng_EPB1OpMode_C "Opmode used" VALUE 0x1C0EFB Kw_Wu8 1.000 OneToOne 0.00 1.000 FORMAT "%5.3" EXTENDED_LIMITS 0.00 255.0 READ_ONLY /end CHARACTERISTIC
/begin CHARACTERISTIC FrmMng_dEPB1SchedMesgLen_C "Applizierbare Botschaftlänge für EPB1" VALUE 0x1C0EFC Kw_Wu8 8.000 OneToOne 0.00 8.000 FORMAT "%5.3" EXTENDED_LIMITS 0.00 255.0 /end CHARACTERISTIC
/begin CHARACTERISTIC FrmMng_EPB1IntrEna_C "Interrupt enabled oder nicht" VALUE 0x1C0EFD Kw_Wu8 1.000 OneToOne 0.00 1.000 FORMAT "%5.3" EXTENDED_LIMITS 0.00 255.0 READ_ONLY /end CHARACTERISTIC
/begin CHARACTERISTIC FrmMng_EPB1Mul_C "Multiplxed oder nicht" VALUE 0x1C0EFE Kw_Wu8 2.000 OneToOne 0.00 2.000 FORMAT "%5.3" EXTENDED_LIMITS 0.00 255.0 READ_ONLY /end CHARACTERISTIC
/begin CHARACTERISTIC FrmMng_EPB1SchedMode_C "CAN Message Schedule Mode fuer RX und TX" VALUE 0x1C0F00 Kw_Wu8 160.0 OneToOne 16.00 176.0 FORMAT "%5.1" EXTENDED_LIMITS 0.00 255.0 READ_ONLY /end CHARACTERISTIC
/begin CHARACTERISTIC FrmMng_EPB1Sched_C "Frequenz vom Transfer abhaengig vom Opmode" VALUE 0x1C0F01 Kw_Wu8 254.0 OneToOne 1.000 255.0 FORMAT "%5.1" EXTENDED_LIMITS 0.00 255.0 READ_ONLY /end CHARACTERISTIC
/begin CHARACTERISTIC FrmMng_EPB1Strt_C "Message-Transfer-Aktivierung relativ zur Startzeit" VALUE 0x1C0F02 Kw_Wu8 255.0 OneToOne 0.00 255.0 FORMAT "%5.1" READ_ONLY /end CHARACTERISTIC
/begin CHARACTERISTIC FrmMng_EPB1TOTmp_C "Time Out" VALUE 0x1C0F03 Kw_Wu8 5100. TimeCAN_TO_ms 20.00 5120. FORMAT "%5.0" /end CHARACTERISTIC
/begin CHARACTERISTIC FrmMng_dESCUID_C "Botschaftsidentifier CAN-Botschaft ESCU" VALUE 0x1C0F04 Kw_Wu32 536870911.000 OneToOne 0.00 536870911.000 FORMAT "%13.3" EXTENDED_LIMITS 0.00 4294967295.00 /end CHARACTERISTIC
/begin CHARACTERISTIC FrmMng_ESCUIDType_C "ID Typ standard oder extended" VALUE 0x1C0F08 Kw_Wu8 0.00 OneToOne 1.000 1.000 FORMAT "%5.3" EXTENDED_LIMITS 0.00 255.0 READ_ONLY /end CHARACTERISTIC
/begin CHARACTERISTIC FrmMng_ESCUNumCAN_C "Auf welchen CAN die Botschaft ist" VALUE 0x1C0F09 Kw_Wu8 2.000 OneToOne 0.00 2.000 FORMAT "%5.3" EXTENDED_LIMITS 0.00 255.0 READ_ONLY /end CHARACTERISTIC
/begin CHARACTERISTIC FrmMng_ESCUNumMsgPos_C "Message Buffer der verwendet wird" VALUE 0x1C0F0A Kw_Wu8 15.00 OneToOne 0.00 15.00 FORMAT "%5.2" EXTENDED_LIMITS 0.00 255.0 READ_ONLY /end CHARACTERISTIC
/begin CHARACTERISTIC FrmMng_ESCUOpMode_C "Richtung transmit/receive" VALUE 0x1C0F0B Kw_Wu8 1.000 OneToOne 0.00 1.000 FORMAT "%5.3" EXTENDED_LIMITS 0.00 255.0 READ_ONLY /end CHARACTERISTIC
/begin CHARACTERISTIC FrmMng_dESCUSchedMesgLen_C "Applizierbare Botschaftlänge für ESCU" VALUE 0x1C0F0C Kw_Wu8 8.000 OneToOne 0.00 8.000 FORMAT "%5.3" EXTENDED_LIMITS 0.00 255.0 /end CHARACTERISTIC
/begin CHARACTERISTIC FrmMng_ESCUIntrEna_C "Interrupt enabled oder nicht" VALUE 0x1C0F0D Kw_Wu8 1.000 OneToOne 0.00 1.000 FORMAT "%5.3" EXTENDED_LIMITS 0.00 255.0 READ_ONLY /end CHARACTERISTIC
/begin CHARACTERISTIC FrmMng_ESCUMul_C "message Buffer ist multiplexed oder nicht" VALUE 0x1C0F0E Kw_Wu8 2.000 OneToOne 0.00 2.000 FORMAT "%5.3" EXTENDED_LIMITS 0.00 255.0 /end CHARACTERISTIC
/begin CHARACTERISTIC FrmMng_ESCUSchedMode_C "CAN Message Schedule Mode fuer RX und TX" VALUE 0x1C0F10 Kw_Wu8 160.0 OneToOne 16.00 176.0 FORMAT "%5.1" EXTENDED_LIMITS 0.00 255.0 READ_ONLY /end CHARACTERISTIC
/begin CHARACTERISTIC FrmMng_ESCUSched_C "Frequenz vom Transfer abhaengig vom Opmode" VALUE 0x1C0F11 Kw_Wu8 254.0 OneToOne 1.000 255.0 FORMAT "%5.1" EXTENDED_LIMITS 0.00 255.0 READ_ONLY /end CHARACTERISTIC
/begin CHARACTERISTIC FrmMng_ESCUStrt_C "Message-Transfer-Aktivierung relativ zur Startzeit" VALUE 0x1C0F12 Kw_Wu8 255.0 OneToOne 0.00 255.0 FORMAT "%5.1" READ_ONLY /end CHARACTERISTIC
/begin CHARACTERISTIC FrmMng_ESCUTOTmp_C "Timeout" VALUE 0x1C0F13 Kw_Wu8 5100. TimeCAN_TO_ms 20.00 5120. FORMAT "%5.0" /end CHARACTERISTIC
/begin CHARACTERISTIC FrmMng_facTrqInrCorr_MAP "Korrekturkennfeld (Lambda/Drehzahl) für Eng1:inneres Motormoment" MAP 0x1D7B9E Kf_Xs16_Ys16_Ws16 2.000000 Fact 0.00 2.000000 FORMAT "%8.6" EXTENDED_LIMITS -4.000000 3.999878
 /begin AXIS_DESCR STD_AXIS Eng_nAvrg EngN 2 0.00 6000.000 FORMAT "%8.3" EXTENDED_LIMITS -32768.00 32767.00 DEPOSIT ABSOLUTE /end AXIS_DESCR
 /begin AXIS_DESCR STD_AXIS FrmMng_rLmbd_mp lambda 2 0.00 30.00000 FORMAT "%8.5" EXTENDED_LIMITS -32.76800 32.76700 DEPOSIT ABSOLUTE /end AXIS_DESCR
/end CHARACTERISTIC
/begin CHARACTERISTIC FrmMng_facTRQInrTrq_Slope_CA "Array von Steigungen für Momenten-Umrechnung" VAL_BLK 0x1D8046 Kwb_Ws16 7.999878 Fact -4.000000 3.999878 FORMAT "%8.6" NUMBER 4 /end CHARACTERISTIC
/begin CHARACTERISTIC FrmMng_dGW1ID_C "CAN-Botschafts ID für Gateway1-Botschaft" VALUE 0x1C0F14 Kw_Wu32 536870911.000 OneToOne 0.00 536870911.000 FORMAT "%13.3" EXTENDED_LIMITS 0.00 4294967295.00 /end CHARACTERISTIC
/begin CHARACTERISTIC FrmMng_GW1IDType_C "ID Typ standard oder extended" VALUE 0x1C0F18 Kw_Wu8 0.00 OneToOne 1.000 1.000 FORMAT "%5.3" EXTENDED_LIMITS 0.00 255.0 READ_ONLY /end CHARACTERISTIC
/begin CHARACTERISTIC FrmMng_GW1NumCAN_C "Auf welchen CAN die Botschaft ist" VALUE 0x1C0F19 Kw_Wu8 2.000 OneToOne 0.00 2.000 FORMAT "%5.3" EXTENDED_LIMITS 0.00 255.0 READ_ONLY /end CHARACTERISTIC
/begin CHARACTERISTIC FrmMng_GW1NumMsgPos_C "Message Buffer der verwendet wird" VALUE 0x1C0F1A Kw_Wu8 15.00 OneToOne 0.00 15.00 FORMAT "%5.2" EXTENDED_LIMITS 0.00 255.0 READ_ONLY /end CHARACTERISTIC
/begin CHARACTERISTIC FrmMng_GW1OpMode_C "Richtung transmit/receive" VALUE 0x1C0F1B Kw_Wu8 1.000 OneToOne 0.00 1.000 FORMAT "%5.3" EXTENDED_LIMITS 0.00 255.0 READ_ONLY /end CHARACTERISTIC
/begin CHARACTERISTIC FrmMng_dGW1SchedMesgLen_C "CAN Botschaftslänge für Gateway1-Botschaft" VALUE 0x1C0F1C Kw_Wu8 8.000 OneToOne 0.00 8.000 FORMAT "%5.3" EXTENDED_LIMITS 0.00 255.0 /end CHARACTERISTIC
/begin CHARACTERISTIC FrmMng_GW1IntrEna_C "Interrupt enabled oder nicht" VALUE 0x1C0F1D Kw_Wu8 1.000 OneToOne 0.00 1.000 FORMAT "%5.3" EXTENDED_LIMITS 0.00 255.0 READ_ONLY /end CHARACTERISTIC
/begin CHARACTERISTIC FrmMng_GW1Mul_C "message Buffer ist multiplexed oder nicht" VALUE 0x1C0F1E Kw_Wu8 2.000 OneToOne 0.00 2.000 FORMAT "%5.3" EXTENDED_LIMITS 0.00 255.0 READ_ONLY /end CHARACTERISTIC
/begin CHARACTERISTIC FrmMng_GW1SchedMode_C "CAN Message Schedule Mode fuer RX und TX" VALUE 0x1C0F20 Kw_Wu8 160.0 OneToOne 16.00 176.0 FORMAT "%5.1" EXTENDED_LIMITS 0.00 255.0 READ_ONLY /end CHARACTERISTIC
/begin CHARACTERISTIC FrmMng_GW1Sched_C "Frequenz vom Transfer abhaengig vom Opmode" VALUE 0x1C0F21 Kw_Wu8 254.0 OneToOne 1.000 255.0 FORMAT "%5.1" EXTENDED_LIMITS 0.00 255.0 READ_ONLY /end CHARACTERISTIC
/begin CHARACTERISTIC FrmMng_GW1Strt_C "Message-Transfer-Aktivierung relativ zur Startzeit" VALUE 0x1C0F22 Kw_Wu8 255.0 OneToOne 0.00 255.0 FORMAT "%5.1" READ_ONLY /end CHARACTERISTIC
/begin CHARACTERISTIC FrmMng_GW1TOTmp_C "Timeout" VALUE 0x1C0F23 Kw_Wu8 5100. TimeCAN_TO_ms 20.00 5120. FORMAT "%5.0" /end CHARACTERISTIC
/begin CHARACTERISTIC FrmMng_LimRawMax_C "CAN Begrenzungsrohwert" VALUE 0x1D781C Kw_Ws32 4294967295.00 OneToOne -2147483648.00 2147483647.00 FORMAT "%13.2" /end CHARACTERISTIC
/begin CHARACTERISTIC FrmMng_RawErr_C "CAN Fehlerkennzeichen Rohwert" VALUE 0x1D7820 Kw_Ws32 4294967295.00 OneToOne -2147483648.00 2147483647.00 FORMAT "%13.2" /end CHARACTERISTIC
/begin CHARACTERISTIC FrmMng_MaxDiffAAG_C "Maximale Differenz damit auf Botschaftszähler unplausibel erkannt wird für AAG" VALUE 0x1D79E0 Kw_Wu8 255.0 OneToOne 0.00 255.0 FORMAT "%5.1" /end CHARACTERISTIC
/begin CHARACTERISTIC FrmMng_MaxDiffACC_C "Maximale Zählerdifferenz für Botschaftszähler ACC-System" VALUE 0x1D78C0 Kw_Wu8 255.0 OneToOne 0.00 255.0 FORMAT "%5.1" /end CHARACTERISTIC
/begin CHARACTERISTIC FrmMng_MaxDiffAirbg_C "Maximale Zählerdifferenz für Botschaftszähler Airbag1" VALUE 0x1D78E4 Kw_Wu8 255.0 OneToOne 0.00 255.0 FORMAT "%5.1" /end CHARACTERISTIC
/begin CHARACTERISTIC FrmMng_MaxDiffAWD1_C "Maximale Botschaftszählerdifferenz für Botschaftszähler Allrad1" VALUE 0x1D78F8 Kw_Wu8 255.0 OneToOne 0.00 255.0 FORMAT "%5.1" /end CHARACTERISTIC
/begin CHARACTERISTIC FrmMng_MaxDiffBEM1_C "Maximale Zählerdifferenz für Botschaftszähler BEM1" VALUE 0x1D7910 Kw_Wu8 255.0 OneToOne 0.00 255.0 FORMAT "%5.1" /end CHARACTERISTIC
/begin CHARACTERISTIC FrmMng_MaxDiffBRK1_C "Maximale Zählerdifferenz für Botschaftszähler BRK1" VALUE 0x1D7954 Kw_Wu8 255.0 OneToOne 0.00 255.0 FORMAT "%5.1" /end CHARACTERISTIC
/begin CHARACTERISTIC FrmMng_MaxDiffBRK2_C "maximale Zählerdifferenz für Botschaftszähler BRK2" VALUE 0x1D7955 Kw_Wu8 255.0 OneToOne 0.00 255.0 FORMAT "%5.1" /end CHARACTERISTIC
/begin CHARACTERISTIC FrmMng_MaxDiffBRK8_C "Maximale Zählerdifferenz für Botschaftszähler BRK8" VALUE 0x1D7956 Kw_Wu8 255.0 OneToOne 0.00 255.0 FORMAT "%5.1" /end CHARACTERISTIC
/begin CHARACTERISTIC FrmMng_MaxDiffCCTL_C "Maximale Zählerdifferenz für Botschaftszähler Cruise Control" VALUE 0x1D7888 Kw_Wu8 255.0 OneToOne 0.00 255.0 FORMAT "%5.1" /end CHARACTERISTIC
/begin CHARACTERISTIC FrmMng_MaxDiffDSP1_C "Maximale Zählerdifferenz für Botschaftszähler Kombi1" VALUE 0x1D797C Kw_Wu8 255.0 OneToOne 0.00 255.0 FORMAT "%5.1" /end CHARACTERISTIC
/begin CHARACTERISTIC FrmMng_MaxDiffEPB1_C "Maximale Zählerdifferenz für Botschaftszähler EPB1" VALUE 0x1D799A Kw_Wu8 255.0 OneToOne 0.00 255.0 FORMAT "%5.1" /end CHARACTERISTIC
/begin CHARACTERISTIC FrmMng_MaxDiffILM_C "Maximale Differenz damit auf Botschaftszähler unplausibel erkannt wird für ILM" VALUE 0x1D79E1 Kw_Wu8 255.0 OneToOne 0.00 255.0 FORMAT "%5.1" /end CHARACTERISTIC
/begin CHARACTERISTIC FrmMng_MaxDiffTSC2_C "Maximale Zählerdifferenz für Botschaftszähler Getriebe2" VALUE 0x1D7A7D Kw_Wu8 255.0 OneToOne 0.00 255.0 FORMAT "%5.1" /end CHARACTERISTIC
/begin CHARACTERISTIC FrmMng_MaxEngGrad_C "Max-Begrenzungswert für Motordrehzahlgradient" VALUE 0x1D7BD2 Kw_Ws16 65535.00 OneToOne -32768.00 32767.00 FORMAT "%8.2" /end CHARACTERISTIC
/begin CHARACTERISTIC FrmMng_MaxPerAAG_C "Maximale Anzahl der Perioden bevor auf stehenden Botschaftszähler erkannt wird für AAG" VALUE 0x1D79E2 Kw_Wu8 255.0 OneToOne 0.00 255.0 FORMAT "%5.1" /end CHARACTERISTIC
/begin CHARACTERISTIC FrmMng_MaxPerACC_C "Maximale Periodenzahl für Botschaftszähler ACC-System" VALUE 0x1D78C1 Kw_Wu8 255.0 OneToOne 0.00 255.0 FORMAT "%5.1" /end CHARACTERISTIC
/begin CHARACTERISTIC FrmMng_MaxPerAirbg_C "Maximale Periodenzahl für Botschaftszähler Airbag1" VALUE 0x1D78E5 Kw_Wu8 255.0 OneToOne 0.00 255.0 FORMAT "%5.1" /end CHARACTERISTIC
/begin CHARACTERISTIC FrmMng_MaxPerAWD1_C "Maximale Perioden für Botschaftszähler Allrad1" VALUE 0x1D78F9 Kw_Wu8 255.0 OneToOne 0.00 255.0 FORMAT "%5.1" /end CHARACTERISTIC
/begin CHARACTERISTIC FrmMng_MaxPerBEM1_C "Maximale Periodenzahl für Botschaftszähler BEM1" VALUE 0x1D7911 Kw_Wu8 255.0 OneToOne 0.00 255.0 FORMAT "%5.1" /end CHARACTERISTIC
/begin CHARACTERISTIC FrmMng_MaxPerBRK1_C "Maximale Periodenzahl für Botschaftszähler BRK1" VALUE 0x1D7957 Kw_Wu8 255.0 OneToOne 0.00 255.0 FORMAT "%5.1" /end CHARACTERISTIC
/begin CHARACTERISTIC FrmMng_MaxPerBRK2_C "maximale Periodenzahl für Botschaftszähler BRK2" VALUE 0x1D7958 Kw_Wu8 255.0 OneToOne 0.00 255.0 FORMAT "%5.1" /end CHARACTERISTIC
/begin CHARACTERISTIC FrmMng_MaxPerBRK8_C "Maximale Periodenzahl für Botschaftszähler BRK8" VALUE 0x1D7959 Kw_Wu8 255.0 OneToOne 0.00 255.0 FORMAT "%5.1" /end CHARACTERISTIC
/begin CHARACTERISTIC FrmMng_MaxPerCCTL_C "Maximale Periodenzahl für Botschaftszähler Cruise Control" VALUE 0x1D7889 Kw_Wu8 255.0 OneToOne 0.00 255.0 FORMAT "%5.1" /end CHARACTERISTIC
/begin CHARACTERISTIC FrmMng_MaxPerDSP1_C "Maximale Periodenzahl für Botschaftszähler Kombi1" VALUE 0x1D797D Kw_Wu8 255.0 OneToOne 0.00 255.0 FORMAT "%5.1" /end CHARACTERISTIC
/begin CHARACTERISTIC FrmMng_MaxPerEPB1_C "Maximale Periodenzahl für Botschaftszähler EPB1" VALUE 0x1D799B Kw_Wu8 255.0 OneToOne 0.00 255.0 FORMAT "%5.1" /end CHARACTERISTIC
/begin CHARACTERISTIC FrmMng_MaxPerILM_C "Maximale Anzahl der Perioden bevor auf stehenden Botschaftszähler erkannt wird für ILM" VALUE 0x1D79E3 Kw_Wu8 255.0 OneToOne 0.00 255.0 FORMAT "%5.1" /end CHARACTERISTIC
/begin CHARACTERISTIC FrmMng_MaxPerTSC2_C "Maximale Periodenzahl für Botschaftszähler Getriebe2" VALUE 0x1D7A81 Kw_Wu8 255.0 OneToOne 0.00 255.0 FORMAT "%5.1" /end CHARACTERISTIC
/begin CHARACTERISTIC FrmMng_MinEngGrad_C "Min-Begrenzungswert für Motordrehzahlgradient" VALUE 0x1D7BD4 Kw_Ws16 65535.00 OneToOne -32768.00 32767.00 FORMAT "%8.2" /end CHARACTERISTIC
/begin CHARACTERISTIC FrmMng_nDes_C "Motorwunschdrehzahl" VALUE 0x1D8072 Kw_Wu16 255.0000 OneToOne 0.00 255.0000 FORMAT "%8.4" EXTENDED_LIMITS 0.00 65535.00 /end CHARACTERISTIC
/begin CHARACTERISTIC FrmMng_nDes_Offset_C "Offset Umrechung SG->CAN für Drehzahl" VALUE 0x1D7824 Kw_Ws16 65535.00 EngN -32768.00 32767.00 FORMAT "%8.2" /end CHARACTERISTIC
/begin CHARACTERISTIC FrmMng_facNDes_Slope_C "Steigung Umrechung SG->CAN für Drehzahl" VALUE 0x1D7826 Kw_Ws16 511.9922 Fact1 -256.0000 255.9922 FORMAT "%8.4" /end CHARACTERISTIC
/begin CHARACTERISTIC FrmMng_NIVEAU1IDType_C "ID Typ standard oder extended" VALUE 0x1C0F28 Kw_Wu8 0.00 OneToOne 1.000 1.000 FORMAT "%5.3" EXTENDED_LIMITS 0.00 255.0 READ_ONLY /end CHARACTERISTIC
/begin CHARACTERISTIC FrmMng_NIVEAU1NumCAN_C "Auf welchen CAN die Botschaft ist" VALUE 0x1C0F29 Kw_Wu8 2.000 OneToOne 0.00 2.000 FORMAT "%5.3" EXTENDED_LIMITS 0.00 255.0 READ_ONLY /end CHARACTERISTIC
/begin CHARACTERISTIC FrmMng_NIVEAU1NumMsgPos_C "Message Buffer der verwendet wird" VALUE 0x1C0F2A Kw_Wu8 15.00 OneToOne 0.00 15.00 FORMAT "%5.2" EXTENDED_LIMITS 0.00 255.0 READ_ONLY /end CHARACTERISTIC
/begin CHARACTERISTIC FrmMng_NIVEAU1OpMode_C "Richtung transmit/receive" VALUE 0x1C0F2B Kw_Wu8 1.000 OneToOne 0.00 1.000 FORMAT "%5.3" EXTENDED_LIMITS 0.00 255.0 READ_ONLY /end CHARACTERISTIC
/begin CHARACTERISTIC FrmMng_NIVEAU1IntrEna_C "Interrupt enabled oder nicht" VALUE 0x1C0F2D Kw_Wu8 1.000 OneToOne 0.00 1.000 FORMAT "%5.3" EXTENDED_LIMITS 0.00 255.0 READ_ONLY /end CHARACTERISTIC
/begin CHARACTERISTIC FrmMng_NIVEAU1Mul_C "message Buffer ist multiplexed oder nicht" VALUE 0x1C0F2E Kw_Wu8 2.000 OneToOne 0.00 2.000 FORMAT "%5.3" EXTENDED_LIMITS 0.00 255.0 READ_ONLY /end CHARACTERISTIC
/begin CHARACTERISTIC FrmMng_NIVEAU1SchedMode_C "CAN Message Schedule Mode fuer RX und TX" VALUE 0x1C0F30 Kw_Wu8 160.0 OneToOne 16.00 176.0 FORMAT "%5.1" EXTENDED_LIMITS 0.00 255.0 READ_ONLY /end CHARACTERISTIC
/begin CHARACTERISTIC FrmMng_NIVEAU1Sched_C "Frequenz vom Transfer abhaengig vom Opmode" VALUE 0x1C0F31 Kw_Wu8 254.0 OneToOne 1.000 255.0 FORMAT "%5.1" EXTENDED_LIMITS 0.00 255.0 READ_ONLY /end CHARACTERISTIC
/begin CHARACTERISTIC FrmMng_NIVEAU1Strt_C "Message-Transfer-Aktivierung relativ zur Startzeit" VALUE 0x1C0F32 Kw_Wu8 255.0 OneToOne 0.00 255.0 FORMAT "%5.1" READ_ONLY /end CHARACTERISTIC
/begin CHARACTERISTIC FrmMng_NIVEAU1TOTmp_C "Timeout" VALUE 0x1C0F33 Kw_Wu8 5100. TimeCAN_TO_ms 20.00 5120. FORMAT "%5.0" /end CHARACTERISTIC
/begin CHARACTERISTIC FrmMng_nLI_Offset_C "Offset Umrechung SG->CAN für Drehzahl" VALUE 0x1D7828 Kw_Ws16 65535.00 EngN -32768.00 32767.00 FORMAT "%8.2" /end CHARACTERISTIC
/begin CHARACTERISTIC FrmMng_facNLI_Slope_C "Steigung Umrechung SG->CAN für Drehzahl" VALUE 0x1D782A Kw_Ws16 511.9922 Fact1 -256.0000 255.9922 FORMAT "%8.4" /end CHARACTERISTIC
/begin CHARACTERISTIC FrmMng_nMulinfo5_1_C "Multiplex Info 1, Botschaft Motor5, Drehzahl bei Momentenmaximum" VALUE 0x1D7830 Kw_Wu16 6000.000 EngN 0.00 6000.000 FORMAT "%8.3" EXTENDED_LIMITS 0.00 65535.00 /end CHARACTERISTIC
/begin CHARACTERISTIC FrmMng_nQLimErr_C "Begrenzungsdrehzahl N_DES für den Fall Begrenzung der Einspritzmenge (InjCtl_stQLimErr) aktiv" VALUE 0x1D7E5A Kw_Ws16 6000.000 EngN 0.00 6000.000 FORMAT "%8.3" EXTENDED_LIMITS -32768.00 32767.00 /end CHARACTERISTIC
/begin CHARACTERISTIC FrmMng_nTrqLimBit_C "Begrenzungsdrehzahl N_DES für den Fall Begrenzung der Einspritzmenge (CoEng_stTrqLimBit) aktiv" VALUE 0x1D7E5C Kw_Ws16 6000.000 EngN 0.00 6000.000 FORMAT "%8.3" EXTENDED_LIMITS -32768.00 32767.00 /end CHARACTERISTIC
/begin CHARACTERISTIC FrmMng_nTrqLimErr_C "Begrenzungsdrehzahl N_DES für den Fall Begrenzung der Einspritzmenge (CoEng_stTrqLimErr) aktiv" VALUE 0x1D7E5E Kw_Ws16 6000.000 EngN 0.00 6000.000 FORMAT "%8.3" EXTENDED_LIMITS -32768.00 32767.00 /end CHARACTERISTIC
/begin CHARACTERISTIC FrmMng_nTrqNLim_C "Begrenzungsdrehzahl N_DES für den Fall Begrenzung der Einspritzmenge (EngPrt_stTrqNLim) aktiv" VALUE 0x1D7E60 Kw_Ws16 6000.000 EngN 0.00 6000.000 FORMAT "%8.3" EXTENDED_LIMITS -32768.00 32767.00 /end CHARACTERISTIC
/begin CHARACTERISTIC FrmMng_n_Offset_C "Offset Umrechung SG->CAN für Drehzahl" VALUE 0x1D7E62 Kw_Ws16 65535.00 EngN -32768.00 32767.00 FORMAT "%8.2" /end CHARACTERISTIC
/begin CHARACTERISTIC FrmMng_facN_Slope_C "Steigung Umrechung SG->CAN für Drehzahl" VALUE 0x1D7E64 Kw_Ws16 7.999878 Fact -4.000000 3.999878 FORMAT "%8.6" /end CHARACTERISTIC
/begin CHARACTERISTIC FrmMng_pACPress_Offset_C "Offset Umrechung SG->CAN für Klima - Kältemitteldruck" VALUE 0x1D7896 Kw_Ws16 131070.0 PresAC_hPa -65536.00 65534.00 FORMAT "%8.2" /end CHARACTERISTIC
/begin CHARACTERISTIC FrmMng_facACPress_Slope_C "Steigung Umrechung SG->CAN für Klima - Kältemitteldruck" VALUE 0x1D7898 Kw_Ws16 7.999878 Fact -4.000000 3.999878 FORMAT "%8.6" /end CHARACTERISTIC
/begin CHARACTERISTIC FrmMng_pBoost_Offset_C "CAN-Umrechnungsparameter Offset für Ladedruck" VALUE 0x1D7E6A Kw_Ws16 65535.00 Pres_hPa -32768.00 32767.00 FORMAT "%8.2" /end CHARACTERISTIC
/begin CHARACTERISTIC FrmMng_facPBoost_Slope_C "CAN-Umrechnungsparameter Steigung für Ladedruck" VALUE 0x1D7E6C Kw_Ws16 7.999878 Fact -4.000000 3.999878 FORMAT "%8.6" /end CHARACTERISTIC
/begin CHARACTERISTIC FrmMng_pwrBEMAltInit_C "Wert für Generatorleistung, wenn keine gültige Botschaft empfangen wird" VALUE 0x1D7912 Kw_Ws16 300000.1 Pwr 0.00 300000.1 FORMAT "%8.1" EXTENDED_LIMITS -308831.1 308821.7 /end CHARACTERISTIC
/begin CHARACTERISTIC FrmMng_pwrInr_Offset_C "Offset für CAN-Generatorleistung" VALUE 0x1D7914 Kw_Ws16 617652.8 Pwr -308831.1 308821.7 FORMAT "%8.1" /end CHARACTERISTIC
/begin CHARACTERISTIC FrmMng_facRpwr_Slope_C "Steigung für Generatorleistung über CAN" VALUE 0x1D7916 Kw_Ws16 511.9922 Fact1 -256.0000 255.9922 FORMAT "%8.4" /end CHARACTERISTIC
/begin CHARACTERISTIC FrmMng_pwrMax_C "maximale Motorleistung" VALUE 0x1D800C Kw_Wu16 655.3500 Pwr_kW 0.00 655.3500 FORMAT "%8.4" /end CHARACTERISTIC
/begin CHARACTERISTIC FrmMng_p_Offset_C "Offset Umrechung SG->CAN für Druck" VALUE 0x1D7832 Kw_Ws16 65535.00 Pres_hPa -32768.00 32767.00 FORMAT "%8.2" /end CHARACTERISTIC
/begin CHARACTERISTIC FrmMng_facP_Slope_C "Steigung Umrechung SG->CAN für Druck" VALUE 0x1D7834 Kw_Ws16 7.999878 Fact -4.000000 3.999878 FORMAT "%8.6" /end CHARACTERISTIC
/begin CHARACTERISTIC FrmMng_rAlt_Offset_C "Offset Umrechung SG->CAN für Generatorlast" VALUE 0x1D7E70 Kw_Ws16 655.3500 Prc -327.6800 327.6700 FORMAT "%8.4" /end CHARACTERISTIC
/begin CHARACTERISTIC FrmMng_facRAlt_Slope_C "Steigung Umrechung SG->CAN für Generatorlast" VALUE 0x1D7E72 Kw_Ws16 7.999878 Fact -4.000000 3.999878 FORMAT "%8.6" /end CHARACTERISTIC
/begin CHARACTERISTIC FrmMng_rAPP_Offset_C "Offset Umrechung SG->CAN für Pedalwertgeber" VALUE 0x1D7836 Kw_Ws16 655.3500 Prc -327.6800 327.6700 FORMAT "%8.4" /end CHARACTERISTIC
/begin CHARACTERISTIC FrmMng_facRAPP_Slope_C "Steigung Umrechung SG->CAN für Pedalwertgeber" VALUE 0x1D7838 Kw_Ws16 7.999878 Fact -4.000000 3.999878 FORMAT "%8.6" /end CHARACTERISTIC
/begin CHARACTERISTIC FrmMng_rBrkDes_Offset_C "Can-Umrechnungsparameter Offset für ""Anforderung Bremsstellgröße"" : ECU -> CAN" VALUE 0x1D7F14 Kw_Ws16 655.3500 Prc -327.6800 327.6700 FORMAT "%8.4" /end CHARACTERISTIC
/begin CHARACTERISTIC FrmMng_facRBrkDes_Slope_C "Can-Umrechnungsparameter Steigung für ""Anforderung Bremsstellgröße"" :  ECU -> CAN" VALUE 0x1D7F16 Kw_Ws16 3.276750 Fact_PrcBrk -1.638400 1.638350 FORMAT "%8.6" /end CHARACTERISTIC
/begin CHARACTERISTIC FrmMng_rGearbx_Offset_C "Offset Umrechung SG->CAN für Gearbx System" VALUE 0x1D783E Kw_Ws16 655.3500 Prc -327.6800 327.6700 FORMAT "%8.4" /end CHARACTERISTIC
/begin CHARACTERISTIC FrmMng_facRGearbx_Slope_C "Steigung Umrechung SG->CAN für Anteils von dem Freien Integralmoment" VALUE 0x1D7840 Kw_Ws16 7.999878 Fact -4.000000 3.999878 FORMAT "%8.6" /end CHARACTERISTIC
/begin CHARACTERISTIC FrmMng_rICur_Offset_C "Offset Umrechung SG->CAN für Drehzahl" VALUE 0x1D7EB6 Kw_Ws16 655.3500 Prc -327.6800 327.6700 FORMAT "%8.4" /end CHARACTERISTIC
/begin CHARACTERISTIC FrmMng_facRICur_Slope_C "Steigung Umrechung SG->CAN für Drehzahl" VALUE 0x1D7EB8 Kw_Ws16 7.999878 Fact -4.000000 3.999878 FORMAT "%8.6" /end CHARACTERISTIC
/begin CHARACTERISTIC FrmMng_dRXIMMCTLID_C "CAN-Identifier für Empfangsbotschaft der Wegfahrsperre" VALUE 0x1C0F34 Kw_Wu32 536870911.000 OneToOne 0.00 536870911.000 FORMAT "%13.3" EXTENDED_LIMITS 0.00 4294967295.00 /end CHARACTERISTIC
/begin CHARACTERISTIC FrmMng_RXIMMCTLIDType_C "ID Typ standard oder extended" VALUE 0x1C0F38 Kw_Wu8 0.00 OneToOne 1.000 1.000 FORMAT "%5.3" EXTENDED_LIMITS 0.00 255.0 READ_ONLY /end CHARACTERISTIC
/begin CHARACTERISTIC FrmMng_RXIMMCTLNumCAN_C "Auf welchen CAN die Botschaft ist" VALUE 0x1C0F39 Kw_Wu8 2.000 OneToOne 0.00 2.000 FORMAT "%5.3" EXTENDED_LIMITS 0.00 255.0 READ_ONLY /end CHARACTERISTIC
/begin CHARACTERISTIC FrmMng_RXIMMCTLNumMsgPos_C "Message Buffer der verwendet wird" VALUE 0x1C0F3A Kw_Wu8 15.00 OneToOne 0.00 15.00 FORMAT "%5.2" EXTENDED_LIMITS 0.00 255.0 READ_ONLY /end CHARACTERISTIC
/begin CHARACTERISTIC FrmMng_RXIMMCTLOpMode_C "Richtung transmit/receive" VALUE 0x1C0F3B Kw_Wu8 1.000 OneToOne 0.00 1.000 FORMAT "%5.3" EXTENDED_LIMITS 0.00 255.0 READ_ONLY /end CHARACTERISTIC
/begin CHARACTERISTIC FrmMng_dRXIMMCTLLen_cu8 "Laenge der Messagedaten in Byte" VALUE 0x1C0F3C Kw_Wu8 8.000 OneToOne 0.00 8.000 FORMAT "%5.3" EXTENDED_LIMITS 0.00 255.0 /end CHARACTERISTIC
/begin CHARACTERISTIC FrmMng_RXIMMCTLIntrEna_C "Interrupt enabled oder nicht" VALUE 0x1C0F3D Kw_Wu8 1.000 OneToOne 0.00 1.000 FORMAT "%5.3" EXTENDED_LIMITS 0.00 255.0 READ_ONLY /end CHARACTERISTIC
/begin CHARACTERISTIC FrmMng_RXIMMCTLMul_C "message Buffer ist multiplexed oder nicht" VALUE 0x1C0F3E Kw_Wu8 2.000 OneToOne 0.00 2.000 FORMAT "%5.3" EXTENDED_LIMITS 0.00 255.0 READ_ONLY /end CHARACTERISTIC
/begin CHARACTERISTIC FrmMng_r_Offset_C "Offset Umrechung SG->CAN für Verhältnisse" VALUE 0x1D800E Kw_Ws16 65535.00 OneToOne -32768.00 32767.00 FORMAT "%8.2" /end CHARACTERISTIC
/begin CHARACTERISTIC FrmMng_facR_Slope_C "Steigung Umrechung SG->CAN für Verhältnisse" VALUE 0x1D8010 Kw_Ws16 7.999878 Fact -4.000000 3.999878 FORMAT "%8.6" /end CHARACTERISTIC
/begin CHARACTERISTIC FrmMng_SA1IDType_C "ID Typ standard oder extended" VALUE 0x1C0F44 Kw_Wu8 0.00 OneToOne 1.000 1.000 FORMAT "%5.3" EXTENDED_LIMITS 0.00 255.0 READ_ONLY /end CHARACTERISTIC
/begin CHARACTERISTIC FrmMng_SA1NumCAN_C "Auf welchem CAN Controller die Botschaft empfangen wird" VALUE 0x1C0F45 Kw_Wu8 2.000 OneToOne 0.00 2.000 FORMAT "%5.3" EXTENDED_LIMITS 0.00 255.0 READ_ONLY /end CHARACTERISTIC
/begin CHARACTERISTIC FrmMng_SA1NumMsgPos_C "Message Buffer der verwendet wird" VALUE 0x1C0F46 Kw_Wu8 15.00 OneToOne 0.00 15.00 FORMAT "%5.2" EXTENDED_LIMITS 0.00 255.0 READ_ONLY /end CHARACTERISTIC
/begin CHARACTERISTIC FrmMng_SA1OpMode_C "Richtung transmit/receive" VALUE 0x1C0F47 Kw_Wu8 1.000 OneToOne 0.00 1.000 FORMAT "%5.3" EXTENDED_LIMITS 0.00 255.0 READ_ONLY /end CHARACTERISTIC
/begin CHARACTERISTIC FrmMng_SA1IntrEna_C "Interrupt enabled oder nicht" VALUE 0x1C0F49 Kw_Wu8 1.000 OneToOne 0.00 1.000 FORMAT "%5.3" EXTENDED_LIMITS 0.00 255.0 READ_ONLY /end CHARACTERISTIC
/begin CHARACTERISTIC FrmMng_SA1Mul_C "message Buffer is multiplexed oder nicht" VALUE 0x1C0F4A Kw_Wu8 2.000 OneToOne 0.00 2.000 FORMAT "%5.3" EXTENDED_LIMITS 0.00 255.0 READ_ONLY /end CHARACTERISTIC
/begin CHARACTERISTIC FrmMng_SA1SchedMode_C "Can Message Schedule fuer RX und TX" VALUE 0x1C0F4C Kw_Wu8 160.0 OneToOne 16.00 176.0 FORMAT "%5.1" EXTENDED_LIMITS 0.00 255.0 READ_ONLY /end CHARACTERISTIC
/begin CHARACTERISTIC FrmMng_SA1Sched_C "Frequenz vom Transfer abhaengig vom Opmode" VALUE 0x1C0F4D Kw_Wu8 254.0 OneToOne 1.000 255.0 FORMAT "%5.1" EXTENDED_LIMITS 0.00 255.0 READ_ONLY /end CHARACTERISTIC
/begin CHARACTERISTIC FrmMng_SA1Strt_C "Message-Transfer-Aktivierung relativ zur Startzeit" VALUE 0x1C0F4E Kw_Wu8 255.0 OneToOne 0.00 255.0 FORMAT "%5.1" READ_ONLY /end CHARACTERISTIC
/begin CHARACTERISTIC FrmMng_SA1TOTmp_C "Timeout" VALUE 0x1C0F4F Kw_Wu8 5100. TimeCAN_TO_ms 20.00 5120. FORMAT "%5.0" /end CHARACTERISTIC
/begin CHARACTERISTIC FrmMng_stCANVer_C "Versionsnummer des CAN- Layouts" VALUE 0x1D7EC0 Kw_Wu8 8.000 OneToOne 0.00 8.000 FORMAT "%5.3" EXTENDED_LIMITS 0.00 255.0 /end CHARACTERISTIC
/begin CHARACTERISTIC FrmMng_stCCSelPlaus_C "Label zum Aktivieren des Plausibilitätschecks für AUDI_ACC (ACC1 -RX)" VALUE 0x1D78C2 Kw_Wu8 1.000 OneToOne 0.00 1.000 FORMAT "%5.3" EXTENDED_LIMITS 0.00 255.0 /end CHARACTERISTIC
/begin CHARACTERISTIC FrmMng_dSTIGNID_C "Botschaftsidentifier CAN-Botschaft StIgn (ZAS1)" VALUE 0x1C0F50 Kw_Wu32 536870911.000 OneToOne 0.00 536870911.000 FORMAT "%13.3" EXTENDED_LIMITS 0.00 4294967295.00 /end CHARACTERISTIC
/begin CHARACTERISTIC FrmMng_STIGNIDType_C "ID Typ standard oder extended" VALUE 0x1C0F54 Kw_Wu8 0.00 OneToOne 1.000 1.000 FORMAT "%5.3" EXTENDED_LIMITS 0.00 255.0 READ_ONLY /end CHARACTERISTIC
/begin CHARACTERISTIC FrmMng_STIGNNumCAN_C "Auf welchen CAN die Botschaft ist" VALUE 0x1C0F55 Kw_Wu8 2.000 OneToOne 0.00 2.000 FORMAT "%5.3" EXTENDED_LIMITS 0.00 255.0 READ_ONLY /end CHARACTERISTIC
/begin CHARACTERISTIC FrmMng_STIGNNumMsgPos_C "Message Buffer der verwendet wird" VALUE 0x1C0F56 Kw_Wu8 15.00 OneToOne 0.00 15.00 FORMAT "%5.2" EXTENDED_LIMITS 0.00 255.0 READ_ONLY /end CHARACTERISTIC
/begin CHARACTERISTIC FrmMng_STIGNOpMode_C "Richtung transmit/receive" VALUE 0x1C0F57 Kw_Wu8 1.000 OneToOne 0.00 1.000 FORMAT "%5.3" EXTENDED_LIMITS 0.00 255.0 READ_ONLY /end CHARACTERISTIC
/begin CHARACTERISTIC FrmMng_dSTIGNSchedMesgLen_C "Applizierbare Botschaftlänge für STIGN" VALUE 0x1C0F58 Kw_Wu8 8.000 OneToOne 0.00 8.000 FORMAT "%5.3" EXTENDED_LIMITS 0.00 255.0 /end CHARACTERISTIC
/begin CHARACTERISTIC FrmMng_STIGNIntrEna_C "Interrupt enabled oder nicht" VALUE 0x1C0F59 Kw_Wu8 1.000 OneToOne 0.00 1.000 FORMAT "%5.3" EXTENDED_LIMITS 0.00 255.0 READ_ONLY /end CHARACTERISTIC
/begin CHARACTERISTIC FrmMng_STIGNMul_C "message Buffer ist multiplexed oder nicht" VALUE 0x1C0F5A Kw_Wu8 2.000 OneToOne 0.00 2.000 FORMAT "%5.3" EXTENDED_LIMITS 0.00 255.0 READ_ONLY /end CHARACTERISTIC
/begin CHARACTERISTIC FrmMng_STIGNSchedMode_C "CAN Message Schedule Mode fuer RX und TX" VALUE 0x1C0F5C Kw_Wu8 160.0 OneToOne 16.00 176.0 FORMAT "%5.1" EXTENDED_LIMITS 0.00 255.0 READ_ONLY /end CHARACTERISTIC
/begin CHARACTERISTIC FrmMng_STIGNSched_C "Frequenz vom Transfer abhaengig vom Opmode" VALUE 0x1C0F5D Kw_Wu8 254.0 OneToOne 1.000 255.0 FORMAT "%5.1" EXTENDED_LIMITS 0.00 255.0 READ_ONLY /end CHARACTERISTIC
/begin CHARACTERISTIC FrmMng_STIGNStrt_C "Message-Transfer-Aktivierung relativ zur Startzeit" VALUE 0x1C0F5E Kw_Wu8 255.0 OneToOne 0.00 255.0 FORMAT "%5.1" READ_ONLY /end CHARACTERISTIC
/begin CHARACTERISTIC FrmMng_STIGNTOTmp_C "Timeout" VALUE 0x1C0F5F Kw_Wu8 5100. TimeCAN_TO_ms 20.00 5120. FORMAT "%5.0" /end CHARACTERISTIC
/begin CHARACTERISTIC FrmMng_stTORxMsgAlcECU_CA "Zuordnung welche Empfangs-Botschaft jeden Steuergerät zugeordnet ist" VAL_BLK 0x1D7842 Kwb_Wu8 255.0 OneToOne 0.00 255.0 FORMAT "%5.1" NUMBER 32 /end CHARACTERISTIC
/begin CHARACTERISTIC FrmMng_stTRQ_C "Status doppelte Momente" VALUE 0x1D7EC9 Kw_Wu8 1.000 OneToOne 0.00 1.000 FORMAT "%5.3" EXTENDED_LIMITS 0.00 255.0 /end CHARACTERISTIC
/begin CHARACTERISTIC FrmMng_swtAC1Ena_C "Freischaltung für CAN-Botschaft Klima1" VALUE 0x1D789A Kw_Wu8 1.000 OneToOne 0.00 1.000 FORMAT "%5.3" EXTENDED_LIMITS 0.00 255.0 /end CHARACTERISTIC
/begin CHARACTERISTIC FrmMng_swtACC1Ena_C "Freischaltung der ACC1-Botschaft" VALUE 0x1D78C3 Kw_Wu8 1.000 OneToOne 0.00 1.000 FORMAT "%5.3" EXTENDED_LIMITS 0.00 255.0 /end CHARACTERISTIC
/begin CHARACTERISTIC FrmMng_swtACCAEna_C "Freischaltung der ACCA-Botschaft" VALUE 0x1D78C4 Kw_Wu8 1.000 OneToOne 0.00 1.000 FORMAT "%5.3" EXTENDED_LIMITS 0.00 255.0 /end CHARACTERISTIC
/begin CHARACTERISTIC FrmMng_swtACCSysEna_C "Freischaltung für CAN-Botschaft ACC System" VALUE 0x1D78C5 Kw_Wu8 1.000 OneToOne 0.00 1.000 FORMAT "%5.3" EXTENDED_LIMITS 0.00 255.0 /end CHARACTERISTIC
/begin CHARACTERISTIC FrmMng_swtAIRBG1Ena_C "Freischaltung für CAN-Botschaft Airbag1" VALUE 0x1D78E8 Kw_Wu8 1.000 OneToOne 0.00 1.000 FORMAT "%5.3" EXTENDED_LIMITS 0.00 255.0 /end CHARACTERISTIC
/begin CHARACTERISTIC FrmMng_swtAWD1Ena_C "Aktivierungsschalter für CAN Botschaft Allrad1" VALUE 0x1D78FA Kw_Wu8 1.000 OneToOne 0.00 1.000 FORMAT "%5.3" EXTENDED_LIMITS 0.00 255.0 /end CHARACTERISTIC
/begin CHARACTERISTIC FrmMng_swtBEM1Ena_C "Freischaltung BEM1-Empfangsbotschaft" VALUE 0x1D7918 Kw_Wu8 1.000 OneToOne 0.00 1.000 FORMAT "%5.3" EXTENDED_LIMITS 0.00 255.0 /end CHARACTERISTIC
/begin CHARACTERISTIC FrmMng_swtBRK1Ena_C "Freischaltung für CAN-Botschaft Bremse1" VALUE 0x1D795A Kw_Wu8 1.000 OneToOne 0.00 1.000 FORMAT "%5.3" EXTENDED_LIMITS 0.00 255.0 /end CHARACTERISTIC
/begin CHARACTERISTIC FrmMng_swtBRK2Ena_C "Freischaltung für CAN-Botschaft Bremse2" VALUE 0x1D795B Kw_Wu8 1.000 OneToOne 0.00 1.000 FORMAT "%5.3" EXTENDED_LIMITS 0.00 255.0 /end CHARACTERISTIC
/begin CHARACTERISTIC FrmMng_swtBRK8Ena_C "Freischaltung für CAN-Botschaft BRK8" VALUE 0x1D795C Kw_Wu8 1.000 OneToOne 0.00 1.000 FORMAT "%5.3" EXTENDED_LIMITS 0.00 255.0 /end CHARACTERISTIC
/begin CHARACTERISTIC FrmMng_swtCCTLEna_C "Freischaltung für CAN-Botschaft CCTL" VALUE 0x1D788B Kw_Wu8 1.000 OneToOne 0.00 1.000 FORMAT "%5.3" EXTENDED_LIMITS 0.00 255.0 /end CHARACTERISTIC
/begin CHARACTERISTIC FrmMng_swtCHRGR1Ena_C "Freischaltung für CAN-Botschaft CHRGR1" VALUE 0x1D7AFC Kw_Wu8 1.000 OneToOne 0.00 1.000 FORMAT "%5.3" EXTENDED_LIMITS 0.00 255.0 /end CHARACTERISTIC
/begin CHARACTERISTIC FrmMng_swtCHRGR2Ena_C "Freischaltung für CAN-Botschaft CHRGR2" VALUE 0x1D7AFD Kw_Wu8 1.000 OneToOne 0.00 1.000 FORMAT "%5.3" EXTENDED_LIMITS 0.00 255.0 /end CHARACTERISTIC
/begin CHARACTERISTIC FrmMng_swtConvAdp_C "Schalter für die LFR Adaption" VALUE 0x1D7ECC Kw_Wu8 1.000 OneToOne 0.00 1.000 FORMAT "%5.3" EXTENDED_LIMITS 0.00 255.0 /end CHARACTERISTIC
/begin CHARACTERISTIC FrmMng_swtDIA1Ena_C "Freischaltung DIA1-Empfangsbotschaft" VALUE 0x1D79E4 Kw_Wu8 1.000 OneToOne 0.00 1.000 FORMAT "%5.3" EXTENDED_LIMITS 0.00 255.0 /end CHARACTERISTIC
/begin CHARACTERISTIC FrmMng_swtDSP1Ena_C "Freischaltung für CAN-Botschaft Kombi1 (DSP1)" VALUE 0x1D797E Kw_Wu8 1.000 OneToOne 0.00 1.000 FORMAT "%5.3" EXTENDED_LIMITS 0.00 255.0 /end CHARACTERISTIC
/begin CHARACTERISTIC FrmMng_swtDSP2Ena_C "Freischaltung für CAN-Botschaft Kombi2 (DSP2)" VALUE 0x1D797F Kw_Wu8 1.000 OneToOne 0.00 1.000 FORMAT "%5.3" EXTENDED_LIMITS 0.00 255.0 /end CHARACTERISTIC
/begin CHARACTERISTIC FrmMng_swtDSP3Ena_C "Freischaltung für CAN-Botschaft Kombi3 (DSP3)" VALUE 0x1D7980 Kw_Wu8 1.000 OneToOne 0.00 1.000 FORMAT "%5.3" EXTENDED_LIMITS 0.00 255.0 /end CHARACTERISTIC
/begin CHARACTERISTIC FrmMng_swtENG1Ena_C "Freischaltung für CAN-Botschaft Motor1" VALUE 0x1D7ECE Kw_Wu8 1.000 OneToOne 0.00 1.000 FORMAT "%5.3" EXTENDED_LIMITS 0.00 255.0 /end CHARACTERISTIC
/begin CHARACTERISTIC FrmMng_swtENG2Ena_C "Freischaltung für CAN-Botschaft Motor2" VALUE 0x1D7ECF Kw_Wu8 1.000 OneToOne 0.00 1.000 FORMAT "%5.3" EXTENDED_LIMITS 0.00 255.0 /end CHARACTERISTIC
/begin CHARACTERISTIC FrmMng_swtENG3Ena_C "Freischaltung für CAN-Botschaft Motor3" VALUE 0x1D7ED0 Kw_Wu8 1.000 OneToOne 0.00 1.000 FORMAT "%5.3" EXTENDED_LIMITS 0.00 255.0 /end CHARACTERISTIC
/begin CHARACTERISTIC FrmMng_swtENG5Ena_C "Freischaltung für CAN-Botschaft Motor5" VALUE 0x1D7ED1 Kw_Wu8 1.000 OneToOne 0.00 1.000 FORMAT "%5.3" EXTENDED_LIMITS 0.00 255.0 /end CHARACTERISTIC
/begin CHARACTERISTIC FrmMng_swtENG6Ena_C "Freischaltung für CAN-Botschaft Motor6" VALUE 0x1D7ED2 Kw_Wu8 1.000 OneToOne 0.00 1.000 FORMAT "%5.3" EXTENDED_LIMITS 0.00 255.0 /end CHARACTERISTIC
/begin CHARACTERISTIC FrmMng_swtENG7Ena_C "Freischaltung für CAN-Botschaft Motor7" VALUE 0x1D7ED3 Kw_Wu8 1.000 OneToOne 0.00 1.000 FORMAT "%5.3" EXTENDED_LIMITS 0.00 255.0 /end CHARACTERISTIC
/begin CHARACTERISTIC FrmMng_swtENGACTR1Ena_C "Freischaltung für CAN-Botschaft ENGACTR1" VALUE 0x1D8080 Kw_Wu8 1.000 OneToOne 0.00 1.000 FORMAT "%5.3" EXTENDED_LIMITS 0.00 255.0 /end CHARACTERISTIC
/begin CHARACTERISTIC FrmMng_swtENGBRKEna_C "Freischaltung für CAN-Botschaft ENGBRK" VALUE 0x1D7F18 Kw_Wu8 1.000 OneToOne 0.00 1.000 FORMAT "%5.3" EXTENDED_LIMITS 0.00 255.0 /end CHARACTERISTIC
/begin CHARACTERISTIC FrmMng_swtENGDISPEna_C "Freischaltung für CAN-Botschaft ENGDISP" VALUE 0x1D7ED4 Kw_Wu8 1.000 OneToOne 0.00 1.000 FORMAT "%5.3" EXTENDED_LIMITS 0.00 255.0 /end CHARACTERISTIC
/begin CHARACTERISTIC FrmMng_swtENGFLXEna_C "Freischaltung für CAN-Botschaft Motor Flexia" VALUE 0x1D8013 Kw_Wu8 1.000 OneToOne 0.00 1.000 FORMAT "%5.3" EXTENDED_LIMITS 0.00 255.0 /end CHARACTERISTIC
/begin CHARACTERISTIC FrmMng_swtENGSLVEna_C "Freischaltung für CAN-Botschaft MotorSLV" VALUE 0x1D8040 Kw_Wu8 1.000 OneToOne 0.00 1.000 FORMAT "%5.3" EXTENDED_LIMITS 0.00 255.0 /end CHARACTERISTIC
/begin CHARACTERISTIC FrmMng_swtENGTRQ1Ena_C "Freischaltung für CAN-Botschaft ENGTRQ1" VALUE 0x1D804E Kw_Wu8 1.000 OneToOne 0.00 1.000 FORMAT "%5.3" EXTENDED_LIMITS 0.00 255.0 /end CHARACTERISTIC
/begin CHARACTERISTIC FrmMng_swtENGTRQ2Ena_C "Freischaltung für CAN-Botschaft ENGTRQ2" VALUE 0x1D804F Kw_Wu8 1.000 OneToOne 0.00 1.000 FORMAT "%5.3" EXTENDED_LIMITS 0.00 255.0 /end CHARACTERISTIC
/begin CHARACTERISTIC FrmMng_swtENGTRQ3Ena_C "Freischaltung für CAN-Botschaft ENGTRQ3" VALUE 0x1D8050 Kw_Wu8 1.000 OneToOne 0.00 1.000 FORMAT "%5.3" EXTENDED_LIMITS 0.00 255.0 /end CHARACTERISTIC
/begin CHARACTERISTIC FrmMng_swtEPB1Ena_C "Freischaltung der EPB1-Botschaft" VALUE 0x1D799C Kw_Wu8 1.000 OneToOne 0.00 1.000 FORMAT "%5.3" EXTENDED_LIMITS 0.00 255.0 /end CHARACTERISTIC
/begin CHARACTERISTIC FrmMng_swtESCUEna_C "Freischaltung für CAN-Botschaft BSG-Last" VALUE 0x1D79B2 Kw_Wu8 1.000 OneToOne 0.00 1.000 FORMAT "%5.3" EXTENDED_LIMITS 0.00 255.0 /end CHARACTERISTIC
/begin CHARACTERISTIC FrmMng_swtGW1Ena_C "Freischaltung GW1-Empfangsbotschaft" VALUE 0x1D79E5 Kw_Wu8 1.000 OneToOne 0.00 1.000 FORMAT "%5.3" EXTENDED_LIMITS 0.00 255.0 /end CHARACTERISTIC
/begin CHARACTERISTIC FrmMng_swtHighLine_C "Schalter feur High line" VALUE 0x1D8082 Kw_Wu8 1.000 OneToOne 0.00 1.000 FORMAT "%5.3" EXTENDED_LIMITS 0.00 255.0 /end CHARACTERISTIC
/begin CHARACTERISTIC FrmMng_swtRevGearSrc_C "Auswahlschalter der Quellbotschaft des Rückfahrlichts (0=0; 1=LICHT1-Botschaft;2=ILM-Botschaft)" VALUE 0x1D79E6 Kw_Wu8 2.000 OneToOne 0.00 2.000 FORMAT "%5.3" EXTENDED_LIMITS 0.00 255.0 /end CHARACTERISTIC
/begin CHARACTERISTIC FrmMng_swtSTIGNEna_C "Freischaltung für CAN-Botschaft ZAS1" VALUE 0x1D7A28 Kw_Wu8 1.000 OneToOne 0.00 1.000 FORMAT "%5.3" EXTENDED_LIMITS 0.00 255.0 /end CHARACTERISTIC
/begin CHARACTERISTIC FrmMng_swtTSC1Ena_C "Freischaltung für CAN-Botschaft Getriebe1" VALUE 0x1D7A8D Kw_Wu8 1.000 OneToOne 0.00 1.000 FORMAT "%5.3" EXTENDED_LIMITS 0.00 255.0 /end CHARACTERISTIC
/begin CHARACTERISTIC FrmMng_swtTSC2Ena_C "Freischaltung für CAN-Botschaft Getriebe2" VALUE 0x1D7A8E Kw_Wu8 1.000 OneToOne 0.00 1.000 FORMAT "%5.3" EXTENDED_LIMITS 0.00 255.0 /end CHARACTERISTIC
/begin CHARACTERISTIC FrmMng_swtTSC3Ena_C "Freischaltung für CAN-Botschaft Getriebe3" VALUE 0x1D7A8F Kw_Wu8 1.000 OneToOne 0.00 1.000 FORMAT "%5.3" EXTENDED_LIMITS 0.00 255.0 /end CHARACTERISTIC
/begin CHARACTERISTIC FrmMng_swtTSC3NeutDisbl_C "Schalter zur Deaktivierung der Aktualisierung von FrmMng_trqTSC3 auf neutralen Momentenwert" VALUE 0x1D7A90 Kw_Wu8 1.000 OneToOne 0.00 1.000 FORMAT "%5.3" EXTENDED_LIMITS 0.00 255.0 /end CHARACTERISTIC
/begin CHARACTERISTIC FrmMng_swtTSC3Type_C "Switch Typs Botschaft Getriebe3" VALUE 0x1D7A91 Kw_Wu8 2.000 OneToOne 0.00 2.000 FORMAT "%5.3" EXTENDED_LIMITS 0.00 255.0 /end CHARACTERISTIC
/begin CHARACTERISTIC FrmMng_tEnv_Offset_C "Offset Umrechung SG->CAN für Umgebungstemperatur" VALUE 0x1D7982 Kw_Ws16 6553.500 Temp_Cels -3549.940 3003.560 FORMAT "%8.3" /end CHARACTERISTIC
/begin CHARACTERISTIC FrmMng_facTEnv_Slope_C "Steigung Umrechung SG->CAN für Umgebungstemperatur" VALUE 0x1D7984 Kw_Ws16 7.999878 Fact -4.000000 3.999878 FORMAT "%8.6" /end CHARACTERISTIC
/begin CHARACTERISTIC FrmMng_tiACCAPoll_C "Erlaubte Zeit zur CAN Polling der ACCA-Botschaft, wenn GRA" VALUE 0x1D78C8 Kw_Wu16 655350.0 Time_ms 0.00 655350.0 FORMAT "%8.1" /end CHARACTERISTIC
/begin CHARACTERISTIC FrmMng_tiAdpStrtDly_C "Verzögerungszeit nach Start" VALUE 0x1D7EE2 Kw_Wu16 655350.0 Time_ms 0.00 655350.0 FORMAT "%8.1" /end CHARACTERISTIC
/begin CHARACTERISTIC FrmMng_tiAdpStrt_C "Speicherzeit bei Schwellwertüberschreitung" VALUE 0x1D78EA Kw_Wu16 655350.0 Time_ms 0.00 655350.0 FORMAT "%8.1" /end CHARACTERISTIC
/begin CHARACTERISTIC FrmMng_tiDebTO_C "Rampendauer für Abschaltung bei short TO Error in AUDI-RX(ACC1-RX Message)" VALUE 0x1D78CA Kw_Wu16 5.000000 Time_s 0.00 5.000000 FORMAT "%8.6" EXTENDED_LIMITS 0.00 655.3500 /end CHARACTERISTIC
/begin CHARACTERISTIC FrmMng_tiDelHotLamp_C "Verzögerungszeit für die Heißlampe nach Startabwurf" VALUE 0x1D7EE8 Kw_Wu16 655140.0 Time_ms 0.00 655140.0 FORMAT "%8.1" EXTENDED_LIMITS 0.00 655350.0 /end CHARACTERISTIC
/begin CHARACTERISTIC FrmMng_ti_Offset_C "Offset Umrechung SG->CAN für Zeit" VALUE 0x1D7A94 Kw_Ws16 655350.0 Time_ms -327680.0 327670.0 FORMAT "%8.1" /end CHARACTERISTIC
/begin CHARACTERISTIC FrmMng_facTi_Slope_C "Steigung Umrechung SG->CAN für Zeit" VALUE 0x1D7A96 Kw_Ws16 511.9922 Fact1 -256.0000 255.9922 FORMAT "%8.4" /end CHARACTERISTIC
/begin CHARACTERISTIC FrmMng_tOil_Offset_C "Offset Umrechung SG->CAN für Öl-Temperatur" VALUE 0x1D7862 Kw_Ws16 6553.500 Temp_Cels -3549.940 3003.560 FORMAT "%8.3" /end CHARACTERISTIC
/begin CHARACTERISTIC FrmMng_facTOil_Slope_C "Steigung Umrechung SG->CAN für Öl-Temperatur" VALUE 0x1D7864 Kw_Ws16 7.999878 Fact -4.000000 3.999878 FORMAT "%8.6" /end CHARACTERISTIC
/begin CHARACTERISTIC FrmMng_TOSIDType_C "ID Typ standard oder extended" VALUE 0x1C0F64 Kw_Wu8 0.00 OneToOne 1.000 1.000 FORMAT "%5.3" EXTENDED_LIMITS 0.00 255.0 READ_ONLY /end CHARACTERISTIC
/begin CHARACTERISTIC FrmMng_TOSNumCAN_C "Auf welchen CAN die Botschaft ist" VALUE 0x1C0F65 Kw_Wu8 2.000 OneToOne 0.00 2.000 FORMAT "%5.3" EXTENDED_LIMITS 0.00 255.0 READ_ONLY /end CHARACTERISTIC
/begin CHARACTERISTIC FrmMng_TOSNumMsgPos_C "Message Buffer der verwendet wird" VALUE 0x1C0F66 Kw_Wu8 15.00 OneToOne 0.00 15.00 FORMAT "%5.2" EXTENDED_LIMITS 0.00 255.0 READ_ONLY /end CHARACTERISTIC
/begin CHARACTERISTIC FrmMng_TOSOpMode_C "Richtung transmit/receive" VALUE 0x1C0F67 Kw_Wu8 1.000 OneToOne 0.00 1.000 FORMAT "%5.3" EXTENDED_LIMITS 0.00 255.0 READ_ONLY /end CHARACTERISTIC
/begin CHARACTERISTIC FrmMng_TOSIntrEna_C "Interrupt enabled oder nicht" VALUE 0x1C0F69 Kw_Wu8 1.000 OneToOne 0.00 1.000 FORMAT "%5.3" EXTENDED_LIMITS 0.00 255.0 READ_ONLY /end CHARACTERISTIC
/begin CHARACTERISTIC FrmMng_TOSMul_C "message Buffer ist multiplexed oder nicht" VALUE 0x1C0F6A Kw_Wu8 2.000 OneToOne 0.00 2.000 FORMAT "%5.3" EXTENDED_LIMITS 0.00 255.0 READ_ONLY /end CHARACTERISTIC
/begin CHARACTERISTIC FrmMng_TOSSchedMode_C "CAN Message Schedule Mode fuer RX und TX" VALUE 0x1C0F6C Kw_Wu8 160.0 OneToOne 16.00 176.0 FORMAT "%5.1" EXTENDED_LIMITS 0.00 255.0 READ_ONLY /end CHARACTERISTIC
/begin CHARACTERISTIC FrmMng_TOSSched_C "Frequenz vom Transfer abhaengig vom Opmode" VALUE 0x1C0F6D Kw_Wu8 254.0 OneToOne 1.000 255.0 FORMAT "%5.1" EXTENDED_LIMITS 0.00 255.0 READ_ONLY /end CHARACTERISTIC
/begin CHARACTERISTIC FrmMng_TOSStrt_C "Message-Transfer-Aktivierung relativ zur Startzeit" VALUE 0x1C0F6E Kw_Wu8 255.0 OneToOne 0.00 255.0 FORMAT "%5.1" READ_ONLY /end CHARACTERISTIC
/begin CHARACTERISTIC FrmMng_TOSTOTmp_C "Timeout" VALUE 0x1C0F6F Kw_Wu8 5100. TimeCAN_TO_ms 20.00 5120. FORMAT "%5.0" /end CHARACTERISTIC
/begin CHARACTERISTIC FrmMng_trFct_Offset_C "Offset für Umrechnung SG -> CAN für Übertragungsfunktion" VALUE 0x1D7A98 Kw_Ws16 65535.00 OneToOne -32768.00 32767.00 FORMAT "%8.2" /end CHARACTERISTIC
/begin CHARACTERISTIC FrmMng_facTrFct_Slope_C "Steigung für Umwandlung SG -> CAN für Übertragungsfunktion" VALUE 0x1D7A9A Kw_Ws16 7.999878 Fact -4.000000 3.999878 FORMAT "%8.6" /end CHARACTERISTIC
/begin CHARACTERISTIC FrmMng_trqACComprLoad_Offset_C "Offset Umrechung SG->CAN für Klimawunschmoment" VALUE 0x1D789C Kw_Ws16 6553.500 Trq -3276.800 3276.700 FORMAT "%8.3" /end CHARACTERISTIC
/begin CHARACTERISTIC FrmMng_facACComprLoad_Slope_C "Steigung Umrechung SG->CAN für Klimawunschmoment" VALUE 0x1D789E Kw_Ws16 7.999878 Fact -4.000000 3.999878 FORMAT "%8.6" /end CHARACTERISTIC
/begin CHARACTERISTIC FrmMng_trqEngTrqPrp_Offset_CA "Array von Offset-Werten für die Umrechnung des Antriebsmoments" VAL_BLK 0x1D8054 Kwb_Ws32 429496729.500 Trq -214748364.800 214748364.700 FORMAT "%13.3" NUMBER 4 /end CHARACTERISTIC
/begin CHARACTERISTIC FrmMng_trqInrTrq_Offset_CA "Array von Offset Werten zur Umrechnung von Trq --> InrTrq" VAL_BLK 0x1D8064 Kwb_Ws16 6553.500 Trq -3276.800 3276.700 FORMAT "%8.3" NUMBER 4 /end CHARACTERISTIC
/begin CHARACTERISTIC FrmMng_trqMulinfo2_3_C "Multiplex Info 3, Botschaft Motor2, maximales Moment" VALUE 0x1D786A Kw_Wu16 630.0000 Trq 0.00 630.0000 FORMAT "%8.4" EXTENDED_LIMITS 0.00 6553.500 /end CHARACTERISTIC
/begin CHARACTERISTIC FrmMng_trqMulinfo5_0_C "Multiplex Info 0, Botschaft Motor5, maximales Moment" VALUE 0x1D7EF4 Kw_Wu16 630.0000 Trq 0.00 630.0000 FORMAT "%8.4" EXTENDED_LIMITS 0.00 6553.500 /end CHARACTERISTIC
/begin CHARACTERISTIC FrmMng_dTSC1ID_C "Botschaftsidentifier CAN-Botschaft TSC1" VALUE 0x1C0F70 Kw_Wu32 536870911.000 OneToOne 0.00 536870911.000 FORMAT "%13.3" EXTENDED_LIMITS 0.00 4294967295.00 /end CHARACTERISTIC
/begin CHARACTERISTIC FrmMng_TSC1IDType_C "ID Typ standard oder extended" VALUE 0x1C0F74 Kw_Wu8 0.00 OneToOne 1.000 1.000 FORMAT "%5.3" EXTENDED_LIMITS 0.00 255.0 READ_ONLY /end CHARACTERISTIC
/begin CHARACTERISTIC FrmMng_TSC1NumCAN_C "Auf welchen CAN die Botschaft ist" VALUE 0x1C0F75 Kw_Wu8 2.000 OneToOne 0.00 2.000 FORMAT "%5.3" EXTENDED_LIMITS 0.00 255.0 READ_ONLY /end CHARACTERISTIC
/begin CHARACTERISTIC FrmMng_TSC1NumMsgPos_C "Message Buffer der verwendet wird" VALUE 0x1C0F76 Kw_Wu8 15.00 OneToOne 0.00 15.00 FORMAT "%5.2" EXTENDED_LIMITS 0.00 255.0 READ_ONLY /end CHARACTERISTIC
/begin CHARACTERISTIC FrmMng_TSC1OpMode_C "Richtung transmit/receive" VALUE 0x1C0F77 Kw_Wu8 1.000 OneToOne 0.00 1.000 FORMAT "%5.3" EXTENDED_LIMITS 0.00 255.0 READ_ONLY /end CHARACTERISTIC
/begin CHARACTERISTIC FrmMng_dTSC1SchedMesgLen_C "Applizierbare Botschaftlänge für TSC1" VALUE 0x1C0F78 Kw_Wu8 8.000 OneToOne 0.00 8.000 FORMAT "%5.3" EXTENDED_LIMITS 0.00 255.0 /end CHARACTERISTIC
/begin CHARACTERISTIC FrmMng_TSC1IntrEna_C "Interrupt enabled oder nicht" VALUE 0x1C0F79 Kw_Wu8 1.000 OneToOne 0.00 1.000 FORMAT "%5.3" EXTENDED_LIMITS 0.00 255.0 READ_ONLY /end CHARACTERISTIC
/begin CHARACTERISTIC FrmMng_TSC1Mul_C "message Buffer ist multiplexed oder nicht" VALUE 0x1C0F7A Kw_Wu8 2.000 OneToOne 0.00 2.000 FORMAT "%5.3" EXTENDED_LIMITS 0.00 255.0 READ_ONLY /end CHARACTERISTIC
/begin CHARACTERISTIC FrmMng_TSC1SchedMode_C "CAN Message Schedule Mode fuer RX und TX" VALUE 0x1C0F7C Kw_Wu8 160.0 OneToOne 16.00 176.0 FORMAT "%5.1" EXTENDED_LIMITS 0.00 255.0 READ_ONLY /end CHARACTERISTIC
/begin CHARACTERISTIC FrmMng_TSC1Sched_C "Frequenz vom Transfer abhaengig vom Opmode" VALUE 0x1C0F7D Kw_Wu8 254.0 OneToOne 1.000 255.0 FORMAT "%5.1" EXTENDED_LIMITS 0.00 255.0 READ_ONLY /end CHARACTERISTIC
/begin CHARACTERISTIC FrmMng_TSC1Strt_C "Message-Transfer-Aktivierung relativ zur Startzeit" VALUE 0x1C0F7E Kw_Wu8 255.0 OneToOne 0.00 255.0 FORMAT "%5.1" READ_ONLY /end CHARACTERISTIC
/begin CHARACTERISTIC FrmMng_TSC1TOTmp_C "Timeout" VALUE 0x1C0F7F Kw_Wu8 5100. TimeCAN_TO_ms 20.00 5120. FORMAT "%5.0" /end CHARACTERISTIC
/begin CHARACTERISTIC FrmMng_dTSC2ID_C "Botschaftsidentifier CAN-Botschaft TSC2" VALUE 0x1C0F80 Kw_Wu32 536870911.000 OneToOne 0.00 536870911.000 FORMAT "%13.3" EXTENDED_LIMITS 0.00 4294967295.00 /end CHARACTERISTIC
/begin CHARACTERISTIC FrmMng_TSC2IDType_C "ID Typ standard oder extended" VALUE 0x1C0F84 Kw_Wu8 0.00 OneToOne 1.000 1.000 FORMAT "%5.3" EXTENDED_LIMITS 0.00 255.0 READ_ONLY /end CHARACTERISTIC
/begin CHARACTERISTIC FrmMng_TSC2NumCAN_C "Auf welchen CAN die Botschaft ist" VALUE 0x1C0F85 Kw_Wu8 2.000 OneToOne 0.00 2.000 FORMAT "%5.3" EXTENDED_LIMITS 0.00 255.0 READ_ONLY /end CHARACTERISTIC
/begin CHARACTERISTIC FrmMng_TSC2NumMsgPos_C "Message Buffer der verwendet wird" VALUE 0x1C0F86 Kw_Wu8 15.00 OneToOne 0.00 15.00 FORMAT "%5.2" EXTENDED_LIMITS 0.00 255.0 READ_ONLY /end CHARACTERISTIC
/begin CHARACTERISTIC FrmMng_TSC2OpMode_C "Richtung transmit/receive" VALUE 0x1C0F87 Kw_Wu8 1.000 OneToOne 0.00 1.000 FORMAT "%5.3" EXTENDED_LIMITS 0.00 255.0 READ_ONLY /end CHARACTERISTIC
/begin CHARACTERISTIC FrmMng_dTSC2SchedMesgLen_C "Applizierbare Botschaftlänge für TSC2" VALUE 0x1C0F88 Kw_Wu8 8.000 OneToOne 0.00 8.000 FORMAT "%5.3" EXTENDED_LIMITS 0.00 255.0 /end CHARACTERISTIC
/begin CHARACTERISTIC FrmMng_TSC2IntrEna_C "Interrupt enabled oder nicht" VALUE 0x1C0F89 Kw_Wu8 1.000 OneToOne 0.00 1.000 FORMAT "%5.3" EXTENDED_LIMITS 0.00 255.0 READ_ONLY /end CHARACTERISTIC
/begin CHARACTERISTIC FrmMng_TSC2Mul_C "message Buffer ist multiplexed oder nicht" VALUE 0x1C0F8A Kw_Wu8 2.000 OneToOne 0.00 2.000 FORMAT "%5.3" EXTENDED_LIMITS 0.00 255.0 READ_ONLY /end CHARACTERISTIC
/begin CHARACTERISTIC FrmMng_TSC2SchedMode_C "CAN Message Schedule Mode fuer RX und TX" VALUE 0x1C0F8C Kw_Wu8 160.0 OneToOne 16.00 176.0 FORMAT "%5.1" EXTENDED_LIMITS 0.00 255.0 READ_ONLY /end CHARACTERISTIC
/begin CHARACTERISTIC FrmMng_TSC2Sched_C "Frequenz vom Transfer abhaengig vom Opmode" VALUE 0x1C0F8D Kw_Wu8 254.0 OneToOne 1.000 255.0 FORMAT "%5.1" EXTENDED_LIMITS 0.00 255.0 READ_ONLY /end CHARACTERISTIC
/begin CHARACTERISTIC FrmMng_TSC2Strt_C "Message-Transfer-Aktivierung relativ zur Startzeit" VALUE 0x1C0F8E Kw_Wu8 255.0 OneToOne 0.00 255.0 FORMAT "%5.1" READ_ONLY /end CHARACTERISTIC
/begin CHARACTERISTIC FrmMng_TSC2TOTmp_C "Timeout" VALUE 0x1C0F8F Kw_Wu8 5100. TimeCAN_TO_ms 20.00 5120. FORMAT "%5.0" /end CHARACTERISTIC
/begin CHARACTERISTIC FrmMng_dTSC3ID_C "Botschaftsidentifier CAN-Botschaft TSC3" VALUE 0x1C0F90 Kw_Wu32 536870911.000 OneToOne 0.00 536870911.000 FORMAT "%13.3" EXTENDED_LIMITS 0.00 4294967295.00 /end CHARACTERISTIC
/begin CHARACTERISTIC FrmMng_TSC3IDType_C "ID Typ standard oder extended" VALUE 0x1C0F94 Kw_Wu8 0.00 OneToOne 1.000 1.000 FORMAT "%5.3" EXTENDED_LIMITS 0.00 255.0 READ_ONLY /end CHARACTERISTIC
/begin CHARACTERISTIC FrmMng_TSC3NumCAN_C "Auf welchen CAN die Botschaft ist" VALUE 0x1C0F95 Kw_Wu8 2.000 OneToOne 0.00 2.000 FORMAT "%5.3" EXTENDED_LIMITS 0.00 255.0 READ_ONLY /end CHARACTERISTIC
/begin CHARACTERISTIC FrmMng_TSC3NumMsgPos_C "Message Buffer der verwendet wird" VALUE 0x1C0F96 Kw_Wu8 15.00 OneToOne 0.00 15.00 FORMAT "%5.2" EXTENDED_LIMITS 0.00 255.0 READ_ONLY /end CHARACTERISTIC
/begin CHARACTERISTIC FrmMng_TSC3OpMode_C "Richtung transmit/receive" VALUE 0x1C0F97 Kw_Wu8 1.000 OneToOne 0.00 1.000 FORMAT "%5.3" EXTENDED_LIMITS 0.00 255.0 READ_ONLY /end CHARACTERISTIC
/begin CHARACTERISTIC FrmMng_dTSC3SchedMesgLen_C "Applizierbare Botschaftlänge für TSC3" VALUE 0x1C0F98 Kw_Wu8 8.000 OneToOne 0.00 8.000 FORMAT "%5.3" EXTENDED_LIMITS 0.00 255.0 /end CHARACTERISTIC
/begin CHARACTERISTIC FrmMng_TSC3IntrEna_C "Interrupt enabled oder nicht" VALUE 0x1C0F99 Kw_Wu8 1.000 OneToOne 0.00 1.000 FORMAT "%5.3" EXTENDED_LIMITS 0.00 255.0 READ_ONLY /end CHARACTERISTIC
/begin CHARACTERISTIC FrmMng_TSC3Mul_C "message Buffer ist multiplexed oder nicht" VALUE 0x1C0F9A Kw_Wu8 2.000 OneToOne 0.00 2.000 FORMAT "%5.3" EXTENDED_LIMITS 0.00 255.0 READ_ONLY /end CHARACTERISTIC
/begin CHARACTERISTIC FrmMng_TSC3SchedMode_C "CAN Message Schedule Mode fuer RX und TX" VALUE 0x1C0F9C Kw_Wu8 160.0 OneToOne 16.00 176.0 FORMAT "%5.1" EXTENDED_LIMITS 0.00 255.0 READ_ONLY /end CHARACTERISTIC
/begin CHARACTERISTIC FrmMng_TSC3Sched_C "Frequenz vom Transfer abhaengig vom Opmode" VALUE 0x1C0F9D Kw_Wu8 254.0 OneToOne 1.000 255.0 FORMAT "%5.1" EXTENDED_LIMITS 0.00 255.0 READ_ONLY /end CHARACTERISTIC
/begin CHARACTERISTIC FrmMng_TSC3Strt_C "Message-Transfer-Aktivierung relativ zur Startzeit" VALUE 0x1C0F9E Kw_Wu8 255.0 OneToOne 0.00 255.0 FORMAT "%5.1" READ_ONLY /end CHARACTERISTIC
/begin CHARACTERISTIC FrmMng_TSC3TOTmp_C "Timeout" VALUE 0x1C0F9F Kw_Wu8 5100. TimeCAN_TO_ms 20.00 5120. FORMAT "%5.0" /end CHARACTERISTIC
/begin CHARACTERISTIC FrmMng_dTXIMMCTLID_C "CAN-Identifier für Sendebotschaft der Wegfahrsperre" VALUE 0x1C0FB0 Kw_Wu32 536870911.000 OneToOne 0.00 536870911.000 FORMAT "%13.3" EXTENDED_LIMITS 0.00 4294967295.00 /end CHARACTERISTIC
/begin CHARACTERISTIC FrmMng_TXIMMCTLIDType_C "ID Typ standard oder extended" VALUE 0x1C0FB4 Kw_Wu8 0.00 OneToOne 1.000 1.000 FORMAT "%5.3" EXTENDED_LIMITS 0.00 255.0 READ_ONLY /end CHARACTERISTIC
/begin CHARACTERISTIC FrmMng_TXIMMCTLNumCAN_C "Auf welchen CAN die Botschaft ist" VALUE 0x1C0FB5 Kw_Wu8 2.000 OneToOne 0.00 2.000 FORMAT "%5.3" EXTENDED_LIMITS 0.00 255.0 READ_ONLY /end CHARACTERISTIC
/begin CHARACTERISTIC FrmMng_TXIMMCTLNumMsgPos_C "Message Buffer der verwendet wird" VALUE 0x1C0FB6 Kw_Wu8 15.00 OneToOne 0.00 15.00 FORMAT "%5.2" EXTENDED_LIMITS 0.00 255.0 READ_ONLY /end CHARACTERISTIC
/begin CHARACTERISTIC FrmMng_TXIMMCTLOpMode_C "Richtung transmit/receive" VALUE 0x1C0FB7 Kw_Wu8 1.000 OneToOne 0.00 1.000 FORMAT "%5.3" EXTENDED_LIMITS 0.00 255.0 READ_ONLY /end CHARACTERISTIC
/begin CHARACTERISTIC FrmMng_dTXIMMCTLSchedMesgLen_C "Applizierbare Botschaftlänge für TXIMMCTL" VALUE 0x1C0FB8 Kw_Wu8 8.000 OneToOne 0.00 8.000 FORMAT "%5.3" EXTENDED_LIMITS 0.00 255.0 /end CHARACTERISTIC
/begin CHARACTERISTIC FrmMng_TXIMMCTLIntrEna_C "Interrupt enabled oder nicht" VALUE 0x1C0FB9 Kw_Wu8 1.000 OneToOne 0.00 1.000 FORMAT "%5.3" EXTENDED_LIMITS 0.00 255.0 READ_ONLY /end CHARACTERISTIC
/begin CHARACTERISTIC FrmMng_TXIMMCTLMul_C "message Buffer ist multiplexed oder nicht" VALUE 0x1C0FBA Kw_Wu8 2.000 OneToOne 0.00 2.000 FORMAT "%5.3" EXTENDED_LIMITS 0.00 255.0 READ_ONLY /end CHARACTERISTIC
/begin CHARACTERISTIC FrmMng_t_Offset_C "Offset Umrechung SG->CAN für Temperatur" VALUE 0x1D786C Kw_Ws16 6553.500 Temp_Cels -3549.940 3003.560 FORMAT "%8.3" /end CHARACTERISTIC
/begin CHARACTERISTIC FrmMng_facT_Slope_C "Steigung Umrechung SG->CAN für Temperatur" VALUE 0x1D786E Kw_Ws16 7.999878 Fact -4.000000 3.999878 FORMAT "%8.6" /end CHARACTERISTIC
/begin CHARACTERISTIC FrmMng_vDesDspl_Offset_C "Offset Umrechung SG->CAN für Fahrgeschwindigkeit" VALUE 0x1D7EF6 Kw_Ws16 65535.00 OneToOne -32768.00 32767.00 FORMAT "%8.2" /end CHARACTERISTIC
/begin CHARACTERISTIC FrmMng_facVDesDspl_Slope_C "Steigung Umrechung SG->CAN für Fahrgeschwindigkeit" VALUE 0x1D7EF8 Kw_Ws16 511.9922 Fact1 -256.0000 255.9922 FORMAT "%8.4" /end CHARACTERISTIC
/begin CHARACTERISTIC FrmMng_vDes_Offset_C "Offset Umrechung SG->CAN für Fahrgeschwindigkeit" VALUE 0x1D7EFA Kw_Ws16 655.3500 Vel -327.6800 327.6700 FORMAT "%8.4" /end CHARACTERISTIC
/begin CHARACTERISTIC FrmMng_facVDes_Slope_C "Steigung Umrechung SG->CAN für Fahrgeschwindigkeit" VALUE 0x1D7EFC Kw_Ws16 511.9922 Fact1 -256.0000 255.9922 FORMAT "%8.4" /end CHARACTERISTIC
/begin CHARACTERISTIC FrmMng_vDspl_Offset_C "CAN-Umrechnungsparameter Offset für angezeigte Ge-schwindigkeit," VALUE 0x1D7870 Kw_Ws16 655.3500 Vel -327.6800 327.6700 FORMAT "%8.4" /end CHARACTERISTIC
/begin CHARACTERISTIC FrmMng_facVDspl_Slope_C "CAN-Umrechnungsparameter Steigung für angezeigte Ge-schwindigkeit," VALUE 0x1D7872 Kw_Ws16 7.999878 Fact -4.000000 3.999878 FORMAT "%8.6" /end CHARACTERISTIC
/begin CHARACTERISTIC FrmMng_vGSInitVal_C "Init-wert für FrmMng_vGS" VALUE 0x1D795E Kw_Ws16 655.3500 Vel -327.6800 327.6700 FORMAT "%8.4" /end CHARACTERISTIC
/begin CHARACTERISTIC FrmMng_vLim_Offset_C "Offset Umrechung SG->CAN für Höchstgeschwindigkeit" VALUE 0x1D78FC Kw_Ws16 655.3500 Vel -327.6800 327.6700 FORMAT "%8.4" /end CHARACTERISTIC
/begin CHARACTERISTIC FrmMng_facVLim_Slope_C "Steigung Umrechung SG->CAN für Höchstgeschwindigkeit" VALUE 0x1D78FE Kw_Ws16 7.999878 Fact -4.000000 3.999878 FORMAT "%8.6" /end CHARACTERISTIC
/begin CHARACTERISTIC FrmMng_volCubCap_C "Hubraum" VALUE 0x1D8018 Kw_Wu16 12.70000 Vol 0.00 12.70000 FORMAT "%8.5" EXTENDED_LIMITS 0.00 655.3500 /end CHARACTERISTIC
/begin CHARACTERISTIC FrmMng_volFlCons_Offset_C "Offset Umrechung SG->CAN für Kraftstoffverbrauch" VALUE 0x1D7EFE Kw_Ws16 65535.00 FlConsum_ul -32768.00 32767.00 FORMAT "%8.2" /end CHARACTERISTIC
/begin CHARACTERISTIC FrmMng_facVolFlCons_Slope_C "Steigung Umrechung SG->CAN für Kraftstoffverbrauch" VALUE 0x1D7F00 Kw_Ws16 7.999878 Fact -4.000000 3.999878 FORMAT "%8.6" /end CHARACTERISTIC
/begin CHARACTERISTIC FrmMng_volNormCyl_C "Normierter Kraftstoffverbrauch pro Zylinder" VALUE 0x1D7F06 Kw_Wu16 2550.000 VolPCyl 0.00 2550.000 FORMAT "%8.3" EXTENDED_LIMITS 0.00 65535.00 /end CHARACTERISTIC
/begin CHARACTERISTIC FrmMng_volTnk_Offset_C "Offset Umrechung SG->CAN für Volumen Tankfüllung" VALUE 0x1D7986 Kw_Ws16 32767.50 Fl_Half_L -16384.00 16383.50 FORMAT "%8.2" /end CHARACTERISTIC
/begin CHARACTERISTIC FrmMng_facVolTnk_Slope_C "Steigung Umrechung SG->CAN für Volumen Tankfüllung" VALUE 0x1D7988 Kw_Ws16 7.999878 Fact -4.000000 3.999878 FORMAT "%8.6" /end CHARACTERISTIC
/begin CHARACTERISTIC FrmMng_v_Offset_C "Offset Umrechung SG->CAN für Fahrgeschwindigkeit" VALUE 0x1D7874 Kw_Ws16 655.3500 Vel -327.6800 327.6700 FORMAT "%8.4" /end CHARACTERISTIC
/begin CHARACTERISTIC FrmMng_facV_Slope_C "Steigung Umrechung SG->CAN für Fahrgeschwindigkeit" VALUE 0x1D7876 Kw_Ws16 7.999878 Fact -4.000000 3.999878 FORMAT "%8.6" /end CHARACTERISTIC
/begin COMPU_METHOD Acc "Fahrzeugbeschleunigung" RAT_FUNC "%6.5" "[m/s^2]" COEFFS 0 1000 0 0 0 1 /end COMPU_METHOD
/begin COMPU_METHOD EngN "Motordrehzahl" RAT_FUNC "%6.2" "[rpm]" COEFFS 0 1 0 0 0 1 /end COMPU_METHOD
/begin COMPU_METHOD Fact "Faktor mit Auflösung 1 / 8192, hauptsächlich für einen Faktorenbereich 0...1 verwendet" RAT_FUNC "%6.5" "[-]" COEFFS 0 8192 0 0 0 1 /end COMPU_METHOD
/begin COMPU_METHOD Fact1 "Faktor mit Auflösung 0,01 (100 mal höherer Bereich als Fact)" RAT_FUNC "%6.4" "[-]" COEFFS 0 128 0 0 0 1 /end COMPU_METHOD
/begin COMPU_METHOD Fact_PrcBrk "Faktor mit Auflösung 0.00005%/bit  für CAN2INT oder INT2CAN" RAT_FUNC "%7.6" "[-]" COEFFS 0 20000 0 0 0 1 /end COMPU_METHOD
/begin COMPU_METHOD FlConsum_ul "Verbrauchsintegral (in Mikroliter)" RAT_FUNC "%6.2" "[ul]" COEFFS 0 1 0 0 0 1 /end COMPU_METHOD
/begin COMPU_METHOD Fl_Half_L "Kraftstoffverbrauchsintegral" RAT_FUNC "%6.3" "[l]" COEFFS 0 2 0 0 0 1 /end COMPU_METHOD
/begin COMPU_METHOD lambda "Lambda" RAT_FUNC "%6.5" "[-]" COEFFS 0 1000 0 0 0 1 /end COMPU_METHOD
/begin COMPU_METHOD OneToOne "eins zu eins (physikalischer Wert ist gleich dem internen Wert)" RAT_FUNC "%6.2" "[-]" COEFFS 0 1 0 0 0 1 /end COMPU_METHOD
/begin COMPU_METHOD Prc "Prozent, gleiche interne Auflösung wie Fact, aber Darstellung in Prozent (0...100%)" RAT_FUNC "%6.4" "[%]" COEFFS 0 100 0 0 0 1 /end COMPU_METHOD
/begin COMPU_METHOD PresAC_hPa "Druck (Klimatisierung) angezeigt in [hPa]" RAT_FUNC "%6.2" "[hPa]" COEFFS 0 0.5 0 0 0 1 /end COMPU_METHOD
/begin COMPU_METHOD Pres_hPa "Druck (angezeigt in [hPa])" RAT_FUNC "%6.2" "[hPa]" COEFFS 0 1 0 0 0 1 /end COMPU_METHOD
/begin COMPU_METHOD Pwr "Leistung" RAT_FUNC "%6.2" "[W]" COEFFS 0 0.10610329539459 0 0 0 1 /end COMPU_METHOD
/begin COMPU_METHOD Pwr_kW "Leistung in kW" RAT_FUNC "%6.4" "[kW]" COEFFS 0 100 0 0 0 1 /end COMPU_METHOD
/begin COMPU_METHOD RatVolLength "Umrechnungsformel für Liter/mm" RAT_FUNC "%6.5" "[l/mm]" COEFFS 0 8192 0 0 0 1 /end COMPU_METHOD
/begin COMPU_METHOD RmpAccCan "Rate of change of acceleration m/s2/s" RAT_FUNC "%6.4" "[m/s^2/s]" COEFFS 0 100 0 0 0 1 /end COMPU_METHOD
/begin COMPU_METHOD SigName "Verbale Umrechnung für Signal Referenz Nummern" TAB_VERB "%6.3" "[-]" COMPU_TAB_REF SigName /end COMPU_METHOD
/begin COMPU_VTAB SigName "Verbale Umrechnung für Signal Referenz Nummern" TAB_VERB 575 0 "Sig_unused" 4 "CoEng_rTrq__Carb_r_DLen1" 5 "CTSCD_tClntLin__Carb_t_DLen1" 11 "BPSCD_pLin__Carb_p_DLen1" 12 "Eng_nAvrg__Carb_n_DLen2" 13 "VSSCD_vCarb1__Carb_v_DLen1" 15 "IATSCD_tAirLin__Carb_t_DLen1" 16 "AFSCD_dmAirRawPerTime__Carb_mAirTim_DLen2" 17 "TVACD_rOut__Carb_r_DLen1" 28 "Signals_PID0x1C__OneToOne_DLen1" 29 "CARB_Mode1PID1D__OneToOne_DLen1" 31 "VehDa_tiCarbEngOn__OneToOne_DLen2" 33 "DSMDur_ctDfctDur1__Carb_l_DLen2" 44 "EGRCD_rOut__Carb_r_DLen1" 45 "EGRVlv_rGvnrDvtRel__Carb_rNeg_DLen1" 48 "DSM_ctWUC__OneToOne_DLen1" 49 "DSM_lDist__Carb_l_DLen2" 51 "APSCD_pSensorVal__Carb_p_DLen1" 60 "EGPpCD_tPreTrbn__Carb_tHighM1_DLen2" 62 "PFlt_tPre__Carb_tHighM1_DLen2" 65 "DSM_stPID41__LowByte_DLen4" 66 "BattCD_u__Carb_uBatt_DLen2" 69 "CARB_rRelThrVlvPos_PID45__Carb_r_DLen1" 70 "EATSCD_tAir__Carb_t_DLen1" 73 "CARB_rAPPCD_PID49__Carb_r_DLen1" 74 "CARB_rAPPCD_PID4A__Carb_r_DLen1" 76 "AirCtl_rTVA__Carb_r_DLen1" 79 "CARB_Mode1PID4F__LowByte_DLen4" 112 "CARB_LSU_rLmbd0__Carb_lr_DLen2" 113 "LSUCD_uO2Raw__Carb_u_DLen2" 114 "CARB_Mode1PID4FB__LowByte_DLen2" 115 "PFlt_tPst__Carb_tHighM1_DLen2" 116 "PFlt_tOxiPre__Carb_tHighM1_DLen2" 117 "PFlt_tOxiPst__Carb_tHighM1_DLen2" 118 "OxiCCD_tPre__Carb_tHighM1_DLen2" 119 "TVASCD_rNrm__Carb_r_DLen1" 120 "EGRVlv_rDesVal__Carb_r_DLen1" 122 "CARB_rNrmInvTVASCD__Carb_r_DLen1" 197 "Eng_nAvrg__n_DLen1" 198 "APPCD_stSwitchSig__OneToOne_DLen1" 199 "APPCD_uRawAPP1__u_DLen1" 200 "APPCD_uRawAPP2__u_DLen1" 201 "APPCD_rAPP1UnFlt__r_DLen1" 202 "BPSCD_uRawVal__u_DLen1" 203 "BPSCD_pOutVal__p_DLen1" 204 "APSCD_pVal__p_DLen1" 205 "APSCD_uRaw__u_DLen1" 206 "IATSCD_tAirLin__t_DLen1" 207 "IATSCD_uRaw__u_DLen1" 208 "FTSCD_tFuel__t_DLen1" 209 "CTSCD_uRaw__u_DLen1" 210 "CTSCD_tClnt__t_DLen1" 211 "OTSCD_tEngOil__t_DLen1" 212 "VSSCD_v__v_DLen1" 213 "AFSCD_dmAirRawPerTime__mAirTim_DLen1" 214 "AFSCD_uRaw__u_DLen1" 215 "AFSCD_dmAirPerTime__mAirTim_DLen1" 216 "BrkCD_stMnSwtRawVal__OneToOne_DLen1" 217 "BrkCD_stRedSwtRawVal__OneToOne_DLen1" 218 "ConvCD_stRawVal__OneToOne_DLen1" 219 "T15CD_stRawVal__OneToOne_DLen1" 220 "BattCD_uRaw__uBatt_DLen1" 221 "IndSys_rVSA__dcyc_DLen1" 222 "InjCtl_qCurr__q_DLen1" 223 "InjCtl_qSetUnBal__q_DLen1" 224 "BPACD_rOut__dcyc_DLen1" 225 "EGRCD_rOut__dcyc_DLen1" 226 "ACCtl_stLogicOut__OneToOne_DLen1" 227 "AOHt_stHt1Out__OneToOne_DLen1" 228 "GlwCtl_stLmpOut__OneToOne_DLen1" 229 "GlwCtl_stActrOut__OneToOne_DLen1" 230 "InjVlv_nCyl1__nCmpTst_DLen1" 231 "InjVlv_nCyl2__nCmpTst_DLen1" 232 "InjVlv_nCyl3__nCmpTst_DLen1" 233 "InjVlv_nCyl4__nCmpTst_DLen1" 234 "InjVlv_nCyl5__nCmpTst_DLen1" 235 "InjVlv_nCyl6__nCmpTst_DLen1" 236 "InjVlv_qFBCCyl1__q_DLen1" 237 "InjVlv_qFBCCyl2__q_DLen1" 238 "InjVlv_qFBCCyl3__q_DLen1" 239 "InjVlv_qFBCCyl4__q_DLen1" 240 "InjVlv_qFBCCyl5__q_DLen1" 241 "InjVlv_qFBCCyl6__q_DLen1" 242 "CaSCD_nPeriod__n_DLen1" 243 "FBC_qDvtCyl[0]__qdiff_DLen1" 244 "FBC_qDvtCyl[1]__qdiff_DLen1" 245 "FBC_qDvtCyl[2]__qdiff_DLen1" 246 "FBC_qDvtCyl[3]__qdiff_DLen1" 247 "FBC_qDvtCyl[4]__qdiff_DLen1" 248 "FBC_qDvtCyl[5]__qdiff_DLen1" 249 "FBC_qDvtCyl[6]__qdiff_DLen1" 250 "FBC_qDvtCyl[7]__qdiff_DLen1" 251 "FBC_qDvtCyl[8]__qdiff_DLen1" 252 "FBC_qDvtCyl[9]__qdiff_DLen1" 253 "InjCrv_phiMI1Des__phiHResol_DLen1" 254 "InjVlv_phiMI1DurCorr__phi_DLen1" 255 "PSP_stLogicOut__OneToOne_DLen1" 256 "ACCD_stMnSwtRawVal__OneToOne_DLen1" 257 "AOHt_stHt2Out__OneToOne_DLen1" 258 "AFSCD_mAirPerCyl__mAirCyl_DLen1" 259 "AFSCD_dmAirNorm__mAirTim_DLen1" 260 "AirCtl_mGovDev__mAirCylGov_DLen1" 261 "AirCtl_rEGR__r_DLen1" 262 "PCR_rBPACD__r_DLen1" 263 "Dfp_LSUCDCircNernst0_Low__OneToOne_DLen1" 264 "GlwCD_stRawVal__OneToOne_DLen1" 265 "APPCD_rFlt__r_DLen1" 266 "HWEMon_numRecovery__OneToOne_DLen1" 281 "DSM_stSysLamp__OneToOne_DLen1" 282 "DSM_stMIL__OneToOne_DLen1" 283 "BattCD_u__uBatt_DLen1" 284 "LIGov_nSetpoint__n_DLen1" 285 "VSSCD_a__a_DLen1" 286 "Tst_Zyklflag_SB5__OneToOne_DLen1" 287 "IATSCD_tAir__t_DLen1" 288 "AccPed_stPlaAPPBrk__OneToOne_DLen1" 289 "AccPed_trqDes__trqhigh_DLen1" 290 "COTSCD_tClnt__t_DLen1" 291 "AccPed_trqInrDesSig__trq_DLen1" 292 "Gearbx_stGear__OneToOne_DLen1" 293 "LSU_rLmbd[0]__rLmbd_DLen1" 294 "LSU_rLmbd[1]__rLmbd_DLen1" 295 "Tst_Zyklflag_SB1__OneToOne_DLen1" 296 "Tst_Zyklflag_SB2__OneToOne_DLen1" 297 "Tst_Zyklflag_SB3__OneToOne_DLen1" 298 "Tst_Zyklflag_SB4__OneToOne_DLen1" 299 "Tst_Zyklflag_SB6__OneToOne_DLen1" 300 "AirCtl_mDesVal__mAirCyl_DLen1" 301 "Tst_Zyklflag_SB7__OneToOne_DLen1" 302 "CtTCtl_tClntDes__t_DLen1" 303 "PCR_pBDes__p_DLen1" 304 "BPSCD_pFltVal__p_DLen1" 305 "FrmMng_lOil_mp__lLvl_DLen1" 306 "FlMng_stMon_mp__OneToOne_DLen1" 307 "FrmMng_stChrgr1Err1__OneToOne_DLen1" 308 "FrmMng_stChrgr1Err2__OneToOne_DLen1" 309 "FrmMng_stChrgr2Err1__OneToOne_DLen1" 310 "FrmMng_stChrgr2Err2__OneToOne_DLen1" 311 "FMTC_qStrt__q_DLen1" 312 "CrCtl_trqDes__trqhigh_DLen1" 313 "CoVM_trqInc__trqhigh_DLen1" 314 "CoEng_trqInrLim__trq_DLen1" 315 "FMTC_trqInrLimSmk__trq_DLen1" 316 "EngPrt_trqLim__trq_DLen1" 317 "CoVM_trqDec__trqhigh_DLen1" 318 "FlMng_qLimSmk__q_DLen1" 319 "CrCtl_vSetPointTrgt__v_DLen1" 320 "AltCD_rAltLoad__r_DLen1" 321 "CoEng_trqInrSet__trq_DLen1" 322 "CoEng_dvolFlConsum__Cnsmp_DLen1" 323 "AirCtl_stMonitor__OneToOne_DLen1" 324 "ACCtl_stLowByte_mp__OneToOne_DLen1" 325 "EngM_stSync__OneToOne_DLen1" 326 "NetMng_stCAN__LowByte_DLen1" 327 "LSUCD_resRiClb__res_DLen1" 328 "LSUCD_uO2Clb__u_DLen1" 329 "FrmMng_stTSC__LowByte_DLen1" 330 "FrmMng_stDCS__LowByte_DLen1" 331 "LSUCD_stAdpt__OneToOne_DLen1" 332 "LSUCD_uRiRaw__u_DLen1" 333 "LSUCD_mAirAftOvrrun__mAir_DLen1" 334 "GlwCtl_tiPst_mp__tiGlw_DLen1" 335 "PCR_stPCR_mp__LowByte_DLen1" 336 "AOHt_stShutOff_mp__LowByte_DLen1" 337 "FrmMng_stTCS__LowByte_DLen1" 338 "FrmMng_trqTSC__trq_DLen1" 339 "FrmMng_trqDCS__trqhigh_DLen1" 340 "CrCCD_stKeySig__OneToOne_DLen1" 341 "CrCtl_stKeyStateSig__OneToOne_DLen1" 342 "PrpCtl_vCurrTrack_mp__v_DLen1" 343 "CtApCD_rHWE_mp__dcyc_DLen1" 344 "Gearbx_trqDec__trq_DLen1" 345 "CrCtl_stShutOffrev__LowByte_DLen1" 346 "AirCtl_stAirCtl_mp__OneToOne_DLen1" 347 "DSM_stRdyAB__LowByte_DLen1" 348 "DSM_stRdyAB__HighByte_DLen1" 349 "DSM_stRdyCD__LowByte_DLen1" 350 "DSM_stRdyCD__HighByte_DLen1" 351 "PrpBrk_trqDes__trqhigh_DLen1" 352 "DSM_ctOBDPath__OneToOne_DLen1" 353 "DSM_ctRdyActCyc_mp__OneToOne_DLen1" 354 "GlwCtl_stLogic__LowByte_DLen1" 355 "GlwCtl_tiPre__tiGlw_DLen1" 356 "FMTC_trqInr__trq_DLen1" 357 "ACCtl_stBitStructure__HighByte_DLen1" 358 "AOHt_stShutOff_mp__HighByte_DLen1" 359 "FrmMng_stTSC__HighByte_DLen1" 360 "FrmMng_stDCS__HighByte_DLen1" 361 "FrmMng_stTCS__HighByte_DLen1" 362 "CrCtl_stSwitchSig__OneToOne_DLen1" 363 "EGSys_tEGLSU__tExhaust_DLen1" 364 "AOHt_NumRly_mp__OneToOne_DLen1" 365 "DSM_ctFcmEntry__OneToOne_DLen1" 368 "GlwCtl_stLogic__HighByte_DLen1" 369 "Dfp_HWEMonUMinSupply_Low__OneToOne_DLen1" 370 "Dfp_HWEMonUMaxSupply_Low__OneToOne_DLen1" 371 "PCR_rBalGvnrDiff__r_DLen1" 372 "Dfp_SOPTst_Low__OneToOne_DLen1" 373 "UAcc_SWPartNum_cs__OneToOne_DLen1" 374 "UAcc_ECUIdentEep_cs__OneToOne_DLen1" 375 "Gearbx_stTSC_mp__OneToOne_DLen1" 376 "CoVM_stActDem__OneToOne_DLen1" 377 "CrCCD_stKey__OneToOne_DLen1" 378 "CrCtl_stShutOff__OneToOne_DLen1" 379 "FanCtl_dcycFan1__dcyc_DLen1" 380 "FanCtl_dcycFan2__dcyc_DLen1" 381 "ACCD_p__pAC_DLen1" 382 "EngPrt_trqPrtLim__trq_DLen1" 383 "ImmCtl_tiLockCount__OneToOne_DLen1" 384 "UAcc_Vin_cs__OneToOne_DLen1" 385 "UAcc_dBGWVin_cs__OneToOne_DLen1" 386 "UAcc_SigBlk80_cs__OneToOne_DLen1" 387 "UAcc_SigBlk82_cs__OneToOne_DLen1" 388 "FlSys_stFlPp__OneToOne_DLen1" 389 "AOHtCD_volFlConsum__Cnsmp_DLen1" 390 "UAcc_MWB26sum_checksum_cs__OneToOne_DLen1" 391 "BPSCD_pLin__p_DLen1" 392 "CoEng_rTrq__r_DLen1" 393 "EngM_stEngMntCtl_MLS1__OneToOne_DLen1" 394 "EngM_stEngMntCtl_MLS2__OneToOne_DLen1" 395 "EngM_stEngMntCtl_GTL1__OneToOne_DLen1" 396 "EngM_stEngMntCtl_GTL2__OneToOne_DLen1" 397 "FanCD_rFan1HWE_mp__dcyc_DLen1" 398 "FanCD_rFan2HWE_mp__dcyc_DLen1" 399 "ACCD_trqCompr__trq_DLen1" 400 "TVACD_rOut__dcyc_DLen1" 401 "PFltCD_tPre__tExhaust_DLen1" 402 "PFltCD_pDiff__p_DLen1" 403 "EGPpCD_tPreTrbn__tExhaust_DLen1" 404 "AC_pwrDes__pwr_DLen1" 405 "Alt_pwrDes__pwr_DLen1" 406 "SrvPmp_pwrDes__pwr_DLen1" 407 "SvLp_dOilLoad__NoUnit_DLen1" 408 "SvLp_dSootLoad__NoUnit_DLen1" 409 "Dfp_LSUCDCircPumpCur0_Low__OneToOne_DLen1" 410 "Dfp_LSUCDCircVirtGnd0_Low__OneToOne_DLen1" 411 "Dfp_LSUCDHtCoup0_Low__OneToOne_DLen1" 412 "Dfp_LSUCDO20_Low__OneToOne_DLen1" 413 "Dfp_LSUCDHeater0_Low__OneToOne_DLen1" 414 "Dfp_LSUCDO2Clb0_Low__OneToOne_DLen1" 415 "Dfp_LSUCDRiClb0_Low__OneToOne_DLen1" 416 "Dfp_LSUCDSPI0_Low__OneToOne_DLen1" 417 "Dfp_LSUCDWireIP0_Low__OneToOne_DLen1" 418 "Dfp_LSUCtlRiExc0_Low__OneToOne_DLen1" 419 "Dfp_LSUMonFullLd_Low__LowByte_DLen1" 420 "Dfp_LSUMonPartLd_Low__LowByte_DLen1" 421 "Dfp_HWEMonEEPROM_Low__OneToOne_DLen1" 422 "Dfp_HWEMonCom_Low__OneToOne_DLen1" 423 "Ad_NumTyp_FreeApplic1_CSTR__FreeApplic1_DLen1" 424 "Ad_NumTyp_FreeApplic2_CSTR__FreeApplic2_DLen1" 425 "Ad_NumTyp_FreeApplic3_CSTR__FreeApplic3_DLen1" 426 "Ad_NumTyp_FreeApplic4_CSTR__FreeApplic4_DLen1" 427 "AFSCD_dmAirPerTimeB2__mAirTim_DLen1" 428 "AFSCD_mAirPerCylB1__mAirCyl_DLen1" 429 "AFSCD_mAirPerCylB2__mAirCyl_DLen1" 431 "BPACD_rOut2__dcyc_DLen1" 432 "AFSCD_dmAirPerTimeB1__mAirTim_DLen1" 468 "FrmMng_stNumTOOvrFlowECU[0]__OneToOne_DLen1" 469 "FrmMng_stNumTOOvrFlowECU[1]__OneToOne_DLen1" 470 "FrmMng_stNumTOOvrFlowECU[2]__OneToOne_DLen1" 471 "FrmMng_stNumTOOvrFlowECU[3]__OneToOne_DLen1" 472 "FrmMng_stNumTOOvrFlowECU[4]__OneToOne_DLen1" 473 "FrmMng_stNumTOOvrFlowECU[5]__OneToOne_DLen1" 474 "FrmMng_stNumTOOvrFlowECU[6]__OneToOne_DLen1" 475 "FrmMng_stNumTOOvrFlowECU[7]__OneToOne_DLen1" 476 "FrmMng_stNumTOOvrFlowECU[8]__OneToOne_DLen1" 477 "FrmMng_stNumTOOvrFlowECU[9]__OneToOne_DLen1" 478 "FrmMng_stNumTOOvrFlowECU[10]__OneToOne_DLen1" 479 "FrmMng_stNumTOOvrFlowECU[11]__OneToOne_DLen1" 480 "FrmMng_stNumTOOvrFlowECU[12]__OneToOne_DLen1" 481 "FrmMng_stNumTOOvrFlowECU[13]__OneToOne_DLen1" 482 "FrmMng_stNumTOOvrFlowECU[14]__OneToOne_DLen1" 483 "FrmMng_stNumTOOvrFlowECU[15]__OneToOne_DLen1" 484 "FrmMng_stNumTOOvrFlowECU[16]__OneToOne_DLen1" 485 "FrmMng_stNumTOOvrFlowECU[17]__OneToOne_DLen1" 486 "FrmMng_stNumTOOvrFlowECU[18]__OneToOne_DLen1" 487 "FrmMng_stNumTOOvrFlowECU[19]__OneToOne_DLen1" 488 "FrmMng_stNumTOOvrFlowECU[20]__OneToOne_DLen1" 489 "FrmMng_stNumTOOvrFlowECU[21]__OneToOne_DLen1" 490 "FrmMng_stNumTOOvrFlowECU[22]__OneToOne_DLen1" 491 "FrmMng_stNumTOOvrFlowECU[23]__OneToOne_DLen1" 492 "FrmMng_stNumTOOvrFlowECU[24]__OneToOne_DLen1" 493 "FrmMng_stNumTOOvrFlowECU[25]__OneToOne_DLen1" 494 "FrmMng_stNumTOOvrFlowECU[26]__OneToOne_DLen1" 495 "FrmMng_stNumTOOvrFlowECU[27]__OneToOne_DLen1" 496 "FrmMng_stNumTOOvrFlowECU[28]__OneToOne_DLen1" 497 "FrmMng_stNumTOOvrFlowECU[29]__OneToOne_DLen1" 498 "FrmMng_stNumTOOvrFlowECU[30]__OneToOne_DLen1" 499 "FrmMng_stNumTOOvrFlowECU[31]__OneToOne_DLen1" 526 "EGRVlv_rEGR__r_DLen1" 527 "EGRSCD_rRelPos__dcyc_DLen1" 532 "BPSCD_pIntVal__p_DLen1" 533 "EGRVlv_rDesVal__dcyc_DLen1" 535 "BPASCD_rRelPos__rNeg_DLen1" 536 "FMA_qRaw_mp__qNeg_DLen1" 538 "FMA_facSwtOff__Fact_DLen1" 601 "T50CD_stRxDebVal__OneToOne_DLen1" 602 "CoEng_stEng__OneToOne_DLen1" 603 "StSysCtl_stStrtCncl__LowByte_DLen1" 604 "PrpCtl_stSPTrack_mp__OneToOne_DLen1" 605 "ACCCD_stACC__OneToOne_DLen1" 606 "InjCrv_qLmbdCtl__q_DLen1" 607 "EGSys_stHtgLSU__OneToOne_DLen1" 608 "LSUCD_dcycHtCor__dcyc_DLen1" 609 "EGSys_pExhGas__p_DLen1" 610 "EGSys_dmEG__mAirTim_DLen1" 611 "LSUCD_drO2Adpt__O2diff_DLen1" 612 "LSUCD_stCircModeNewLow__OneToOne_DLen1" 613 "LSU_stPlausChk__OneToOne_DLen1" 614 "LSU_stO2Err__LowByte_DLen1" 615 "PFlt_pPre__p_DLen1" 616 "PFlt_pDiff__pPFlt_DLen1" 617 "PFlt_tPre__tExhaust_DLen1" 623 "PFlt_pDiffOfsValAct_mp__pPFlt_DLen1" 624 "PFlt_qFl_mp__q_DLen1" 625 "PFlt_tiSnceRgn_mp__ti_DLen1" 626 "PFlt_lSnceRgn_mp__l_DLen1" 627 "PFlt_stCntRes__OneToOne_DLen1" 628 "PFlt_numEngPOp_mp__OneToOne_DLen1" 629 "FMA_qIC__qdiff_DLen1" 630 "FMA_stSwtOff__LowByte_DLen1" 631 "EEPCD_stErrSet__OneToOne_DLen1" 632 "EEPCD_stOptErrCodSet__OneToOne_DLen1" 633 "CtTCtl_dcycThst__dcyc_DLen1" 634 "CtTCtl_stCtl__OneToOne_DLen1" 635 "EATSCD_tAir__t_DLen1" 636 "HDSCD_prcAir__r_DLen1" 638 "LSUCD_uO2Raw__u_DLen1" 639 "LSUCD_rO2Adpt__r_DLen1" 640 "PFlt_pDiffOfsValOld_mp__pPFlt_DLen1" 643 "ConvCD_stIlsDebVal__OneToOne_DLen1" 644 "StSysCtl_stT50CDOn__OneToOne_DLen1" 645 "StSysCtl_stT50CDOff__OneToOne_DLen1" 646 "T50CD_stDebVal__OneToOne_DLen1" 653 "AirCtl_mMaxDev_mp__mAirCylGov_DLen1" 654 "AirCtl_mMinDev_mp__mAirCylGov_DLen1" 655 "AirCtl_stDebDef__OneToOne_DLen1" 656 "AFSCD_stPlSetyDrft_mp__LowByte_DLen1" 657 "AFSCD_rAirNorm__Fact_DLen1" 658 "NetMng_stCAN__HighByte_DLen1" 659 "NetMng_stCAN__Byte2_DLen1" 660 "NetMng_stCAN__Byte3_DLen1" 661 "PCR_stPCR_mp__HighByte_DLen1" 662 "CrCtl_stShutOffrev__HighByte_DLen1" 663 "CrCtl_stShutOffrev__Byte2_DLen1" 664 "CrCtl_stShutOffrev__Byte3_DLen1" 665 "LSU_stO2Err__HighByte_DLen1" 666 "FMA_stSwtOff__HighByte_DLen1" 667 "AFSCD_stPlSetyDrft_mp__HighByte_DLen1" 671 "CARB_TstNotUsedMaxU__LowByte_DLen2" 672 "CARB_TstNotUsedMinU__LowByte_DLen2" 673 "CARB_TstNotUsedMaxS__LowByte_DLen2" 674 "CARB_TstNotUsedMinS__LowByte_DLen2" 675 "CARB_TstNotUsedTrue__LowByte_DLen2" 676 "CARB_TstNotUsedFalse__LowByte_DLen2" 681 "CoEng_dvolFlConsAllTot__Cnsmp_DLen1" 682 "EGT_st__Byte3_DLen1" 683 "EGT_st__Byte2_DLen1" 684 "EGT_st__HighByte_DLen1" 685 "EGT_st__LowByte_DLen1" 687 "LSUCD_stO2Valid__LowByte_DLen1" 688 "AirCtl_stEGRClgBypVlv__LowByte_DLen1" 689 "FQlSCD_rFlQlLin__ratio_DLen1" 690 "GlwCD_stLampOut__LowByte_DLen1" 691 "GlwCD_stOutHWE_mp__LowByte_DLen1" 692 "GlwCD_rGSK__dcyc_DLen1" 693 "FlPpCD_stFlPp__LowByte_DLen1" 694 "AFVCD_stActrOut__LowByte_DLen1" 695 "FrmMng_prcFan__dcyc_DLen1" 696 "EGPpCD_tLinPreTrbn__tExhaust_DLen1" 697 "EngPrt_facPrtLimCorr__Fact_DLen1" 698 "EngPrt_tPreTrbn__t_DLen1" 699 "FrmMng_trqFrcCan__trq_DLen1" 700 "CoVeh_trqAcs__trq_DLen1" 701 "CoEng_trqMin__trq_DLen1" 702 "BPSCD_pAvgDiff__pDiff_DLen1" 703 "IndSys_pAdj__pDiff_DLen1" 704 "BPSCD_ctAvg__OneToOne_DLen1" 705 "CtT_stCondMon__LowByte_DLen1" 706 "CtT_tAir__t_DLen1" 707 "SvLp_dOilLoadWIV2__NoUnitII_DLen1" 708 "SvLp_dSootLoadWIV2__NoUnitII_DLen1" 709 "CARB_stRdyCurrABCD__LowByte_DLen1" 710 "CARB_stRdyCurrABCD__HighByte_DLen1" 711 "CARB_stRdyCurrABCD__Byte2_DLen1" 712 "CARB_stRdyCurrABCD__Byte3_DLen1" 713 "CtT_stCondMon__HighByte_DLen1" 714 "CoEng_ctUnpla__OneToOne_DLen1" 716 "SvLpCD_ltmpMin2__lLvl2_DLen1" 717 "FanCtl_prcAddReq__r_DLen1" 718 "Dfp_LSUMonOvrRun_Low__LowByte_DLen1" 719 "Dfp_LSUMonDyn_Low__LowByte_DLen1" 720 "APPCD_rRawAPP1__r_DLen1" 721 "APPCD_rRawAPP2__r_DLen1" 722 "APPCD_rKDThres__r_DLen1" 727 "Shtrp_ctRemain__OneToOne_DLen1" 728 "Shtrp_numCurrTst__OneToOne_DLen1" 729 "CrCtl_stShutOffrevSig__LowByte_DLen1" 730 "CrCtl_stShutOffirevSig__LowByte_DLen1" 731 "ACCCD_trqDes__trqhigh_DLen1" 732 "ACC_trqDes__trqhigh_DLen1" 733 "ACC_trqBrk__trqhigh_DLen1" 734 "ACCCD_stACC__OneToOne_DLen1__2" 735 "ACCCD_stBrkErr_mp__OneToOne_DLen1" 736 "ACCCD_stSensErr_mp__OneToOne_DLen1" 737 "ACC_stState__OneToOne_DLen1" 738 "ACCCD_aDes__a_DLen1" 739 "ACCCD_phiRoad__phi2_DLen1" 740 "ACC_rBrkDes__r_DLen1" 748 "TVASCD_rRelPos__dcyc_DLen1" 750 "ThrVlv_rDesVal__dcyc_DLen1" 751 "ThrVlv_stMon__LowByte_DLen1" 752 "ThrVlv_stMon__HighByte_DLen1" 753 "ThrVlv_rTVA__dcyc_DLen1" 755 "StSysCtl_stStrtCncl_mp__LowByte_DLen1" 756 "StSysCtl_stStrtCncl_mp__HighByte_DLen1" 757 "FrmMng_rChrgr1Actr__dcyc_DLen1" 758 "FrmMng_tChrgr1ASIC__tExhaust_DLen1" 759 "FrmMng_rChrgr2Actr__dcyc_DLen1" 760 "FrmMng_tChrgr2ASIC__tExhaust_DLen1" 761 "Shtrp_ActFreeTstTog__OneToOne_DLen1" 762 "PFlt_tSimPstPFlt_mp__tExhaust_DLen1" 763 "FrmMng_volFuelFil__volLiter_DLen1" 764 "CtT_tClntMod__t_DLen1" 765 "InjCrv_stT3Dia_mp__LowByte_DLen1" 766 "InjCrv_stT3Dia_mp__HighByte_DLen1" 767 "InjCrv_ctT3DiaMin_mp__OneToOne_DLen1" 768 "InjCrv_tT3DiaMin_mp__tExhaust_DLen1" 769 "EGRCD_stCBVOutHWE_mp__LowByte_DLen1" 770 "FlClgCD_stFlClg__LowByte_DLen1" 771 "DIUMPR_ctIgn_mp__ct_DLen1" 772 "DIUMPR_ctGenDenom_mp__ct_DLen1" 773 "TVASCD_rDrftOpn_mp__dcycNeghighres_DLen1" 774 "TVASCD_rDrftCls_mp__dcycNeghighres_DLen1" 775 "WDASCD_stWntrSwtVal__LowByte_DLen1" 776 "WDASCD_stWntrLogVal_mp__LowByte_DLen1" 777 "PFlt_stRlsPlausTemp__OneToOne_DLen1" 778 "PFlt_stRlsPlausTempPrePFlt__OneToOne_DLen1" 779 "PFlt_stRlsPlausTempPreOxiC__OneToOne_DLen1" 780 "PFlt_stRlsPlausTempPreTrbn__OneToOne_DLen1" 781 "PFlt_stRlsPlausTempPstPFlt__OneToOne_DLen1" 1000 "BIP_tiDvtFltMI1[1]__tius_DLen1" 1001 "BIP_tiDvtFltMI1[2]__tius_DLen1" 1002 "BIP_tiDvtFltMI1[3]__tius_DLen1" 1003 "BIP_tiDvtFltMI1[4]__tius_DLen1" 1004 "BIP_tiDvtFltMI1[5]__tius_DLen1" 1005 "BIP_tiDvtFltMI1[6]__tius_DLen1" 1006 "BIP_tiDvtFltMI1[7]__tius_DLen1" 1007 "BIP_tiDvtFltMI1[8]__tius_DLen1" 1008 "BIP_tiDvtFltMI1[9]__tius_DLen1" 1009 "BIP_tiDvtFltMI1[10]__tius_DLen1" 1010 "BIPCD_stBIPDetMI1[1]__OneToOne_DLen1" 1011 "BIPCD_stBIPDetMI1[2]__OneToOne_DLen1" 1012 "BIPCD_stBIPDetMI1[3]__OneToOne_DLen1" 1013 "BIPCD_stBIPDetMI1[4]__OneToOne_DLen1" 1014 "BIPCD_stBIPDetMI1[5]__OneToOne_DLen1" 1015 "BIPCD_stBIPDetMI1[6]__OneToOne_DLen1" 1016 "BIPCD_stBIPDetMI1[7]__OneToOne_DLen1" 1017 "BIPCD_stBIPDetMI1[8]__OneToOne_DLen1" 1018 "BIPCD_stBIPDetMI1[9]__OneToOne_DLen1" 1019 "BIPCD_stBIPDetMI1[10]__OneToOne_DLen1" 1020 "EngM_phiCaSOfsCorr__phi_DLen1" 1021 "InjVCD_stInjVlv_mp__OneToOne_DLen1" 1022 "AFSCD_rAirThrHiPlHi_mp__Fact_DLen1" 1023 "AFSCD_rAirThrLoPlLo_mp__Fact_DLen1" 1024 "InjCrv_qPoI2Des__q_DLen1" 1025 "InjCrv_phiPoI2Des__phiHResol_DLen1" 1026 "InjVlv_phiPoI2Dur__phi_DLen1" 1027 "InjVlv_phiPiI1DurCorr__phi_DLen1" 1028 "InjCrv_qPiI1Des__q_DLen1" 1029 "InjCrv_phiPiI1Des__phiHResol_DLen1" 1030 "InjCrv_qPoI2LmbdOfs__q_DLen1" 1031 "PFlt_tiSumRgnMaxTmr__tisecond_DLen1" 1032 "PFlt_rAshLdLrn_mp__r_DLen1" 1033 "PFlt_rSotSimPres__r_DLen1" 1034 "PFlt_lSum_mp__l_DLen1" 1035 "PFlt_ctRgnLck__LowByte_DLen1" 1036 "PFlt_stCntRes__LowByte_DLen1" 1037 "PFlt_tiOp_mp__tiHour_DLen1" 1038 "IndSys_swtVacMonOn__OneToOne_DLen1" 1044 "BPASCD_rLinRelPos__r_DLen1" 1045 "VSACD_rOut__rNeg_DLen1" 1046 "BIPCD_stBIPDetPiI1[1]__OneToOne_DLen1" 1047 "BIPCD_stBIPDetPiI1[2]__OneToOne_DLen1" 1048 "BIPCD_stBIPDetPiI1[3]__OneToOne_DLen1" 1049 "BIPCD_stBIPDetPiI1[4]__OneToOne_DLen1" 1050 "BIPCD_stBIPDetPiI1[5]__OneToOne_DLen1" 1051 "BIPCD_stBIPDetPiI1[6]__OneToOne_DLen1" 1052 "BIPCD_stBIPDetPiI1[7]__OneToOne_DLen1" 1053 "BIPCD_stBIPDetPiI1[8]__OneToOne_DLen1" 1054 "BIPCD_stBIPDetPiI1[9]__OneToOne_DLen1" 1055 "BIPCD_stBIPDetPiI1[10]__OneToOne_DLen1" 1056 "BIPCD_stBIPDetPoI2[1]__OneToOne_DLen1" 1057 "BIPCD_stBIPDetPoI2[2]__OneToOne_DLen1" 1058 "BIPCD_stBIPDetPoI2[3]__OneToOne_DLen1" 1059 "BIPCD_stBIPDetPoI2[4]__OneToOne_DLen1" 1060 "BIPCD_stBIPDetPoI2[5]__OneToOne_DLen1" 1061 "BIPCD_stBIPDetPoI2[6]__OneToOne_DLen1" 1062 "BIPCD_stBIPDetPoI2[7]__OneToOne_DLen1" 1063 "BIPCD_stBIPDetPoI2[8]__OneToOne_DLen1" 1064 "BIPCD_stBIPDetPoI2[9]__OneToOne_DLen1" 1065 "BIPCD_stBIPDetPoI2[10]__OneToOne_DLen1" 1066 "BIP_tiDvtFltPiI1[1]__tius_DLen1" 1067 "BIP_tiDvtFltPiI1[2]__tius_DLen1" 1068 "BIP_tiDvtFltPiI1[3]__tius_DLen1" 1069 "BIP_tiDvtFltPiI1[4]__tius_DLen1" 1070 "BIP_tiDvtFltPiI1[5]__tius_DLen1" 1071 "BIP_tiDvtFltPiI1[6]__tius_DLen1" 1072 "BIP_tiDvtFltPiI1[7]__tius_DLen1" 1073 "BIP_tiDvtFltPiI1[8]__tius_DLen1" 1074 "BIP_tiDvtFltPiI1[9]__tius_DLen1" 1075 "BIP_tiDvtFltPiI1[10]__tius_DLen1" 1076 "BIP_tiDvtFltPoI2[1]__tius_DLen1" 1077 "BIP_tiDvtFltPoI2[2]__tius_DLen1" 1078 "BIP_tiDvtFltPoI2[3]__tius_DLen1" 1079 "BIP_tiDvtFltPoI2[4]__tius_DLen1" 1080 "BIP_tiDvtFltPoI2[5]__tius_DLen1" 1081 "BIP_tiDvtFltPoI2[6]__tius_DLen1" 1082 "BIP_tiDvtFltPoI2[7]__tius_DLen1" 1083 "BIP_tiDvtFltPoI2[8]__tius_DLen1" 1084 "BIP_tiDvtFltPoI2[9]__tius_DLen1" 1085 "BIP_tiDvtFltPoI2[10]__tius_DLen1" 1086 "PFlt_tFlt__tExhaust_DLen1" 1087 "PFlt_mAshTrmTot__mAsh_DLen1" 1089 "PFlt_rSotRatFlt_mp__r_DLen1" 1091 "PFlt_stCntRes__OneToOne_DLen1__2" 1092 "AddPCD_numStrkRem_mp__stroke_DLen1" 1093 "AddPmp_volAddTotDia_mp__vol_DLen1" 1094 "AddPmp_volAddDia_mp__volHigh_DLen1" 1095 "AddPmp_rAdd_mp__MLperL_DLen1" 1096 "EGRSCD_rOfsLrnLst__dcycNeg_DLen1" 1097 "EGRSCD_stAdapt__LowByte_DLen1" 1098 "BPASCD_rOfs__dcycNeg_DLen1" 1099 "BPASCD_stOfs__LowByte_DLen1" 1100 "FlSCD_volTotal__volLiter_DLen1" 1101 "UAcc_sigEnvDat[0]__LowByte_DLen1" 1102 "UAcc_sigEnvDat[1]__LowByte_DLen1" 1103 "UAcc_sigEnvDat[2]__LowByte_DLen1" 1104 "UAcc_sigEnvDat[3]__LowByte_DLen1" 1105 "UAcc_sigEnvDat[4]__LowByte_DLen1" 1106 "UAcc_sigEnvDat[5]__LowByte_DLen1" 1107 "UAcc_sigEnvDat[6]__LowByte_DLen1" 1108 "PFlt_tPst__tExhaust_DLen1" 1109 "GlwCD_rGSK__r_DLen1" 1110 "AddPCD_uTnkLvlRawVal__u_DLen1" 1111 "InjCrv_stPoI2LmbdT3Ctl__LowByte_DLen1" 1112 "PFlt_tSimPreTrbn_mp__tExhaust_DLen1" 1113 "PFlt_tSimPrePFlt_mp__tExhaust_DLen1" 1114 "DIUMPR_rMBGrp[0]__rDIUMPR_DLen1" 1115 "DIUMPR_rMBGrp[1]__rDIUMPR_DLen1" 1116 "DIUMPR_rMBGrp[2]__rDIUMPR_DLen1" 1117 "DIUMPR_rMBGrp[3]__rDIUMPR_DLen1" 1118 "DIUMPR_rMBGrp[4]__rDIUMPR_DLen1" 1119 "DIUMPR_rMBGrp[5]__rDIUMPR_DLen1" 1120 "DIUMPR_rMBGrp[6]__rDIUMPR_DLen1" 1121 "DIUMPR_rMBGrp[7]__rDIUMPR_DLen1" 1122 "DIUMPR_rMBGrp[8]__rDIUMPR_DLen1" 1123 "DIUMPR_rMBGrp[9]__rDIUMPR_DLen1" 1124 "DIUMPR_rMBGrp[10]__rDIUMPR_DLen1" 1125 "DIUMPR_rMBGrp[11]__rDIUMPR_DLen1" 1126 "DIUMPR_rMBGrp[12]__rDIUMPR_DLen1" 1127 "DIUMPR_rMBGrp[13]__rDIUMPR_DLen1" 1128 "DIUMPR_rMBGrp[14]__rDIUMPR_DLen1" 1129 "PFlt_dvol__dvol_DLen1" 1130 "PFlt_pDiffMinSty_mp__pPFlt_DLen1" 1131 "PFltCD_tPst__tExhaust_DLen1" 1132 "InjCrv_stPoI2LmbdT3Ctl__LowByte_DLen1__2" 1133 "InjCrv_tT3DiaPreNomFlt_mp__tExhaust_DLen1" 1134 "EGRSCD_rTmpOfs__dcycNeghighres_DLen1" 1147 "PFlt_rSotSimMax__r_DLen1" 1148 "EGSys_tOxiCatBrik[0]__tExhaust_DLen1" 1149 "EGSys_tOxiCatBrik[1]__tExhaust_DLen1" 1150 "PFlt_rSotSimTemp__r_DLen1" 1151 "PFlt_facArrhThm_mp__facArrh_DLen1" 1152 "PFlt_mSotSimTemp__mSot_DLen1" /end COMPU_VTAB
/begin COMPU_METHOD Temp_Cels "Temperatur dargestellt in °C (gleiche interne Darstellung wie Temp_Kelv)" RAT_FUNC "%6.1" "[deg C]" COEFFS 0 10 2731.4 0 0 1 /end COMPU_METHOD
/begin COMPU_METHOD TimeCAN_TO_ms "Umrechnung von einer Inputzeit (ms) in eine Nummer" RAT_FUNC "%6.1" "[ms]" COEFFS 0 0.05 -1 0 0 1 /end COMPU_METHOD
/begin COMPU_METHOD TimeDeb "Entprellzeit in Millisekunden für Libraryfunktion Debounce" RAT_FUNC "%6.1" "[ms]" COEFFS 0 0.1 0 0 0 1 /end COMPU_METHOD
/begin COMPU_METHOD TimeDelay_s "Zeitkonstante T1 (in s) für PT1, DT1, etc." RAT_FUNC "%9.3" "[s]" COEFFS 0 0 1 0 0.00023283064365387 0 /end COMPU_METHOD
/begin COMPU_METHOD Time_ms "Zeit in ms für Fehlerentprellung (DSM) und SW-Timer" RAT_FUNC "%6.1" "[ms]" COEFFS 0 0.1 0 0 0 1 /end COMPU_METHOD
/begin COMPU_METHOD Time_s "Zeit in s für Fehlerentprellung (DSM) und SW-Timer" RAT_FUNC "%6.4" "[s]" COEFFS 0 100 0 0 0 1 /end COMPU_METHOD
/begin COMPU_METHOD TrnvrsAcc "Umrechnung für Querbeschleunigung" RAT_FUNC "%6.4" "[g]" COEFFS 0 100 0 0 0 1 /end COMPU_METHOD
/begin COMPU_METHOD Trq "Motormoment" RAT_FUNC "%6.3" "[Nm]" COEFFS 0 10 0 0 0 1 /end COMPU_METHOD
/begin COMPU_METHOD TrqPerSec "Motormomentengradient" RAT_FUNC "%6.2" "[Nm/s]" COEFFS 0 1 0 0 0 1 /end COMPU_METHOD
/begin COMPU_METHOD Vel "Fahrzeuggeschwindigkeit, gleiche interne Auflösung wie Vel_SI" RAT_FUNC "%6.4" "[km/h]" COEFFS 0 100 0 0 0 1 /end COMPU_METHOD
/begin COMPU_METHOD Vol "Volumen" RAT_FUNC "%6.4" "[l]" COEFFS 0 100 0 0 0 1 /end COMPU_METHOD
/begin COMPU_METHOD VolPCyl "Umrechnung für Liter pro Zylinder" RAT_FUNC "%6.2" "[l/Cyl]" COEFFS 0 1 0 0 0 1 /end COMPU_METHOD
/begin RECORD_LAYOUT Kf_Xs16_Ys16_Ws16 NO_AXIS_PTS_X 1 SWORD NO_AXIS_PTS_Y 2 SWORD AXIS_PTS_X 3 SWORD INDEX_INCR DIRECT AXIS_PTS_Y 4 SWORD INDEX_INCR DIRECT FNC_VALUES 5 SWORD COLUMN_DIR DIRECT /end RECORD_LAYOUT
/begin RECORD_LAYOUT Kwb_Ws16 FNC_VALUES 1 SWORD COLUMN_DIR DIRECT /end RECORD_LAYOUT
/begin RECORD_LAYOUT Kwb_Ws32 FNC_VALUES 1 SLONG COLUMN_DIR DIRECT /end RECORD_LAYOUT
/begin RECORD_LAYOUT Kwb_Wu16 FNC_VALUES 1 UWORD COLUMN_DIR DIRECT /end RECORD_LAYOUT
/begin RECORD_LAYOUT Kwb_Wu8 FNC_VALUES 1 UBYTE COLUMN_DIR DIRECT /end RECORD_LAYOUT
/begin RECORD_LAYOUT Kw_Ws16 FNC_VALUES 1 SWORD COLUMN_DIR DIRECT /end RECORD_LAYOUT
/begin RECORD_LAYOUT Kw_Ws32 FNC_VALUES 1 SLONG COLUMN_DIR DIRECT /end RECORD_LAYOUT
/begin RECORD_LAYOUT Kw_Wu16 FNC_VALUES 1 UWORD COLUMN_DIR DIRECT /end RECORD_LAYOUT
/begin RECORD_LAYOUT Kw_Wu32 FNC_VALUES 1 ULONG COLUMN_DIR DIRECT /end RECORD_LAYOUT
/begin RECORD_LAYOUT Kw_Wu8 FNC_VALUES 1 UBYTE COLUMN_DIR DIRECT /end RECORD_LAYOUT
/begin FUNCTION FrmMng_Co "CAN Message Frames für Übertragung und Empfang"
 /begin DEF_CHARACTERISTIC FrmMng_AC1IDType_C FrmMng_AC1IntrEna_C FrmMng_AC1Mul_C FrmMng_AC1NumCAN_C FrmMng_AC1NumMsgPos_C FrmMng_AC1OpMode_C FrmMng_AC1SchedMode_C FrmMng_AC1Sched_C FrmMng_AC1Strt_C FrmMng_AC1TOTmp_C FrmMng_ACC1IntrEna_C FrmMng_ACC1Mul_C FrmMng_ACC1NumCAN_C FrmMng_ACC1NumMsgPos_C FrmMng_ACC1OpMode_C FrmMng_ACC1TOTmp_C FrmMng_ACCAIntrEna_C FrmMng_ACCAMul_C FrmMng_ACCANumCAN_C FrmMng_ACCANumMsgPos_C FrmMng_ACCAOpMode_C FrmMng_ACCASchedMode_C FrmMng_ACCASched_C FrmMng_ACCAStrt_C FrmMng_ACCATOTmp_C FrmMng_ACCSysIntrEna_C FrmMng_ACCSysMul_C FrmMng_ACCSysNumCAN_C FrmMng_ACCSysNumMsgPos_C FrmMng_ACCSysOpMode_C FrmMng_ACCSystemSchedMode_C FrmMng_ACCSystemSched_C FrmMng_ACCSystemStrt_C FrmMng_ACCSystemTOTmp_C FrmMng_AIRBG1IDType_C FrmMng_AIRBG1IntrEna_C FrmMng_AIRBG1Mul_C FrmMng_AIRBG1NumCAN_C FrmMng_AIRBG1NumMsgPos_C FrmMng_AIRBG1OpMode_C FrmMng_AIRBG1SchedMode_C FrmMng_AIRBG1Sched_C FrmMng_AIRBG1Strt_C FrmMng_AIRBG1TOTmp_C FrmMng_AWD1IDType_C FrmMng_AWD1IntrEna_C FrmMng_AWD1Mul_C FrmMng_AWD1NumCAN_C FrmMng_AWD1NumMsgPos_C FrmMng_AWD1OpMode_C FrmMng_AWD1SchedMode_C FrmMng_AWD1Sched_C FrmMng_AWD1Strt_C FrmMng_AWD1TOTmp_C FrmMng_BEM1IDType_C FrmMng_BEM1IntrEna_C FrmMng_BEM1Mul_C FrmMng_BEM1NumCAN_C FrmMng_BEM1NumMsgPos_C FrmMng_BEM1OpMode_C FrmMng_BEM1SchedMode_C FrmMng_BEM1Sched_C FrmMng_BEM1Strt_C FrmMng_BEM1TOTmp_C FrmMng_BRK1IDType_C FrmMng_BRK1IntrEna_C FrmMng_BRK1Mul_C FrmMng_BRK1NumCAN_C FrmMng_BRK1NumMsgPos_C FrmMng_BRK1OpMode_C FrmMng_BRK1SchedMode_C FrmMng_BRK1Sched_C FrmMng_BRK1Strt_C FrmMng_BRK1TOTmp_C FrmMng_BRK2IDType_C FrmMng_BRK2IntrEna_C FrmMng_BRK2Mul_C FrmMng_BRK2NumCAN_C FrmMng_BRK2NumMsgPos_C FrmMng_BRK2OpMode_C FrmMng_BRK2SchedMode_C FrmMng_BRK2Sched_C FrmMng_BRK2Strt_C FrmMng_BRK2TOTmp_C FrmMng_BRK8IDType_C FrmMng_BRK8IntrEna_C FrmMng_BRK8Mul_C FrmMng_BRK8NumCAN_C FrmMng_BRK8NumMsgPos_C FrmMng_BRK8OpMode_C FrmMng_BRK8SchedMode_C FrmMng_BRK8Sched_C FrmMng_BRK8Strt_C FrmMng_BRK8TOTmp_C FrmMng_BRK_ENABLEMASK_C FrmMng_BUF1IDType_C FrmMng_BUF1IntrEna_C FrmMng_BUF1MsgID_C FrmMng_BUF1Mul_C FrmMng_BUF1NumCAN_C FrmMng_BUF1NumMsgPos_C FrmMng_BUF1OpMode_C FrmMng_CCTLIDType_C FrmMng_CCTLIntrEna_C FrmMng_CCTLMul_C FrmMng_CCTLNumCAN_C FrmMng_CCTLNumMsgPos_C FrmMng_CCTLOpMode_C FrmMng_CCTLSchedMode_C FrmMng_CCTLSched_C FrmMng_CCTLStrt_C FrmMng_CCTLTOTmp_C FrmMng_CHRGR1IDType_C FrmMng_CHRGR1IntrEna_C FrmMng_CHRGR1Mul_C FrmMng_CHRGR1NumCAN_C FrmMng_CHRGR1NumMsgPos_C FrmMng_CHRGR1OpMode_C FrmMng_CHRGR1SchedMode_C FrmMng_CHRGR1Sched_C FrmMng_CHRGR1Strt_C FrmMng_CHRGR1TOTmp_C FrmMng_CHRGR2IDType_C FrmMng_CHRGR2IntrEna_C FrmMng_CHRGR2Mul_C FrmMng_CHRGR2NumCAN_C FrmMng_CHRGR2NumMsgPos_C FrmMng_CHRGR2OpMode_C FrmMng_CHRGR2SchedMode_C FrmMng_CHRGR2Sched_C FrmMng_CHRGR2Strt_C FrmMng_CHRGR2TOTmp_C FrmMng_DIA1IDType_C FrmMng_DIA1IntrEna_C FrmMng_DIA1Mul_C FrmMng_DIA1NumCAN_C FrmMng_DIA1NumMsgPos_C FrmMng_DIA1OpMode_C FrmMng_DIA1SchedMode_C FrmMng_DIA1Sched_C FrmMng_DIA1Strt_C FrmMng_DIA1TOTmp_C FrmMng_DSP1IDType_C FrmMng_DSP1IntrEna_C FrmMng_DSP1Mul_C FrmMng_DSP1NumCAN_C FrmMng_DSP1NumMsgPos_C FrmMng_DSP1OpMode_C FrmMng_DSP1SchedMode_C FrmMng_DSP1Sched_C FrmMng_DSP1Strt_C FrmMng_DSP1TOTmp_C FrmMng_DSP2IDType_C FrmMng_DSP2IntrEna_C FrmMng_DSP2Mul_C FrmMng_DSP2NumCAN_C FrmMng_DSP2NumMsgPos_C FrmMng_DSP2OpMode_C FrmMng_DSP2SchedMode_C FrmMng_DSP2Sched_C FrmMng_DSP2Strt_C FrmMng_DSP2TOTmp_C FrmMng_DebAC1TODef_C FrmMng_DebAC1TOOk_C FrmMng_DebACCCSDef_C FrmMng_DebACCCSOk_C FrmMng_DebACCTODef_C FrmMng_DebACCTOOk_C FrmMng_DebAIRBGCSDef_C FrmMng_DebAIRBGCSOk_C FrmMng_DebAIRBGTODef_C FrmMng_DebAIRBGTOOk_C FrmMng_DebBRK1TODef_C FrmMng_DebBRK1TOOk_C FrmMng_DebBRK2TODef_C FrmMng_DebBRK2TOOk_C FrmMng_DebBSG3TODef_C FrmMng_DebBSG3TOOk_C FrmMng_DebCCTLCSDef_C FrmMng_DebCCTLCSOk_C FrmMng_DebCCTLTODef_C FrmMng_DebCCTLTOOk_C FrmMng_DebDSP1TODef_C FrmMng_DebDSP1TOOk_C FrmMng_DebDSP2TODef_C FrmMng_DebDSP2TOOk_C FrmMng_DebESCUTODef_C FrmMng_DebESCUTOOk_C FrmMng_DebLICHT2TODef_C FrmMng_DebLICHT2TOOk_C FrmMng_DebStIgnTODef_C FrmMng_DebStIgnTOOk_C FrmMng_DebTSC1TODef_C FrmMng_DebTSC1TOOk_C FrmMng_DebTSC2TODef_C FrmMng_DebTSC2TOOk_C FrmMng_DebTSC3TODef_C FrmMng_DebTSC3TOOk_C FrmMng_DebWIPERTODef_C FrmMng_DebWIPERTOOk_C FrmMng_ENG1IDType_C FrmMng_ENG1IntrEna_C FrmMng_ENG1Mul_C FrmMng_ENG1NumCAN_C FrmMng_ENG1NumMsgPos_C FrmMng_ENG1OpMode_C FrmMng_ENG2IDType_C FrmMng_ENG2IntrEna_C FrmMng_ENG2Mul_C FrmMng_ENG2NumCAN_C FrmMng_ENG2NumMsgPos_C FrmMng_ENG2OpMode_C FrmMng_ENG3IDType_C FrmMng_ENG3IntrEna_C FrmMng_ENG3Mul_C FrmMng_ENG3NumCAN_C FrmMng_ENG3NumMsgPos_C FrmMng_ENG3OpMode_C FrmMng_ENG5IDType_C FrmMng_ENG5IntrEna_C FrmMng_ENG5Mul_C FrmMng_ENG5NumCAN_C FrmMng_ENG5NumMsgPos_C FrmMng_ENG5OpMode_C FrmMng_ENG6IDType_C FrmMng_ENG6IntrEna_C FrmMng_ENG6Mul_C FrmMng_ENG6NumCAN_C FrmMng_ENG6NumMsgPos_C FrmMng_ENG6OpMode_C FrmMng_ENG7IDType_C FrmMng_ENG7IntrEna_C FrmMng_ENG7Mul_C FrmMng_ENG7NumCAN_C FrmMng_ENG7NumMsgPos_C FrmMng_ENG7OpMode_C FrmMng_ENGACTR1IDType_C FrmMng_ENGACTR1IntrEna_C FrmMng_ENGACTR1Mul_C FrmMng_ENGACTR1NumCAN_C FrmMng_ENGACTR1NumMsgPos_C FrmMng_ENGACTR1OpMode_C FrmMng_ENGBRKIDType_C FrmMng_ENGBRKIntrEna_C FrmMng_ENGBRKMul_C FrmMng_ENGBRKNumCAN_C FrmMng_ENGBRKNumMsgPos_C FrmMng_ENGBRKOpMode_C FrmMng_ENGDISPIDType_C FrmMng_ENGDISPIntrEna_C FrmMng_ENGDISPMul_C FrmMng_ENGDISPNumCAN_C FrmMng_ENGDISPNumMsgPos_C FrmMng_ENGDISPOpMode_C FrmMng_ENGFLXIDType_C FrmMng_ENGFLXIntrEna_C FrmMng_ENGFLXMul_C FrmMng_ENGFLXNumCAN_C FrmMng_ENGFLXNumMsgPos_C FrmMng_ENGFLXOpMode_C FrmMng_ENGSLVIDType_C FrmMng_ENGSLVIntrEna_C FrmMng_ENGSLVMul_C FrmMng_ENGSLVNumCAN_C FrmMng_ENGSLVNumMsgPos_C FrmMng_ENGSLVOpMode_C FrmMng_ENGTRQ1IDType_C FrmMng_ENGTRQ1IntrEna_C FrmMng_ENGTRQ1Mul_C FrmMng_ENGTRQ1NumCAN_C FrmMng_ENGTRQ1NumMsgPos_C FrmMng_ENGTRQ1OpMode_C FrmMng_ENGTRQ2IDType_C FrmMng_ENGTRQ2IntrEna_C FrmMng_ENGTRQ2Mul_C FrmMng_ENGTRQ2NumCAN_C FrmMng_ENGTRQ2NumMsgPos_C FrmMng_ENGTRQ2OpMode_C FrmMng_ENGTRQ3IDType_C FrmMng_ENGTRQ3IntrEna_C FrmMng_ENGTRQ3Mul_C FrmMng_ENGTRQ3NumCAN_C FrmMng_ENGTRQ3NumMsgPos_C FrmMng_ENGTRQ3OpMode_C FrmMng_EPB1IDType_C FrmMng_EPB1IntrEna_C FrmMng_EPB1Mul_C FrmMng_EPB1NumCAN_C FrmMng_EPB1NumMsgPos_C FrmMng_EPB1OpMode_C FrmMng_EPB1SchedMode_C FrmMng_EPB1Sched_C FrmMng_EPB1Strt_C FrmMng_EPB1TOTmp_C FrmMng_ESCUIDType_C FrmMng_ESCUIntrEna_C FrmMng_ESCUMul_C FrmMng_ESCUNumCAN_C FrmMng_ESCUNumMsgPos_C FrmMng_ESCUOpMode_C FrmMng_ESCUSchedMode_C FrmMng_ESCUSched_C FrmMng_ESCUStrt_C FrmMng_ESCUTOTmp_C FrmMng_GW1IDType_C FrmMng_GW1IntrEna_C FrmMng_GW1Mul_C FrmMng_GW1NumCAN_C FrmMng_GW1NumMsgPos_C FrmMng_GW1OpMode_C FrmMng_GW1SchedMode_C FrmMng_GW1Sched_C FrmMng_GW1Strt_C FrmMng_GW1TOTmp_C FrmMng_LimRawMax_C FrmMng_MaxDiffACC_C FrmMng_MaxDiffAirbg_C FrmMng_MaxDiffCCTL_C FrmMng_MaxDiffTSC2_C FrmMng_MaxEngGrad_C FrmMng_MaxPerACC_C FrmMng_MaxPerAirbg_C FrmMng_MaxPerCCTL_C FrmMng_MaxPerTSC2_C FrmMng_MinEngGrad_C FrmMng_NIVEAU1IDType_C FrmMng_NIVEAU1IntrEna_C FrmMng_NIVEAU1Mul_C FrmMng_NIVEAU1NumCAN_C FrmMng_NIVEAU1NumMsgPos_C FrmMng_NIVEAU1OpMode_C FrmMng_NIVEAU1SchedMode_C FrmMng_NIVEAU1Sched_C FrmMng_NIVEAU1Strt_C FrmMng_NIVEAU1TOTmp_C FrmMng_RXIMMCTLIDType_C FrmMng_RXIMMCTLIntrEna_C FrmMng_RXIMMCTLMul_C FrmMng_RXIMMCTLNumCAN_C FrmMng_RXIMMCTLNumMsgPos_C FrmMng_RXIMMCTLOpMode_C FrmMng_RawErr_C FrmMng_SA1IDType_C FrmMng_SA1IntrEna_C FrmMng_SA1Mul_C FrmMng_SA1NumCAN_C FrmMng_SA1NumMsgPos_C FrmMng_SA1OpMode_C FrmMng_SA1SchedMode_C FrmMng_SA1Sched_C FrmMng_SA1Strt_C FrmMng_SA1TOTmp_C FrmMng_STIGNIDType_C FrmMng_STIGNIntrEna_C FrmMng_STIGNMul_C FrmMng_STIGNNumCAN_C FrmMng_STIGNNumMsgPos_C FrmMng_STIGNOpMode_C FrmMng_STIGNSchedMode_C FrmMng_STIGNSched_C FrmMng_STIGNStrt_C FrmMng_STIGNTOTmp_C FrmMng_TOSIDType_C FrmMng_TOSIntrEna_C FrmMng_TOSMul_C FrmMng_TOSNumCAN_C FrmMng_TOSNumMsgPos_C FrmMng_TOSOpMode_C FrmMng_TOSSchedMode_C FrmMng_TOSSched_C FrmMng_TOSStrt_C FrmMng_TOSTOTmp_C FrmMng_TSC1IDType_C FrmMng_TSC1IntrEna_C FrmMng_TSC1Mul_C FrmMng_TSC1NumCAN_C FrmMng_TSC1NumMsgPos_C FrmMng_TSC1OpMode_C FrmMng_TSC1SchedMode_C FrmMng_TSC1Sched_C FrmMng_TSC1Strt_C FrmMng_TSC1TOTmp_C FrmMng_TSC2IDType_C FrmMng_TSC2IntrEna_C FrmMng_TSC2Mul_C FrmMng_TSC2NumCAN_C FrmMng_TSC2NumMsgPos_C FrmMng_TSC2OpMode_C FrmMng_TSC2SchedMode_C FrmMng_TSC2Sched_C FrmMng_TSC2Strt_C FrmMng_TSC2TOTmp_C FrmMng_TSC3IDType_C FrmMng_TSC3IntrEna_C FrmMng_TSC3Mul_C FrmMng_TSC3NumCAN_C FrmMng_TSC3NumMsgPos_C FrmMng_TSC3OpMode_C FrmMng_TSC3SchedMode_C FrmMng_TSC3Sched_C FrmMng_TSC3Strt_C FrmMng_TSC3TOTmp_C FrmMng_TXIMMCTLIDType_C FrmMng_TXIMMCTLIntrEna_C FrmMng_TXIMMCTLMul_C FrmMng_TXIMMCTLNumCAN_C FrmMng_TXIMMCTLNumMsgPos_C FrmMng_TXIMMCTLOpMode_C FrmMng_ctMulEng2_C FrmMng_ctMulEng5_C FrmMng_dAC1ID_C FrmMng_dAC1SchedMesgLen_C FrmMng_dACC1SchedMesgLen_C FrmMng_dACCASchedMesgLen_C FrmMng_dACCSysID_C FrmMng_dACCSysSchedMesgLen_C FrmMng_dAIRBG1ID_C FrmMng_dAIRBG1SchedMesgLen_C FrmMng_dAWD1SchedMesgLen_C FrmMng_dAirIndSys_C FrmMng_dBRK1ID_C FrmMng_dBRK1SchedMesgLen_C FrmMng_dBRK2ID_C FrmMng_dBRK2SchedMesgLen_C FrmMng_dBuf1Len_cu8 FrmMng_dCCTLID_C FrmMng_dCHRGR1SchedMesgLen_C FrmMng_dCHRGR2SchedMesgLen_C FrmMng_dDSP1ID_C FrmMng_dDSP1SchedMesgLen_C FrmMng_dDSP2ID_C FrmMng_dDSP2SchedMesgLen_C FrmMng_dENG1ID_C FrmMng_dENG1SchedMesgLen_C FrmMng_dENG2ID_C FrmMng_dENG2SchedMesgLen_C FrmMng_dENG3ID_C FrmMng_dENG3SchedMesgLen_C FrmMng_dENG5ID_C FrmMng_dENG5SchedMesgLen_C FrmMng_dENG6ID_C FrmMng_dENG6SchedMesgLen_C FrmMng_dENG7ID_C FrmMng_dENG7SchedMesgLen_C FrmMng_dENGACTR1SchedMesgLen_C FrmMng_dENGBRKID_C FrmMng_dENGBRKSchedMesgLen_C FrmMng_dENGDISPID_C FrmMng_dENGDISPSchedMesgLen_C FrmMng_dENGFLXID_C FrmMng_dENGFLXSchedMesgLen_C FrmMng_dENGSLVID_C FrmMng_dENGSLVSchedMesgLen_C FrmMng_dENGTRQ1ID_C FrmMng_dENGTRQ1SchedMesgLen_C FrmMng_dENGTRQ2ID_C FrmMng_dENGTRQ2SchedMesgLen_C FrmMng_dENGTRQ3ID_C FrmMng_dENGTRQ3SchedMesgLen_C FrmMng_dEPB1SchedMesgLen_C FrmMng_dESCUID_C FrmMng_dESCUSchedMesgLen_C FrmMng_dMulinfo2_0_C FrmMng_dMulinfo2_1_C FrmMng_dMulinfo2_2_C FrmMng_dNrVlv_C FrmMng_dOilload_C FrmMng_dRXIMMCTLID_C FrmMng_dRXIMMCTLLen_cu8 FrmMng_dSTIGNID_C FrmMng_dSTIGNSchedMesgLen_C FrmMng_dSlpFillCrv_C FrmMng_dSootTurbo_C FrmMng_dTSC1ID_C FrmMng_dTSC1SchedMesgLen_C FrmMng_dTSC2ID_C FrmMng_dTSC2SchedMesgLen_C FrmMng_dTSC3ID_C FrmMng_dTSC3SchedMesgLen_C FrmMng_dTXIMMCTLID_C FrmMng_dTXIMMCTLSchedMesgLen_C FrmMng_dTrq_Offset_C FrmMng_dnLI_C FrmMng_facACComprLoad_Slope_C FrmMng_facACPress_Slope_C FrmMng_facDTrq_Slope_C FrmMng_facNDes_Slope_C FrmMng_facNLI_Slope_C FrmMng_facN_Slope_C FrmMng_facPBoost_Slope_C FrmMng_facP_Slope_C FrmMng_facRAPP_Slope_C FrmMng_facRAlt_Slope_C FrmMng_facRGearbx_Slope_C FrmMng_facRICur_Slope_C FrmMng_facR_Slope_C FrmMng_facTEnv_Slope_C FrmMng_facTOil_Slope_C FrmMng_facT_Slope_C FrmMng_facTi_Slope_C FrmMng_facTrFct_Slope_C FrmMng_facVDesDspl_Slope_C FrmMng_facVDes_Slope_C FrmMng_facVDspl_Slope_C FrmMng_facV_Slope_C FrmMng_facVolFlCons_Slope_C FrmMng_facVolTnk_Slope_C FrmMng_nDes_C FrmMng_nDes_Offset_C FrmMng_nLI_Offset_C FrmMng_nMulinfo5_1_C FrmMng_n_Offset_C FrmMng_pACPress_Offset_C FrmMng_pBoost_Offset_C FrmMng_p_Offset_C FrmMng_pwrMax_C FrmMng_rAPP_Offset_C FrmMng_rAlt_Offset_C FrmMng_rGearbx_Offset_C FrmMng_rICur_Offset_C FrmMng_r_Offset_C FrmMng_stCANVer_C FrmMng_stTORxMsgAlcECU_CA FrmMng_stTRQ_C FrmMng_swtAC1Ena_C FrmMng_swtACCSysEna_C FrmMng_swtAIRBG1Ena_C FrmMng_swtBRK1Ena_C FrmMng_swtBRK2Ena_C FrmMng_swtCCTLEna_C FrmMng_swtConvAdp_C FrmMng_swtDSP1Ena_C FrmMng_swtDSP2Ena_C FrmMng_swtDSP3Ena_C FrmMng_swtENG1Ena_C FrmMng_swtENG2Ena_C FrmMng_swtENG3Ena_C FrmMng_swtENG5Ena_C FrmMng_swtENG6Ena_C FrmMng_swtENG7Ena_C FrmMng_swtENGBRKEna_C FrmMng_swtENGDISPEna_C FrmMng_swtENGFLXEna_C FrmMng_swtENGSLVEna_C FrmMng_swtENGTRQ1Ena_C FrmMng_swtENGTRQ2Ena_C FrmMng_swtENGTRQ3Ena_C FrmMng_swtESCUEna_C FrmMng_swtSTIGNEna_C FrmMng_swtTSC1Ena_C FrmMng_swtTSC2Ena_C FrmMng_swtTSC3Ena_C FrmMng_swtTSC3NeutDisbl_C FrmMng_swtTSC3Type_C FrmMng_tEnv_Offset_C FrmMng_tOil_Offset_C FrmMng_t_Offset_C FrmMng_tiAdpPT1_C FrmMng_tiAdpStrtDly_C FrmMng_tiAdpStrt_C FrmMng_tiDelHotLamp_C FrmMng_ti_Offset_C FrmMng_trFct_Offset_C FrmMng_trqACComprLoad_Offset_C FrmMng_trqMulinfo2_3_C FrmMng_trqMulinfo5_0_C FrmMng_vDesDspl_Offset_C FrmMng_vDes_Offset_C FrmMng_vDspl_Offset_C FrmMng_v_Offset_C FrmMng_volCubCap_C FrmMng_volFlCons_Offset_C FrmMng_volNormCyl_C FrmMng_volTnk_Offset_C /end DEF_CHARACTERISTIC
/end FUNCTION
/begin FUNCTION FrmMng_ENG01 "collects information from the system, creates the ENG01 frame for CAN and copies this frame to the image-buffer for HWE." /begin DEF_CHARACTERISTIC FrmMng_facTrqInrCorr_MAP /end DEF_CHARACTERISTIC /end FUNCTION
/begin FUNCTION FrmMng_ENG03 "Transmits the ENG03 data frame via CAN."
 /begin DEF_CHARACTERISTIC FrmMng_nQLimErr_C FrmMng_nTrqLimBit_C FrmMng_nTrqLimErr_C FrmMng_nTrqNLim_C /end DEF_CHARACTERISTIC
/end FUNCTION
/begin FUNCTION FrmMng_General "General function"
 /begin DEF_CHARACTERISTIC FrmMng_DebACCCNTDef_C FrmMng_DebACCCNTOk_C FrmMng_DebAIRBGCNTDef_C FrmMng_DebAIRBGCNTOk_C FrmMng_DebAWD1CNTDef_C FrmMng_DebAWD1CNTOk_C FrmMng_DebBRK1CNTDef_C FrmMng_DebBRK1CNTOk_C FrmMng_DebCCTLCNTDef_C FrmMng_DebCCTLCNTOk_C FrmMng_DebTSC1CNTDef_C FrmMng_DebTSC1CNTOk_C FrmMng_DebTSC2CNTDef_C FrmMng_DebTSC2CNTOk_C FrmMng_DebTSC3CNTDef_C FrmMng_DebTSC3CNTOk_C FrmMng_dCHRGR1ID_C FrmMng_dCHRGR2ID_C FrmMng_dENGACTR1ID_C FrmMng_dTrqReso_C FrmMng_facTRQInrTrq_Slope_CA FrmMng_swtCHRGR1Ena_C FrmMng_swtCHRGR2Ena_C FrmMng_swtENGACTR1Ena_C FrmMng_swtHighLine_C FrmMng_trqEngTrqPrp_Offset_CA FrmMng_trqInrTrq_Offset_CA /end DEF_CHARACTERISTIC
/end FUNCTION
/begin FUNCTION FrmMng_RecAC "Frame Manager Prozeß für die Klima-Empfangsbotschaft vom CAN" /begin DEF_CHARACTERISTIC FrmMng_DebAC1DLCDef_C FrmMng_DebAC1DLCOk_C /end DEF_CHARACTERISTIC /end FUNCTION
/begin FUNCTION FrmMng_RecACC "Frame Manager Prozeß für die ACC-Empfangsbotschaft vom CAN"
 /begin DEF_CHARACTERISTIC FrmMng_ACC1IDType_C FrmMng_ACCAIDType_C FrmMng_ACCSysIDType_C FrmMng_DebACCDLCDef_C FrmMng_DebACCDLCOk_C FrmMng_aACC_Offset_C FrmMng_aCtlDvt_Offset_C FrmMng_aDes_Offset_C FrmMng_dACC1ID_C FrmMng_dACCAID_C FrmMng_daACCGradMax_Offset_C FrmMng_facAACC_Slope_C FrmMng_facACtlDvt_Slope_C FrmMng_facADes_Slope_C FrmMng_facDaACCGradMax_Slope_C FrmMng_stCCSelPlaus_C FrmMng_swtACC1Ena_C FrmMng_swtACCAEna_C FrmMng_tiACCAPoll_C FrmMng_tiDebTO_C /end DEF_CHARACTERISTIC
/end FUNCTION
/begin FUNCTION FrmMng_RecAIRBG "Frame Manager Prozeß für die Airbag-Empfangsbotschaft vom CAN"
 /begin DEF_CHARACTERISTIC FrmMng_DebAIRBGDLCDef_C FrmMng_DebAIRBGDLCOk_C FrmMng_facRBrkDes_Slope_C FrmMng_rBrkDes_Offset_C FrmMng_tiDebCrCtlNeg_C FrmMng_tiDebCrCtlPos_C FrmMng_tiDebNeg_C FrmMng_tiDebPos_C /end DEF_CHARACTERISTIC
/end FUNCTION
/begin FUNCTION FrmMng_RecAWD "Empfangsprozeß für die Allradbotschaften"
 /begin DEF_CHARACTERISTIC FrmMng_DebAWD1DLCDef_C FrmMng_DebAWD1DLCOk_C FrmMng_DebAWD1TODef_C FrmMng_DebAWD1TOOk_C FrmMng_MaxDiffAWD1_C FrmMng_MaxPerAWD1_C FrmMng_dAWD1ID_C FrmMng_facVLim_Slope_C FrmMng_swtAWD1Ena_C FrmMng_vLim_Offset_C /end DEF_CHARACTERISTIC
/end FUNCTION
/begin FUNCTION FrmMng_RecBEM "Empfangsprozeß für Energiemanager CAN-Botschaft"
 /begin DEF_CHARACTERISTIC FrmMng_DebBEM1CNTDef_C FrmMng_DebBEM1CNTOk_C FrmMng_DebBEM1CSDef_C FrmMng_DebBEM1CSOk_C FrmMng_DebBEM1DLCDef_C FrmMng_DebBEM1DLCOk_C FrmMng_DebBEM1TODef_C FrmMng_DebBEM1TOOk_C FrmMng_MaxDiffBEM1_C FrmMng_MaxPerBEM1_C FrmMng_dBEM1ID_C FrmMng_dBEM1SchedMesgLen_C FrmMng_facRpwr_Slope_C FrmMng_pwrBEMAltInit_C FrmMng_pwrInr_Offset_C FrmMng_swtBEM1Ena_C /end DEF_CHARACTERISTIC
/end FUNCTION
/begin FUNCTION FrmMng_RecBrk "Frame Manager Prozeß für die Bremsen-Empfangsbotschaft vom CAN"
 /begin DEF_CHARACTERISTIC FrmMng_DebBRK1CSDef_C FrmMng_DebBRK1CSOk_C FrmMng_DebBRK1DLCDef_C FrmMng_DebBRK1DLCOk_C FrmMng_DebBRK2CNTDef_C FrmMng_DebBRK2CNTOk_C FrmMng_DebBRK2DLCDef_C FrmMng_DebBRK2DLCOk_C FrmMng_DebBRK8CNTDef_C FrmMng_DebBRK8CNTOk_C FrmMng_DebBRK8CSDef_C FrmMng_DebBRK8CSOk_C FrmMng_DebBRK8DLCDef_C FrmMng_DebBRK8DLCOk_C FrmMng_DebBRK8TODef_C FrmMng_DebBRK8TOOk_C FrmMng_MaxDiffBRK1_C FrmMng_MaxDiffBRK2_C FrmMng_MaxDiffBRK8_C FrmMng_MaxPerBRK1_C FrmMng_MaxPerBRK2_C FrmMng_MaxPerBRK8_C FrmMng_aLong_Offset_C FrmMng_aTrnvrs_Offset_C FrmMng_aVeh_Offset_C FrmMng_dBRK8ID_C FrmMng_dBRK8SchedMesgLen_C FrmMng_facALong_Slope_C FrmMng_facATrnvrs_Slope_C FrmMng_facAVeh_Slope_C FrmMng_swtBRK8Ena_C FrmMng_vGSInitVal_C /end DEF_CHARACTERISTIC
/end FUNCTION
/begin FUNCTION FrmMng_RecCGW "Empfangsprozeß für Gateway CAN-Botschaft"
 /begin DEF_CHARACTERISTIC DSM_CDCDfp_FrmMngLICHT1TO_C DSM_CDCDfp_FrmMngLICHT2TO_C DSM_CDCDfp_FrmMngWIPERTO_C DSM_CDKDfp_FrmMngLICHT1TO_C DSM_ClaDfp_FrmMngLICHT1TO_C DSM_EnvDfp_FrmMngLICHT1TO_C DSM_FMKDfp_FrmMngLICHT1TO_C FrmMng_DebAAGCNTDef_C FrmMng_DebAAGCNTOk_C FrmMng_DebAAGTODef_C FrmMng_DebAAGTOOk_C FrmMng_DebDIA1DLCDef_C FrmMng_DebDIA1DLCOk_C FrmMng_DebDIA1TODef_C FrmMng_DebDIA1TOOk_C FrmMng_DebGW1DLCDef_C FrmMng_DebGW1DLCOk_C FrmMng_DebGW1TODef_C FrmMng_DebGW1TOOk_C FrmMng_DebILMCNTDef_C FrmMng_DebILMCNTOk_C FrmMng_DebILMTODef_C FrmMng_DebILMTOOk_C FrmMng_DebLICHT1TODef_C FrmMng_DebLICHT1TOOk_C FrmMng_MaxDiffAAG_C FrmMng_MaxDiffILM_C FrmMng_MaxPerAAG_C FrmMng_MaxPerILM_C FrmMng_dDIA1ID_C FrmMng_dDIA1SchedMesgLen_C FrmMng_dGW1ID_C FrmMng_dGW1SchedMesgLen_C FrmMng_swtDIA1Ena_C FrmMng_swtGW1Ena_C FrmMng_swtRevGearSrc_C /end DEF_CHARACTERISTIC
/end FUNCTION
/begin FUNCTION FrmMng_RecDsp "Frame Manager Prozeß für die Kombi-Empfangsbotschaft vom CAN"
 /begin DEF_CHARACTERISTIC FrmMng_DSP3IDType_C FrmMng_DSP3IntrEna_C FrmMng_DSP3Mul_C FrmMng_DSP3NumCAN_C FrmMng_DSP3NumMsgPos_C FrmMng_DSP3OpMode_C FrmMng_DSP3SchedMode_C FrmMng_DSP3Sched_C FrmMng_DSP3Strt_C FrmMng_DSP3TOTmp_C FrmMng_DebDSP1CNTDef_C FrmMng_DebDSP1CNTOk_C FrmMng_DebDSP1DLCDef_C FrmMng_DebDSP1DLCOk_C FrmMng_DebDSP2DLCDef_C FrmMng_DebDSP2DLCOk_C FrmMng_DebDSP3DLCDef_C FrmMng_DebDSP3DLCOk_C FrmMng_DebDSP3TODef_C FrmMng_DebDSP3TOOk_C FrmMng_MaxDiffDSP1_C FrmMng_MaxPerDSP1_C FrmMng_dDSP3ID_C FrmMng_dDSP3SchedMesgLen_C /end DEF_CHARACTERISTIC
/end FUNCTION
/begin FUNCTION FrmMng_RecEPB "Frame Manager Prozeß für die EPB-Empfangsbotschaft vom CAN"
 /begin DEF_CHARACTERISTIC FrmMng_DebEPB1CNTDef_C FrmMng_DebEPB1CNTOk_C FrmMng_DebEPB1CSDef_C FrmMng_DebEPB1CSOk_C FrmMng_DebEPB1DLCDef_C FrmMng_DebEPB1DLCOk_C FrmMng_DebEPB1TODef_C FrmMng_DebEPB1TOOk_C FrmMng_MaxDiffEPB1_C FrmMng_MaxPerEPB1_C FrmMng_dEPB1ID_C FrmMng_swtEPB1Ena_C /end DEF_CHARACTERISTIC
/end FUNCTION
/end MODULE
/end PROJECT
