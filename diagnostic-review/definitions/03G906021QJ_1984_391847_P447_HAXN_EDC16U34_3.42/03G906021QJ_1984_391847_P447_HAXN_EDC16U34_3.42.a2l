ASAP2_VERSION 1 3
/begin PROJECT X447 "EDC16U34"
/begin HEADER "" VERSION "VAA1" PROJECT_NO X447 /end HEADER
/begin MODULE DIM ""
/begin MOD_COMMON "" BYTE_ORDER MSB_FIRST ALIGNMENT_BYTE 1 ALIGNMENT_WORD 2 ALIGNMENT_LONG 4 ALIGNMENT_FLOAT32_IEEE 4 /end MOD_COMMON
/begin CHARACTERISTIC AccPed_tiDebAliveDef_C "Entprellzeit für Lebenderrkennung APP" VALUE 0x1C2794 Kw_Wu16 655350.0 Time_ms 0.00 655350.0 FORMAT "%8.1" /end CHARACTERISTIC
/begin CHARACTERISTIC AccPed_tiDebAliveOk_C "Entprellzeit für Lebenderrkennung APP" VALUE 0x1C2796 Kw_Wu16 655350.0 Time_ms 0.00 655350.0 FORMAT "%8.1" /end CHARACTERISTIC
/begin CHARACTERISTIC AccPed_tiDebPladrLckDef_C "Entprellzeit für Erkennung APP-Gradient" VALUE 0x1C2798 Kw_Wu16 655350.0 Time_ms 0.00 655350.0 FORMAT "%8.1" /end CHARACTERISTIC
/begin CHARACTERISTIC AccPed_tiDebPladrLckOk_C "Entprellzeit für Erkennung APP-Gradient" VALUE 0x1C279A Kw_Wu16 655350.0 Time_ms 0.00 655350.0 FORMAT "%8.1" /end CHARACTERISTIC
/begin CHARACTERISTIC AccPed_tiDebMisUseOk_C "Entprellzeit für nicht erkannten Mißbrauch" VALUE 0x1C279C Kw_Wu16 655350.0 Time_ms 0.00 655350.0 FORMAT "%8.1" /end CHARACTERISTIC
/begin CHARACTERISTIC AccPed_tiDebMisUseDef_C "Entprellzeit für Mißbrauchserkennung" VALUE 0x1C279E Kw_Wu16 655350.0 Time_ms 0.00 655350.0 FORMAT "%8.1" /end CHARACTERISTIC
/begin CHARACTERISTIC AccPed_dfacRampSlope_C "Rampensteigung der Transitionsfunktion" VALUE 0x1C27A0 Kw_Wu32 1.00000202656 RmpFactLow 0.00 1.00000202656 FORMAT "%13.11" EXTENDED_LIMITS 0.00 63999.9999851 /end CHARACTERISTIC
/begin CHARACTERISTIC AccPed_dnDORmpSlpPos_CUR "Kennlinie zur Festlegung der Rampensteigung für Solldrehzahlerhöhung des Anfahrreglers" CURVE 0x1C27A4 Kl_Xs16_Ws16 6000.000 RmpEngN_2 0.00 6000.000 FORMAT "%8.3" EXTENDED_LIMITS -64000.00 63998.05
 /begin AXIS_DESCR STD_AXIS Eng_tEng Temp_Cels 6 -3549.940 3003.560 FORMAT "%8.3" DEPOSIT ABSOLUTE /end AXIS_DESCR
/end CHARACTERISTIC
/begin CHARACTERISTIC AccPed_dnDOSetP_MAP "Kennfeld für Solldrehzahlerhöhung des Anfahrreglers" MAP 0x1C27BE Kf_Xs16_Ys16_Ws16 6000.000 EngN 0.00 6000.000 FORMAT "%8.3" EXTENDED_LIMITS -32768.00 32767.00
 /begin AXIS_DESCR STD_AXIS AccPed_rAPP Prc 6 -327.6800 327.6700 FORMAT "%8.4" DEPOSIT ABSOLUTE /end AXIS_DESCR
 /begin AXIS_DESCR STD_AXIS APSCD_pVal Pres_hPa 6 -32768.00 32767.00 FORMAT "%8.2" DEPOSIT ABSOLUTE /end AXIS_DESCR
/end CHARACTERISTIC
/begin CHARACTERISTIC AccPed_drAPPUnFltLim_C "Schwelle Fahrpedalgradient für Aufhebung der Plausibilitätsprüfung Fahrpedal/Bremse" VALUE 0x1C2822 Kw_Ws16 5000.000 PrcPerSec 0.00 5000.000 FORMAT "%8.3" EXTENDED_LIMITS -16384.00 16383.50 /end CHARACTERISTIC
/begin CHARACTERISTIC AccPed_drLimpMax_C "Maximaler APP-Gradient im Notfahrbetrieb" VALUE 0x1C2824 Kw_Ws16 5000.000 PrcPerSec 0.00 5000.000 FORMAT "%8.3" EXTENDED_LIMITS -16384.00 16383.50 /end CHARACTERISTIC
/begin CHARACTERISTIC AccPed_facAppWntrMode0_MAP "Gang- und drehzahlabhängiges Kennfeld zur Berechnung des Fahrerwunsches bei aktivem Winterfahrprogramm" MAP 0x1C2826 Kf_Xs16_Ys16_Ws16 1.000000 FactLow 0.00 1.000000 FORMAT "%8.6" EXTENDED_LIMITS -32.00000 31.99902
 /begin AXIS_DESCR STD_AXIS Eng_nAvrg EngN 16 0.00 6000.000 FORMAT "%8.3" EXTENDED_LIMITS -32768.00 32767.00 DEPOSIT ABSOLUTE /end AXIS_DESCR
 /begin AXIS_DESCR STD_AXIS Gearbx_stGear OneToOne 8 -1.000 6.000 FORMAT "%5.3" EXTENDED_LIMITS -128.0 127.0 DEPOSIT ABSOLUTE /end AXIS_DESCR
/end CHARACTERISTIC
/begin CHARACTERISTIC AccPed_drLimUp_C "positive Rampensteigung bei Erkennung oder Heilung Unplausibilität  PWG-Bremse" VALUE 0x1C295C Kw_Wu32 655359.399872 RmpPrc 0.599975585938 655359.999847 FORMAT "%13.6" EXTENDED_LIMITS 0.00 655359.999847 /end CHARACTERISTIC
/begin CHARACTERISTIC AccPed_drLimDwn_C "negative Rampensteigung bei Unplausibilität PWG-Bremse" VALUE 0x1C2960 Kw_Wu32 655359.399872 RmpPrc 0.599975585938 655359.999847 FORMAT "%13.6" EXTENDED_LIMITS 0.00 655359.999847 /end CHARACTERISTIC
/begin CHARACTERISTIC AccPed_nDOMax_C "Obere Begrenzung der Solldrehzahlanforderung des Anfahrreglers" VALUE 0x1C2964 Kw_Ws16 6000.000 EngN 0.00 6000.000 FORMAT "%8.3" EXTENDED_LIMITS -32768.00 32767.00 /end CHARACTERISTIC
/begin CHARACTERISTIC AccPed_nErr_C "Leerlaufsolldrehzahl bei Plausibilitätsfehler" VALUE 0x1C2966 Kw_Ws16 6000.000 EngN 0.00 6000.000 FORMAT "%8.3" EXTENDED_LIMITS -32768.00 32767.00 /end CHARACTERISTIC
/begin CHARACTERISTIC AccPed_nLIMinBrk_C "APP Leerlaufsolldrehzahlvorgabe bei gedrueckter Bremse" VALUE 0x1C2968 Kw_Ws16 6000.000 EngN 0.00 6000.000 FORMAT "%8.3" EXTENDED_LIMITS -32768.00 32767.00 /end CHARACTERISTIC
/begin CHARACTERISTIC AccPed_nLIMinvHigh_C "APP Leerlaufsolldrehzahlvorgabe bei Fahrzeuggeschwindigkeit oberhalb Schwelle" VALUE 0x1C296A Kw_Ws16 6000.000 EngN 0.00 6000.000 FORMAT "%8.3" EXTENDED_LIMITS -32768.00 32767.00 /end CHARACTERISTIC
/begin CHARACTERISTIC AccPed_nLIMinvLow_C "APP Leerlaufsolldrehzahlvorgabe bei Fahrzeuggeschwindigkeit unterhalb Schwelle" VALUE 0x1C296C Kw_Ws16 6000.000 EngN 0.00 6000.000 FORMAT "%8.3" EXTENDED_LIMITS -32768.00 32767.00 /end CHARACTERISTIC
/begin CHARACTERISTIC AccPed_nLimMisUse_C "Drehzahlschwelle für Mißbrauchserkennung" VALUE 0x1C296E Kw_Ws16 6000.000 EngN 0.00 6000.000 FORMAT "%8.3" EXTENDED_LIMITS -32768.00 32767.00 /end CHARACTERISTIC
/begin CHARACTERISTIC AccPed_nLimNMR_C "Drehzahlschwelle für nicht überwachten Betriebsbereich" VALUE 0x1C2970 Kw_Ws16 6000.000 EngN 0.00 6000.000 FORMAT "%8.3" EXTENDED_LIMITS -32768.00 32767.00 /end CHARACTERISTIC
/begin CHARACTERISTIC AccPed_nLim_C "Drehzahlschwelle für Freigabe Fahrpedalprüfung" VALUE 0x1C2972 Kw_Ws16 6000.000 EngN 0.00 6000.000 FORMAT "%8.3" EXTENDED_LIMITS -32768.00 32767.00 /end CHARACTERISTIC
/begin CHARACTERISTIC AccPed_nPlaAPPBrk_C "Leerlaufdrehzahl im Falle einer Unplausibilität PWG/Bremse" VALUE 0x1C2974 Kw_Ws16 6000.000 EngN 0.00 6000.000 FORMAT "%8.3" EXTENDED_LIMITS -32768.00 32767.00 /end CHARACTERISTIC
/begin CHARACTERISTIC AccPed_nPWinDO_CUR "Kennlinie zur Festlegung der positiven Fenstergrenze des Anfahrreglers" CURVE 0x1C2976 Kl_Xs16_Ws16 6000.000 EngN 0.00 6000.000 FORMAT "%8.3" EXTENDED_LIMITS -32768.00 32767.00
 /begin AXIS_DESCR STD_AXIS Eng_tEng Temp_Cels 6 -3549.940 3003.560 FORMAT "%8.3" DEPOSIT ABSOLUTE /end AXIS_DESCR
/end CHARACTERISTIC
/begin CHARACTERISTIC AccPed_PKpDO_CUR "Kennlinie zur Applikation der Großsignalverstärkung des Anfahrreglers" CURVE 0x1C2990 Kl_Xs16_Ws16 400.0000 KP_RPM2NM_2 0.00 400.0000 FORMAT "%8.4" EXTENDED_LIMITS -1.600000 1.599951
 /begin AXIS_DESCR STD_AXIS Eng_tEng Temp_Cels 6 -3549.940 3003.560 FORMAT "%8.3" DEPOSIT ABSOLUTE /end AXIS_DESCR
/end CHARACTERISTIC
/begin CHARACTERISTIC AccPed_PKpSigDO_CUR "Kennlinie zur Applikation der Kleinsignalverstärkung des Anfahrreglers" CURVE 0x1C29AA Kl_Xs16_Ws16 400.0000 KP_RPM2NM_2 0.00 400.0000 FORMAT "%8.4" EXTENDED_LIMITS -1.600000 1.599951
 /begin AXIS_DESCR STD_AXIS Eng_tEng Temp_Cels 6 -3549.940 3003.560 FORMAT "%8.3" DEPOSIT ABSOLUTE /end AXIS_DESCR
/end CHARACTERISTIC
/begin CHARACTERISTIC AccPed_tiPlausBrkDebNeg_C "Entprellzeit Fehlerheilung bei Unplausibilität AccPed-Bremse" VALUE 0x1C29C4 Kw_Wu16 655350.0 Time_ms 0.00 655350.0 FORMAT "%8.1" /end CHARACTERISTIC
/begin CHARACTERISTIC AccPed_tiPlausBrkDebPos_C "Entrpellzeit für Fehler bei Unplausibilität AccPed-Bremse" VALUE 0x1C29C6 Kw_Wu16 655350.0 Time_ms 0.00 655350.0 FORMAT "%8.1" /end CHARACTERISTIC
/begin CHARACTERISTIC AccPed_rAppWntrMode0_MAP "Kennfeld für die Neubewertung des Fahrpedalwertes bei aktivem Winterfahrprogramm (Mode Wntr1)" MAP 0x1C29C8 Kf_Xs16_Ys16_Ws16 100.0000 Prc 0.00 100.0000 FORMAT "%8.4" EXTENDED_LIMITS -327.6800 327.6700
 /begin AXIS_DESCR STD_AXIS Eng_nAvrg EngN 16 0.00 6000.000 FORMAT "%8.3" EXTENDED_LIMITS -32768.00 32767.00 DEPOSIT ABSOLUTE /end AXIS_DESCR
 /begin AXIS_DESCR STD_AXIS AccPed_rChkdVal Prc 9 0.00 100.0000 FORMAT "%8.4" EXTENDED_LIMITS -327.6800 327.6700 DEPOSIT ABSOLUTE /end AXIS_DESCR
/end CHARACTERISTIC
/begin CHARACTERISTIC AccPed_rErrValPlaus_C "Ersatzwert PWG bei Fehler" VALUE 0x1C2B1E Kw_Ws16 100.0000 Prc 0.00 100.0000 FORMAT "%8.4" EXTENDED_LIMITS -327.6800 327.6700 /end CHARACTERISTIC
/begin CHARACTERISTIC AccPed_rLimpMax_C "Maximaler APP-Wert im Notfahrbetrieb" VALUE 0x1C2B20 Kw_Ws16 100.0000 Prc 0.00 100.0000 FORMAT "%8.4" EXTENDED_LIMITS -327.6800 327.6700 /end CHARACTERISTIC
/begin CHARACTERISTIC AccPed_rPlaMaxVal_C "Maximaler APP-Wert bei Plausibilitaetsverletzung" VALUE 0x1C2B22 Kw_Ws16 100.0000 Prc 0.00 100.0000 FORMAT "%8.4" EXTENDED_LIMITS -327.6800 327.6700 /end CHARACTERISTIC
/begin CHARACTERISTIC AccPed_rThPlaus_C "Schwelle für Erkennung: PWG betätigt" VALUE 0x1C2B24 Kw_Ws16 100.0000 Prc 0.00 100.0000 FORMAT "%8.4" EXTENDED_LIMITS -327.6800 327.6700 /end CHARACTERISTIC
/begin CHARACTERISTIC AccPed_rThresPrpMin_C "minimaler Antriebswert" VALUE 0x1C2B26 Kw_Ws16 100.0000 Prc 0.00 100.0000 FORMAT "%8.4" EXTENDED_LIMITS -327.6800 327.6700 /end CHARACTERISTIC
/begin CHARACTERISTIC AccPed_rThresPrp_C "Schwelle zwischen Schub- und Zugbetrieb" VALUE 0x1C2B28 Kw_Ws16 100.0000 Prc 0.00 100.0000 FORMAT "%8.4" EXTENDED_LIMITS -327.6800 327.6700 /end CHARACTERISTIC
/begin CHARACTERISTIC AccPed_rThresSfty_C "Schwellwert für die Aktivierung der Plausibilitätsprüfung Fahrpedalstellung - Bremse (Sicherheitsfall)" VALUE 0x1C2B2A Kw_Ws16 100.0000 Prc 0.00 100.0000 FORMAT "%8.4" EXTENDED_LIMITS -327.6800 327.6700 /end CHARACTERISTIC
/begin CHARACTERISTIC AccPed_rZero_C "PWG-Stellung, unterhalb der Schubbetrieb gelten soll" VALUE 0x1C2B2C Kw_Ws16 100.0000 Prc 0.00 100.0000 FORMAT "%8.4" EXTENDED_LIMITS -327.6800 327.6700 /end CHARACTERISTIC
/begin CHARACTERISTIC AccPed_stBrkPlausMSK_C "Konstante zum ausmaskieren der Bits für den Plausibilitätscheck Bremse" VALUE 0x1C2B2E Kw_Wu8 255.0 OneToOne 0.00 255.0 FORMAT "%5.1" /end CHARACTERISTIC
/begin CHARACTERISTIC AccPed_stGearSel_CUR "Auswahl der _MAPs AccPed_trqEng#_MAP, #={0,...,5} zur Interpolation zwischen den Gaengen" CURVE 0x1C2B30 Kl_Xs16_Ws16 6.000000 Map_Select 0.00 6.000000 FORMAT "%8.6" EXTENDED_LIMITS -128.0000 127.9961
 /begin AXIS_DESCR STD_AXIS AccPed_rVnTrqEngActv_mp VelToN 7 0.00 0.3276700 FORMAT "%9.7" EXTENDED_LIMITS -0.3276800 0.3276700 DEPOSIT ABSOLUTE /end AXIS_DESCR
/end CHARACTERISTIC
/begin CHARACTERISTIC AccPed_stTipSlit_C "Bitmaske zur Detektion von Wählhebel in Tipgasse" VALUE 0x1C2B4E Kw_Wu16 65535.00 OneToOne 0.00 65535.00 FORMAT "%8.2" /end CHARACTERISTIC
/begin CHARACTERISTIC AccPed_swtActvKD_C "Schalter zur Aktivierung des Kick-Down Signals (ermöglicht kurzfristige Deaktivierung des Winterfahrprogramms)" VALUE 0x1C2B50 Kw_Wu8 1.000 OneToOne 0.00 1.000 FORMAT "%5.3" EXTENDED_LIMITS 0.00 255.0 /end CHARACTERISTIC
/begin CHARACTERISTIC AccPed_swtAliveDetEna_C "Schalter um Lebenderkennung zu aktivieren (1: Lebenderkennung aktiv, 0: inaktiev)" VALUE 0x1C2B51 Kw_Wu8 1.000 OneToOne 0.00 1.000 FORMAT "%5.3" EXTENDED_LIMITS 0.00 255.0 /end CHARACTERISTIC
/begin CHARACTERISTIC AccPed_swtAppGradEna_C "Schalter zur Aktivierung der Rücksetzbedingung der APP/Bremse-Plausibilisierung durch APP-Aenderung" VALUE 0x1C2B52 Kw_Wu8 1.000 OneToOne 0.00 1.000 FORMAT "%5.3" EXTENDED_LIMITS 0.00 255.0 /end CHARACTERISTIC
/begin CHARACTERISTIC AccPed_swtBrkDet_C "Schalter zur Auswahl der Bremssignalerkennung (1: Erkennung durch Ändern des Hauptschalters, 0: durch Wert von BrkCD_stPressed)" VALUE 0x1C2B53 Kw_Wu8 1.000 OneToOne 0.00 1.000 FORMAT "%5.3" EXTENDED_LIMITS 0.00 255.0 /end CHARACTERISTIC
/begin CHARACTERISTIC AccPed_swtBrkReset_C "Bremse-Reset Bedingungen (=0 (für alte Version), =1 (für neue Änderungen Toureg GP))" VALUE 0x1C2B54 Kw_Wu8 1.000 OneToOne 0.00 1.000 FORMAT "%5.3" EXTENDED_LIMITS 0.00 255.0 /end CHARACTERISTIC
/begin CHARACTERISTIC AccPed_swtClthEna_C "Schalter zum Einbeziehen des Kupplungsstatus in den Anfahrregler" VALUE 0x1C2B55 Kw_Wu8 1.000 OneToOne 0.00 1.000 FORMAT "%5.3" EXTENDED_LIMITS 0.00 255.0 /end CHARACTERISTIC
/begin CHARACTERISTIC AccPed_swtClthPrtEna_C "Schalter zum Freischalten des Kupplungsschutzes" VALUE 0x1C2B56 Kw_Wu8 1.000 OneToOne 0.00 1.000 FORMAT "%5.3" EXTENDED_LIMITS 0.00 255.0 /end CHARACTERISTIC
/begin CHARACTERISTIC AccPed_swtClthPrtviaDOEna_C "Schalter zum entkoppeln des Anfahrreglers und des Kupplungsschutz" VALUE 0x1C2B57 Kw_Wu8 1.000 OneToOne 0.00 1.000 FORMAT "%5.3" EXTENDED_LIMITS 0.00 255.0 /end CHARACTERISTIC
/begin CHARACTERISTIC AccPed_swtDOEna_C "Schalter zum Freischalten des Anfahrreglers" VALUE 0x1C2B58 Kw_Wu8 1.000 OneToOne 0.00 1.000 FORMAT "%5.3" EXTENDED_LIMITS 0.00 255.0 /end CHARACTERISTIC
/begin CHARACTERISTIC AccPed_swtEPBEna_C "switch for the torque limitation" VALUE 0x1C2B59 Kw_Wu8 2.000 OneToOne 0.00 2.000 FORMAT "%5.3" EXTENDED_LIMITS 0.00 255.0 /end CHARACTERISTIC
/begin CHARACTERISTIC AccPed_swtESPEna_C "Schalter zum Einbeziehen des ESP-Status in den Anfahrregler" VALUE 0x1C2B5A Kw_Wu8 1.000 OneToOne 0.00 1.000 FORMAT "%5.3" EXTENDED_LIMITS 0.00 255.0 /end CHARACTERISTIC
/begin CHARACTERISTIC AccPed_swtMisUseEna_C "Schalter zur Aktivierung der Mißbrauchserkennung" VALUE 0x1C2B5B Kw_Wu8 1.000 OneToOne 0.00 1.000 FORMAT "%5.3" EXTENDED_LIMITS 0.00 255.0 /end CHARACTERISTIC
/begin CHARACTERISTIC AccPed_swtPlausCheckReqd_C "Freigabe der Überprüfung auf Unplausibilität (1:Freigabe, 0: keine Freigabe)" VALUE 0x1C2B5C Kw_Wu8 1.000 OneToOne 0.00 1.000 FORMAT "%5.3" EXTENDED_LIMITS 0.00 255.0 /end CHARACTERISTIC
/begin CHARACTERISTIC AccPed_swtrVnFltEna_C "Zeitkonstante PT1 Filter v/n Verhältnis für die gangabhängige Berechnung des (voreilenden) Zugwunschmomentes" VALUE 0x1C2B5D Kw_Wu8 1.000 OneToOne 0.00 1.000 FORMAT "%5.3" EXTENDED_LIMITS 0.00 255.0 /end CHARACTERISTIC
/begin CHARACTERISTIC AccPed_swtrVnFreeze_C "Schalter zur Aktivierung bzw. Deaktivierung des Einfrierens vom v/n-Verhältnis im Falle eines Fahrzeuggeschwindigkeitsfehlers (0" VALUE 0x1C2B5E Kw_Wu8 1.000 OneToOne 0.00 1.000 FORMAT "%5.3" EXTENDED_LIMITS 0.00 255.0 /end CHARACTERISTIC
/begin CHARACTERISTIC AccPed_swtTipSlitIsSport_C "Schalter zum Ermöglichen des Sportfahrverhaltens bei Wahlhebel in Tippgasse" VALUE 0x1C2B5F Kw_Wu8 1.000 OneToOne 0.00 1.000 FORMAT "%5.3" EXTENDED_LIMITS 0.00 255.0 /end CHARACTERISTIC
/begin CHARACTERISTIC AccPed_swtTrqRampEna_C "Status der Rampe in der Transitionsfunktion (0: Rampen deaktiviert 1: Rampen aktiviert)" VALUE 0x1C2B60 Kw_Wu8 1.000 OneToOne 0.00 1.000 FORMAT "%5.3" EXTENDED_LIMITS 0.00 255.0 /end CHARACTERISTIC
/begin CHARACTERISTIC AccPed_swtTrqTransType_C "legt die Art der internen Speicherung des Fahrpedalwerts in der Transitionsfunktion fest." VALUE 0x1C2B61 Kw_Wu8 1.000 OneToOne 0.00 1.000 FORMAT "%5.3" EXTENDED_LIMITS 0.00 255.0 /end CHARACTERISTIC
/begin CHARACTERISTIC AccPed_swtVehDynReqd_C "1: Berücksichtigung Fahrdynamikeingriffe aktiv, 0: Berücksichtigung Fahrdynamikeingriffe inaktiv" VALUE 0x1C2B62 Kw_Wu8 1.000 OneToOne 0.00 1.000 FORMAT "%5.3" EXTENDED_LIMITS 0.00 255.0 /end CHARACTERISTIC
/begin CHARACTERISTIC AccPed_tEngTrq0ColdHigh_C "oberer Motortemperatur-Hysteresenschwellwert der Anfahrkennfeldumschaltung" VALUE 0x1C2B64 Kw_Ws16 250.0000 Temp_Cels -50.14000 199.8600 FORMAT "%8.4" EXTENDED_LIMITS -3549.940 3003.560 /end CHARACTERISTIC
/begin CHARACTERISTIC AccPed_tEngTrq0ColdLow_C "unterer Motortemperatur-Hysteresenschwellwert für den Anfahrkennfeldumschlater" VALUE 0x1C2B66 Kw_Ws16 250.0000 Temp_Cels -50.14000 199.8600 FORMAT "%8.4" EXTENDED_LIMITS -3549.940 3003.560 /end CHARACTERISTIC
/begin CHARACTERISTIC AccPed_tiChkDebNeg_C "Entprellzeit ""Unplausibilität zurücksetzen""" VALUE 0x1C2B68 Kw_Wu16 655350.0 TimeDeb 0.00 655350.0 FORMAT "%8.1" /end CHARACTERISTIC
/begin CHARACTERISTIC AccPed_tiChkDebPos_C "Entprellzeit für Erkennung auf Unplausibilität AccPed-Brk" VALUE 0x1C2B6A Kw_Wu16 655350.0 TimeDeb 0.00 655350.0 FORMAT "%8.1" /end CHARACTERISTIC
/begin CHARACTERISTIC AccPed_tiDebPlaDet_C "Entprellzeit für APP/Bremse Plausibilitaetserkennung" VALUE 0x1C2B6C Kw_Wu16 655350.0 TimeDeb 0.00 655350.0 FORMAT "%8.1" /end CHARACTERISTIC
/begin CHARACTERISTIC AccPed_tiDebPlaRst_C "Entprellzeit für APP/Bremse Plausibilisierung ruecksetzen" VALUE 0x1C2B6E Kw_Wu16 655350.0 TimeDeb 0.00 655350.0 FORMAT "%8.1" /end CHARACTERISTIC
/begin CHARACTERISTIC AccPed_tiPlaAPPBrkCANwaitHW_C "Entprellzeit für die Plausibiltät Bremse - PWG bei ESP Bremseingriff" VALUE 0x1C2B70 Kw_Wu16 655350.0 TimeDeb 0.00 655350.0 FORMAT "%8.1" /end CHARACTERISTIC
/begin CHARACTERISTIC AccPed_tiVnTrqEngPT1_C "Zeitkonstante PT1 Filter V/n Verhaeltniss fuer die gangabh. Berechnung des (voreilenden) Zugwunschmomentes" VALUE 0x1C2B74 Kw_Wu32 4294.9673 TimeDelay_s 0.0000010000000 4294.9673 FORMAT "%9.4" /end CHARACTERISTIC
/begin CHARACTERISTIC AccPed_trqEng0Cold_MAP "Anfahrkennfeld für kalten Motor" MAP 0x1C2B78 Kf_Xs16_Ys16_Ws16 1000.000 Trq 0.00 1000.000 FORMAT "%8.3" EXTENDED_LIMITS -3276.800 3276.700
 /begin AXIS_DESCR STD_AXIS Eng_nAvrg EngN 16 0.00 6000.000 FORMAT "%8.3" EXTENDED_LIMITS -32768.00 32767.00 DEPOSIT ABSOLUTE /end AXIS_DESCR
 /begin AXIS_DESCR STD_AXIS AccPed_rAPP Prc 9 0.00 100.0000 FORMAT "%8.4" EXTENDED_LIMITS -327.6800 327.6700 DEPOSIT ABSOLUTE /end AXIS_DESCR
/end CHARACTERISTIC
/begin CHARACTERISTIC AccPed_trqEng0_MAP "1.Gang oder allgem. genutzt: (voreilendes) Zugwunschmoment aus Mot.-Drehz. und AccPed_rChkdVal (resp. APPCD_rAPP1UnFlt)" MAP 0x1C2CCE Kf_Xs16_Ys16_Ws16 1000.000 Trq 0.00 1000.000 FORMAT "%8.3" EXTENDED_LIMITS -3276.800 3276.700
 /begin AXIS_DESCR STD_AXIS Eng_nAvrg EngN 16 0.00 6000.000 FORMAT "%8.3" EXTENDED_LIMITS -32768.00 32767.00 DEPOSIT ABSOLUTE /end AXIS_DESCR
 /begin AXIS_DESCR STD_AXIS AccPed_rAPP Prc 9 0.00 100.0000 FORMAT "%8.4" EXTENDED_LIMITS -327.6800 327.6700 DEPOSIT ABSOLUTE /end AXIS_DESCR
/end CHARACTERISTIC
/begin CHARACTERISTIC AccPed_trqEng1_MAP "Fahrverhaltenkennfeld in Motormoment bei konventioneller Antriebsstrangsteuerung" MAP 0x1C2E24 Kf_Xs16_Ys16_Ws16 1000.000 Trq 0.00 1000.000 FORMAT "%8.3" EXTENDED_LIMITS -3276.800 3276.700
 /begin AXIS_DESCR STD_AXIS Eng_nAvrg EngN 16 0.00 6000.000 FORMAT "%8.3" EXTENDED_LIMITS -32768.00 32767.00 DEPOSIT ABSOLUTE /end AXIS_DESCR
 /begin AXIS_DESCR STD_AXIS AccPed_rAPP Prc 9 0.00 100.0000 FORMAT "%8.4" EXTENDED_LIMITS -327.6800 327.6700 DEPOSIT ABSOLUTE /end AXIS_DESCR
/end CHARACTERISTIC
/begin CHARACTERISTIC AccPed_trqEng2_MAP "Fahrverhaltenkennfeld in Motormoment bei konventioneller Antriebsstrangsteuerung" MAP 0x1C2F7A Kf_Xs16_Ys16_Ws16 1000.000 Trq 0.00 1000.000 FORMAT "%8.3" EXTENDED_LIMITS -3276.800 3276.700
 /begin AXIS_DESCR STD_AXIS Eng_nAvrg EngN 16 0.00 6000.000 FORMAT "%8.3" EXTENDED_LIMITS -32768.00 32767.00 DEPOSIT ABSOLUTE /end AXIS_DESCR
 /begin AXIS_DESCR STD_AXIS AccPed_rAPP Prc 9 0.00 100.0000 FORMAT "%8.4" EXTENDED_LIMITS -327.6800 327.6700 DEPOSIT ABSOLUTE /end AXIS_DESCR
/end CHARACTERISTIC
/begin CHARACTERISTIC AccPed_trqEng3_MAP "4.Gang: (voreilendes) Zugwunschmoment aus Mot.-Drehz. und AccPed_rChkdVal (resp. APPCD_rAPP1UnFlt)" MAP 0x1C30D0 Kf_Xs16_Ys16_Ws16 1000.000 Trq 0.00 1000.000 FORMAT "%8.3" EXTENDED_LIMITS -3276.800 3276.700
 /begin AXIS_DESCR STD_AXIS Eng_nAvrg EngN 16 0.00 6000.000 FORMAT "%8.3" EXTENDED_LIMITS -32768.00 32767.00 DEPOSIT ABSOLUTE /end AXIS_DESCR
 /begin AXIS_DESCR STD_AXIS AccPed_rAPP Prc 9 0.00 100.0000 FORMAT "%8.4" EXTENDED_LIMITS -327.6800 327.6700 DEPOSIT ABSOLUTE /end AXIS_DESCR
/end CHARACTERISTIC
/begin CHARACTERISTIC AccPed_trqEng4_MAP "5.Gang: (voreilendes) Zugwunschmoment aus Mot.-Drehz. und AccPed_rChkdVal (resp. APPCD_rAPP1UnFlt)" MAP 0x1C3226 Kf_Xs16_Ys16_Ws16 1000.000 Trq 0.00 1000.000 FORMAT "%8.3" EXTENDED_LIMITS -3276.800 3276.700
 /begin AXIS_DESCR STD_AXIS Eng_nAvrg EngN 16 0.00 6000.000 FORMAT "%8.3" EXTENDED_LIMITS -32768.00 32767.00 DEPOSIT ABSOLUTE /end AXIS_DESCR
 /begin AXIS_DESCR STD_AXIS AccPed_rAPP Prc 9 0.00 100.0000 FORMAT "%8.4" EXTENDED_LIMITS -327.6800 327.6700 DEPOSIT ABSOLUTE /end AXIS_DESCR
/end CHARACTERISTIC
/begin CHARACTERISTIC AccPed_trqEng5_MAP "6.Gang: (voreilendes) Zugwunschmoment aus Mot.-Drehz. und AccPed_rChkdVal (resp. APPCD_rAPP1UnFlt)" MAP 0x1C337C Kf_Xs16_Ys16_Ws16 1000.000 Trq 0.00 1000.000 FORMAT "%8.3" EXTENDED_LIMITS -3276.800 3276.700
 /begin AXIS_DESCR STD_AXIS Eng_nAvrg EngN 16 0.00 6000.000 FORMAT "%8.3" EXTENDED_LIMITS -32768.00 32767.00 DEPOSIT ABSOLUTE /end AXIS_DESCR
 /begin AXIS_DESCR STD_AXIS AccPed_rAPP Prc 9 0.00 100.0000 FORMAT "%8.4" EXTENDED_LIMITS -327.6800 327.6700 DEPOSIT ABSOLUTE /end AXIS_DESCR
/end CHARACTERISTIC
/begin CHARACTERISTIC AccPed_trqEng6_MAP "6.Gang: (voreilendes) Zugwunschmoment aus Mot.-Drehz. und AccPed_rChkdVal (resp. APPCD_rAPP1UnFlt)" MAP 0x1C34D2 Kf_Xs16_Ys16_Ws16 1000.000 Trq 0.00 1000.000 FORMAT "%8.3" EXTENDED_LIMITS -3276.800 3276.700
 /begin AXIS_DESCR STD_AXIS Eng_nAvrg EngN 16 0.00 6000.000 FORMAT "%8.3" EXTENDED_LIMITS -32768.00 32767.00 DEPOSIT ABSOLUTE /end AXIS_DESCR
 /begin AXIS_DESCR STD_AXIS AccPed_rAPP Prc 9 0.00 100.0000 FORMAT "%8.4" EXTENDED_LIMITS -327.6800 327.6700 DEPOSIT ABSOLUTE /end AXIS_DESCR
/end CHARACTERISTIC
/begin CHARACTERISTIC AccPed_trqEngLim_MAP "Kennfeld für den maximal zulässigen Zuganteil des Fahrerwunsches (Kupplungsschutz)" MAP 0x1C3628 Kf_Xs16_Ys16_Ws16 52427.20 TrqPrp 0.00 52427.20 FORMAT "%8.2" EXTENDED_LIMITS -52428.80 52427.20
 /begin AXIS_DESCR STD_AXIS VehDa_rVn VelToN 6 -0.3276800 0.3276700 FORMAT "%9.7" DEPOSIT ABSOLUTE /end AXIS_DESCR
 /begin AXIS_DESCR STD_AXIS Eng_nAvrg EngN 7 -32768.00 32767.00 FORMAT "%8.2" DEPOSIT ABSOLUTE /end AXIS_DESCR
/end CHARACTERISTIC
/begin CHARACTERISTIC AccPed_trqEngLow_MAP "Fahrverhaltenkennfeld für Minimalwert des Fahrerwunsches." MAP 0x1C369A Kf_Xs16_Ys16_Ws16 1000.000 Trq 0.00 1000.000 FORMAT "%8.3" EXTENDED_LIMITS -3276.800 3276.700
 /begin AXIS_DESCR STD_AXIS Eng_nAvrg EngN 16 0.00 6000.000 FORMAT "%8.3" EXTENDED_LIMITS -32768.00 32767.00 DEPOSIT ABSOLUTE /end AXIS_DESCR
 /begin AXIS_DESCR STD_AXIS AccPed_rAPP Prc 9 0.00 100.0000 FORMAT "%8.4" EXTENDED_LIMITS -327.6800 327.6700 DEPOSIT ABSOLUTE /end AXIS_DESCR
/end CHARACTERISTIC
/begin CHARACTERISTIC AccPed_trqNMRMax_C "maximale erlaubte Momentenforderung im nicht überwachbaren Bereich des PWG" VALUE 0x1C37F0 Kw_Ws32 104856.000000 TrqPrpHigh -52428.8000000 52427.2000000 FORMAT "%13.7" EXTENDED_LIMITS -214748364.800 214748364.700 /end CHARACTERISTIC
/begin CHARACTERISTIC AccPed_trqPrpSport_MAP "Kennfeld für Mastershift im Sport-Modus" MAP 0x1C37F4 Kf_Xs16_Ys16_Ws16 52427.20 TrqPrp 0.00 52427.20 FORMAT "%8.2" EXTENDED_LIMITS -52428.80 52427.20
 /begin AXIS_DESCR STD_AXIS VSSCD_v Vel 12 -327.6800 327.6700 FORMAT "%8.4" DEPOSIT ABSOLUTE /end AXIS_DESCR
 /begin AXIS_DESCR STD_AXIS AccPed_rChkdVal Prc 8 -327.6800 327.6700 FORMAT "%8.4" DEPOSIT ABSOLUTE /end AXIS_DESCR
/end CHARACTERISTIC
/begin CHARACTERISTIC AccPed_trqPrp_MAP "Fahrverhaltenkennfeld als Getriebeausgangsmoment für Mastershift Antriebsstrangmanagement" MAP 0x1C38E0 Kf_Xs16_Ys16_Ws16 52427.20 TrqPrp 0.00 52427.20 FORMAT "%8.2" EXTENDED_LIMITS -52428.80 52427.20
 /begin AXIS_DESCR STD_AXIS VSSCD_v Vel 12 -327.6800 327.6700 FORMAT "%8.4" DEPOSIT ABSOLUTE /end AXIS_DESCR
 /begin AXIS_DESCR STD_AXIS AccPed_rChkdVal Prc 8 -327.6800 327.6700 FORMAT "%8.4" DEPOSIT ABSOLUTE /end AXIS_DESCR
/end CHARACTERISTIC
/begin CHARACTERISTIC AccPed_vDODne_C "Obere Geschwindigkeitsgrenze für den Anfahrregler" VALUE 0x1C39CC Kw_Ws16 300.0000 Vel 0.00 300.0000 FORMAT "%8.4" EXTENDED_LIMITS -327.6800 327.6700 /end CHARACTERISTIC
/begin CHARACTERISTIC AccPed_vDOEna_C "Untere Geschwindigkeitsgrenze für den Anfahrregler" VALUE 0x1C39CE Kw_Ws16 300.0000 Vel 0.00 300.0000 FORMAT "%8.4" EXTENDED_LIMITS -327.6800 327.6700 /end CHARACTERISTIC
/begin CHARACTERISTIC AccPed_vLim_C "Geschwindigkeitsschwelle für Freigabe Fahrpedalprüfung" VALUE 0x1C39D0 Kw_Ws16 300.0000 Vel 0.00 300.0000 FORMAT "%8.4" EXTENDED_LIMITS -327.6800 327.6700 /end CHARACTERISTIC
/begin CHARACTERISTIC AccPed_vThresLI_C "Geschwindigkeitschschwelle für Leerlaufsolldrehzahlauswahl" VALUE 0x1C39D4 Kw_Ws16 300.0000 Vel 0.00 300.0000 FORMAT "%8.4" EXTENDED_LIMITS -327.6800 327.6700 /end CHARACTERISTIC
/begin CHARACTERISTIC ACCtl_drAccPedHi_C "obere Hystereseschwelle für Fahrpedaländerung (Abschaltbedingung BESCHLEUNIGUNG)" VALUE 0x1C39D8 Kw_Ws16 32767.50 Prc_D20ms -16384.00 16383.50 FORMAT "%8.2" /end CHARACTERISTIC
/begin CHARACTERISTIC ACCtl_drAccPedLo_C "untere Hystereseschwelle für Fahrpedaländerung (Abschaltbedingung BESCHLEUNIGUNG)" VALUE 0x1C39DA Kw_Ws16 32767.50 Prc_D20ms -16384.00 16383.50 FORMAT "%8.2" /end CHARACTERISTIC
/begin CHARACTERISTIC ACCtl_nAccVehHi_C "obere Hystereseschwelle für Drehzahl (Abschaltbedingung BESCHLEUNIGUNG)" VALUE 0x1C39DC Kw_Ws16 65535.00 EngN -32768.00 32767.00 FORMAT "%8.2" /end CHARACTERISTIC
/begin CHARACTERISTIC ACCtl_nAccVehLo_C "untere Hystereseschwelle für Drehzahl (Abschaltbedingung BESCHLEUNIGUNG)" VALUE 0x1C39DE Kw_Ws16 65535.00 EngN -32768.00 32767.00 FORMAT "%8.2" /end CHARACTERISTIC
/begin CHARACTERISTIC ACCtl_nDAEngHi_C "Obere Hysteresegrenze für Motordrehzahl" VALUE 0x1C39E0 Kw_Ws16 65535.00 EngN -32768.00 32767.00 FORMAT "%8.2" /end CHARACTERISTIC
/begin CHARACTERISTIC ACCtl_nDAEngLo_C "Untere Hysteresegrenze für Motordrehzahl" VALUE 0x1C39E2 Kw_Ws16 65535.00 EngN -32768.00 32767.00 FORMAT "%8.2" /end CHARACTERISTIC
/begin CHARACTERISTIC ACCtl_nKliIdlSpd_C "LL-Solldrehzahl bei Erhöhung durch Klimakompressor" VALUE 0x1C3AC0 Kw_Ws16 6000.000 EngN 0.00 6000.000 FORMAT "%8.3" EXTENDED_LIMITS -32768.00 32767.00 /end CHARACTERISTIC
/begin CHARACTERISTIC ACCtl_nLIGovHi_C "Obere Hysteresegrenze für Motordrehzahl (Abschaltbedingung UNTERSCHNEIDEN DER LEERLAUFDREHZAHL)" VALUE 0x1C39E4 Kw_Ws16 65535.00 EngN -32768.00 32767.00 FORMAT "%8.2" /end CHARACTERISTIC
/begin CHARACTERISTIC ACCtl_nLIGovLo_C "Untere Hysteresegrenze für Motordrehzahl (Abschaltbedingung UNTERSCHNEIDEN DER LEERLAUFDREHZAHL)" VALUE 0x1C39E6 Kw_Ws16 65535.00 EngN -32768.00 32767.00 FORMAT "%8.2" /end CHARACTERISTIC
/begin CHARACTERISTIC ACCtl_nLIGovRelHi_C "Die obere Hystereseschwelle für den Unterschied zwischen der leerlaufdrehzahl und der drehzahl" VALUE 0x1C39E8 Kw_Ws16 65535.00 EngN -32768.00 32767.00 FORMAT "%8.2" /end CHARACTERISTIC
/begin CHARACTERISTIC ACCtl_nLIGovRelLo_C "Die untere Hystereseschwelle für den Unterschied zwischen der leerlaufdrehzahl und der drehzahl" VALUE 0x1C39EA Kw_Ws16 65535.00 EngN -32768.00 32767.00 FORMAT "%8.2" /end CHARACTERISTIC
/begin CHARACTERISTIC ACCtl_nOffset_C "Offset für Leerlaufsolldrehzahl bei  Drezahlschwelle" VALUE 0x1C3AC2 Kw_Ws16 6000.000 EngN 0.00 6000.000 FORMAT "%8.3" EXTENDED_LIMITS -32768.00 32767.00 /end CHARACTERISTIC
/begin CHARACTERISTIC ACCtl_nSysErrHi_C "obere Hysteresegrenze für Motordrehzahl (Abschaltbedingung SYSTEMFEHLER)" VALUE 0x1C39EC Kw_Ws16 65535.00 EngN -32768.00 32767.00 FORMAT "%8.2" /end CHARACTERISTIC
/begin CHARACTERISTIC ACCtl_nSysErrLo_C "Untere Hysteresegrenze für Motordrehzahl (Abschaltbedingung SYSTEMFEHLER)" VALUE 0x1C39EE Kw_Ws16 65535.00 EngN -32768.00 32767.00 FORMAT "%8.2" /end CHARACTERISTIC
/begin CHARACTERISTIC ACCtl_pAccValHi_C "obere Hystereseschwelle für  Atmosphärendruck (Abschaltbedingung BESCHLEUNIGUNG)" VALUE 0x1C39F0 Kw_Ws16 65535.00 Pres_hPa -32768.00 32767.00 FORMAT "%8.2" /end CHARACTERISTIC
/begin CHARACTERISTIC ACCtl_pAccValLo_C "untere Hystereseschwelle für  Atmosphärendruck (Abschaltbedingung BESCHLEUNIGUNG)" VALUE 0x1C39F2 Kw_Ws16 65535.00 Pres_hPa -32768.00 32767.00 FORMAT "%8.2" /end CHARACTERISTIC
/begin CHARACTERISTIC ACCtl_pACPMaxHi_C "obere Hystereseschwelle für  Kältemitteldruck (Abschaltbedingung KÄLTEMITTELDRUCK)" VALUE 0x1C39F4 Kw_Ws16 131070.0 PresAC_hPa -65536.00 65534.00 FORMAT "%8.2" /end CHARACTERISTIC
/begin CHARACTERISTIC ACCtl_pACPMaxLo_C "untere Hystereseschwelle für  Kältemitteldruck (Abschaltbedingung KÄLTEMITTELDRUCK)" VALUE 0x1C39F6 Kw_Ws16 131070.0 PresAC_hPa -65536.00 65534.00 FORMAT "%8.2" /end CHARACTERISTIC
/begin CHARACTERISTIC ACCtl_pACPMinHi_C "obere Hystereseschwelle für  Kältemitteldruck (Abschaltbedingung KÄLTEMITTELDRUCK)" VALUE 0x1C39F8 Kw_Ws16 131070.0 PresAC_hPa -65536.00 65534.00 FORMAT "%8.2" /end CHARACTERISTIC
/begin CHARACTERISTIC ACCtl_pACPMinLo_C "untere Hystereseschwelle für  Kältemitteldruck (Abschaltbedingung KÄLTEMITTELDRUCK)" VALUE 0x1C39FA Kw_Ws16 131070.0 PresAC_hPa -65536.00 65534.00 FORMAT "%8.2" /end CHARACTERISTIC
/begin CHARACTERISTIC ACCtl_rAccPedHi_C "obere Hystereseschwelle für Fahrpedal (Abschaltbedingung BESCHLEUNIGUNG)" VALUE 0x1C39FC Kw_Ws16 655.3500 Prc -327.6800 327.6700 FORMAT "%8.4" /end CHARACTERISTIC
/begin CHARACTERISTIC ACCtl_rAccPedLo_C "untere Hystereseschwelle für Fahrpedal (Abschaltbedingung BESCHLEUNIGUNG)" VALUE 0x1C39FE Kw_Ws16 655.3500 Prc -327.6800 327.6700 FORMAT "%8.4" /end CHARACTERISTIC
/begin CHARACTERISTIC ACCtl_stDAGearHi_C "obere Hystereseschwelle für Gearbx_stGear (Abschaltbedingung ANFAHREN)" VALUE 0x1C3A00 Kw_Ws8 255.0 OneToOne -128.0 127.0 FORMAT "%5.1" /end CHARACTERISTIC
/begin CHARACTERISTIC ACCtl_stDAGearLo_C "untere Hystereseschwelle für Gearbx_stGearl (Abschaltbedingung ANFAHREN)" VALUE 0x1C3A01 Kw_Ws8 255.0 OneToOne -128.0 127.0 FORMAT "%5.1" /end CHARACTERISTIC
/begin CHARACTERISTIC ACCtl_stShtOffMinSwtOnTime_C "Aktivierung der Funktionalität ¿Deaktivierung der minimalen Einschaltdauer¿" VALUE 0x1C3AC4 Kw_Wu8 1.000 OneToOne 0.00 1.000 FORMAT "%5.3" EXTENDED_LIMITS 0.00 255.0 /end CHARACTERISTIC
/begin CHARACTERISTIC ACCtl_swtEnableRequest_C "Freigabe der Klimaanforderungen für LL-Solldrehzahlerhöhung" VALUE 0x1C3AC5 Kw_Wu8 15.00 OneToOne 0.00 15.00 FORMAT "%5.2" EXTENDED_LIMITS 0.00 255.0 /end CHARACTERISTIC
/begin CHARACTERISTIC ACCtl_swtFanErrEna_C "Schalter zur Aktivierung der Abschaltbedingungen wegen Lüfterfehler" VALUE 0x1C3A02 Kw_Wu8 255.0 OneToOne 0.00 255.0 FORMAT "%5.1" /end CHARACTERISTIC
/begin CHARACTERISTIC ACCtl_swtnLIGovRelEna_C "Schalter zur Aktivierung der abschaltbedingung aufgrund der leerlaufdrehzahl" VALUE 0x1C3A03 Kw_Wu8 1.000 OneToOne 0.00 1.000 FORMAT "%5.3" EXTENDED_LIMITS 0.00 255.0 /end CHARACTERISTIC
/begin CHARACTERISTIC ACCtl_swtoff_mode_C "Schalter: Abschaltung/Leistungsreduzierung" VALUE 0x1C3AC6 Kw_Wu16 65535.00 OneToOne 0.00 65535.00 FORMAT "%8.2" /end CHARACTERISTIC
/begin CHARACTERISTIC ACCtl_swtSelAirTemp_C "Umschalter Umgebungslufttemperatur und Ansauglufttemperatur" VALUE 0x1C3AC8 Kw_Wu8 1.000 OneToOne 0.00 1.000 FORMAT "%5.3" EXTENDED_LIMITS 0.00 255.0 /end CHARACTERISTIC
/begin CHARACTERISTIC ACCtl_swtTempACOff_C "Schalter der Temperaturwert des Arrays auswählt" VALUE 0x1C3A04 Kw_Wu8 4.00000000000 EngTempFldSel 0.00 4.00000000000 FORMAT "%13.11" /end CHARACTERISTIC
/begin CHARACTERISTIC ACCtl_swtTempHys_C "Schalter derTemperaturwert des Arrays auswählt" VALUE 0x1C3A05 Kw_Wu8 4.00000000000 EngTempFldSel 0.00 4.00000000000 FORMAT "%13.11" /end CHARACTERISTIC
/begin CHARACTERISTIC ACCtl_swtVehStand_C "Schalter für Aktivierung der ""Fahrzeug Stillstand"" Erkennung für die Klimaanlage" VALUE 0x1C3AC9 Kw_Wu8 1.000 OneToOne 0.00 1.000 FORMAT "%5.3" EXTENDED_LIMITS 0.00 255.0 /end CHARACTERISTIC
/begin CHARACTERISTIC ACCtl_swtVehStopEna_C "Schalter zum Freischalten der Anschaltbedingung Anfahren für Klimaanlafge lastlos" VALUE 0x1C3A06 Kw_Wu8 255.0 OneToOne 0.00 255.0 FORMAT "%5.1" /end CHARACTERISTIC
/begin CHARACTERISTIC ACCtl_tAccAir1Hi_C "obere Hystereseschwelle für Umgebungstemperatur (Abschaltbedingung BESCHLEUNIGUNG)" VALUE 0x1C3A08 Kw_Ws16 6553.500 Temp_Cels -3549.940 3003.560 FORMAT "%8.3" /end CHARACTERISTIC
/begin CHARACTERISTIC ACCtl_tAccAir1Lo_C "untere Hystereseschwelle für Umgebungstemperatur (Abschaltbedingung BESCHLEUNIGUNG)" VALUE 0x1C3A0A Kw_Ws16 6553.500 Temp_Cels -3549.940 3003.560 FORMAT "%8.3" /end CHARACTERISTIC
/begin CHARACTERISTIC ACCtl_tAccAir2Hi_C "obere Hystereseschwelle für Umgebungstemperatur (Abschaltbedingung BESCHLEUNIGUNG)" VALUE 0x1C3A0C Kw_Ws16 6553.500 Temp_Cels -3549.940 3003.560 FORMAT "%8.3" /end CHARACTERISTIC
/begin CHARACTERISTIC ACCtl_tAccAir2Lo_C "untere Hystereseschwelle für Umgebungstemperatur (Abschaltbedingung BESCHLEUNIGUNG)" VALUE 0x1C3A0E Kw_Ws16 6553.500 Temp_Cels -3549.940 3003.560 FORMAT "%8.3" /end CHARACTERISTIC
/begin CHARACTERISTIC ACCtl_tACPairHi_C "obere Hystereseschwelle für Umgebungstemperatur (Abschaltbedingung KÄLTEMITTELDRUCK)" VALUE 0x1C3A10 Kw_Ws16 6553.500 Temp_Cels -3549.940 3003.560 FORMAT "%8.3" /end CHARACTERISTIC
/begin CHARACTERISTIC ACCtl_tACPairLo_C "untere Hystereseschwelle für Umgebungstemperatur (Abschaltbedingung KÄLTEMITTELDRUCK)" VALUE 0x1C3A12 Kw_Ws16 6553.500 Temp_Cels -3549.940 3003.560 FORMAT "%8.3" /end CHARACTERISTIC
/begin CHARACTERISTIC ACCtl_tClntMin_C "Minimale Wassertemperaturschwelle" VALUE 0x1C3ACC Kw_Ws16 200.0000 Temp_Cels -50.14000 149.8600 FORMAT "%8.4" EXTENDED_LIMITS -3549.940 3003.560 /end CHARACTERISTIC
/begin CHARACTERISTIC ACCtl_tiAccAirMin_C "Mindestzeit die ACCtl_stLogicOut == 1 sein muß (Abschaltbedingung BESCHLEUNIGUNG)" VALUE 0x1C3A14 Kw_Wu16 200000.0 Time_ms 0.00 200000.0 FORMAT "%8.1" EXTENDED_LIMITS 0.00 655350.0 /end CHARACTERISTIC
/begin CHARACTERISTIC ACCtl_tiAccMin_C "Mindestabschaltdauer durch Abschaltbedingung Beschleunigung" VALUE 0x1C3A16 Kw_Wu16 200000.0 Time_ms 0.00 200000.0 FORMAT "%8.1" EXTENDED_LIMITS 0.00 655350.0 /end CHARACTERISTIC
/begin CHARACTERISTIC ACCtl_tiACOnDly_C "Klima EIN Verzögerung" VALUE 0x1C3A18 Kw_Wu16 200000.0 Time_ms 0.00 200000.0 FORMAT "%8.1" EXTENDED_LIMITS 0.00 655350.0 /end CHARACTERISTIC
/begin CHARACTERISTIC ACCtl_tiACPmin_C "Mindestabschaltdauer durch Abschaltbedingung AC-KÄLTEMITTELDRUCK" VALUE 0x1C3A1A Kw_Wu16 200000.0 Time_ms 0.00 200000.0 FORMAT "%8.1" EXTENDED_LIMITS 0.00 655350.0 /end CHARACTERISTIC
/begin CHARACTERISTIC ACCtl_tiACStrtDly_CUR "Kennlinie: abhängig vom Klimadruck, die Startens der Klimaanlage zu bestimmen" CURVE 0x1C3A1C Kl_Xs16_Ws16 327570.0 Time_ms 0.00 327570.0 FORMAT "%8.1" EXTENDED_LIMITS -327680.0 327670.0
 /begin AXIS_DESCR STD_AXIS ACCD_p PresAC_hPa 4 0.00 50800.00 FORMAT "%8.2" EXTENDED_LIMITS -65536.00 65534.00 DEPOSIT ABSOLUTE /end AXIS_DESCR
/end CHARACTERISTIC
/begin CHARACTERISTIC ACCtl_tiCANESCU_C "Mindestabschaltdauer durch Abschaltbedingung CAN-ESCU" VALUE 0x1C3A2E Kw_Wu16 200000.0 Time_ms 0.00 200000.0 FORMAT "%8.1" EXTENDED_LIMITS 0.00 655350.0 /end CHARACTERISTIC
/begin CHARACTERISTIC ACCtl_tiCANGearbx_C "Mindestabschaltdauer durch Abschaltbedingung CAN-EGS" VALUE 0x1C3A30 Kw_Wu16 200000.0 Time_ms 0.00 200000.0 FORMAT "%8.1" EXTENDED_LIMITS 0.00 655350.0 /end CHARACTERISTIC
/begin CHARACTERISTIC ACCtl_tiDAmax_MAP "max Zeit für Abschalten AC beim Anfahren" MAP 0x1C3A32 Kf_Xs16_Ys16_Ws16 327570.0 Time_ms 0.00 327570.0 FORMAT "%8.1" EXTENDED_LIMITS -327680.0 327670.0
 /begin AXIS_DESCR STD_AXIS ACCtl_tACOff_mp Temp_Cels 4 -50.14000 199.8600 FORMAT "%8.4" EXTENDED_LIMITS -3549.940 3003.560 DEPOSIT ABSOLUTE /end AXIS_DESCR
 /begin AXIS_DESCR STD_AXIS APSCD_pVal Pres_hPa 4 0.00 3500.000 FORMAT "%8.3" EXTENDED_LIMITS -32768.00 32767.00 DEPOSIT ABSOLUTE /end AXIS_DESCR
/end CHARACTERISTIC
/begin CHARACTERISTIC ACCtl_tiDAmin_MAP "min Zeit für Abschalten AC beim Anfahren" MAP 0x1C3A66 Kf_Xs16_Ys16_Ws16 327570.0 Time_ms 0.00 327570.0 FORMAT "%8.1" EXTENDED_LIMITS -327680.0 327670.0
 /begin AXIS_DESCR STD_AXIS ACCtl_tACOff_mp Temp_Cels 4 -50.14000 199.8600 FORMAT "%8.4" EXTENDED_LIMITS -3549.940 3003.560 DEPOSIT ABSOLUTE /end AXIS_DESCR
 /begin AXIS_DESCR STD_AXIS APSCD_pVal Pres_hPa 4 0.00 3500.000 FORMAT "%8.3" EXTENDED_LIMITS -32768.00 32767.00 DEPOSIT ABSOLUTE /end AXIS_DESCR
/end CHARACTERISTIC
/begin CHARACTERISTIC ACCtl_tiLIGov_C "Mindestabschaltdauer durch Abschaltbedingung UNTERSCHNEIDEN DER LEERLAUFDREHZAHL" VALUE 0x1C3A9A Kw_Wu16 200000.0 Time_ms 0.00 200000.0 FORMAT "%8.1" EXTENDED_LIMITS 0.00 655350.0 /end CHARACTERISTIC
/begin CHARACTERISTIC ACCtl_tiMaxTSCfreezeReduction_C "maximale Einfrierzeit durch TSC Eingriff bei Leistungsreduzierung" VALUE 0x1C3ACE Kw_Ws16 200000.0 Time_ms 0.00 200000.0 FORMAT "%8.1" EXTENDED_LIMITS -327680.0 327670.0 /end CHARACTERISTIC
/begin CHARACTERISTIC ACCtl_tiMaxTSCfreeze_C "maximale Klimakompressorstatus - Einfrierzeit für TSC (EGS) Eingriff" VALUE 0x1C3AD0 Kw_Ws16 200000.0 Time_ms 0.00 200000.0 FORMAT "%8.1" EXTENDED_LIMITS -327680.0 327670.0 /end CHARACTERISTIC
/begin CHARACTERISTIC ACCtl_tiMinSwitchOn_C "Mindesteinschaltdauer" VALUE 0x1C3AD2 Kw_Wu16 200000.0 Time_ms 0.00 200000.0 FORMAT "%8.1" EXTENDED_LIMITS 0.00 655350.0 /end CHARACTERISTIC
/begin CHARACTERISTIC ACCtl_tiMinSwitchReduction_C "Mindesteinschaltdauer für Leistungsdauer" VALUE 0x1C3AD4 Kw_Wu16 200000.0 Time_ms 0.00 200000.0 FORMAT "%8.1" EXTENDED_LIMITS 0.00 655350.0 /end CHARACTERISTIC
/begin CHARACTERISTIC ACCtl_tiStrtOn_C "Aktivierungsdauer nach erfolgtem Start" VALUE 0x1C3AD6 Kw_Wu16 200000.0 Time_ms 0.00 200000.0 FORMAT "%8.1" EXTENDED_LIMITS 0.00 655350.0 /end CHARACTERISTIC
/begin CHARACTERISTIC ACCtl_tiSysErrmin_C "Mindestabschaltdauer durch Abschaltbedingung SYSTEM FEHLER" VALUE 0x1C3A9C Kw_Wu16 200000.0 Time_ms 0.00 200000.0 FORMAT "%8.1" EXTENDED_LIMITS 0.00 655350.0 /end CHARACTERISTIC
/begin CHARACTERISTIC ACCtl_tiTempRedMin_C "minimale Zeit für Leistungsreduktion wegen Übertemperatur" VALUE 0x1C3A9E Kw_Wu16 200000.0 Time_ms 0.00 200000.0 FORMAT "%8.1" EXTENDED_LIMITS 0.00 655350.0 /end CHARACTERISTIC
/begin CHARACTERISTIC ACCtl_tiWTmin_C "Mindestabschaltdauer durch Abschaltbedingung WASSERTEMPERATUR" VALUE 0x1C3AA0 Kw_Wu16 200000.0 Time_ms 0.00 200000.0 FORMAT "%8.1" EXTENDED_LIMITS 0.00 655350.0 /end CHARACTERISTIC
/begin CHARACTERISTIC ACCtl_tTempRedHi_C "obere Hystereseschwelle für Temperatur (Leistungsreduktion des  Klimakompressors)" VALUE 0x1C3AA2 Kw_Ws16 6553.500 Temp_Cels -3549.940 3003.560 FORMAT "%8.3" /end CHARACTERISTIC
/begin CHARACTERISTIC ACCtl_tTempRedLo_C "untere Hystereseschwelle für Temperatur (Leistungsreduktion des  Klimakompressors)" VALUE 0x1C3AA4 Kw_Ws16 6553.500 Temp_Cels -3549.940 3003.560 FORMAT "%8.3" /end CHARACTERISTIC
/begin CHARACTERISTIC ACCtl_tWTHi_CUR "Geschwindigkeit / Temperatur Konverter - obere Hys. schwelle (Abschaltbedingung WASSERTEMPERATUR)" CURVE 0x1C3AA6 Kl_Xs16_Ws16 200.0000 Temp_Cels -50.14000 149.8600 FORMAT "%8.4" EXTENDED_LIMITS -3549.940 3003.560
 /begin AXIS_DESCR STD_AXIS VSSCD_v Vel 3 0.00 300.0000 FORMAT "%8.4" EXTENDED_LIMITS -327.6800 327.6700 DEPOSIT ABSOLUTE /end AXIS_DESCR
/end CHARACTERISTIC
/begin CHARACTERISTIC ACCtl_tWTSubthresh_C "Hysteresebreite für Temperatur (aus Temperaturarray) Abschaltbedingung" VALUE 0x1C3AB4 Kw_Ws16 6553.500 TempDiff_Kelv -3276.800 3276.700 FORMAT "%8.3" /end CHARACTERISTIC
/begin CHARACTERISTIC ACCtl_vAccVehHi_C "obere Hystereseschwelle für Fahrgeschwindigkeit (Abschaltbedingung BESCHLEUNIGUNG)" VALUE 0x1C3AB6 Kw_Ws16 655.3500 Vel -327.6800 327.6700 FORMAT "%8.4" /end CHARACTERISTIC
/begin CHARACTERISTIC ACCtl_vAccVehLo_C "untere Hystereseschwelle für Fahrgeschwindigkeit (Abschaltbedingung BESCHLEUNIGUNG)" VALUE 0x1C3AB8 Kw_Ws16 655.3500 Vel -327.6800 327.6700 FORMAT "%8.4" /end CHARACTERISTIC
/begin CHARACTERISTIC ACCtl_vDAVehHi_C "Obere Hysteresegrenze für Fahrzeuggeschwindigkeit" VALUE 0x1C3ABA Kw_Ws16 655.3500 Vel -327.6800 327.6700 FORMAT "%8.4" /end CHARACTERISTIC
/begin CHARACTERISTIC ACCtl_vDAVehLo_C "Untere Hysteresegrenze für Fahrzeuggeschwindigkeit" VALUE 0x1C3ABC Kw_Ws16 655.3500 Vel -327.6800 327.6700 FORMAT "%8.4" /end CHARACTERISTIC
/begin CHARACTERISTIC ACCtl_vVehStop_C "Fahrzeuggeschwindigkeit bis zu der das Fahrzeug als stehend erkannt wird für die Abschaltbedingung Anfahren bei Klimaanlage" VALUE 0x1C3ABE Kw_Ws16 655.3500 Vel -327.6800 327.6700 FORMAT "%8.4" /end CHARACTERISTIC
/begin CHARACTERISTIC ACTrqC_tiDT1TrqDyn_C "Reziprokzeit T1 für DT1" VALUE 0x1C3AD8 Kw_Wu32 0.89999315 TimeDelay_s 0.099999239 0.99999239 FORMAT "%9.7" EXTENDED_LIMITS 0.0000010000000 4294.9673 /end CHARACTERISTIC
/begin CHARACTERISTIC ACTrqC_dDT1TrqDynfact_C "Verstärkungsfaktor für DT1" VALUE 0x1C3ADC Kw_Ws32 0.00 Kd 1.00000000000 1.00000000000 FORMAT "%13.11" EXTENDED_LIMITS -32768.0000000 32767.9999847 /end CHARACTERISTIC
/begin CHARACTERISTIC ACTrqC_factDiv_C "Divisionsfaktor für Übersetzungsverhältnis (Motor / Kompressor)" VALUE 0x1C3AE0 Kw_Ws16 255.0000 Fact1 0.00 255.0000 FORMAT "%8.4" EXTENDED_LIMITS -256.0000 255.9922 /end CHARACTERISTIC
/begin CHARACTERISTIC ACTrqC_factMul_C "Multiplikationsfaktor für Übersetzungsverhältnis (Motor / Kompressor)" VALUE 0x1C3AE2 Kw_Ws16 255.0000 Fact1 0.00 255.0000 FORMAT "%8.4" EXTENDED_LIMITS -256.0000 255.9922 /end CHARACTERISTIC
/begin CHARACTERISTIC ACTrqC_swtCalc_C "Wert des Softwareschalters Eingangsgröße ACTrqC" VALUE 0x1C3AE4 Kw_Wu8 1.000 OneToOne 0.00 1.000 FORMAT "%5.3" EXTENDED_LIMITS 0.00 255.0 /end CHARACTERISTIC
/begin CHARACTERISTIC ACTrqC_swtCANtrq_C "Schalter für die Momentenanforderug via CAN" VALUE 0x1C3AE5 Kw_Wu8 255.0 OneToOne 0.00 255.0 FORMAT "%5.1" /end CHARACTERISTIC
/begin CHARACTERISTIC ACTrqC_trqConvp_MAP "Kennfeld für Reibmomentberechnung Über KÜhlmitteldruck" MAP 0x1C3AE6 Kf_Xs16_Ys16_Ws16 50.00000 Trq 0.00 50.00000 FORMAT "%8.5" EXTENDED_LIMITS -3276.800 3276.700
 /begin AXIS_DESCR STD_AXIS Eng_nAvrg EngN 8 0.00 6000.000 FORMAT "%8.3" EXTENDED_LIMITS -32768.00 32767.00 DEPOSIT ABSOLUTE /end AXIS_DESCR
 /begin AXIS_DESCR STD_AXIS ACCD_p PresAC_hPa 8 0.00 50800.00 FORMAT "%8.2" EXTENDED_LIMITS -65536.00 65534.00 DEPOSIT ABSOLUTE /end AXIS_DESCR
/end CHARACTERISTIC
/begin CHARACTERISTIC ACTrqC_trqConvt_MAP "Kennfeld für Reibmomentberechnung Über Luft-temperaturgeber" MAP 0x1C3B8A Kf_Xs16_Ys16_Ws16 50.00000 Trq 0.00 50.00000 FORMAT "%8.5" EXTENDED_LIMITS -3276.800 3276.700
 /begin AXIS_DESCR STD_AXIS Eng_nAvrg EngN 8 0.00 6000.000 FORMAT "%8.3" EXTENDED_LIMITS -32768.00 32767.00 DEPOSIT ABSOLUTE /end AXIS_DESCR
 /begin AXIS_DESCR STD_AXIS IATSCD_tAir Temp_Cels 8 -50.14000 199.8600 FORMAT "%8.4" EXTENDED_LIMITS -3549.940 3003.560 DEPOSIT ABSOLUTE /end AXIS_DESCR
/end CHARACTERISTIC
/begin CHARACTERISTIC AC_pwrAdjValDef_C "Standardwert für Abgleich Leistungsanforderung Klimakompressor" VALUE 0x1C2034 Kw_Ws16 0.00 Fact 1.000000 1.000000 FORMAT "%8.6" EXTENDED_LIMITS -4.000000 3.999878 /end CHARACTERISTIC
/begin CHARACTERISTIC AC_pwrAdjValMax_C "Maximalwert für Abgleich Leistungsanforderung Klimakompressor" VALUE 0x1C2036 Kw_Ws16 3.199951 Fact 0.00 3.199951 FORMAT "%8.6" EXTENDED_LIMITS -4.000000 3.999878 /end CHARACTERISTIC
/begin CHARACTERISTIC AC_pwrAdjValMin_C "Minimalwert für Abgleich Leistungsanforderung Klimakompressor" VALUE 0x1C2038 Kw_Ws16 3.199951 Fact 0.00 3.199951 FORMAT "%8.6" EXTENDED_LIMITS -4.000000 3.999878 /end CHARACTERISTIC
/begin CHARACTERISTIC AC_rTrans_C "Übersetzung des Klimakompressorantriebs" VALUE 0x1C203A Kw_Ws16 427.6800 TransR -327.6800 100.0000 FORMAT "%8.4" EXTENDED_LIMITS -327.6800 327.6700 /end CHARACTERISTIC
/begin CHARACTERISTIC ADCMon_DebQueueDef_C "Fehlerentprellzeit für ADC-Queue-Fehler" VALUE 0x1C1FC2 Kw_Wu16 655350.0 Time_ms 0.00 655350.0 FORMAT "%8.1" /end CHARACTERISTIC
/begin CHARACTERISTIC ADCMon_DebRefVltgSRCDef_C "Fehlerentprellzeit für ADC-Referenzspannungsfehler" VALUE 0x1C1FC4 Kw_Wu16 655350.0 Time_ms 0.00 655350.0 FORMAT "%8.1" /end CHARACTERISTIC
/begin CHARACTERISTIC ADCMon_DebTstImpDef_C "Fehleranzahl für ADC-Testimpulsfehler (ereignisentprellt)" VALUE 0x1C1FC6 Kw_Wu16 65535.00 OneToOne 0.00 65535.00 FORMAT "%8.2" /end CHARACTERISTIC
/begin CHARACTERISTIC ADCMon_nQueueMon_C "Drehzahlschwelle für Ablaufkontrolle der ereignissynchronen ADC-Queueüberwachung" VALUE 0x1C1FC8 Kw_Ws16 6000.000 EngN 0.00 6000.000 FORMAT "%8.3" EXTENDED_LIMITS -32768.00 32767.00 /end CHARACTERISTIC
/begin CHARACTERISTIC ADCMon_tiQueueMon_C "Timeout für Ablaufkontrolle der ereignissynchronen ADC-Queueüberwachung" VALUE 0x1C1FCC Kw_Wu16 1310700. Time_ms_20ms 0.00 1310700. FORMAT "%8.0" /end CHARACTERISTIC
/begin CHARACTERISTIC ADCMon_tiSendTstImp_C "Zeitabstand zwischen zwei ADC-Testimpulsen" VALUE 0x1C1FCE Kw_Wu16 655330.0 Time_ms 20.00000 655350.0 FORMAT "%8.1" EXTENDED_LIMITS 0.00 655350.0 /end CHARACTERISTIC
/begin CHARACTERISTIC ADCMon_uRefSRCMax_C "Obere Grenze für ADC-Referenzspannung" VALUE 0x1C1FD0 Kw_Ws16 5200.391 Volt 0.00 5200.391 FORMAT "%8.3" EXTENDED_LIMITS -160156.4 160151.5 /end CHARACTERISTIC
/begin CHARACTERISTIC ADCMon_uRefSRCMin_C "Untere Grenze für ADC-Referenzspannung" VALUE 0x1C1FD2 Kw_Ws16 5200.391 Volt 0.00 5200.391 FORMAT "%8.3" EXTENDED_LIMITS -160156.4 160151.5 /end CHARACTERISTIC
/begin CHARACTERISTIC ADCMon_uTstImpSRCMax_C "Obere Grenze für ADC-Testimpulsspannung" VALUE 0x1C1FD4 Kw_Ws16 5200.391 Volt 0.00 5200.391 FORMAT "%8.3" EXTENDED_LIMITS -160156.4 160151.5 /end CHARACTERISTIC
/begin CHARACTERISTIC AFSCD_dmAirThrSRCLo_C "untere SRC Grenze des HFM Luftmassensignals" VALUE 0x1C3C30 Kw_Ws16 2000.000 AirMassPerTime -1000.000 1000.000 FORMAT "%8.3" EXTENDED_LIMITS -3276.800 3276.700 /end CHARACTERISTIC
/begin CHARACTERISTIC AFSCD_dmAirThrSRCHi_C "obere SRC Grenze des HFM Luftmassensignals" VALUE 0x1C3C32 Kw_Ws16 1000.000 AirMassPerTime 0.00 1000.000 FORMAT "%8.3" EXTENDED_LIMITS -3276.800 3276.700 /end CHARACTERISTIC
/begin CHARACTERISTIC AFSCD_dmLin_CUR "Linearisierungkennline Sensorspannung in Luftmasse pro Zeit" CURVE 0x1C3C34 Kl_Xs16_Ws16 2000.000 AirMassPerTime -1000.000 1000.000 FORMAT "%8.3" EXTENDED_LIMITS -3276.800 3276.700
 /begin AXIS_DESCR STD_AXIS AFSCD_uRaw Volt 32 0.00 5200.391 FORMAT "%8.3" EXTENDED_LIMITS -160156.4 160151.5 DEPOSIT ABSOLUTE /end AXIS_DESCR
/end CHARACTERISTIC
/begin CHARACTERISTIC AFSCD_facSwtOnCor_C "MLB Anfangswert der HFM-Einschaltkorrektur" VALUE 0x1C3CB6 Kw_Ws16 3.000000 Fact 0.00 3.000000 FORMAT "%8.6" EXTENDED_LIMITS -4.000000 3.999878 /end CHARACTERISTIC
/begin CHARACTERISTIC AFSCD_tiSwtOnCor_C "MLB Zeitkonstante fuer die HFM-Einschaltkorrektur" VALUE 0x1C3CB8 Kw_Wu16 65540.00 Time_ms 0.00 65540.00 FORMAT "%8.2" EXTENDED_LIMITS 0.00 655350.0 /end CHARACTERISTIC
/begin CHARACTERISTIC AFSCD_DebPlHiOffsDrftDef_C "Fehlerentprellzeit fuer Plausibilitaetscheck des Offsetdrifts High" VALUE 0x1C3CBA Kw_Wu16 655350.0 Time_ms 0.00 655350.0 FORMAT "%8.1" /end CHARACTERISTIC
/begin CHARACTERISTIC AFSCD_DebPlHiOffsDrftOk_C "Heilungsentprellzeit fuer Plausibilitaetscheck des Offsetdrifts High" VALUE 0x1C3CBC Kw_Wu16 655350.0 Time_ms 0.00 655350.0 FORMAT "%8.1" /end CHARACTERISTIC
/begin CHARACTERISTIC AFSCD_DebPlHiSetyDrftDef_C "Defektentprellzeit für Plausibilisierung der oberen Luftmassnesensor-Empfindlichkeitsdriftgrenze" VALUE 0x1C3CBE Kw_Wu16 655350.0 Time_ms 0.00 655350.0 FORMAT "%8.1" /end CHARACTERISTIC
/begin CHARACTERISTIC AFSCD_DebPlHiSetyDrftOk_C "Heilungsentprellzeit für Plausibilisierung der oberen Luftmassensensor-Empfindlichkeitsdriftgrenze" VALUE 0x1C3CC0 Kw_Wu16 655350.0 Time_ms 0.00 655350.0 FORMAT "%8.1" /end CHARACTERISTIC
/begin CHARACTERISTIC AFSCD_DebPlLoOffsDrftDef_C "LMM Plausibilitaet Offsetdrift HFM5 1ms Defekterkennungs-Zeit" VALUE 0x1C3CC2 Kw_Wu16 655350.0 Time_ms 0.00 655350.0 FORMAT "%8.1" /end CHARACTERISTIC
/begin CHARACTERISTIC AFSCD_DebPlLoOffsDrftOk_C "LMM Plausibilitaet Offsetdrift HFM5 1ms Intakterkennungs-Zeit" VALUE 0x1C3CC4 Kw_Wu16 655350.0 Time_ms 0.00 655350.0 FORMAT "%8.1" /end CHARACTERISTIC
/begin CHARACTERISTIC AFSCD_DebPlLoSetyDrftDef_C "Defektentprellzeit für Plausibilisierung der unteren Luftmassensensor-Empfindlichkeitsdriftgrenze" VALUE 0x1C3CC6 Kw_Wu16 655350.0 Time_ms 0.00 655350.0 FORMAT "%8.1" /end CHARACTERISTIC
/begin CHARACTERISTIC AFSCD_DebPlLoSetyDrftOk_C "Heilungsentprellzeit für Plausibilisierung der unteren Luftmassensensor-Empfindlichkeitsdriftgrenze [ms]" VALUE 0x1C3CC8 Kw_Wu16 655350.0 Time_ms 0.00 655350.0 FORMAT "%8.1" /end CHARACTERISTIC
/begin CHARACTERISTIC AFSCD_DebSRCHiAirmDef_C "HFM5 Signal oberer SRC Defekterkennungs-Zeit" VALUE 0x1C3CCA Kw_Wu16 655350.0 Time_ms 0.00 655350.0 FORMAT "%8.1" /end CHARACTERISTIC
/begin CHARACTERISTIC AFSCD_DebSRCHiAirmOk_C "HFM5 Signal oberer SRC Intakterkennungs-Zeit" VALUE 0x1C3CCC Kw_Wu16 655350.0 Time_ms 0.00 655350.0 FORMAT "%8.1" /end CHARACTERISTIC
/begin CHARACTERISTIC AFSCD_DebSRCHiSplyVltgDef_C "LMM  Speisung oberer  SRC  Defekterkennungs-Zeit" VALUE 0x1C3CCE Kw_Wu16 655350.0 Time_ms 0.00 655350.0 FORMAT "%8.1" /end CHARACTERISTIC
/begin CHARACTERISTIC AFSCD_DebSRCHiSplyVltgOk_C "LMM  Speisung oberer  SRC  Intakterkennungs-Zeit" VALUE 0x1C3CD0 Kw_Wu16 655350.0 Time_ms 0.00 655350.0 FORMAT "%8.1" /end CHARACTERISTIC
/begin CHARACTERISTIC AFSCD_DebSRCLoAirmDef_C "HFM5 Signal unterer SRC Defekterkennungs-Zeit" VALUE 0x1C3CD2 Kw_Wu16 655350.0 Time_ms 0.00 655350.0 FORMAT "%8.1" /end CHARACTERISTIC
/begin CHARACTERISTIC AFSCD_DebSRCLoAirmOk_C "HFM5 Signal unterer SRC Intakterkennungs-Zeit" VALUE 0x1C3CD4 Kw_Wu16 655350.0 Time_ms 0.00 655350.0 FORMAT "%8.1" /end CHARACTERISTIC
/begin CHARACTERISTIC AFSCD_DebSRCLoSplyVltgDef_C "LMM  Speisung unterer SRC  Defekterkennungs-Zeit" VALUE 0x1C3CD6 Kw_Wu16 655350.0 Time_ms 0.00 655350.0 FORMAT "%8.1" /end CHARACTERISTIC
/begin CHARACTERISTIC AFSCD_DebSRCLoSplyVltgOk_C "LMM  Speisung unterer SRC  Intakterkennungs-Zeit" VALUE 0x1C3CD8 Kw_Wu16 655350.0 Time_ms 0.00 655350.0 FORMAT "%8.1" /end CHARACTERISTIC
/begin CHARACTERISTIC AFSCD_dmAirPerTimeDfl_C "Luftmasse pro Zeit Vorgabewert" VALUE 0x1C3CDA Kw_Ws16 1000.000 AirMassPerTime 0.00 1000.000 FORMAT "%8.3" EXTENDED_LIMITS -3276.800 3276.700 /end CHARACTERISTIC
/begin CHARACTERISTIC AFSCD_dmCorrAirPerTime2_CUR "Kennlinie für den korrigierter Wert der Luftmasse pro Zeiteinheit basierend auf der Drehzahl" CURVE 0x1C3CDC Kl_Xs16_Ws16 1000.000 AirMassPerTime 0.00 1000.000 FORMAT "%8.3" EXTENDED_LIMITS -3276.800 3276.700
 /begin AXIS_DESCR STD_AXIS Eng_nAvrg EngN 30 0.00 6000.000 FORMAT "%8.3" EXTENDED_LIMITS -32768.00 32767.00 DEPOSIT ABSOLUTE /end AXIS_DESCR
/end CHARACTERISTIC
/begin CHARACTERISTIC AFSCD_dmCorrAirPerTime_CUR "Kennlinie für den korrigierter Wert der Luftmasse pro Zeiteinheit basierend auf der Drehzahl" CURVE 0x1C3D56 Kl_Xs16_Ws16 1000.000 AirMassPerTime 0.00 1000.000 FORMAT "%8.3" EXTENDED_LIMITS -3276.800 3276.700
 /begin AXIS_DESCR STD_AXIS Eng_nAvrg EngN 30 0.00 6000.000 FORMAT "%8.3" EXTENDED_LIMITS -32768.00 32767.00 DEPOSIT ABSOLUTE /end AXIS_DESCR
/end CHARACTERISTIC
/begin CHARACTERISTIC AFSCD_dmPlsCor_MAP "additive Luftmasse zur Pulsationskorrektur der Luftmasse pro Zeit" MAP 0x1C3DD0 Kf_Xs16_Ys16_Ws16 2000.000 AirMassPerTime -1000.000 1000.000 FORMAT "%8.3" EXTENDED_LIMITS -3276.800 3276.700
 /begin AXIS_DESCR STD_AXIS Eng_nAvrg EngN 16 0.00 6000.000 FORMAT "%8.3" EXTENDED_LIMITS -32768.00 32767.00 DEPOSIT ABSOLUTE /end AXIS_DESCR
 /begin AXIS_DESCR STD_AXIS InjCtl_qRaw InjMass 16 0.00 327.6700 FORMAT "%8.4" EXTENDED_LIMITS -327.6800 327.6700 DEPOSIT ABSOLUTE /end AXIS_DESCR
/end CHARACTERISTIC
/begin CHARACTERISTIC AFSCD_facAirPerCylCor_MAP "Korrekturfaktor abhängig von Lufttemperatur und Atmosphärendruck" MAP 0x1C4014 Kf_Xs16_Ys16_Ws16 3.199951 Fact 0.00 3.199951 FORMAT "%8.6" EXTENDED_LIMITS -4.000000 3.999878
 /begin AXIS_DESCR STD_AXIS IATSCD_tAir Temp_Cels 8 -50.14000 199.8600 FORMAT "%8.4" EXTENDED_LIMITS -3549.940 3003.560 DEPOSIT ABSOLUTE /end AXIS_DESCR
 /begin AXIS_DESCR STD_AXIS APSCD_pVal Pres_hPa 8 0.00 3500.000 FORMAT "%8.3" EXTENDED_LIMITS -32768.00 32767.00 DEPOSIT ABSOLUTE /end AXIS_DESCR
/end CHARACTERISTIC
/begin CHARACTERISTIC AFSCD_facCorrVal_MAP "Korrekturfaktor basierend auf der Drehzahl und der Menge" MAP 0x1C40B8 Kf_Xs16_Ys16_Ws16 3.199951 Fact 0.00 3.199951 FORMAT "%8.6" EXTENDED_LIMITS -4.000000 3.999878
 /begin AXIS_DESCR STD_AXIS Eng_nAvrg EngN 10 0.00 6000.000 FORMAT "%8.3" EXTENDED_LIMITS -32768.00 32767.00 DEPOSIT ABSOLUTE /end AXIS_DESCR
 /begin AXIS_DESCR STD_AXIS InjCtl_qRaw InjMass 12 0.00 327.6700 FORMAT "%8.4" EXTENDED_LIMITS -327.6800 327.6700 DEPOSIT ABSOLUTE /end AXIS_DESCR
/end CHARACTERISTIC
/begin CHARACTERISTIC AFSCD_facPlsCor_MAP "Kennfeld für die Pulsationskorrektur" MAP 0x1C41D8 Kf_Xs16_Ys16_Ws16 7.999878 Fact -4.000000 3.999878 FORMAT "%8.6"
 /begin AXIS_DESCR STD_AXIS Eng_nAvrg EngN 16 0.00 6000.000 FORMAT "%8.3" EXTENDED_LIMITS -32768.00 32767.00 DEPOSIT ABSOLUTE /end AXIS_DESCR
 /begin AXIS_DESCR STD_AXIS InjCtl_qRaw InjMass 16 0.00 327.6700 FORMAT "%8.4" EXTENDED_LIMITS -327.6800 327.6700 DEPOSIT ABSOLUTE /end AXIS_DESCR
/end CHARACTERISTIC
/begin CHARACTERISTIC AFSCD_mAirPerCylDfl_MAP "Vorgabewert für die Luftmasse pro Zylinder im Fehlerfall" MAP 0x1C441C Kf_Xs16_Ys16_Ws16 1500.000 AirMassPerCyl 0.00 1500.000 FORMAT "%8.3" EXTENDED_LIMITS -3276.800 3276.700
 /begin AXIS_DESCR STD_AXIS Eng_nAvrg EngN 8 0.00 6000.000 FORMAT "%8.3" EXTENDED_LIMITS -32768.00 32767.00 DEPOSIT ABSOLUTE /end AXIS_DESCR
 /begin AXIS_DESCR STD_AXIS AFSCD_pCurr_mp Pres_hPa 8 0.00 3500.000 FORMAT "%8.3" EXTENDED_LIMITS -32768.00 32767.00 DEPOSIT ABSOLUTE /end AXIS_DESCR
/end CHARACTERISTIC
/begin CHARACTERISTIC AFSCD_mPlsCor_MAP "additive Luftmasse zur Pulsationskorrektur der Luftmasse pro Zylinder" MAP 0x1C44C0 Kf_Xs16_Ys16_Ws16 2000.000 AirMassPerCyl -1000.000 1000.000 FORMAT "%8.3" EXTENDED_LIMITS -3276.800 3276.700
 /begin AXIS_DESCR STD_AXIS Eng_nAvrg EngN 16 0.00 6000.000 FORMAT "%8.3" EXTENDED_LIMITS -32768.00 32767.00 DEPOSIT ABSOLUTE /end AXIS_DESCR
 /begin AXIS_DESCR STD_AXIS InjCtl_qRaw InjMass 16 0.00 327.6700 FORMAT "%8.4" EXTENDED_LIMITS -327.6800 327.6700 DEPOSIT ABSOLUTE /end AXIS_DESCR
/end CHARACTERISTIC
/begin CHARACTERISTIC AFSCD_uThrHiPlOffsDrft_C "obere Spannungsschwelle der Plausibilitätsprüfung der Offsetdrift" VALUE 0x1C4704 Kw_Ws16 5200.391 Volt 0.00 5200.391 FORMAT "%8.3" EXTENDED_LIMITS -160156.4 160151.5 /end CHARACTERISTIC
/begin CHARACTERISTIC AFSCD_uThrLoPlOffsDrft_C "untere Spannungsschwelle der Plausibilitätsprüfung der Offsetdrift" VALUE 0x1C4706 Kw_Ws16 5200.391 Volt 0.00 5200.391 FORMAT "%8.3" EXTENDED_LIMITS -160156.4 160151.5 /end CHARACTERISTIC
/begin CHARACTERISTIC AFSCD_tClntThrLoShtrp_C "Untere Kühlwassertemperaturschwelle für die Plaus-prüfung der Driftempfindlichkeit des Luftmassenmessers im Short Trip Mode" VALUE 0x1C4708 Kw_Ws16 200.0000 Temp_Cels -50.14000 149.8600 FORMAT "%8.4" EXTENDED_LIMITS -3549.940 3003.560 /end CHARACTERISTIC
/begin CHARACTERISTIC AFSCD_pAirThrLoShtrp_C "untere Atmosphärendruckschwelle für die Plausibilitätsprüfung der Luftmassensensor-Empfindlichkeit im Short Trip Mode" VALUE 0x1C470A Kw_Ws16 1000.000 Pres_hPa 500.0000 1500.000 FORMAT "%8.3" EXTENDED_LIMITS -32768.00 32767.00 /end CHARACTERISTIC
/begin CHARACTERISTIC AFSCD_qRawThrHiShtrp_C "Maximale Einspritzmenge für Plausibilisierungsfreigabe der Luftmassensensor-Empfindlichkeitsdrift im Short Trip Mode" VALUE 0x1C470C Kw_Ws16 150.0000 InjMass 0.00 150.0000 FORMAT "%8.4" EXTENDED_LIMITS -327.6800 327.6700 /end CHARACTERISTIC
/begin CHARACTERISTIC AFSCD_nAvrgThrLoPlHiShtrp_C "Untere Drehzahlschwelle für Plausibilisierung der oberen Luftmassensensor-Driftgrenze im Short Trip Mode" VALUE 0x1C470E Kw_Ws16 6000.000 EngN 0.00 6000.000 FORMAT "%8.3" EXTENDED_LIMITS -32768.00 32767.00 /end CHARACTERISTIC
/begin CHARACTERISTIC AFSCD_nAvrgThrHiPlHiShtrp_C "Obere Drehzahlschwelle für Plausibilisierung der oberen Luftmassensensor-Driftgrenze im Short Trip Mode" VALUE 0x1C4710 Kw_Ws16 6000.000 EngN 0.00 6000.000 FORMAT "%8.3" EXTENDED_LIMITS -32768.00 32767.00 /end CHARACTERISTIC
/begin CHARACTERISTIC AFSCD_rAirThrHiPlHiShtrp_C "Obere Normverhältnisschwelle für Plausibilisierung der oberen Luftmassensensor-Driftgrenze im Short Trip Mode" VALUE 0x1C4712 Kw_Ws16 7.999878 Fact -4.000000 3.999878 FORMAT "%8.6" /end CHARACTERISTIC
/begin CHARACTERISTIC AFSCD_nAvrgThrLoPlLoShtrp_C "Untere Drehzahlschwelle für Plausibilisierung der unteren Luftmassensensor-Driftgrenze im Short Trip Mode" VALUE 0x1C4714 Kw_Ws16 6000.000 EngN 0.00 6000.000 FORMAT "%8.3" EXTENDED_LIMITS -32768.00 32767.00 /end CHARACTERISTIC
/begin CHARACTERISTIC AFSCD_nAvrgThrHiPlLoShtrp_C "Obere Drehzahlschwelle für Plausibilisierung der unteren Luftmassensensor-Driftgrenze im Short Trip Mode" VALUE 0x1C4716 Kw_Ws16 6000.000 EngN 0.00 6000.000 FORMAT "%8.3" EXTENDED_LIMITS -32768.00 32767.00 /end CHARACTERISTIC
/begin CHARACTERISTIC AFSCD_rAirThrLoPlLoShtrp_C "Untere Normverhältnisschwelle für Plausibilisierung der unteren Luftmassensensor-Driftgrenze im Short Trip Mode" VALUE 0x1C4718 Kw_Ws16 7.999878 Fact -4.000000 3.999878 FORMAT "%8.6" /end CHARACTERISTIC
/begin CHARACTERISTIC AFSCD_tClntThrLo_C "Untere Kühlwassertemperaturschwelle für die Plausibilitätsprüfung der Driftempfindlichkeit des Luftmassenmessers" VALUE 0x1C471C Kw_Ws16 200.0000 Temp_Cels -50.14000 149.8600 FORMAT "%8.4" EXTENDED_LIMITS -3549.940 3003.560 /end CHARACTERISTIC
/begin CHARACTERISTIC AFSCD_tClntThrHi_C "Obere Kühlmitteltemperaturschwelle für Plausibilisierungsfreigabe der Luftmassensensor-Empfindlichkeitsdrift" VALUE 0x1C471E Kw_Ws16 200.0000 Temp_Cels -50.14000 149.8600 FORMAT "%8.4" EXTENDED_LIMITS -3549.940 3003.560 /end CHARACTERISTIC
/begin CHARACTERISTIC AFSCD_rSwirlThrHi_C "Maximale Sollpossition der Einlasskanalabschaltung für Plausibilisierungsfreigabe der  Luftmassensensor-Empfindlichkeitsdrift" VALUE 0x1C4720 Kw_Ws16 100.0000 DtyCyc 0.00 100.0000 FORMAT "%8.4" EXTENDED_LIMITS -327.6800 327.6700 /end CHARACTERISTIC
/begin CHARACTERISTIC AFSCD_pAirThrLo_C "untere Atmosphärendruckschwelle für die Plausibilitätsprüfung der Luftmassensensor-Empfindlichkeit" VALUE 0x1C4722 Kw_Ws16 1000.000 Pres_hPa 500.0000 1500.000 FORMAT "%8.3" EXTENDED_LIMITS -32768.00 32767.00 /end CHARACTERISTIC
/begin CHARACTERISTIC AFSCD_qRawThrHi_C "Maximale Einspritzmenge für Plausibilisierungsfreigabe der Luftmassensensor-Empfindlichkeitsdrift" VALUE 0x1C4724 Kw_Ws16 150.0000 InjMass 0.00 150.0000 FORMAT "%8.4" EXTENDED_LIMITS -327.6800 327.6700 /end CHARACTERISTIC
/begin CHARACTERISTIC AFSCD_nAvrgThrLoPlHi_C "Untere Drehzahlschwelle für Plausibilisierung der oberen Luftmassensensor-Driftgrenze" VALUE 0x1C4726 Kw_Ws16 6000.000 EngN 0.00 6000.000 FORMAT "%8.3" EXTENDED_LIMITS -32768.00 32767.00 /end CHARACTERISTIC
/begin CHARACTERISTIC AFSCD_nAvrgThrHiPlHi_C "Obere Drehzahlschwelle für Plausibilisierung der oberen Luftmassensensor-Driftgrenze" VALUE 0x1C4728 Kw_Ws16 6000.000 EngN 0.00 6000.000 FORMAT "%8.3" EXTENDED_LIMITS -32768.00 32767.00 /end CHARACTERISTIC
/begin CHARACTERISTIC AFSCD_pBstThrHiPlHi_C "Obere Ladedruckschwelle für Plausibilisierung der oberen Luftmassensensor-Driftgrenze" VALUE 0x1C472A Kw_Ws16 3500.000 Pres_hPa 0.00 3500.000 FORMAT "%8.3" EXTENDED_LIMITS -32768.00 32767.00 /end CHARACTERISTIC
/begin CHARACTERISTIC AFSCD_rAirThrHiPlHi_C "Obere Normverhältnisschwelle für Plausibilisierung der oberen Luftmassensensor-Driftgrenze" VALUE 0x1C472C Kw_Ws16 7.999878 Fact -4.000000 3.999878 FORMAT "%8.6" /end CHARACTERISTIC
/begin CHARACTERISTIC AFSCD_nAvrgThrLoPlLo_C "Untere Drehzahlschwelle für Plausibilisierung der unteren Luftmassensensor-Driftgrenze" VALUE 0x1C472E Kw_Ws16 6000.000 EngN 0.00 6000.000 FORMAT "%8.3" EXTENDED_LIMITS -32768.00 32767.00 /end CHARACTERISTIC
/begin CHARACTERISTIC AFSCD_nAvrgThrHiPlLo_C "Obere Drehzahlschwelle für Plausibilisierung der unteren Luftmassensensor-Driftgrenze" VALUE 0x1C4730 Kw_Ws16 6000.000 EngN 0.00 6000.000 FORMAT "%8.3" EXTENDED_LIMITS -32768.00 32767.00 /end CHARACTERISTIC
/begin CHARACTERISTIC AFSCD_pBstThrLoPlLo_C "Untere Ladedruckschwelle für Plausibilisierung der unteren Luftmassensensor-Driftgrenze" VALUE 0x1C4732 Kw_Ws16 3500.000 Pres_hPa 0.00 3500.000 FORMAT "%8.3" EXTENDED_LIMITS -32768.00 32767.00 /end CHARACTERISTIC
/begin CHARACTERISTIC AFSCD_rAirThrLoPlLo_C "Untere Normverhältnisschwelle für Plausibilisierung der unteren Luftmassensensor-Driftgrenze" VALUE 0x1C4734 Kw_Ws16 7.999878 Fact -4.000000 3.999878 FORMAT "%8.6" /end CHARACTERISTIC
/begin CHARACTERISTIC AFSCD_rEGRPThrHi_C "Obere Schwelle der Stellgröße des AGR-Ventils für Plausibilisierungsfreigabe der Luftmassensensor-Empfindlichkeitsdrift" VALUE 0x1C4736 Kw_Ws16 400.0000 Prc -200.0000 200.0000 FORMAT "%8.4" EXTENDED_LIMITS -327.6800 327.6700 /end CHARACTERISTIC
/begin CHARACTERISTIC AFSCD_rTVAPThrHi_C "obere Drosselklappenstellung fuer die Plausibilitaetspruefung der Luftmassenmessungsdriftempfindlichkeit" VALUE 0x1C4738 Kw_Ws16 400.0000 Prc -200.0000 200.0000 FORMAT "%8.4" EXTENDED_LIMITS -327.6800 327.6700 /end CHARACTERISTIC
/begin CHARACTERISTIC AFSCD_tiDlyEGRPPlSetyDrft_C "Verzögerungszeit nach Veränderung der Abgasrückführung für Plausibilisierungsfreigabe der Luftmassensensor-Empfindlichkeitsdrift" VALUE 0x1C473C Kw_Wu32 65540.0000000 Time_ms 0.00 65540.0000000 FORMAT "%13.7" EXTENDED_LIMITS 0.00 42949672950.0 /end CHARACTERISTIC
/begin CHARACTERISTIC AFSCD_tiDlyStrPlSetyDrft_C "Verzögerungszeit nach Motorstart für Plausibilisierungsfreigabe der Luftmassensensor-Empfindlichkeitsdrift" VALUE 0x1C4740 Kw_Wu16 65540.00 Time_ms 0.00 65540.00 FORMAT "%8.2" EXTENDED_LIMITS 0.00 655350.0 /end CHARACTERISTIC
/begin CHARACTERISTIC AFSCD_pNormAir_C "Normale Atmosphärendruck" VALUE 0x1C4744 Kw_Ws16 2500.000 Pres_hPa 0.00 2500.000 FORMAT "%8.3" EXTENDED_LIMITS -32768.00 32767.00 /end CHARACTERISTIC
/begin CHARACTERISTIC AFSCD_tiPT1rAirNorm_C "Zeitkonstante des PT1-Filters zur Verwendung für AFSCD_rAirNorm" VALUE 0x1C4748 Kw_Wu32 4294.9673 TimeDelay_s 0.0000010000000 4294.9673 FORMAT "%9.4" /end CHARACTERISTIC
/begin CHARACTERISTIC AFSCD_tiLPFilt_C "Zeitkonstante für HFM Tiefpaß Filter" VALUE 0x1C0B38 Kw_Wu32 0.099997239 TimeDelay_s 0.0000020000000 0.099999239 FORMAT "%10.8" EXTENDED_LIMITS 0.0000010000000 4294.9673 /end CHARACTERISTIC
/begin CHARACTERISTIC AFSCD_qAirmThrSRCHiActv_CUR "Mengenschwelle fuer SRC High der Luftmasse" CURVE 0x1C474C Kl_Xs16_Ws16 100.0000 InjMass 0.00 100.0000 FORMAT "%8.4" EXTENDED_LIMITS -327.6800 327.6700
 /begin AXIS_DESCR STD_AXIS Eng_nAvrg EngN 12 0.00 6000.000 FORMAT "%8.3" EXTENDED_LIMITS -32768.00 32767.00 DEPOSIT ABSOLUTE /end AXIS_DESCR
/end CHARACTERISTIC
/begin CHARACTERISTIC AFSCD_nAvrgThrLoSRCLo_C "unterer Drehzahlschwellwert fuer den SRC Low der Luftmasse" VALUE 0x1C477E Kw_Ws16 6000.000 EngN 0.00 6000.000 FORMAT "%8.3" EXTENDED_LIMITS -32768.00 32767.00 /end CHARACTERISTIC
/begin CHARACTERISTIC AFSCD_nAvrgThrHiSRCLo_C "oberer Drehzahlschwellwert fuer den SRC Low der Luftmasse" VALUE 0x1C4780 Kw_Ws16 6000.000 EngN 0.00 6000.000 FORMAT "%8.3" EXTENDED_LIMITS -32768.00 32767.00 /end CHARACTERISTIC
/begin CHARACTERISTIC AFSCD_tiDlyActvSRCHiAirm_C "Zeitkonstante fuer die Fehlererkennung des SRC High des Luftmassenmessers" VALUE 0x1C4782 Kw_Wu16 65540.00 Time_ms 0.00 65540.00 FORMAT "%8.2" EXTENDED_LIMITS 0.00 655350.0 /end CHARACTERISTIC
/begin CHARACTERISTIC AFSCD_swtAirSysVal_C "Schalter zur Auswahl ein einzelnes/doppeltes Luftsystem" VALUE 0x1C47F0 Kw_Wu8 2.000 OneToOne 1.000 3.000 FORMAT "%5.3" EXTENDED_LIMITS 0.00 255.0 READ_ONLY /end CHARACTERISTIC
/begin CHARACTERISTIC AFSCD_swtAirSysType_C "SW-Schaltertyp zur Auswahl eine Luftsystemsart (0=Datensatzwert, nicht applizierbar/1=EEPROM-Wert/2=Datensatzwert)" VALUE 0x1C47F1 Kw_Wu8 0.00 OneToOne 0.00 0.00 FORMAT "%5.2" EXTENDED_LIMITS 0.00 255.0 READ_ONLY /end CHARACTERISTIC
/begin CHARACTERISTIC AFSCD_swtDebCfg_C "Schalter zur Auswahl des Entprellmodus" VALUE 0x1C4784 Kw_Wu8 1.000 OneToOne 0.00 1.000 FORMAT "%5.3" EXTENDED_LIMITS 0.00 255.0 /end CHARACTERISTIC
/begin CHARACTERISTIC AFSCD_swtSwtOnCor_C "Schalter zum Aktivieren der Einschaltkorrektur (0: aus  /  1: ein)" VALUE 0x1C4785 Kw_Wu8 1.000 OneToOne 0.00 1.000 FORMAT "%5.3" EXTENDED_LIMITS 0.00 255.0 /end CHARACTERISTIC
/begin CHARACTERISTIC AFSCD_tAirTempCorr_CUR "Temperaturkorrektur aus Lufttemperatur" CURVE 0x1C4786 Kl_Xs16_Ws16 6553.500 Temp_Cels -3549.940 3003.560 FORMAT "%8.3"
 /begin AXIS_DESCR STD_AXIS IATSCD_tAir Temp_Cels 25 -50.14000 199.8600 FORMAT "%8.4" EXTENDED_LIMITS -3549.940 3003.560 DEPOSIT ABSOLUTE /end AXIS_DESCR
/end CHARACTERISTIC
/begin CHARACTERISTIC AFSCD_tiOffsDrftTstLim_C "Zeitdauer für die Plausibilitätsprüfung der Offsetdrift im Nachlauf" VALUE 0x1C47EC Kw_Wu16 655350.0 Time_ms 0.00 655350.0 FORMAT "%8.1" /end CHARACTERISTIC
/begin CHARACTERISTIC AFSCD_tNormAir_C "Normale Atmosphärentemperatur" VALUE 0x1C47EE Kw_Ws16 140.0000 Temp_Cels -40.14000 99.86000 FORMAT "%8.5" EXTENDED_LIMITS -3549.940 3003.560 /end CHARACTERISTIC
/begin CHARACTERISTIC AFVCD_ctPwrStgOnMax_C "maximale Anzahl von Endstufen-Einschaltungen pro Fahrzyklus bei SCB oder Übertemperatur" VALUE 0x1C47F2 Kw_Wu16 65535.00 OneToOne 0.00 65535.00 FORMAT "%8.2" /end CHARACTERISTIC
/begin CHARACTERISTIC AFVCD_DebExcTempDef_C "Fehlerentprellzeit Übertemperatur" VALUE 0x1C47F4 Kw_Wu16 655350.0 Time_ms 0.00 655350.0 FORMAT "%8.1" /end CHARACTERISTIC
/begin CHARACTERISTIC AFVCD_DebExcTempOk_C "Heilungsentprellzeit Übertemperatur" VALUE 0x1C47F6 Kw_Wu16 655350.0 Time_ms 0.00 655350.0 FORMAT "%8.1" /end CHARACTERISTIC
/begin CHARACTERISTIC AFVCD_DebNoLdDef_C "Fehlerentprellzeit keine Last" VALUE 0x1C47F8 Kw_Wu16 655350.0 Time_ms 0.00 655350.0 FORMAT "%8.1" /end CHARACTERISTIC
/begin CHARACTERISTIC AFVCD_DebNoLdOk_C "Heilungsentprellzeit keine Last" VALUE 0x1C47FA Kw_Wu16 655350.0 Time_ms 0.00 655350.0 FORMAT "%8.1" /end CHARACTERISTIC
/begin CHARACTERISTIC AFVCD_DebShCirBattDef_C "Fehlerentprellzeit Kurzschluß nach Batterie" VALUE 0x1C47FC Kw_Wu16 655350.0 Time_ms 0.00 655350.0 FORMAT "%8.1" /end CHARACTERISTIC
/begin CHARACTERISTIC AFVCD_DebShCirBattOk_C "Heilungsentprellzeit Kurzschluß nach Batterie" VALUE 0x1C47FE Kw_Wu16 655350.0 Time_ms 0.00 655350.0 FORMAT "%8.1" /end CHARACTERISTIC
/begin CHARACTERISTIC AFVCD_DebShCirGndDef_C "Fehlerentprellzeit Kurzschluß nach Masse" VALUE 0x1C4800 Kw_Wu16 655350.0 Time_ms 0.00 655350.0 FORMAT "%8.1" /end CHARACTERISTIC
/begin CHARACTERISTIC AFVCD_DebShCirGndOk_C "Heilungsentprellzeit Kurzschluß nach Masse" VALUE 0x1C4802 Kw_Wu16 655350.0 Time_ms 0.00 655350.0 FORMAT "%8.1" /end CHARACTERISTIC
/begin CHARACTERISTIC AFVCD_stActrInvOut_C "Invertierung des Ausgangs" VALUE 0x1C4804 Kw_Wu8 1.000 OneToOne 0.00 1.000 FORMAT "%5.3" EXTENDED_LIMITS 0.00 255.0 /end CHARACTERISTIC
/begin CHARACTERISTIC AFVCD_stPwrStgActrActv_C "Statuswort zu Spezifikation des Abschaltverhaltens der Actr-Endstufe" VALUE 0x1C4805 Kw_Wu8 255.0 OneToOne 0.00 255.0 FORMAT "%5.1" /end CHARACTERISTIC
/begin CHARACTERISTIC AFVCD_stPwrStgActrDia_C "such Statuswort zu Spezifikation des Abschaltverhaltens der Actr-Endstufendiagnose" VALUE 0x1C4806 Kw_Wu8 255.0 OneToOne 0.00 255.0 FORMAT "%5.1" /end CHARACTERISTIC
/begin CHARACTERISTIC AFVCD_stSPICtl_C "Parameter zur Anzeige der verwendeten Endstufenart ( 1 = SPI kontrollierbare Endstufe, 0 = nicht SPI-Endstufe )" VALUE 0x1C4807 Kw_Wu8 1.000 OneToOne 0.00 1.000 FORMAT "%5.3" EXTENDED_LIMITS 0.00 255.0 /end CHARACTERISTIC
/begin CHARACTERISTIC AFVCD_tiBtwTst_C "Zeitabstand, in dem im Fehlerfall die Endstufe getestet wird" VALUE 0x1C4808 Kw_Wu16 29900.00 Time_ms 100.0000 30000.00 FORMAT "%8.2" EXTENDED_LIMITS 0.00 655350.0 /end CHARACTERISTIC
/begin CHARACTERISTIC AFVCD_tiPwrStgOn_C "Zeit für welche die Endstufe im Fehlerfall eingeschalten wird (nur nicht SPI kontrolliert)" VALUE 0x1C480A Kw_Wu16 500.0000 Time_ms 0.00 500.0000 FORMAT "%8.4" EXTENDED_LIMITS 0.00 655350.0 /end CHARACTERISTIC
/begin CHARACTERISTIC AFVCtl_dmAcouHighOff_C "Obere Schwelle für die Hysterese-Hoch => Akustikfunktion" VALUE 0x1C480C Kw_Ws16 2000.000 AirMassPerTime -1000.000 1000.000 FORMAT "%8.3" EXTENDED_LIMITS -3276.800 3276.700 /end CHARACTERISTIC
/begin CHARACTERISTIC AFVCtl_dmAcouHighOn_C "Untere Schwelle für die Hysterese-Hoch => Akustikfunktion" VALUE 0x1C480E Kw_Ws16 2000.000 AirMassPerTime -1000.000 1000.000 FORMAT "%8.3" EXTENDED_LIMITS -3276.800 3276.700 /end CHARACTERISTIC
/begin CHARACTERISTIC AFVCtl_dmAcouLowOff_C "Untere Schwelle für die Hysterese-Niedrig => Akustikfunktion" VALUE 0x1C4810 Kw_Ws16 2000.000 AirMassPerTime -1000.000 1000.000 FORMAT "%8.3" EXTENDED_LIMITS -3276.800 3276.700 /end CHARACTERISTIC
/begin CHARACTERISTIC AFVCtl_dmAcouLowOn_C "Obere Schwelle für die Hysterese-Niedrig => Akustikfunktion" VALUE 0x1C4812 Kw_Ws16 2000.000 AirMassPerTime -1000.000 1000.000 FORMAT "%8.3" EXTENDED_LIMITS -3276.800 3276.700 /end CHARACTERISTIC
/begin CHARACTERISTIC AFVCtl_dmHeightOff_C "Untere Schwelle für die Hysterese => Höhenfunktion" VALUE 0x1C4814 Kw_Ws16 2000.000 AirMassPerTime -1000.000 1000.000 FORMAT "%8.3" EXTENDED_LIMITS -3276.800 3276.700 /end CHARACTERISTIC
/begin CHARACTERISTIC AFVCtl_dmHeightOn_C "Obere Schwelle für die Hysterese => Höhenfunktion" VALUE 0x1C4816 Kw_Ws16 2000.000 AirMassPerTime -1000.000 1000.000 FORMAT "%8.3" EXTENDED_LIMITS -3276.800 3276.700 /end CHARACTERISTIC
/begin CHARACTERISTIC AFVCtl_dmPwrOff_C "Untere Schwelle für die Hysterese => Leistungsfunktion" VALUE 0x1C4818 Kw_Ws16 2000.000 AirMassPerTime -1000.000 1000.000 FORMAT "%8.3" EXTENDED_LIMITS -3276.800 3276.700 /end CHARACTERISTIC
/begin CHARACTERISTIC AFVCtl_dmPwrOn_C "Obere Schwelle für die Hysterese => Leistungsfunktion" VALUE 0x1C481A Kw_Ws16 2000.000 AirMassPerTime -1000.000 1000.000 FORMAT "%8.3" EXTENDED_LIMITS -3276.800 3276.700 /end CHARACTERISTIC
/begin CHARACTERISTIC AFVCtl_dmRainHighOff_C "Obere Schwelle für die Hysterese-Hoch" VALUE 0x1C481C Kw_Ws16 2000.000 AirMassPerTime -1000.000 1000.000 FORMAT "%8.3" EXTENDED_LIMITS -3276.800 3276.700 /end CHARACTERISTIC
/begin CHARACTERISTIC AFVCtl_dmRainHighOn_C "Untere Schwelle für die Hysterese-Hoch" VALUE 0x1C481E Kw_Ws16 2000.000 AirMassPerTime -1000.000 1000.000 FORMAT "%8.3" EXTENDED_LIMITS -3276.800 3276.700 /end CHARACTERISTIC
/begin CHARACTERISTIC AFVCtl_dmRainLowOff_C "Untere Schwelle für die Hysterese-Niedrig" VALUE 0x1C4820 Kw_Ws16 2000.000 AirMassPerTime -1000.000 1000.000 FORMAT "%8.3" EXTENDED_LIMITS -3276.800 3276.700 /end CHARACTERISTIC
/begin CHARACTERISTIC AFVCtl_dmRainLowOn_C "Obere Schwelle für die Hysterese-Niedrig" VALUE 0x1C4822 Kw_Ws16 2000.000 AirMassPerTime -1000.000 1000.000 FORMAT "%8.3" EXTENDED_LIMITS -3276.800 3276.700 /end CHARACTERISTIC
/begin CHARACTERISTIC AFVCtl_dmSnowHighOff_C "Obere Schwelle für die Hysterese-Hoch => Schneefunktion" VALUE 0x1C4824 Kw_Ws16 2000.000 AirMassPerTime -1000.000 1000.000 FORMAT "%8.3" EXTENDED_LIMITS -3276.800 3276.700 /end CHARACTERISTIC
/begin CHARACTERISTIC AFVCtl_dmSnowHighOn_C "Untere Schwelle für die Hysterese-Hoch => Schneefunktion" VALUE 0x1C4826 Kw_Ws16 2000.000 AirMassPerTime -1000.000 1000.000 FORMAT "%8.3" EXTENDED_LIMITS -3276.800 3276.700 /end CHARACTERISTIC
/begin CHARACTERISTIC AFVCtl_dmSnowLowOff_C "Untere Schwelle für die Hysterese-Niedrig => Schneefunktion" VALUE 0x1C4828 Kw_Ws16 2000.000 AirMassPerTime -1000.000 1000.000 FORMAT "%8.3" EXTENDED_LIMITS -3276.800 3276.700 /end CHARACTERISTIC
/begin CHARACTERISTIC AFVCtl_dmSnowLowOn_C "Obere Schwelle für die Hysterese-Niedrig => Schneefunktion" VALUE 0x1C482A Kw_Ws16 2000.000 AirMassPerTime -1000.000 1000.000 FORMAT "%8.3" EXTENDED_LIMITS -3276.800 3276.700 /end CHARACTERISTIC
/begin CHARACTERISTIC AFVCtl_nAcouHighOff_C "Obere Schwelle für die Hysterese-Hoch => Akustikfunktion" VALUE 0x1C482C Kw_Ws16 5960.000 EngN 40.00000 6000.000 FORMAT "%8.3" EXTENDED_LIMITS -32768.00 32767.00 /end CHARACTERISTIC
/begin CHARACTERISTIC AFVCtl_nAcouHighOn_C "Untere Schwelle für die Hysterese-Hoch => Akustikfunktion" VALUE 0x1C482E Kw_Ws16 5960.000 EngN 40.00000 6000.000 FORMAT "%8.3" EXTENDED_LIMITS -32768.00 32767.00 /end CHARACTERISTIC
/begin CHARACTERISTIC AFVCtl_nAcouLowOff_C "Untere Schwelle für die Hysterese-Niedrig => Akustikfunktion" VALUE 0x1C4830 Kw_Ws16 5960.000 EngN 40.00000 6000.000 FORMAT "%8.3" EXTENDED_LIMITS -32768.00 32767.00 /end CHARACTERISTIC
/begin CHARACTERISTIC AFVCtl_nAcouLowOn_C "Obere Schwelle für die Hysterese-Niedrig => Akustikfunktion" VALUE 0x1C4832 Kw_Ws16 5960.000 EngN 40.00000 6000.000 FORMAT "%8.3" EXTENDED_LIMITS -32768.00 32767.00 /end CHARACTERISTIC
/begin CHARACTERISTIC AFVCtl_pHeightOff_C "Obere Schwelle für die Hysterese => Höhenfunktion" VALUE 0x1C4834 Kw_Ws16 3500.000 Pres_hPa 0.00 3500.000 FORMAT "%8.3" EXTENDED_LIMITS -32768.00 32767.00 /end CHARACTERISTIC
/begin CHARACTERISTIC AFVCtl_pHeightOn_C "Untere Schwelle für die Hysterese => Höhenfunktion" VALUE 0x1C4836 Kw_Ws16 3500.000 Pres_hPa 0.00 3500.000 FORMAT "%8.3" EXTENDED_LIMITS -32768.00 32767.00 /end CHARACTERISTIC
/begin CHARACTERISTIC AFVCtl_tiRainWiperHoldNeg_C "Entprellzeit für Scheibenwischer AUS" VALUE 0x1C4838 Kw_Wu16 655350.0 TimeDeb 0.00 655350.0 FORMAT "%8.1" /end CHARACTERISTIC
/begin CHARACTERISTIC AFVCtl_tiRainWiperHoldPos_C "Entprellzeit für Scheibenwischer EIN" VALUE 0x1C483A Kw_Wu16 655350.0 TimeDeb 0.00 655350.0 FORMAT "%8.1" /end CHARACTERISTIC
/begin CHARACTERISTIC AFVCtl_tAirSnowOff_C "Obere Schwelle für die Hysterese => Schneefunktion" VALUE 0x1C483C Kw_Ws16 250.0000 Temp_Cels -50.14000 199.8600 FORMAT "%8.4" EXTENDED_LIMITS -3549.940 3003.560 /end CHARACTERISTIC
/begin CHARACTERISTIC AFVCtl_tAirSnowOn_C "Untere Schwelle für die Hysterese => Schneefunktion" VALUE 0x1C483E Kw_Ws16 250.0000 Temp_Cels -50.14000 199.8600 FORMAT "%8.4" EXTENDED_LIMITS -3549.940 3003.560 /end CHARACTERISTIC
/begin CHARACTERISTIC AFVCtl_tIndPwrOff_C "Untere Schwelle für die Hysterese-Niedrig => Leistungsfunktion" VALUE 0x1C4840 Kw_Ws16 250.0000 Temp_Cels -50.14000 199.8600 FORMAT "%8.4" EXTENDED_LIMITS -3549.940 3003.560 /end CHARACTERISTIC
/begin CHARACTERISTIC AFVCtl_tIndPwrOn_C "Obere Schwelle für die Hysterese-Niedrig => Leistungsfunktion" VALUE 0x1C4842 Kw_Ws16 250.0000 Temp_Cels -50.14000 199.8600 FORMAT "%8.4" EXTENDED_LIMITS -3549.940 3003.560 /end CHARACTERISTIC
/begin CHARACTERISTIC AFVCtl_tIndSnowOff_C "Obere Schwelle für die Hysterese => Schneefunktion" VALUE 0x1C4844 Kw_Ws16 250.0000 Temp_Cels -50.14000 199.8600 FORMAT "%8.4" EXTENDED_LIMITS -3549.940 3003.560 /end CHARACTERISTIC
/begin CHARACTERISTIC AFVCtl_tIndSnowOn_C "Untere Schwelle für die Hysterese => Schneefunktion" VALUE 0x1C4846 Kw_Ws16 250.0000 Temp_Cels -50.14000 199.8600 FORMAT "%8.4" EXTENDED_LIMITS -3549.940 3003.560 /end CHARACTERISTIC
/begin CHARACTERISTIC AFVCtl_vRainHighOff_C "Obere Schwelle für die Hysterese-Hoch" VALUE 0x1C4848 Kw_Ws16 300.0000 Vel 0.00 300.0000 FORMAT "%8.4" EXTENDED_LIMITS -327.6800 327.6700 /end CHARACTERISTIC
/begin CHARACTERISTIC AFVCtl_vRainHighOn_C "Untere Schwelle für die Hysterese-Hoch" VALUE 0x1C484A Kw_Ws16 300.0000 Vel 0.00 300.0000 FORMAT "%8.4" EXTENDED_LIMITS -327.6800 327.6700 /end CHARACTERISTIC
/begin CHARACTERISTIC AFVCtl_vRainLowOff_C "Untere Schwelle für die Hysterese-Niedrig" VALUE 0x1C484C Kw_Ws16 300.0000 Vel 0.00 300.0000 FORMAT "%8.4" EXTENDED_LIMITS -327.6800 327.6700 /end CHARACTERISTIC
/begin CHARACTERISTIC AFVCtl_vRainLowOn_C "Obere Schwelle für die Hysterese-Niedrig" VALUE 0x1C484E Kw_Ws16 300.0000 Vel 0.00 300.0000 FORMAT "%8.4" EXTENDED_LIMITS -327.6800 327.6700 /end CHARACTERISTIC
/begin CHARACTERISTIC AFVCtl_vSnowHighOff_C "Obere Schwelle für die Hysterese-Hoch => Schneefunktion" VALUE 0x1C4850 Kw_Ws16 300.0000 Vel 0.00 300.0000 FORMAT "%8.4" EXTENDED_LIMITS -327.6800 327.6700 /end CHARACTERISTIC
/begin CHARACTERISTIC AFVCtl_vSnowHighOn_C "Untere Schwelle für die Hysterese-Hoch => Schneefunktion" VALUE 0x1C4852 Kw_Ws16 300.0000 Vel 0.00 300.0000 FORMAT "%8.4" EXTENDED_LIMITS -327.6800 327.6700 /end CHARACTERISTIC
/begin CHARACTERISTIC AFVCtl_vSnowLowOff_C "Untere Schwelle für die Hysterese-Niedrig => Schneefunktion" VALUE 0x1C4854 Kw_Ws16 300.0000 Vel 0.00 300.0000 FORMAT "%8.4" EXTENDED_LIMITS -327.6800 327.6700 /end CHARACTERISTIC
/begin CHARACTERISTIC AFVCtl_vSnowLowOn_C "Obere Schwelle für die Hysterese-Niedrig => Schneefunktion" VALUE 0x1C4856 Kw_Ws16 300.0000 Vel 0.00 300.0000 FORMAT "%8.4" EXTENDED_LIMITS -327.6800 327.6700 /end CHARACTERISTIC
/begin CHARACTERISTIC AOHtCD_ctPwrStgOnMaxHt1_C "Maximaler Zähler für Powerstage On im Gehlerfall für Heater eins" VALUE 0x1CA7B0 Kw_Wu16 65535.00 OneToOne 0.00 65535.00 FORMAT "%8.2" /end CHARACTERISTIC
/begin CHARACTERISTIC AOHtCD_ctPwrStgOnMaxHt2_C "Maximaler Zähler für Powerstage On im Gehlerfall für Heater zwei" VALUE 0x1CA7B2 Kw_Wu16 65535.00 OneToOne 0.00 65535.00 FORMAT "%8.2" /end CHARACTERISTIC
/begin CHARACTERISTIC AOHtCD_ctPwrStgOnMaxHt3_C "Maximaler Zähler für Powerstage On im Gehlerfall für Heater drei" VALUE 0x1CA7B4 Kw_Wu16 65535.00 OneToOne 0.00 65535.00 FORMAT "%8.2" /end CHARACTERISTIC
/begin CHARACTERISTIC AOHtCD_DebBattDefHt1_C "Defektzeit fuer Fehler ""Kurzschluß nach BATT"" (Zuheizer 1)" VALUE 0x1CA7B6 Kw_Wu16 655350.0 Time_ms 0.00 655350.0 FORMAT "%8.1" /end CHARACTERISTIC
/begin CHARACTERISTIC AOHtCD_DebBattOkHt1_C "Heilungszeit fuer Fehler ""Kurzschluß nach BATT"" (Zuheizer 1)" VALUE 0x1CA7B8 Kw_Wu16 655350.0 Time_ms 0.00 655350.0 FORMAT "%8.1" /end CHARACTERISTIC
/begin CHARACTERISTIC AOHtCD_DebBattDefHt2_C "Defektzeit fuer Fehler ""Kurzschluß nach BATT"" (Zuheizer 2)" VALUE 0x1CA7BA Kw_Wu16 655350.0 Time_ms 0.00 655350.0 FORMAT "%8.1" /end CHARACTERISTIC
/begin CHARACTERISTIC AOHtCD_DebBattOkHt2_C "Heilungszeit fuer Fehler ""Kurzschluß nach BATT"" (Zuheizer 2)" VALUE 0x1CA7BC Kw_Wu16 655350.0 Time_ms 0.00 655350.0 FORMAT "%8.1" /end CHARACTERISTIC
/begin CHARACTERISTIC AOHtCD_DebBattDefHt3_C "Defektzeit fuer Fehler ""Kurzschluß nach BATT"" (Zuheizer 3)" VALUE 0x1CA7BE Kw_Wu16 655350.0 Time_ms 0.00 655350.0 FORMAT "%8.1" /end CHARACTERISTIC
/begin CHARACTERISTIC AOHtCD_DebBattOkHt3_C "Heilungszeit fuer Fehler ""Kurzschluß nach BATT"" (Zuheizer 3)" VALUE 0x1CA7C0 Kw_Wu16 655350.0 Time_ms 0.00 655350.0 FORMAT "%8.1" /end CHARACTERISTIC
/begin CHARACTERISTIC AOHtCD_DebGndDefHt1_C "Defektzeit fuer Fehler ""Kurzschluß nach Masse"" (Zuheizer 1)" VALUE 0x1CA7C2 Kw_Wu16 655350.0 Time_ms 0.00 655350.0 FORMAT "%8.1" /end CHARACTERISTIC
/begin CHARACTERISTIC AOHtCD_DebGndOkHt1_C "Heilungszeit fuer Fehler ""Kurzschluß nach Masse"" (Zuheizer 1)" VALUE 0x1CA7C4 Kw_Wu16 655350.0 Time_ms 0.00 655350.0 FORMAT "%8.1" /end CHARACTERISTIC
/begin CHARACTERISTIC AOHtCD_DebGndDefHt2_C "Defektzeit fuer Fehler ""Kurzschluß nach Masse"" (Zuheizer 2)" VALUE 0x1CA7C6 Kw_Wu16 655350.0 Time_ms 0.00 655350.0 FORMAT "%8.1" /end CHARACTERISTIC
/begin CHARACTERISTIC AOHtCD_DebGndOkHt2_C "Heilungszeit fuer Fehler ""Kurzschluß nach Masse"" (Zuheizer 2)" VALUE 0x1CA7C8 Kw_Wu16 655350.0 Time_ms 0.00 655350.0 FORMAT "%8.1" /end CHARACTERISTIC
/begin CHARACTERISTIC AOHtCD_DebGndDefHt3_C "Defektzeit fuer Fehler ""Kurzschluß nach Masse"" (Zuheizer 3)" VALUE 0x1CA7CA Kw_Wu16 655350.0 Time_ms 0.00 655350.0 FORMAT "%8.1" /end CHARACTERISTIC
/begin CHARACTERISTIC AOHtCD_DebGndOkHt3_C "Heilungszeit fuer Fehler ""Kurzschluß nach Masse"" (Zuheizer 3)" VALUE 0x1CA7CC Kw_Wu16 655350.0 Time_ms 0.00 655350.0 FORMAT "%8.1" /end CHARACTERISTIC
/begin CHARACTERISTIC AOHtCD_DebNoLoadDefHt1_C "Defektzeit fuer Fehler ""Endstufe im Leerlauf"" (Zuheizer 1)" VALUE 0x1CA7CE Kw_Wu16 655350.0 Time_ms 0.00 655350.0 FORMAT "%8.1" /end CHARACTERISTIC
/begin CHARACTERISTIC AOHtCD_DebNoLoadOkHt1_C "Heilungszeit fuer Fehler ""Endstufe im Leerlauf"" (Zuheizer 1)" VALUE 0x1CA7D0 Kw_Wu16 655350.0 Time_ms 0.00 655350.0 FORMAT "%8.1" /end CHARACTERISTIC
/begin CHARACTERISTIC AOHtCD_DebNoLoadDefHt2_C "Defektzeit fuer Fehler ""Endstufe im Leerlauf"" (Zuheizer 2)" VALUE 0x1CA7D2 Kw_Wu16 655350.0 Time_ms 0.00 655350.0 FORMAT "%8.1" /end CHARACTERISTIC
/begin CHARACTERISTIC AOHtCD_DebNoLoadOkHt2_C "Heilungszeit fuer Fehler ""Endstufe im Leerlauf"" (Zuheizer 2)" VALUE 0x1CA7D4 Kw_Wu16 655350.0 Time_ms 0.00 655350.0 FORMAT "%8.1" /end CHARACTERISTIC
/begin CHARACTERISTIC AOHtCD_DebNoLoadDefHt3_C "Defektzeit fuer Fehler ""Endstufe im Leerlauf"" (Zuheizer 3)" VALUE 0x1CA7D6 Kw_Wu16 655350.0 Time_ms 0.00 655350.0 FORMAT "%8.1" /end CHARACTERISTIC
/begin CHARACTERISTIC AOHtCD_DebNoLoadOkHt3_C "Heilungszeit fuer Fehler ""Endstufe im Leerlauf"" (Zuheizer 3)" VALUE 0x1CA7D8 Kw_Wu16 655350.0 Time_ms 0.00 655350.0 FORMAT "%8.1" /end CHARACTERISTIC
/begin CHARACTERISTIC AOHtCD_DebTempDefHt1_C "Defektzeit für Fehler ""Endstufe mit Uebertemperatur"" (Zuheizer 1)" VALUE 0x1CA7DA Kw_Wu16 655350.0 Time_ms 0.00 655350.0 FORMAT "%8.1" /end CHARACTERISTIC
/begin CHARACTERISTIC AOHtCD_DebTempOkHt1_C "Heilungszeit für Fehler ""Endstufe mit Uebertemperatur"" (Zuheizer 1)" VALUE 0x1CA7DC Kw_Wu16 655350.0 Time_ms 0.00 655350.0 FORMAT "%8.1" /end CHARACTERISTIC
/begin CHARACTERISTIC AOHtCD_DebTempDefHt2_C "Defektzeit für Fehler ""Endstufe mit Uebertemperatur"" (Zuheizer 2)" VALUE 0x1CA7DE Kw_Wu16 655350.0 Time_ms 0.00 655350.0 FORMAT "%8.1" /end CHARACTERISTIC
/begin CHARACTERISTIC AOHtCD_DebTempOkHt2_C "Heilungszeit für Fehler ""Endstufe mit Uebertemperatur"" (Zuheizer 2)" VALUE 0x1CA7E0 Kw_Wu16 655350.0 Time_ms 0.00 655350.0 FORMAT "%8.1" /end CHARACTERISTIC
/begin CHARACTERISTIC AOHtCD_DebTempDefHt3_C "Defektzeit für Fehler ""Endstufe mit Uebertemperatur"" (Zuheizer 3)" VALUE 0x1CA7E2 Kw_Wu16 655350.0 Time_ms 0.00 655350.0 FORMAT "%8.1" /end CHARACTERISTIC
/begin CHARACTERISTIC AOHtCD_DebTempOkHt3_C "Heilungszeit für Fehler ""Endstufe mit Uebertemperatur"" (Zuheizer 3)" VALUE 0x1CA7E4 Kw_Wu16 655350.0 Time_ms 0.00 655350.0 FORMAT "%8.1" /end CHARACTERISTIC
/begin CHARACTERISTIC AOHtCD_stPwmInInv_C "Invertierungsparameter fuer das PWM Signal des Dieselzuheizers" VALUE 0x1CA7E6 Kw_Wu8 1.000 OneToOne 0.00 1.000 FORMAT "%5.3" EXTENDED_LIMITS 0.00 255.0 /end CHARACTERISTIC
/begin CHARACTERISTIC AOHtCD_stDigInvHt1_C "Ausgangssignalinvertierung des Zuheizers 1" VALUE 0x1CA7E7 Kw_Wu8 1.000 OneToOne 0.00 1.000 FORMAT "%5.3" EXTENDED_LIMITS 0.00 255.0 /end CHARACTERISTIC
/begin CHARACTERISTIC AOHtCD_stDigInvHt2_C "Ausgangssignalinvertierung des Zuheizers 2" VALUE 0x1CA7E8 Kw_Wu8 1.000 OneToOne 0.00 1.000 FORMAT "%5.3" EXTENDED_LIMITS 0.00 255.0 /end CHARACTERISTIC
/begin CHARACTERISTIC AOHtCD_stDigInvHt3_C "Ausgangssignalinvertierung des Zuheizers 3" VALUE 0x1CA7E9 Kw_Wu8 1.000 OneToOne 0.00 1.000 FORMAT "%5.3" EXTENDED_LIMITS 0.00 255.0 /end CHARACTERISTIC
/begin CHARACTERISTIC AOHtCD_stSPICtlHt1_C "Schalter ob Endstufe SPI kontrollierbar = 1 oder nicht SPI kontrollierbar = 0" VALUE 0x1CA7EA Kw_Wu8 1.000 OneToOne 0.00 1.000 FORMAT "%5.3" EXTENDED_LIMITS 0.00 255.0 /end CHARACTERISTIC
/begin CHARACTERISTIC AOHtCD_stSPICtlHt2_C "Schalter ob Endstufe SPI kontrollierbar = 1 oder nicht SPI kontrollierbar = 0" VALUE 0x1CA7EB Kw_Wu8 1.000 OneToOne 0.00 1.000 FORMAT "%5.3" EXTENDED_LIMITS 0.00 255.0 /end CHARACTERISTIC
/begin CHARACTERISTIC AOHtCD_stSPICtlHt3_C "Schalter ob Endstufe SPI kontrollierbar = 1 oder nicht SPI kontrollierbar = 0" VALUE 0x1CA7EC Kw_Wu8 1.000 OneToOne 0.00 1.000 FORMAT "%5.3" EXTENDED_LIMITS 0.00 255.0 /end CHARACTERISTIC
/begin CHARACTERISTIC AOHtCD_stUsrSwtInvIn_C "Dig.Eingang invertieren (Zuheizer Fahrerschalter)" VALUE 0x1CA7ED Kw_Wu8 1.000 OneToOne 0.00 1.000 FORMAT "%5.3" EXTENDED_LIMITS 0.00 255.0 /end CHARACTERISTIC
/begin CHARACTERISTIC AOHtCD_swtHeater12EnaVal_C "Schalterwert, ob Zuheizer 1 und 2 aktiv sind (=1) oder inaktiv (=0)" VALUE 0x1CA7EE Kw_Wu8 1.000 OneToOne 0.00 1.000 FORMAT "%5.3" EXTENDED_LIMITS 0.00 255.0 /end CHARACTERISTIC
/begin CHARACTERISTIC AOHtCD_swtHeater12EnaType_C "Schaltertyp" VALUE 0x1CA7EF Kw_Wu8 2.000 OneToOne 0.00 2.000 FORMAT "%5.3" EXTENDED_LIMITS 0.00 255.0 /end CHARACTERISTIC
/begin CHARACTERISTIC AOHtCD_tiBtwTstHt1_C "Zeitabstand, in dem im Fehlerfall die Endstufe getestet wird" VALUE 0x1CA7F0 Kw_Wu16 29900.00 Time_ms 100.0000 30000.00 FORMAT "%8.2" EXTENDED_LIMITS 0.00 655350.0 /end CHARACTERISTIC
/begin CHARACTERISTIC AOHtCD_tiBtwTstHt2_C "Zeitabstand, in dem im Fehlerfall die Endstufe getestet wird" VALUE 0x1CA7F2 Kw_Wu16 29900.00 Time_ms 100.0000 30000.00 FORMAT "%8.2" EXTENDED_LIMITS 0.00 655350.0 /end CHARACTERISTIC
/begin CHARACTERISTIC AOHtCD_tiBtwTstHt3_C "Zeitabstand, in dem im Fehlerfall die Endstufe getestet wird" VALUE 0x1CA7F4 Kw_Wu16 29900.00 Time_ms 100.0000 30000.00 FORMAT "%8.2" EXTENDED_LIMITS 0.00 655350.0 /end CHARACTERISTIC
/begin CHARACTERISTIC AOHtCD_tiMax_C "Maximale Periodendauer in ms" VALUE 0x1CA7F8 Kw_Ws32 1000.00000000 Time_ms 0.00 1000.00000000 FORMAT "%13.8" EXTENDED_LIMITS -21474836480.0 21474836470.0 /end CHARACTERISTIC
/begin CHARACTERISTIC AOHtCD_tiPwrStgOnHt1_C "Zeit für welche die Endstufe im Fehlerfall eingeschalten wird (nur nicht SPI kontrolliert)" VALUE 0x1CA7FC Kw_Wu16 500.0000 Time_ms 0.00 500.0000 FORMAT "%8.4" EXTENDED_LIMITS 0.00 655350.0 /end CHARACTERISTIC
/begin CHARACTERISTIC AOHtCD_tiPwrStgOnHt2_C "Zeit für welche die Endstufe im Fehlerfall eingeschalten wird (nur nicht SPI kontrolliert)" VALUE 0x1CA7FE Kw_Wu16 500.0000 Time_ms 0.00 500.0000 FORMAT "%8.4" EXTENDED_LIMITS 0.00 655350.0 /end CHARACTERISTIC
/begin CHARACTERISTIC AOHtCD_tiPwrStgOnHt3_C "Zeit für welche die Endstufe im Fehlerfall eingeschalten wird (nur nicht SPI kontrolliert)" VALUE 0x1CA800 Kw_Wu16 500.0000 Time_ms 0.00 500.0000 FORMAT "%8.4" EXTENDED_LIMITS 0.00 655350.0 /end CHARACTERISTIC
/begin CHARACTERISTIC AOHtCD_tiUsrSwtDebNeg_C "Entprellzeit des Zuheiz-Fahrerschalters (negative Flanke)" VALUE 0x1CA802 Kw_Wu16 655350.0 TimeDeb 0.00 655350.0 FORMAT "%8.1" /end CHARACTERISTIC
/begin CHARACTERISTIC AOHtCD_tiUsrSwtDebPos_C "Entprellzeit des Zuheiz-Fahrerschalters (positive Flanke)" VALUE 0x1CA804 Kw_Wu16 655350.0 TimeDeb 0.00 655350.0 FORMAT "%8.1" /end CHARACTERISTIC
/begin CHARACTERISTIC AOHtCD_VolPerImp_C "Zuheizerkonstante (l/h)/Hz" VALUE 0x1CA808 Kw_Ws32 0.230000000000 dFlConsum 0.00 0.230000000000 FORMAT "%14.12" EXTENDED_LIMITS -21474836.4800 21474836.4700 /end CHARACTERISTIC
/begin CHARACTERISTIC AOHt_nEngHigh_C "obere Grenze der Drehzahl des Hysteresenelements" VALUE 0x1CA64C Kw_Ws16 5000.000 EngN 0.00 5000.000 FORMAT "%8.3" EXTENDED_LIMITS -32768.00 32767.00 /end CHARACTERISTIC
/begin CHARACTERISTIC AOHt_nEngLow_C "untere Grenze der Drehzahl des Hysteresenelements" VALUE 0x1CA64E Kw_Ws16 5000.000 EngN 0.00 5000.000 FORMAT "%8.3" EXTENDED_LIMITS -32768.00 32767.00 /end CHARACTERISTIC
/begin CHARACTERISTIC AOHt_nEngOffs_C "Drehzahloffset zur Übernahme der Solldrehzahlanforderung durch AOHt" VALUE 0x1CA650 Kw_Ws16 6000.000 EngN 0.00 6000.000 FORMAT "%8.3" EXTENDED_LIMITS -32768.00 32767.00 /end CHARACTERISTIC
/begin CHARACTERISTIC AOHt_nMin_C "Leerlaufanhebung bei Zuheizung" VALUE 0x1CA652 Kw_Ws16 2000.000 EngN 0.00 2000.000 FORMAT "%8.3" EXTENDED_LIMITS -32768.00 32767.00 /end CHARACTERISTIC
/begin CHARACTERISTIC AOHt_NumHeat_C "Anzahl angeschlossener Heizelemente" VALUE 0x1CA654 Kw_Wu8 3.000 OneToOne 0.00 3.000 FORMAT "%5.3" EXTENDED_LIMITS 0.00 255.0 /end CHARACTERISTIC
/begin CHARACTERISTIC AOHt_rOff_CUR "Kennlinie zur Berechnung der unteren Hystereseschwelle Generatorlast" CURVE 0x1CA656 Kl_Xs16_Ws16 100.0000 Prc 0.00 100.0000 FORMAT "%8.4" EXTENDED_LIMITS -327.6800 327.6700
 /begin AXIS_DESCR STD_AXIS Eng_nAvrg EngN 25 0.00 6000.000 FORMAT "%8.3" EXTENDED_LIMITS -32768.00 32767.00 DEPOSIT ABSOLUTE /end AXIS_DESCR
/end CHARACTERISTIC
/begin CHARACTERISTIC AOHt_rOn_CUR "Kennlinie zur Berechnung der oberen Hystereseschwelle Generatorlast" CURVE 0x1CA6BC Kl_Xs16_Ws16 100.0000 Prc 0.00 100.0000 FORMAT "%8.4" EXTENDED_LIMITS -327.6800 327.6700
 /begin AXIS_DESCR STD_AXIS Eng_nAvrg EngN 25 0.00 6000.000 FORMAT "%8.3" EXTENDED_LIMITS -32768.00 32767.00 DEPOSIT ABSOLUTE /end AXIS_DESCR
/end CHARACTERISTIC
/begin CHARACTERISTIC AOHt_rSE_C "Wert um der die Einschaltschwelle aus AOHt_rOn_CUR für die Zeit AOHt_tiSE_C abgesenkt wird" VALUE 0x1CA724 Kw_Wu32 100.000000000 Prc 0.00 100.000000000 FORMAT "%13.9" EXTENDED_LIMITS 0.00 42949672.9500 /end CHARACTERISTIC
/begin CHARACTERISTIC AOHt_stCAN_C "Bit0=1: CAN Anforderung auf Heizelement 1 und 2, Bit1=1: CAN Anforderung auf Heizelement 3" VALUE 0x1CA728 Kw_Wu8 3.000 OneToOne 0.00 3.000 FORMAT "%5.3" EXTENDED_LIMITS 0.00 255.0 /end CHARACTERISTIC
/begin CHARACTERISTIC AOHt_stESCUShtOffDfl_C "Defaultwert für ""Zuheizer abschalten"" wenn CAN-Botschaf für die Abschaltanforderung fehlerhaft ist." VALUE 0x1CA729 Kw_Wu8 1.000 OneToOne 0.00 1.000 FORMAT "%5.3" EXTENDED_LIMITS 0.00 255.0 /end CHARACTERISTIC
/begin CHARACTERISTIC AOHt_stESCUShtOff_C "Zuheizer-Abschaltung bei Leerlaufdrehzahlanhebungsanforderung von CAN-BSG erlauben" VALUE 0x1CA72A Kw_Wu8 3.000 OneToOne 0.00 3.000 FORMAT "%5.3" EXTENDED_LIMITS 0.00 255.0 /end CHARACTERISTIC
/begin CHARACTERISTIC AOHt_stSwt_C "Kein Motor-Aus-Funktion Konfiguration" VALUE 0x1CA72B Kw_Wu8 255.0 OneToOne 0.00 255.0 FORMAT "%5.1" /end CHARACTERISTIC
/begin CHARACTERISTIC AOHt_stUsrSwtEnable_C "Signalbehandlung des Zuheizungs-Fahrerschalters aktivieren/deaktivieren" VALUE 0x1CA72C Kw_Wu8 1.000 OneToOne 0.00 1.000 FORMAT "%5.3" EXTENDED_LIMITS 0.00 255.0 /end CHARACTERISTIC
/begin CHARACTERISTIC AOHt_swtFrztAirEna_C "einfrieren des Lufttemperaturwertes ermöglichen" VALUE 0x1CA72D Kw_Wu8 1.000 OneToOne 0.00 1.000 FORMAT "%5.3" EXTENDED_LIMITS 0.00 255.0 /end CHARACTERISTIC
/begin CHARACTERISTIC AOHt_swtSensAir_C "Auswahl der Lufttemperatur" VALUE 0x1CA72E Kw_Ws16 1.000000 OneToOne 0.00 1.000000 FORMAT "%8.6" EXTENDED_LIMITS -32768.00 32767.00 /end CHARACTERISTIC
/begin CHARACTERISTIC AOHt_swtSigCan_C "Schalter zur Aktivierung der Zusatzheizung über CAN" VALUE 0x1CA730 Kw_Wu8 1.000 OneToOne 0.00 1.000 FORMAT "%5.3" EXTENDED_LIMITS 0.00 255.0 /end CHARACTERISTIC
/begin CHARACTERISTIC AOHt_swtTemp_C "Schalter der Temperaturwert des Arrays auswählt" VALUE 0x1CA731 Kw_Wu8 4.00000000000 EngTempFldSel 0.00 4.00000000000 FORMAT "%13.11" /end CHARACTERISTIC
/begin CHARACTERISTIC AOHt_tAirUpLi_CUR "Kennlinie fuer die Berechnung von AOHt_tCltOn_mp" CURVE 0x1CA732 Kl_Xs16_Ws16 600.0000 Temp_Cels -273.1400 326.8600 FORMAT "%8.4" EXTENDED_LIMITS -3549.940 3003.560
 /begin AXIS_DESCR STD_AXIS AOHt_tAir_mp Temp_Cels 25 -273.1400 326.8600 FORMAT "%8.4" EXTENDED_LIMITS -3549.940 3003.560 DEPOSIT ABSOLUTE /end AXIS_DESCR
/end CHARACTERISTIC
/begin CHARACTERISTIC AOHt_tEnvHigh_C "obere Grenze der Umgebungstemperatur des Hysteresenelements" VALUE 0x1CA798 Kw_Ws16 3276.700 Temp_Cels -273.1400 3003.560 FORMAT "%8.3" EXTENDED_LIMITS -3549.940 3003.560 /end CHARACTERISTIC
/begin CHARACTERISTIC AOHt_tEnvLow_C "untere Grenze der Umgebungstemperatur des Hysteresenelements" VALUE 0x1CA79A Kw_Ws16 3276.700 Temp_Cels -273.1400 3003.560 FORMAT "%8.3" EXTENDED_LIMITS -3549.940 3003.560 /end CHARACTERISTIC
/begin CHARACTERISTIC AOHt_tHysRng_C "Temperaturbereich fuer die Hysterese" VALUE 0x1CA79C Kw_Ws16 400.0000 TempDiff_Kelv 0.00 400.0000 FORMAT "%8.4" EXTENDED_LIMITS -3276.800 3276.700 /end CHARACTERISTIC
/begin CHARACTERISTIC AOHt_tiSE_C "Zeitdauer in der die Absenkung AOHt_rSE_C aktiv ist" VALUE 0x1CA7A0 Kw_Wu32 3600000.00000 Time_ms 0.00 3600000.00000 FORMAT "%13.5" EXTENDED_LIMITS 0.00 42949672950.0 /end CHARACTERISTIC
/begin CHARACTERISTIC AOHt_tiStrt_C "Startverzoegerung fuer die Heizleistungssteigerung" VALUE 0x1CA7A4 Kw_Wu32 3600000.00000 Time_ms 0.00 3600000.00000 FORMAT "%13.5" EXTENDED_LIMITS 0.00 42949672950.0 /end CHARACTERISTIC
/begin CHARACTERISTIC AOHt_tiVER_C "Zuschaltverzögerung für das nächste Heizelement" VALUE 0x1CA7A8 Kw_Wu32 3600000.00000 Time_ms 0.00 3600000.00000 FORMAT "%13.5" EXTENDED_LIMITS 0.00 42949672950.0 /end CHARACTERISTIC
/begin CHARACTERISTIC AOHt_uBattHigh_C "obere Grenze der Batteriespannung des Hysteresenelements" VALUE 0x1CA7AC Kw_Ws16 100009.6 Volt_Batt 0.00 100009.6 FORMAT "%8.1" EXTENDED_LIMITS -665674.1 665653.8 /end CHARACTERISTIC
/begin CHARACTERISTIC AOHt_uBattLow_C "untere Grenze der Batteriespannung des Hysteresenelements" VALUE 0x1CA7AE Kw_Ws16 100009.6 Volt_Batt 0.00 100009.6 FORMAT "%8.1" EXTENDED_LIMITS -665674.1 665653.8 /end CHARACTERISTIC
/begin CHARACTERISTIC APPCD_uAPP1_SRCMin_C "Spannung SRC-low" VALUE 0x1CA80C Kw_Ws16 5200.391 Volt 0.00 5200.391 FORMAT "%8.3" EXTENDED_LIMITS -160156.4 160151.5 /end CHARACTERISTIC
/begin CHARACTERISTIC APPCD_uAPP1_SRCMax_C "Spannung SRC-high" VALUE 0x1CA80E Kw_Ws16 5200.391 Volt 0.00 5200.391 FORMAT "%8.3" EXTENDED_LIMITS -160156.4 160151.5 /end CHARACTERISTIC
/begin CHARACTERISTIC APPCD_rLinAPP1_CUR "Linerisierungs-Kennlinie APP1" CURVE 0x1CA810 Kl_Xs16_Ws16 100.0000 Prc 0.00 100.0000 FORMAT "%8.4" EXTENDED_LIMITS -327.6800 327.6700
 /begin AXIS_DESCR STD_AXIS APPCD_uRawAPP1 Volt 10 0.00 5200.391 FORMAT "%8.3" EXTENDED_LIMITS -160156.4 160151.5 DEPOSIT ABSOLUTE /end AXIS_DESCR
/end CHARACTERISTIC
/begin CHARACTERISTIC APPCD_uAPP2_SRCMin_C "Spannung SRC-low" VALUE 0x1CA83A Kw_Ws16 5200.391 Volt 0.00 5200.391 FORMAT "%8.3" EXTENDED_LIMITS -160156.4 160151.5 /end CHARACTERISTIC
/begin CHARACTERISTIC APPCD_uAPP2_SRCMax_C "Spannung SRC-high" VALUE 0x1CA83C Kw_Ws16 5200.391 Volt 0.00 5200.391 FORMAT "%8.3" EXTENDED_LIMITS -160156.4 160151.5 /end CHARACTERISTIC
/begin CHARACTERISTIC APPCD_rLinAPP2_CUR "Linerisierungs-Kennlinie APP2" CURVE 0x1CA83E Kl_Xs16_Ws16 100.0000 Prc 0.00 100.0000 FORMAT "%8.4" EXTENDED_LIMITS -327.6800 327.6700
 /begin AXIS_DESCR STD_AXIS APPCD_uRawAPP2 Volt 10 0.00 5200.391 FORMAT "%8.3" EXTENDED_LIMITS -160156.4 160151.5 DEPOSIT ABSOLUTE /end AXIS_DESCR
/end CHARACTERISTIC
/begin CHARACTERISTIC APPCD_uAPPPre_SRCMin_C "Spannung SRC-low" VALUE 0x1CA90C Kw_Ws16 5200.391 Volt 0.00 5200.391 FORMAT "%8.3" EXTENDED_LIMITS -160156.4 160151.5 /end CHARACTERISTIC
/begin CHARACTERISTIC APPCD_uAPPPre_SRCMax_C "Spannung SRC-high" VALUE 0x1CA90E Kw_Ws16 5200.391 Volt 0.00 5200.391 FORMAT "%8.3" EXTENDED_LIMITS -160156.4 160151.5 /end CHARACTERISTIC
/begin CHARACTERISTIC APPCD_rLinAPPPre_CUR "Linearisierungs-Kennlinie APP" CURVE 0x1CA910 Kl_Xs16_Ws16 100.0000 Prc 0.00 100.0000 FORMAT "%8.4" EXTENDED_LIMITS -327.6800 327.6700
 /begin AXIS_DESCR STD_AXIS APPCD_uRawAPPPre_mp Volt 2 0.00 5200.391 FORMAT "%8.3" EXTENDED_LIMITS -160156.4 160151.5 DEPOSIT ABSOLUTE /end AXIS_DESCR
/end CHARACTERISTIC
/begin CHARACTERISTIC APPCD_cntDebMax_C "Maximalwert des Entprellungszählers" VALUE 0x1CA868 Kw_Wu8 255.0 OneToOne 0.00 255.0 FORMAT "%5.1" /end CHARACTERISTIC
/begin CHARACTERISTIC APPCD_DebSRCHighDef_C "Defektzeit SRC-high" VALUE 0x1CA86A Kw_Wu16 655350.0 Time_ms 0.00 655350.0 FORMAT "%8.1" /end CHARACTERISTIC
/begin CHARACTERISTIC APPCD_DebSRCHighOk_C "Heilungszeit SRC-high" VALUE 0x1CA86C Kw_Wu16 655350.0 Time_ms 0.00 655350.0 FORMAT "%8.1" /end CHARACTERISTIC
/begin CHARACTERISTIC APPCD_DebSRCLowDef_C "Defektzeit SRC-low" VALUE 0x1CA86E Kw_Wu16 655350.0 Time_ms 0.00 655350.0 FORMAT "%8.1" /end CHARACTERISTIC
/begin CHARACTERISTIC APPCD_DebSRCLowOk_C "Heilungszeit SRC-low" VALUE 0x1CA870 Kw_Wu16 655350.0 Time_ms 0.00 655350.0 FORMAT "%8.1" /end CHARACTERISTIC
/begin CHARACTERISTIC APPCD_DebSyncDef_C "Entprellzeit Gleichlauffehler APP1/APP2" VALUE 0x1CA872 Kw_Wu16 655350.0 Time_ms 0.00 655350.0 FORMAT "%8.1" /end CHARACTERISTIC
/begin CHARACTERISTIC APPCD_DebSyncOk_C "Heilzeit Gleichlauffehler APP1/APP2" VALUE 0x1CA874 Kw_Wu16 655350.0 Time_ms 0.00 655350.0 FORMAT "%8.1" READ_ONLY /end CHARACTERISTIC
/begin CHARACTERISTIC APPCD_drAPPJit1_C "Groesse des Jitters des APP-Wertes der unterdrueckt wird" VALUE 0x1CA91A Kw_Ws16 100.0000 Prc 0.00 100.0000 FORMAT "%8.4" EXTENDED_LIMITS -327.6800 327.6700 /end CHARACTERISTIC
/begin CHARACTERISTIC APPCD_drAPPJit2_C "Groesse des Jitters des APP-Wertes der unterdrueckt wird" VALUE 0x1CA91C Kw_Ws16 100.0000 Prc 0.00 100.0000 FORMAT "%8.4" EXTENDED_LIMITS -327.6800 327.6700 /end CHARACTERISTIC
/begin CHARACTERISTIC APPCD_duAPPJit_C "Groesse des Jitters der APP-Rohspannung der unterdrueckt wird" VALUE 0x1CA876 Kw_Ws16 5200.391 Volt 0.00 5200.391 FORMAT "%8.3" EXTENDED_LIMITS -160156.4 160151.5 /end CHARACTERISTIC
/begin CHARACTERISTIC APPCD_facrAPP1APP2_C "Faktor zwischen den Rohspannungen APP1/APP2" VALUE 0x1C1FEC Kw_Ws16 7.999878 Fact -4.000000 3.999878 FORMAT "%8.6" /end CHARACTERISTIC
/begin CHARACTERISTIC APPCD_tiNegExtIntPT1_C "PT1 Filterzeitkonstante für externe Eingriffe neg.Steigung" VALUE 0x1CA878 Kw_Wu32 4294.9673 TimeDelay_s 0.0000010000000 4294.9673 FORMAT "%9.4" /end CHARACTERISTIC
/begin CHARACTERISTIC APPCD_tiPosExtIntPT1_C "PT1 Filterzeitkonstante für externe Eingriffe pos. Steigung" VALUE 0x1CA87C Kw_Wu32 4294.9673 TimeDelay_s 0.0000010000000 4294.9673 FORMAT "%9.4" /end CHARACTERISTIC
/begin CHARACTERISTIC APPCD_tiLowNegPT1_C "Filterzeit low position, neg. Steig" VALUE 0x1CA880 Kw_Wu32 4294.9673 TimeDelay_s 0.0000010000000 4294.9673 FORMAT "%9.4" /end CHARACTERISTIC
/begin CHARACTERISTIC APPCD_tiLowPosPT1_C "Filterzeit low position, pos. Steig." VALUE 0x1CA884 Kw_Wu32 4294.9673 TimeDelay_s 0.0000010000000 4294.9673 FORMAT "%9.4" /end CHARACTERISTIC
/begin CHARACTERISTIC APPCD_tiMidNegPT1_C "Filterzeit mid. position, neg. Steig." VALUE 0x1CA888 Kw_Wu32 4294.9673 TimeDelay_s 0.0000010000000 4294.9673 FORMAT "%9.4" /end CHARACTERISTIC
/begin CHARACTERISTIC APPCD_tiMidPosPT1_C "Filterzeit mid. position, pos. Steig." VALUE 0x1CA88C Kw_Wu32 4294.9673 TimeDelay_s 0.0000010000000 4294.9673 FORMAT "%9.4" /end CHARACTERISTIC
/begin CHARACTERISTIC APPCD_tiUppNegPT1_C "Filterzeit upper position, neg. Steig." VALUE 0x1CA890 Kw_Wu32 4294.9673 TimeDelay_s 0.0000010000000 4294.9673 FORMAT "%9.4" /end CHARACTERISTIC
/begin CHARACTERISTIC APPCD_tiUppPosPT1_C "Filterzeit upper position, pos. Steig.:" VALUE 0x1CA894 Kw_Wu32 4294.9673 TimeDelay_s 0.0000010000000 4294.9673 FORMAT "%9.4" /end CHARACTERISTIC
/begin CHARACTERISTIC APPCD_swtNoFlt_C "Schalter für Filter AUS bei betätigter Kupplung (0 = Filter ein bei betätigter Kupplung, 1 = Filter aus bei betätigter Kupplung)" VALUE 0x1CA898 Kw_Wu8 1.000 OneToOne 0.00 1.000 FORMAT "%5.3" EXTENDED_LIMITS 0.00 255.0 /end CHARACTERISTIC
/begin CHARACTERISTIC APPCD_rThrFltLowPos_C "Schwelle Filterzeit low position, pos. Steig." VALUE 0x1CA89A Kw_Ws16 100.0000 Prc 0.00 100.0000 FORMAT "%8.4" EXTENDED_LIMITS -327.6800 327.6700 /end CHARACTERISTIC
/begin CHARACTERISTIC APPCD_rThrFltMidPos_C "APPSchwelle Filterzeit mid. position, pos. Steig." VALUE 0x1CA89C Kw_Ws16 100.0000 Prc 0.00 100.0000 FORMAT "%8.4" EXTENDED_LIMITS -327.6800 327.6700 /end CHARACTERISTIC
/begin CHARACTERISTIC APPCD_rThrFltLowNeg_C "Schwelle Filterzeit low position, neg. Steig." VALUE 0x1CA89E Kw_Ws16 100.0000 Prc 0.00 100.0000 FORMAT "%8.4" EXTENDED_LIMITS -327.6800 327.6700 /end CHARACTERISTIC
/begin CHARACTERISTIC APPCD_rThrFltMidNeg_C "Schwelle Filterzeit mid position, neg. Steig." VALUE 0x1CA8A0 Kw_Ws16 100.0000 Prc 0.00 100.0000 FORMAT "%8.4" EXTENDED_LIMITS -327.6800 327.6700 /end CHARACTERISTIC
/begin CHARACTERISTIC APPCD_numAdcAPP1_C "Applikationsparameter  fuer den Fahrpedal 1 position -Fuehler" VALUE 0x1C1FEE Kw_Wu8 23.0000000000 NumPinAdc 2.00000000000 25.0000000000 FORMAT "%13.10" /end CHARACTERISTIC
/begin CHARACTERISTIC APPCD_numAdcAPP2_C "Applikationsparameter  fuer den Fahrpedal 2 position -Fuehler" VALUE 0x1C1FEF Kw_Wu8 23.0000000000 NumPinAdc 2.00000000000 25.0000000000 FORMAT "%13.10" /end CHARACTERISTIC
/begin CHARACTERISTIC APPCD_duLimErrPos_C "Rampensteigung der Rohspannung PWG" VALUE 0x1CA8A4 Kw_Wu32 320312805.400 RmpVoltSens 0.00 320312805.400 FORMAT "%13.3" /end CHARACTERISTIC
/begin CHARACTERISTIC APPCD_duLimErrNeg_C "Rampensteigung der Rohspannung PWG" VALUE 0x1CA8A8 Kw_Wu32 320312805.400 RmpVoltSens 0.00 320312805.400 FORMAT "%13.3" READ_ONLY /end CHARACTERISTIC
/begin CHARACTERISTIC APPCD_rKickDownErrThres_C "Pedalwertschwelle für die Kick Down Fehlerdektion" VALUE 0x1CA8AC Kw_Ws16 100.0000 Prc 0.00 100.0000 FORMAT "%8.4" EXTENDED_LIMITS -327.6800 327.6700 /end CHARACTERISTIC
/begin CHARACTERISTIC APPCD_rKickDownlrnThres_C "schwellwert des zu startenden kickdown-lernens" VALUE 0x1CA8AE Kw_Ws16 100.0000 Prc 0.00 100.0000 FORMAT "%8.4" EXTENDED_LIMITS -327.6800 327.6700 /end CHARACTERISTIC
/begin CHARACTERISTIC APPCD_rLinAPP_CUR "Linearisierungskennline für APP" CURVE 0x1CA8B0 Kl_Xs16_Ws16 100.0000 Prc 0.00 100.0000 FORMAT "%8.4" EXTENDED_LIMITS -327.6800 327.6700
 /begin AXIS_DESCR STD_AXIS APPCD_uRaw_mp Volt 2 0.00 5200.391 FORMAT "%8.3" EXTENDED_LIMITS -160156.4 160151.5 DEPOSIT ABSOLUTE /end AXIS_DESCR
/end CHARACTERISTIC
/begin CHARACTERISTIC APPCD_SSpMonAPP1_C "Auswahl der Sensor-Versorgungs-Spannung für APP1" VALUE 0x1CA8BA Kw_Wu8 2.000 OneToOne 1.000 3.000 FORMAT "%5.3" EXTENDED_LIMITS 0.00 255.0 /end CHARACTERISTIC
/begin CHARACTERISTIC APPCD_SSpMonAPP2_C "Auswahl der Sensor-Versorgungs-Spannung für APP2" VALUE 0x1CA8BB Kw_Wu8 2.000 OneToOne 1.000 3.000 FORMAT "%5.3" EXTENDED_LIMITS 0.00 255.0 /end CHARACTERISTIC
/begin CHARACTERISTIC APPCD_stDigInInvKickDown_C "Invertierung des Eingangsignals" VALUE 0x1CA8BC Kw_Wu8 1.000 OneToOne 0.00 1.000 FORMAT "%5.3" EXTENDED_LIMITS 0.00 255.0 /end CHARACTERISTIC
/begin CHARACTERISTIC APPCD_stLowIdlSwtInvIn_C "Invertiertes Eingangssignal" VALUE 0x1CA8BD Kw_Wu8 1.000 OneToOne 0.00 1.000 FORMAT "%5.3" EXTENDED_LIMITS 0.00 255.0 /end CHARACTERISTIC
/begin CHARACTERISTIC APPCD_swtDigInPresent_C "Schalter zur Deaktivierung des digitalen Eingangs von APPCD" VALUE 0x1CA8BE Kw_Wu8 1.000 OneToOne 0.00 1.000 FORMAT "%5.3" EXTENDED_LIMITS 0.00 255.0 /end CHARACTERISTIC
/begin CHARACTERISTIC APPCD_swtEnaPeakFlt_C "Schalter zum Ausfiltern von PWG-Spannungsspitzen" VALUE 0x1CA8BF Kw_Wu8 1.000 OneToOne 0.00 1.000 FORMAT "%5.3" EXTENDED_LIMITS 0.00 255.0 /end CHARACTERISTIC
/begin CHARACTERISTIC APPCD_swtEnaUnJitPre1_C "Schalter zur Aktivierung der Entjitterung (1: Entjitterung aktiviert, 0: Entjitterung deaktiviert)" VALUE 0x1CA91E Kw_Wu8 1.000 OneToOne 0.00 1.000 FORMAT "%5.3" EXTENDED_LIMITS 0.00 255.0 /end CHARACTERISTIC
/begin CHARACTERISTIC APPCD_swtEnaUnJitPre2_C "Schalter zur Aktivierung der Entjitterung (1: Entjitterung aktiviert, 0: Entjitterung deaktiviert)" VALUE 0x1CA91F Kw_Wu8 1.000 OneToOne 0.00 1.000 FORMAT "%5.3" EXTENDED_LIMITS 0.00 255.0 /end CHARACTERISTIC
/begin CHARACTERISTIC APPCD_swtEnaUnJit_C "Schalter zur Aktivierung der Entjitterung (1: Entjitterung aktiviert, Entjitterung deaktiviert)" VALUE 0x1CA8C0 Kw_Wu8 1.000 OneToOne 0.00 1.000 FORMAT "%5.3" EXTENDED_LIMITS 0.00 255.0 /end CHARACTERISTIC
/begin CHARACTERISTIC APPCD_swtExtIntEna_C "Schalter zur Freischaltung der PT1 Parameter für externe Eingriffe" VALUE 0x1CA8C1 Kw_Wu8 1.000 OneToOne 0.00 1.000 FORMAT "%5.3" EXTENDED_LIMITS 0.00 255.0 /end CHARACTERISTIC
/begin CHARACTERISTIC APPCD_swtKickDownHighAPP_C "Schalter zur Auswahl der Kick-Down-Spannungsschwelle" VALUE 0x1CA8C2 Kw_Wu8 1.000 OneToOne 0.00 1.000 FORMAT "%5.3" EXTENDED_LIMITS 0.00 255.0 /end CHARACTERISTIC
/begin CHARACTERISTIC APPCD_swtKickDown_C "Schalter zur Auswahl der Quelle von dem Kickdown-Signal" VALUE 0x1CA8C3 Kw_Wu8 1.000 OneToOne 0.00 1.000 FORMAT "%5.3" EXTENDED_LIMITS 0.00 255.0 /end CHARACTERISTIC
/begin CHARACTERISTIC APPCD_swtPrefillEna_C "Schalter zur Aktivierung der Prefill-Funktion (0: Prefill deaktiviert, 1: Prefill aktiviert" VALUE 0x1CA920 Kw_Wu8 1.000 OneToOne 0.00 1.000 FORMAT "%5.3" EXTENDED_LIMITS 0.00 255.0 /end CHARACTERISTIC
/begin CHARACTERISTIC APPCD_swtTypeVal_C "Auswahl zwischen Doppelanalog- und Poti/Schalter-PWG" VALUE 0x1CA8C4 Kw_Wu8 2.000 OneToOne 0.00 2.000 FORMAT "%5.3" EXTENDED_LIMITS 0.00 255.0 READ_ONLY /end CHARACTERISTIC
/begin CHARACTERISTIC APPCD_swtTypeType_C "Auswahl zwischen Doppelanalog- und Poti/Schalter-PWG" VALUE 0x1CA8C5 Kw_Wu8 0.00 OneToOne 2.000 2.000 FORMAT "%5.3" EXTENDED_LIMITS 0.00 255.0 READ_ONLY /end CHARACTERISTIC
/begin CHARACTERISTIC APPCD_tiDebPWGDrftDef_C "Fehlerentprellzeit für Fehlerbedingung der PWG-Drift" VALUE 0x1CA8C6 Kw_Wu16 655140.0 Time_ms 0.00 655140.0 FORMAT "%8.1" EXTENDED_LIMITS 0.00 655350.0 /end CHARACTERISTIC
/begin CHARACTERISTIC APPCD_tiDebPWGDrftOk_C "Heilungsentprellzeit für Fehlerbedingung der PWG-Drift" VALUE 0x1CA8C8 Kw_Wu16 655140.0 Time_ms 0.00 655140.0 FORMAT "%8.1" EXTENDED_LIMITS 0.00 655350.0 /end CHARACTERISTIC
/begin CHARACTERISTIC APPCD_tiDisplayTimeOut_C "Time Out Zeit für die Anzeige der Kick Down Lern Texte" VALUE 0x1CA8CA Kw_Wu16 655140.0 Time_ms 0.00 655140.0 FORMAT "%8.1" EXTENDED_LIMITS 0.00 655350.0 /end CHARACTERISTIC
/begin CHARACTERISTIC APPCD_tiDebKickDownDef_C "Fehlerentprellzeit für Dfp_APPCD_KickDown_mp" VALUE 0x1CA8CC Kw_Wu16 655350.0 Time_ms 0.00 655350.0 FORMAT "%8.1" /end CHARACTERISTIC
/begin CHARACTERISTIC APPCD_tiDebKickDownOk_C "Fehlerheilzeit für  Dfp_APPCD_KickDown_mp" VALUE 0x1CA8CE Kw_Wu16 655350.0 Time_ms 0.00 655350.0 FORMAT "%8.1" /end CHARACTERISTIC
/begin CHARACTERISTIC APPCD_DebKDDioPlaOk_C "Entprellzeit für Dfp_APPCD_KickDown Heilungserkennung" VALUE 0x1CA8D0 Kw_Wu16 655350.0 Time_ms 0.00 655350.0 FORMAT "%8.1" /end CHARACTERISTIC
/begin CHARACTERISTIC APPCD_DebKDDioPlaDef_C "Entprellzeit für Dfp_APPCD_KickDown Defekterkennung" VALUE 0x1CA8D2 Kw_Wu16 655350.0 Time_ms 0.00 655350.0 FORMAT "%8.1" /end CHARACTERISTIC
/begin CHARACTERISTIC APPCD_tiKickDownlrnTimeout_C "Lernfunktionsdauer" VALUE 0x1CA8D4 Kw_Wu16 655140.0 Time_ms 0.00 655140.0 FORMAT "%8.1" EXTENDED_LIMITS 0.00 655350.0 /end CHARACTERISTIC
/begin CHARACTERISTIC APPCD_tiKickDownSwtDebNeg_C "Entprellwert für neg. Steigung" VALUE 0x1CA8D6 Kw_Wu16 655350.0 TimeDeb 0.00 655350.0 FORMAT "%8.1" /end CHARACTERISTIC
/begin CHARACTERISTIC APPCD_tiKickDownSwtDebPos_C "Entprellwert für pos. Steigung" VALUE 0x1CA8D8 Kw_Wu16 655350.0 TimeDeb 0.00 655350.0 FORMAT "%8.1" /end CHARACTERISTIC
/begin CHARACTERISTIC APPCD_tiKickDownTolcLim_C "Toleranzzeitdauer für Kickdown-Lernwert gültig" VALUE 0x1CA8DA Kw_Wu16 655140.0 Time_ms 0.00 655140.0 FORMAT "%8.1" EXTENDED_LIMITS 0.00 655350.0 /end CHARACTERISTIC
/begin CHARACTERISTIC APPCD_uAPPMin_C "Ersatzwert für APP-Rohspannung bei Defekt beider Geber" VALUE 0x1CA8DC Kw_Ws16 5200.391 Volt 0.00 5200.391 FORMAT "%8.3" EXTENDED_LIMITS -160156.4 160151.5 /end CHARACTERISTIC
/begin CHARACTERISTIC APPCD_uKickDownCorrVal_C "Zu applizierender Korrekturwert für gelernten Kick-Down-Wert" VALUE 0x1CA8DE Kw_Ws16 1999.022 Volt 0.00 1999.022 FORMAT "%8.3" EXTENDED_LIMITS -160156.4 160151.5 /end CHARACTERISTIC
/begin CHARACTERISTIC APPCD_uKickDownHighAPP_C "obere Hys.-Kick-Down-Spg.-Schwelle für APP" VALUE 0x1CA8E0 Kw_Ws16 5200.391 Volt 0.00 5200.391 FORMAT "%8.3" EXTENDED_LIMITS -160156.4 160151.5 /end CHARACTERISTIC
/begin CHARACTERISTIC APPCD_uKickDownLowAPP_C "untere Hys.-Kick-Down-Spg.-Schwelle für APP" VALUE 0x1CA8E2 Kw_Ws16 5200.391 Volt 0.00 5200.391 FORMAT "%8.3" EXTENDED_LIMITS -160156.4 160151.5 /end CHARACTERISTIC
/begin CHARACTERISTIC APPCD_uKickDownThresDfl_C "Kickdown-Vorgabeschwellwert im Kickdown-Lernfehlerfall" VALUE 0x1CA8E4 Kw_Ws16 5200.391 Volt 0.00 5200.391 FORMAT "%8.3" EXTENDED_LIMITS -160156.4 160151.5 /end CHARACTERISTIC
/begin CHARACTERISTIC APPCD_uKickDownTolcLim_C "Toleranzwert von APP1 während Kickdown-Lernens" VALUE 0x1CA8E6 Kw_Ws16 5200.391 Volt 0.00 5200.391 FORMAT "%8.3" EXTENDED_LIMITS -160156.4 160151.5 /end CHARACTERISTIC
/begin CHARACTERISTIC APPCD_uMaxLowIdlePWG1_C "Maximalwert der Leerlaufschwelle für PWG1" VALUE 0x1CA8E8 Kw_Ws16 5200.391 Volt 0.00 5200.391 FORMAT "%8.3" EXTENDED_LIMITS -160156.4 160151.5 /end CHARACTERISTIC
/begin CHARACTERISTIC APPCD_uMaxLowIdlePWG2_C "Maximalwert der Leerlaufschwelle für PWG2" VALUE 0x1CA8EA Kw_Ws16 5200.391 Volt 0.00 5200.391 FORMAT "%8.3" EXTENDED_LIMITS -160156.4 160151.5 /end CHARACTERISTIC
/begin CHARACTERISTIC APPCD_uMinSync_C "Minimale Rohspannung zur Freigabe der Gleichlaufprüfung" VALUE 0x1CA8EC Kw_Ws16 5200.391 Volt 0.00 5200.391 FORMAT "%8.3" EXTENDED_LIMITS -160156.4 160151.5 /end CHARACTERISTIC
/begin CHARACTERISTIC APPCD_uPWG1_C "applizierbarer Spannungswert PWG1" VALUE 0x1CA8EE Kw_Ws16 5200.391 Volt 0.00 5200.391 FORMAT "%8.3" EXTENDED_LIMITS -160156.4 160151.5 /end CHARACTERISTIC
/begin CHARACTERISTIC APPCD_uPWG2_C "applizierbarer Spannungswert PWG2" VALUE 0x1CA8F0 Kw_Ws16 5200.391 Volt 0.00 5200.391 FORMAT "%8.3" EXTENDED_LIMITS -160156.4 160151.5 /end CHARACTERISTIC
/begin CHARACTERISTIC APPCD_uRawAPP2dOff_C "Offset für APP2-Rohspannung" VALUE 0x1CA8F2 Kw_Ws16 498.5337 Volt 0.00 498.5337 FORMAT "%8.4" EXTENDED_LIMITS -160156.4 160151.5 /end CHARACTERISTIC
/begin CHARACTERISTIC APPCD_uSync_CUR "Kennlinie zur Bestimmung der maximal zulaessigen Abweichung APP1/APP2" CURVE 0x1CA8F4 Kl_Xs16_Ws16 5200.391 Volt 0.00 5200.391 FORMAT "%8.3" EXTENDED_LIMITS -160156.4 160151.5
 /begin AXIS_DESCR STD_AXIS APPCD_uRawAPP1 Volt 5 0.00 5200.391 FORMAT "%8.3" EXTENDED_LIMITS -160156.4 160151.5 DEPOSIT ABSOLUTE /end AXIS_DESCR
/end CHARACTERISTIC
/begin CHARACTERISTIC APPCD_vDflMin_C "Minimum-Schwelle für die Geschwindigkeitserfassung" VALUE 0x1CA90A Kw_Ws16 20.00000 Vel 0.00 20.00000 FORMAT "%8.5" EXTENDED_LIMITS -327.6800 327.6700 /end CHARACTERISTIC
/begin CHARACTERISTIC APSCD_uSRCMin_C "Atmosphaerendruckfuehler SRC-Min Fehlerschwelle" VALUE 0x1CA924 Kw_Ws16 5200.391 Volt 0.00 5200.391 FORMAT "%8.3" EXTENDED_LIMITS -160156.4 160151.5 /end CHARACTERISTIC
/begin CHARACTERISTIC APSCD_uSRCMax_C "Atmosphaerendruckfuehler SRC-Max Fehlerschwelle" VALUE 0x1CA926 Kw_Ws16 5200.391 Volt 0.00 5200.391 FORMAT "%8.3" EXTENDED_LIMITS -160156.4 160151.5 /end CHARACTERISTIC
/begin CHARACTERISTIC APSCD_pLin_CUR "Atmosphaerendruck Liniarisierungskennlinie" CURVE 0x1CA928 Kl_Xs16_Ws16 3500.000 Pres_hPa 0.00 3500.000 FORMAT "%8.3" EXTENDED_LIMITS -32768.00 32767.00
 /begin AXIS_DESCR STD_AXIS APSCD_uRaw Volt 25 0.00 5000.000 FORMAT "%8.3" EXTENDED_LIMITS -160156.4 160151.5 DEPOSIT ABSOLUTE /end AXIS_DESCR
/end CHARACTERISTIC
/begin CHARACTERISTIC APSCD_DebSigDef_C "Entprellzeit defekt für ungültiges CAN-Signal für Atmosphärendruck" VALUE 0x1CA98E Kw_Wu16 655350.0 Time_ms 0.00 655350.0 FORMAT "%8.1" /end CHARACTERISTIC
/begin CHARACTERISTIC APSCD_DebSigOk_C "Heilungsentprellzeit für ungültiges CAN-Signal Atmosphärendruck" VALUE 0x1CA990 Kw_Wu16 655350.0 Time_ms 0.00 655350.0 FORMAT "%8.1" /end CHARACTERISTIC
/begin CHARACTERISTIC APSCD_DebSRCDef_C "Entprellzeit fuer SRC Defektzeit" VALUE 0x1CA992 Kw_Wu16 655350.0 Time_ms 0.00 655350.0 FORMAT "%8.1" /end CHARACTERISTIC
/begin CHARACTERISTIC APSCD_DebSRCOk_C "Entprellzeit fuer SRC-Heilzeit" VALUE 0x1CA994 Kw_Wu16 655350.0 Time_ms 0.00 655350.0 FORMAT "%8.1" /end CHARACTERISTIC
/begin CHARACTERISTIC APSCD_nLimHigh_C "obere Drehzahlgrenze zur Berechnung des Luftdrucks aus dem Ladedruck" VALUE 0x1CA996 Kw_Ws16 6000.000 EngN 0.00 6000.000 FORMAT "%8.3" EXTENDED_LIMITS -32768.00 32767.00 /end CHARACTERISTIC
/begin CHARACTERISTIC APSCD_pCor_MAP "Atmosphaerendruck Korrekturkennfeld (Drehzahlabhaengig)" MAP 0x1CA998 Kf_Xs16_Ys16_Ws16 7000.000 Pres_hPa -3500.000 3500.000 FORMAT "%8.3" EXTENDED_LIMITS -32768.00 32767.00
 /begin AXIS_DESCR STD_AXIS Eng_nAvrg EngN 10 0.00 6000.000 FORMAT "%8.3" EXTENDED_LIMITS -32768.00 32767.00 DEPOSIT ABSOLUTE /end AXIS_DESCR
 /begin AXIS_DESCR STD_AXIS Eng_dnAvrg Eng_dN 10 -6000.000 6000.000 FORMAT "%8.3" EXTENDED_LIMITS -32768.00 32767.00 DEPOSIT ABSOLUTE /end AXIS_DESCR
/end CHARACTERISTIC
/begin CHARACTERISTIC APSCD_pVal_Vector "Bypass Konfiguration Label für Bypass Wert Atmosphärendruck" VALUE 0x1C0A44 Kw_Wu8 255.0 OneToOne 0.00 255.0 FORMAT "%5.1" /end CHARACTERISTIC
/begin CHARACTERISTIC APSCD_pVal_Channel "Bypass Konfiguration Label für Bypass Wert Atmosphärendruck" VALUE 0x1C0A45 Kw_Wu8 255.0 OneToOne 0.00 255.0 FORMAT "%5.1" /end CHARACTERISTIC
/begin CHARACTERISTIC APSCD_dpRmpSlpUp_C "positive Atmosphaerendruck - Rampensteigung" VALUE 0x1CAA8C Kw_Wu32 65535999.9847 RmpPres_hPa 0.00 65535999.9847 FORMAT "%13.4" /end CHARACTERISTIC
/begin CHARACTERISTIC APSCD_dpRmpSlpDwn_C "negative Atmosphaerendruck - Rampensteigung" VALUE 0x1CAA90 Kw_Wu32 65535999.9847 RmpPres_hPa 0.00 65535999.9847 FORMAT "%13.4" /end CHARACTERISTIC
/begin CHARACTERISTIC APSCD_swtInst_C "Atmosphaerendruck Funktionsschalter (1: verbaut, 0: nicht verbaut)" VALUE 0x1CAA94 Kw_Wu8 1.000 OneToOne 0.00 1.000 FORMAT "%5.3" EXTENDED_LIMITS 0.00 255.0 /end CHARACTERISTIC
/begin CHARACTERISTIC APSCD_swtSigVal_C "Schalter zur Umschaltung der Signalquelle ADC/CAN (0 = ADC, 1 = CAN)" VALUE 0x1CAA95 Kw_Wu8 1.000 OneToOne 0.00 1.000 FORMAT "%5.3" EXTENDED_LIMITS 0.00 255.0 /end CHARACTERISTIC
/begin CHARACTERISTIC APSCD_swtSrcpVal_C "Schalter ob APSCD_pVal aus Ladedruck berechnet wird (1) oder nicht (0)" VALUE 0x1CAA96 Kw_Wu8 1.000 OneToOne 0.00 1.000 FORMAT "%5.3" EXTENDED_LIMITS 0.00 255.0 /end CHARACTERISTIC
/begin CHARACTERISTIC APSCD_tiDel_C "Atmosphaerendruck Verzögerungszeit bis Berechnung von Ladedruck beginnt" VALUE 0x1CAA98 Kw_Wu16 655350.0 Time_ms 0.00 655350.0 FORMAT "%8.1" /end CHARACTERISTIC
/begin CHARACTERISTIC APSCD_stSensIDWord_C "Atmosphaerendruck Geberkennwort" VALUE 0x1CAA9A Kw_Wu16 65535.00 OneToOne 0.00 65535.00 FORMAT "%8.2" /end CHARACTERISTIC
/begin CHARACTERISTIC APSCD_pDfl_C "Atmosphaerendruck Vorgabewert" VALUE 0x1CAA9C Kw_Ws16 3500.000 Pres_hPa 0.00 3500.000 FORMAT "%8.3" EXTENDED_LIMITS -32768.00 32767.00 /end CHARACTERISTIC
/begin CHARACTERISTIC ARnMon_stInvIn_C "Eingangssignal der KL15 invertieren" VALUE 0x1CAAA0 Kw_Wu8 1.000 OneToOne 0.00 1.000 FORMAT "%5.3" EXTENDED_LIMITS 0.00 255.0 READ_ONLY /end CHARACTERISTIC
/begin CHARACTERISTIC ARnMon_stInvOut_C "Ausgangssignal für Selbsthaltung des HR invertieren" VALUE 0x1CAAA1 Kw_Wu8 1.000 OneToOne 0.00 1.000 FORMAT "%5.3" EXTENDED_LIMITS 0.00 255.0 READ_ONLY /end CHARACTERISTIC
/begin CHARACTERISTIC ARnMon_tiARnMax_C "Zeitdauer des erlaubten Nachlaufs" VALUE 0x1CAAA4 Kw_Wu32 42949672950.0 Time_ms 0.00 42949672950.0 FORMAT "%13.1" READ_ONLY /end CHARACTERISTIC
/begin CHARACTERISTIC ASDdc_T1Clu_C "ARD Störungsregler T1, ausgekuppelt" VALUE 0x1CB168 Kw_Wr32 1.50000000 ASD_GvrnDT1T1_float 0.00 1.50000000 FORMAT "%10.8" EXTENDED_LIMITS -1.00000000E+37 1.00000000E+37 /end CHARACTERISTIC
/begin CHARACTERISTIC ASDdc_KdClu_C "ARD Störungsregler Kd=sqrt(Td)/T1, ausgekuppelt" VALUE 0x1CB16C Kw_Wr32 5.00000000 ASD_GvrnDT1Kd_float 0.00 5.00000000 FORMAT "%10.8" EXTENDED_LIMITS -1.00000000E+37 1.00000000E+37 /end CHARACTERISTIC
/begin CHARACTERISTIC ASDdc_dAccPedThres_C "Pedalwertgeber Schwelle" VALUE 0x1CAAA8 Kw_Ws16 100.0000 Prc 0.00 100.0000 FORMAT "%8.4" EXTENDED_LIMITS -327.6800 327.6700 /end CHARACTERISTIC
/begin CHARACTERISTIC ASDdc_dActGearFac_CUR "Kennlinie mit Faktoren für Turbinendrehzahlberechung" CURVE 0x1CAAAA Kl_Xs16_Ws16 0.3276700 VelToN 0.00 0.3276700 FORMAT "%9.7" EXTENDED_LIMITS -0.3276800 0.3276700
 /begin AXIS_DESCR STD_AXIS ASDdc_stActGear_mp OneToOne 6 -1.000 6.000 FORMAT "%5.3" EXTENDED_LIMITS -128.0 127.0 DEPOSIT ABSOLUTE /end AXIS_DESCR
/end CHARACTERISTIC
/begin CHARACTERISTIC ASDdc_dConvClthThres_C "Wandlerkupplungszustand Schwelle" VALUE 0x1CAAC4 Kw_Wu8 3.000 OneToOne 0.00 3.000 FORMAT "%5.3" EXTENDED_LIMITS 0.00 255.0 /end CHARACTERISTIC
/begin CHARACTERISTIC ASDdc_tiDT1TrqDyn_C "Zeitkonstante für DT1 Element" VALUE 0x1CB170 Kw_Wu32 4294.9673 TimeDelay_s 0.0000010000000 4294.9673 FORMAT "%9.4" /end CHARACTERISTIC
/begin CHARACTERISTIC ASDdc_dDT1TrqDynfact_C "Verstärkung für DT1 Element" VALUE 0x1CB174 Kw_Ws32 1.00000000000 Kd 0.00 1.00000000000 FORMAT "%13.11" EXTENDED_LIMITS -32768.0000000 32767.9999847 /end CHARACTERISTIC
/begin CHARACTERISTIC ASDdc_dFacNHiDwn_C "Rampenparameter für oberen Drehzahlbereich" VALUE 0x1CAAC8 Kw_Wu32 1000.00000000 Rmp_Fact16 0.00 1000.00000000 FORMAT "%13.8" EXTENDED_LIMITS 0.00 1023999.99976 /end CHARACTERISTIC
/begin CHARACTERISTIC ASDdc_dFacNLoDwn_C "Rampenparameter für unteren Drehzahlbereich" VALUE 0x1CAACC Kw_Wu32 1000.00000000 Rmp_Fact16 0.00 1000.00000000 FORMAT "%13.8" EXTENDED_LIMITS 0.00 1023999.99976 /end CHARACTERISTIC
/begin CHARACTERISTIC ASDdc_dfacRmp_MAP "Steilheit der Faktorrampe für Abschaltung des ASddc im Schubfall" MAP 0x1CB178 Kf_Xs16_Ys16_Ws16 7.479906 Rmp_Fact16 0.02002716 7.499933 FORMAT "%8.6" EXTENDED_LIMITS -7.812500 7.812262
 /begin AXIS_DESCR STD_AXIS DrvTrn_rTransDT TransR 6 0.00 100.0000 FORMAT "%8.4" EXTENDED_LIMITS -327.6800 327.6700 DEPOSIT ABSOLUTE /end AXIS_DESCR
 /begin AXIS_DESCR STD_AXIS Eng_nAvrg EngN 4 0.00 6000.000 FORMAT "%8.3" EXTENDED_LIMITS -32768.00 32767.00 DEPOSIT ABSOLUTE /end AXIS_DESCR
/end CHARACTERISTIC
/begin CHARACTERISTIC ASDdc_dnAvrgLtdExitNeg_CUR "Abbruchbedingung negativer Lastschlag der abgeleiteten mittleren Motordrehzahl" CURVE 0x1CAAD0 Kl_Xs16_Ws16 12000.00 rev_acc -6000.000 6000.000 FORMAT "%8.3" EXTENDED_LIMITS -32768.00 32767.00
 /begin AXIS_DESCR STD_AXIS ASDdc_stActGear_mp OneToOne 6 0.00 6.000 FORMAT "%5.3" EXTENDED_LIMITS -128.0 127.0 DEPOSIT ABSOLUTE /end AXIS_DESCR
/end CHARACTERISTIC
/begin CHARACTERISTIC ASDdc_dnAvrgLtdExitPos_CUR "Limit fuer Drehzahlgardient fuer Abbruch positiver Lastfall" CURVE 0x1CAAEA Kl_Xs16_Ws16 12000.00 rev_acc -6000.000 6000.000 FORMAT "%8.3" EXTENDED_LIMITS -32768.00 32767.00
 /begin AXIS_DESCR STD_AXIS ASDdc_stActGear_mp OneToOne 6 0.00 6.000 FORMAT "%5.3" EXTENDED_LIMITS -128.0 127.0 DEPOSIT ABSOLUTE /end AXIS_DESCR
/end CHARACTERISTIC
/begin CHARACTERISTIC ASDdc_dnAvrgLtdNeg_CUR "Drehzahlgradientenschwelle für negativen Lastwechsel" CURVE 0x1CAB04 Kl_Xs16_Ws16 12000.00 rev_acc -6000.000 6000.000 FORMAT "%8.3" EXTENDED_LIMITS -32768.00 32767.00
 /begin AXIS_DESCR STD_AXIS ASDdc_stActGear_mp OneToOne 6 0.00 6.000 FORMAT "%5.3" EXTENDED_LIMITS -128.0 127.0 DEPOSIT ABSOLUTE /end AXIS_DESCR
/end CHARACTERISTIC
/begin CHARACTERISTIC ASDdc_dnAvrgLtdPos_CUR "Drehzahlgradientenschwelle für positiven Lastwechsel" CURVE 0x1CAB1E Kl_Xs16_Ws16 12000.00 rev_acc -6000.000 6000.000 FORMAT "%8.3" EXTENDED_LIMITS -32768.00 32767.00
 /begin AXIS_DESCR STD_AXIS ASDdc_stActGear_mp OneToOne 6 0.00 6.000 FORMAT "%5.3" EXTENDED_LIMITS -128.0 127.0 DEPOSIT ABSOLUTE /end AXIS_DESCR
/end CHARACTERISTIC
/begin CHARACTERISTIC ASDdc_dnIntegLtdNeg_CUR "Limit fuer Drehzahlintegral fuer Abbruch im negativen Lastfall" CURVE 0x1CAB38 Kl_Xs16_Ws16 2000.000 OneToOne -1000.000 1000.000 FORMAT "%8.3" EXTENDED_LIMITS -32768.00 32767.00
 /begin AXIS_DESCR STD_AXIS ASDdc_stActGear_mp OneToOne 6 0.00 6.000 FORMAT "%5.3" EXTENDED_LIMITS -128.0 127.0 DEPOSIT ABSOLUTE /end AXIS_DESCR
/end CHARACTERISTIC
/begin CHARACTERISTIC ASDdc_dnIntegLtdPos_MAP "Limit für Drehzahlintegral für Abbruch im positiven Lastschlag" MAP 0x1CAB52 Kf_Xs16_Ys16_Ws16 2000.000 OneToOne -1000.000 1000.000 FORMAT "%8.3" EXTENDED_LIMITS -32768.00 32767.00
 /begin AXIS_DESCR STD_AXIS ASDdc_stActGear_mp OneToOne 6 0.00 6.000 FORMAT "%5.3" EXTENDED_LIMITS -128.0 127.0 DEPOSIT ABSOLUTE /end AXIS_DESCR
 /begin AXIS_DESCR STD_AXIS ASDdc_trqEngOutLtd_mp Trq 4 -3276.800 3276.700 FORMAT "%8.3" DEPOSIT ABSOLUTE /end AXIS_DESCR
/end CHARACTERISTIC
/begin CHARACTERISTIC ASDdc_dNNegIKi_C "Integratorparameter Beendigung negativer Lastwechsel" VALUE 0x1CAB9C Kw_Wu32 999999.999767 Ki 0.00 999999.999767 FORMAT "%13.6" /end CHARACTERISTIC
/begin CHARACTERISTIC ASDdc_dNPosIKi_C "Integratorparameter für Beendigung postiver Lastwechsel" VALUE 0x1CABA0 Kw_Wu32 999999.999767 Ki 0.00 999999.999767 FORMAT "%13.6" /end CHARACTERISTIC
/begin CHARACTERISTIC ASDdc_dnTrbnSpdRmpSlpUp_C "Rampensteigung für Überblenden auf alternatives Drehzahlsignal" VALUE 0x1CABA4 Kw_Wu32 65535999.9847 RmpEngN 0.00 65535999.9847 FORMAT "%13.4" /end CHARACTERISTIC
/begin CHARACTERISTIC ASDdc_dnTrbnSpdRmpSlpDwn_C "Rampensteigung für Überblenden auf alternatives Drehzahlsignal" VALUE 0x1CABA8 Kw_Wu32 65535999.9847 RmpEngN 0.00 65535999.9847 FORMAT "%13.4" /end CHARACTERISTIC
/begin CHARACTERISTIC ASDdc_dtrqNeg_C "Negative Hystereseschwelle" VALUE 0x1CB1C0 Kw_Ws16 8000.977 RmpTrqdHigh -4000.488 4000.488 FORMAT "%8.3" EXTENDED_LIMITS -48000.00 47998.54 /end CHARACTERISTIC
/begin CHARACTERISTIC ASDdc_dtrqPos_C "Positive Hystereseschwelle" VALUE 0x1CB1C2 Kw_Ws16 4000.488 RmpTrqdHigh 0.00 4000.488 FORMAT "%8.3" EXTENDED_LIMITS -48000.00 47998.54 /end CHARACTERISTIC
/begin CHARACTERISTIC ASDdc_T1ExtInt_C "ARD Störungsregler T1, externer Eingriff" VALUE 0x1CB1C4 Kw_Wr32 1.50000000 ASD_GvrnDT1T1_float 0.00 1.50000000 FORMAT "%10.8" EXTENDED_LIMITS -1.00000000E+37 1.00000000E+37 /end CHARACTERISTIC
/begin CHARACTERISTIC ASDdc_KdExtInt_C "ARD Störungsregler Kd=sqrt(Td)/T1, externer Eingriff" VALUE 0x1CB1C8 Kw_Wr32 5.00000000 ASD_GvrnDT1Kd_float 0.00 5.00000000 FORMAT "%10.8" EXTENDED_LIMITS -1.00000000E+37 1.00000000E+37 /end CHARACTERISTIC
/begin CHARACTERISTIC ASDdc_facKdGripPos_CUR "Kennlinie für Mulitplikatonsfaktor für die Verstärkung bei positiver Momententendenz" CURVE 0x1CB1CC Kl_Xs16_Ws16 1.000000 Fact1 0.00 1.000000 FORMAT "%8.6" EXTENDED_LIMITS -256.0000 255.9922
 /begin AXIS_DESCR STD_AXIS ASDrf_rAPP1Flt Prc 8 0.00 100.0000 FORMAT "%8.4" EXTENDED_LIMITS -327.6800 327.6700 DEPOSIT ABSOLUTE /end AXIS_DESCR
/end CHARACTERISTIC
/begin CHARACTERISTIC ASDdc_factrqDT1InitNeg_C "negativer Faktor fuer die Initialisierung des DT1-Gliedes" VALUE 0x1CABAC Kw_Ws16 1.000000 Fact 0.00 1.000000 FORMAT "%8.6" EXTENDED_LIMITS -4.000000 3.999878 /end CHARACTERISTIC
/begin CHARACTERISTIC ASDdc_factrqDT1InitPos_C "positiver Faktor fuer die Initialisierung des DT1-Gliedes" VALUE 0x1CABAE Kw_Ws16 1.000000 Fact 0.00 1.000000 FORMAT "%8.6" EXTENDED_LIMITS -4.000000 3.999878 /end CHARACTERISTIC
/begin CHARACTERISTIC ASDdc_KddNDT1_C "Verstärkungsfaktor für DT1 - Glied für Ableitung der mittleren Motordrehzahl" VALUE 0x1CABB0 Kw_Ws32 100.000000000 Kd -50.0000000000 50.0000000000 FORMAT "%13.10" EXTENDED_LIMITS -32768.0000000 32767.9999847 /end CHARACTERISTIC
/begin CHARACTERISTIC ASDdc_KdGrip_MAP "Zeitkonstante Kd des ARD-SR (ASDdc) für den Zustand Kraftschluss" MAP 0x1CB1EE Kf_Xs16_Ys16_Ws16 1.500000 Kd16_sqr_rpm2Nm 0.00 1.500000 FORMAT "%8.6" EXTENDED_LIMITS -32.00000 31.99902
 /begin AXIS_DESCR STD_AXIS DrvTrn_rTransDT TransR 16 0.00 100.0000 FORMAT "%8.4" EXTENDED_LIMITS -327.6800 327.6700 DEPOSIT ABSOLUTE /end AXIS_DESCR
 /begin AXIS_DESCR STD_AXIS ASDdc_nAvrg_mp EngN 10 -32768.00 32767.00 FORMAT "%8.2" DEPOSIT ABSOLUTE /end AXIS_DESCR
/end CHARACTERISTIC
/begin CHARACTERISTIC ASDdc_KdPwrOnOff_MAP "Faktorkennfeld für Verstärkung des D2T2-Filters im Lastschlagfall" MAP 0x1CB366 Kf_Xs16_Ys16_Ws16 1.500000 Kd16_sqr_rpm2Nm 0.00 1.500000 FORMAT "%8.6" EXTENDED_LIMITS -32.00000 31.99902
 /begin AXIS_DESCR STD_AXIS ASDdc_stPosNeg_mp OneToOne 2 0.00 1.000 FORMAT "%5.3" EXTENDED_LIMITS 0.00 255.0 DEPOSIT ABSOLUTE /end AXIS_DESCR
 /begin AXIS_DESCR STD_AXIS ASDdc_nAvrg_mp EngN 10 -32768.00 32767.00 FORMAT "%8.2" DEPOSIT ABSOLUTE /end AXIS_DESCR
/end CHARACTERISTIC
/begin CHARACTERISTIC ASDdc_NGvnrDT1KdNeg_CUR "Differentialverstärkung des D-Reglers für negativen Lastschlag" CURVE 0x1CABB4 Kl_Xs16_Ws16 6.400000 KD_RPM2NM_4 0.00 6.400000 FORMAT "%8.6" EXTENDED_LIMITS -6.400000 6.399805
 /begin AXIS_DESCR STD_AXIS ASDdc_stActGear_mp OneToOne 6 0.00 6.000 FORMAT "%5.3" EXTENDED_LIMITS -128.0 127.0 DEPOSIT ABSOLUTE /end AXIS_DESCR
/end CHARACTERISTIC
/begin CHARACTERISTIC ASDdc_NGvnrDT1KdPos_CUR "Differentialverstärkung des D-Reglers für positiven Lastschlag" CURVE 0x1CABCE Kl_Xs16_Ws16 6.400000 KD_RPM2NM_4 0.00 6.400000 FORMAT "%8.6" EXTENDED_LIMITS -6.400000 6.399805
 /begin AXIS_DESCR STD_AXIS ASDdc_stActGear_mp OneToOne 6 0.00 6.000 FORMAT "%5.3" EXTENDED_LIMITS -128.0 127.0 DEPOSIT ABSOLUTE /end AXIS_DESCR
/end CHARACTERISTIC
/begin CHARACTERISTIC ASDdc_NGvnrIKiNeg_CUR "gangabhängige Parameter des I-Reglers für negativen Lastschlag" CURVE 0x1CABE8 Kl_Xs16_Ws16 0.9998679 KI_RPM2NM_2 0.00 0.9998679 FORMAT "%8.6" EXTENDED_LIMITS -12.20703 12.20666
 /begin AXIS_DESCR STD_AXIS ASDdc_stActGear_mp OneToOne 6 0.00 6.000 FORMAT "%5.3" EXTENDED_LIMITS -128.0 127.0 DEPOSIT ABSOLUTE /end AXIS_DESCR
/end CHARACTERISTIC
/begin CHARACTERISTIC ASDdc_NGvnrIKiPos_CUR "gangabhängige Parameter des I-Reglers für positiven Lastschlag" CURVE 0x1CAC02 Kl_Xs16_Ws16 0.9998679 KI_RPM2NM_2 0.00 0.9998679 FORMAT "%8.6" EXTENDED_LIMITS -12.20703 12.20666
 /begin AXIS_DESCR STD_AXIS ASDdc_stActGear_mp OneToOne 6 0.00 6.000 FORMAT "%5.3" EXTENDED_LIMITS -128.0 127.0 DEPOSIT ABSOLUTE /end AXIS_DESCR
/end CHARACTERISTIC
/begin CHARACTERISTIC ASDdc_NGvnrPKpNeg_CUR "gangabhängige Parameter des P-Reglers für negativen Lastschlag" CURVE 0x1CAC1C Kl_Xs16_Ws16 6.400000 KP_RPM2NM_4 0.00 6.400000 FORMAT "%8.6" EXTENDED_LIMITS -6.400000 6.399805
 /begin AXIS_DESCR STD_AXIS ASDdc_stActGear_mp OneToOne 6 0.00 6.000 FORMAT "%5.3" EXTENDED_LIMITS -128.0 127.0 DEPOSIT ABSOLUTE /end AXIS_DESCR
/end CHARACTERISTIC
/begin CHARACTERISTIC ASDdc_NGvnrPKpPos_CUR "gangabhängige Parameter des P-Reglers für positiven Lastschlag" CURVE 0x1CAC36 Kl_Xs16_Ws16 6.400000 KP_RPM2NM_4 0.00 6.400000 FORMAT "%8.6" EXTENDED_LIMITS -6.400000 6.399805
 /begin AXIS_DESCR STD_AXIS ASDdc_stActGear_mp OneToOne 6 0.00 6.000 FORMAT "%5.3" EXTENDED_LIMITS -128.0 127.0 DEPOSIT ABSOLUTE /end AXIS_DESCR
/end CHARACTERISTIC
/begin CHARACTERISTIC ASDdc_NGvnrRstINeg_MAP "Initialisierungsmoment des I-Reglers neagtiver Lastschlag" MAP 0x1CAC50 Kf_Xs16_Ys16_Ws16 1100.000 Trq -100.0000 1000.000 FORMAT "%8.3" EXTENDED_LIMITS -3276.800 3276.700
 /begin AXIS_DESCR STD_AXIS ASDdc_stActGear_mp OneToOne 6 0.00 6.000 FORMAT "%5.3" EXTENDED_LIMITS -128.0 127.0 DEPOSIT ABSOLUTE /end AXIS_DESCR
 /begin AXIS_DESCR STD_AXIS ASDdc_nSlipN_mp EngN 8 -32768.00 32767.00 FORMAT "%8.2" DEPOSIT ABSOLUTE /end AXIS_DESCR
/end CHARACTERISTIC
/begin CHARACTERISTIC ASDdc_NGvnrRstIPos0_MAP "Kennfeld 0 vom Kennraum für das Initialisierungsmoment des I-Reglers positver Lastschlag" MAP 0x1CACD0 Kf_Xs16_Ys16_Ws16 1100.000 Trq -100.0000 1000.000 FORMAT "%8.3" EXTENDED_LIMITS -3276.800 3276.700
 /begin AXIS_DESCR STD_AXIS ASDdc_nDeltaLead_mp EngN 6 -5000.000 5000.000 FORMAT "%8.3" EXTENDED_LIMITS -32768.00 32767.00 DEPOSIT ABSOLUTE /end AXIS_DESCR
 /begin AXIS_DESCR STD_AXIS Eng_nAvrg EngN 6 40.00000 6000.000 FORMAT "%8.3" EXTENDED_LIMITS -32768.00 32767.00 DEPOSIT ABSOLUTE /end AXIS_DESCR
/end CHARACTERISTIC
/begin CHARACTERISTIC ASDdc_NGvnrRstIPos1_MAP "Kennfeld 1 vom Kennraum für das Initialisierungsmoment des I-Reglers positver Lastschlag" MAP 0x1CAD34 Kf_Xs16_Ys16_Ws16 1100.000 Trq -100.0000 1000.000 FORMAT "%8.3" EXTENDED_LIMITS -3276.800 3276.700
 /begin AXIS_DESCR STD_AXIS ASDdc_nDeltaLead_mp EngN 6 -5000.000 5000.000 FORMAT "%8.3" EXTENDED_LIMITS -32768.00 32767.00 DEPOSIT ABSOLUTE /end AXIS_DESCR
 /begin AXIS_DESCR STD_AXIS Eng_nAvrg EngN 6 40.00000 6000.000 FORMAT "%8.3" EXTENDED_LIMITS -32768.00 32767.00 DEPOSIT ABSOLUTE /end AXIS_DESCR
/end CHARACTERISTIC
/begin CHARACTERISTIC ASDdc_NGvnrRstIPos2_MAP "Kennfeld 2 vom Kennraum für das Initialisierungsmoment des I-Reglers positver Lastschlag" MAP 0x1CAD98 Kf_Xs16_Ys16_Ws16 1100.000 Trq -100.0000 1000.000 FORMAT "%8.3" EXTENDED_LIMITS -3276.800 3276.700
 /begin AXIS_DESCR STD_AXIS ASDdc_nDeltaLead_mp EngN 6 -5000.000 5000.000 FORMAT "%8.3" EXTENDED_LIMITS -32768.00 32767.00 DEPOSIT ABSOLUTE /end AXIS_DESCR
 /begin AXIS_DESCR STD_AXIS Eng_nAvrg EngN 6 40.00000 6000.000 FORMAT "%8.3" EXTENDED_LIMITS -32768.00 32767.00 DEPOSIT ABSOLUTE /end AXIS_DESCR
/end CHARACTERISTIC
/begin CHARACTERISTIC ASDdc_NGvnrRstIPos3_MAP "Kennfeld 3 vom Kennraum für das Initialisierungsmoment des I-Reglers positver Lastschlag" MAP 0x1CADFC Kf_Xs16_Ys16_Ws16 1100.000 Trq -100.0000 1000.000 FORMAT "%8.3" EXTENDED_LIMITS -3276.800 3276.700
 /begin AXIS_DESCR STD_AXIS ASDdc_nDeltaLead_mp EngN 6 -5000.000 5000.000 FORMAT "%8.3" EXTENDED_LIMITS -32768.00 32767.00 DEPOSIT ABSOLUTE /end AXIS_DESCR
 /begin AXIS_DESCR STD_AXIS Eng_nAvrg EngN 6 40.00000 6000.000 FORMAT "%8.3" EXTENDED_LIMITS -32768.00 32767.00 DEPOSIT ABSOLUTE /end AXIS_DESCR
/end CHARACTERISTIC
/begin CHARACTERISTIC ASDdc_NGvnrRstIPos4_MAP "Kennfeld 4 vom Kennraum für das Initialisierungsmoment des I-Reglers positver Lastschlag" MAP 0x1CAE60 Kf_Xs16_Ys16_Ws16 1100.000 Trq -100.0000 1000.000 FORMAT "%8.3" EXTENDED_LIMITS -3276.800 3276.700
 /begin AXIS_DESCR STD_AXIS ASDdc_nDeltaLead_mp EngN 6 -5000.000 5000.000 FORMAT "%8.3" EXTENDED_LIMITS -32768.00 32767.00 DEPOSIT ABSOLUTE /end AXIS_DESCR
 /begin AXIS_DESCR STD_AXIS Eng_nAvrg EngN 6 40.00000 6000.000 FORMAT "%8.3" EXTENDED_LIMITS -32768.00 32767.00 DEPOSIT ABSOLUTE /end AXIS_DESCR
/end CHARACTERISTIC
/begin CHARACTERISTIC ASDdc_NGvnrRstIPos5_MAP "Kennfeld 5 vom Kennraum für das Initialisierungsmoment des I-Reglers positver Lastschlag" MAP 0x1CAEC4 Kf_Xs16_Ys16_Ws16 1100.000 Trq -100.0000 1000.000 FORMAT "%8.3" EXTENDED_LIMITS -3276.800 3276.700
 /begin AXIS_DESCR STD_AXIS ASDdc_nDeltaLead_mp EngN 6 -5000.000 5000.000 FORMAT "%8.3" EXTENDED_LIMITS -32768.00 32767.00 DEPOSIT ABSOLUTE /end AXIS_DESCR
 /begin AXIS_DESCR STD_AXIS Eng_nAvrg EngN 6 40.00000 6000.000 FORMAT "%8.3" EXTENDED_LIMITS -32768.00 32767.00 DEPOSIT ABSOLUTE /end AXIS_DESCR
/end CHARACTERISTIC
/begin CHARACTERISTIC ASDdc_nLtdExitNeg_CUR "gangabhängige Schlupfdrehzahlschwelle Beendigung negativer Lastschlag" CURVE 0x1CAF28 Kl_Xs16_Ws16 12000.00 EngN -6000.000 6000.000 FORMAT "%8.3" EXTENDED_LIMITS -32768.00 32767.00
 /begin AXIS_DESCR STD_AXIS ASDdc_stActGear_mp OneToOne 6 0.00 6.000 FORMAT "%5.3" EXTENDED_LIMITS -128.0 127.0 DEPOSIT ABSOLUTE /end AXIS_DESCR
/end CHARACTERISTIC
/begin CHARACTERISTIC ASDdc_nLtdExitPos_CUR "gangabhängige Schlupfdrehzahlschwelle Beendigung positver Lastschlag" CURVE 0x1CAF42 Kl_Xs16_Ws16 12000.00 EngN -6000.000 6000.000 FORMAT "%8.3" EXTENDED_LIMITS -32768.00 32767.00
 /begin AXIS_DESCR STD_AXIS ASDdc_stActGear_mp OneToOne 6 0.00 6.000 FORMAT "%5.3" EXTENDED_LIMITS -128.0 127.0 DEPOSIT ABSOLUTE /end AXIS_DESCR
/end CHARACTERISTIC
/begin CHARACTERISTIC ASDdc_nLtdNegLdRevl_C "Motordrehzahlschwelle Beendigung negativer Lastschlag" VALUE 0x1CAF5C Kw_Ws16 5960.000 EngN 40.00000 6000.000 FORMAT "%8.3" EXTENDED_LIMITS -32768.00 32767.00 /end CHARACTERISTIC
/begin CHARACTERISTIC ASDdc_nMaxNLdRevlNeg_CUR "obere gangabhaengige Schlupfdrehzahlgrenzen negativer Lastwechsel" CURVE 0x1CAF5E Kl_Xs16_Ws16 12000.00 EngN -6000.000 6000.000 FORMAT "%8.3" EXTENDED_LIMITS -32768.00 32767.00
 /begin AXIS_DESCR STD_AXIS ASDdc_stActGear_mp OneToOne 6 0.00 6.000 FORMAT "%5.3" EXTENDED_LIMITS -128.0 127.0 DEPOSIT ABSOLUTE /end AXIS_DESCR
/end CHARACTERISTIC
/begin CHARACTERISTIC ASDdc_nMaxNLdRevlPos_MAP "obere Gang,- und drehzahlabhängige Schlupfdrehzahlgrenzen positiver Lastschlag" MAP 0x1CAF78 Kf_Xs16_Ys16_Ws16 7000.000 EngN -1000.000 6000.000 FORMAT "%8.3" EXTENDED_LIMITS -32768.00 32767.00
 /begin AXIS_DESCR STD_AXIS ASDdc_stActGear_mp OneToOne 6 0.00 6.000 FORMAT "%5.3" EXTENDED_LIMITS -128.0 127.0 DEPOSIT ABSOLUTE /end AXIS_DESCR
 /begin AXIS_DESCR STD_AXIS Eng_nAvrg EngN 6 0.00 6000.000 FORMAT "%8.3" EXTENDED_LIMITS -32768.00 32767.00 DEPOSIT ABSOLUTE /end AXIS_DESCR
/end CHARACTERISTIC
/begin CHARACTERISTIC ASDdc_nMinNLdRevlNeg_CUR "untere gangabhaengige Schlupfdrehzahlgrenzen negativer Lastwechsel" CURVE 0x1CAFDC Kl_Xs16_Ws16 12000.00 EngN -6000.000 6000.000 FORMAT "%8.3" EXTENDED_LIMITS -32768.00 32767.00
 /begin AXIS_DESCR STD_AXIS ASDdc_stActGear_mp OneToOne 6 0.00 6.000 FORMAT "%5.3" EXTENDED_LIMITS -128.0 127.0 DEPOSIT ABSOLUTE /end AXIS_DESCR
/end CHARACTERISTIC
/begin CHARACTERISTIC ASDdc_nMinNLdRevlPos_CUR "untere gangabhaengige Schlupfdrehzahlgrenzen positiver Lastwechsel" CURVE 0x1CAFF6 Kl_Xs16_Ws16 7000.000 EngN -1000.000 6000.000 FORMAT "%8.3" EXTENDED_LIMITS -32768.00 32767.00
 /begin AXIS_DESCR STD_AXIS ASDdc_stActGear_mp OneToOne 6 0.00 6.000 FORMAT "%5.3" EXTENDED_LIMITS -128.0 127.0 DEPOSIT ABSOLUTE /end AXIS_DESCR
/end CHARACTERISTIC
/begin CHARACTERISTIC ASDdc_nPwrOnOffLim_C "Drehzahlschwelle, ab der Lastschlagerkennung aktiv werden kann" VALUE 0x1CB3AA Kw_Wu16 65535.00 EngN 0.00 65535.00 FORMAT "%8.2" /end CHARACTERISTIC
/begin CHARACTERISTIC ASDdc_nSPOfsNeg_CUR "gangabhängige Offsetdrehzahl für Sollwertbildung negativer Lastschlag" CURVE 0x1CB010 Kl_Xs16_Ws16 12000.00 EngN -6000.000 6000.000 FORMAT "%8.3" EXTENDED_LIMITS -32768.00 32767.00
 /begin AXIS_DESCR STD_AXIS ASDdc_stActGear_mp OneToOne 6 0.00 6.000 FORMAT "%5.3" EXTENDED_LIMITS -128.0 127.0 DEPOSIT ABSOLUTE /end AXIS_DESCR
/end CHARACTERISTIC
/begin CHARACTERISTIC ASDdc_nSPOfsPos_MAP "gang- und motorausgangsdrehzahlabhängige Offsetdrehzahl für Sollwertbildung positiver Lastschlag" MAP 0x1CB02A Kf_Xs16_Ys16_Ws16 12000.00 EngN -6000.000 6000.000 FORMAT "%8.3" EXTENDED_LIMITS -32768.00 32767.00
 /begin AXIS_DESCR STD_AXIS ASDdc_stActGear_mp OneToOne 6 0.00 6.000 FORMAT "%5.3" EXTENDED_LIMITS -128.0 127.0 DEPOSIT ABSOLUTE /end AXIS_DESCR
 /begin AXIS_DESCR STD_AXIS ASDdc_trqEngOutLtd_mp Trq 4 -3276.800 3276.700 FORMAT "%8.3" DEPOSIT ABSOLUTE /end AXIS_DESCR
/end CHARACTERISTIC
/begin CHARACTERISTIC ASDdc_nThresHysNHi_C "Obere Hysteresedrehzahlschwelle für Parameter Umschaltung negativer Lastschlag" VALUE 0x1CB072 Kw_Ws16 5960.000 EngN 40.00000 6000.000 FORMAT "%8.3" EXTENDED_LIMITS -32768.00 32767.00 /end CHARACTERISTIC
/begin CHARACTERISTIC ASDdc_nThresHysNLo_C "Untere Hysteresedrehzahlschwelle für Parameter Umschaltung negativer Lastschlag" VALUE 0x1CB074 Kw_Ws16 5960.000 EngN 40.00000 6000.000 FORMAT "%8.3" EXTENDED_LIMITS -32768.00 32767.00 /end CHARACTERISTIC
/begin CHARACTERISTIC ASDdc_rAccPedPartLd_C "obere Hystereseschwelle für den ungefilterten PWG Wert" VALUE 0x1CB076 Kw_Ws16 100.0000 Prc 0.00 100.0000 FORMAT "%8.4" EXTENDED_LIMITS -327.6800 327.6700 /end CHARACTERISTIC
/begin CHARACTERISTIC ASDdc_rAccPedFullLd_C "obere Hystereseschwelle für den ungefilterten PWG Wert" VALUE 0x1CB078 Kw_Ws16 100.0000 Prc 0.00 100.0000 FORMAT "%8.4" EXTENDED_LIMITS -327.6800 327.6700 /end CHARACTERISTIC
/begin CHARACTERISTIC ASDdc_stAccPedPartLd_C "unterer Hystereseausgangswert für den ungefilterten PWG Wert" VALUE 0x1CB07A Kw_Ws16 65535.00 OneToOne -32768.00 32767.00 FORMAT "%8.2" READ_ONLY /end CHARACTERISTIC
/begin CHARACTERISTIC ASDdc_stAccPedFullLd_C "oberer Hystereseausgangswert für den ungefilterten PWG Wert" VALUE 0x1CB07C Kw_Ws16 65535.00 OneToOne -32768.00 32767.00 FORMAT "%8.2" READ_ONLY /end CHARACTERISTIC
/begin CHARACTERISTIC ASDdc_stActGear_CUR "Kennlinie zur Auswahl eines Kennfeldes vom Kennraum für das Initialisierungsmoment des I-Reglers bei positiven Lastschlag" CURVE 0x1CB07E Kl_Xs16_Ws16 5.000000 Map_Select 0.00 5.000000 FORMAT "%8.6" EXTENDED_LIMITS -128.0000 127.9961
 /begin AXIS_DESCR STD_AXIS ASDdc_stActGear_mp OneToOne 6 1.000 6.000 FORMAT "%5.3" EXTENDED_LIMITS -128.0 127.0 DEPOSIT ABSOLUTE /end AXIS_DESCR
/end CHARACTERISTIC
/begin CHARACTERISTIC ASDdc_stCalcPT1FltNeg_C "Status PT1 Filterung negativer Lastschlag (1=aktiv)" VALUE 0x1CB098 Kw_Wu8 1.000 OneToOne 0.00 1.000 FORMAT "%5.3" EXTENDED_LIMITS 0.00 255.0 /end CHARACTERISTIC
/begin CHARACTERISTIC ASDdc_stCalcPT1FltPos_C "Status PT1 Filterung negativer Lastschlag (1=aktiv)" VALUE 0x1CB099 Kw_Wu8 1.000 OneToOne 0.00 1.000 FORMAT "%5.3" EXTENDED_LIMITS 0.00 255.0 /end CHARACTERISTIC
/begin CHARACTERISTIC ASDdc_stKickDown_C "Einfluss des Kick-Down Signals (1=aktiv)" VALUE 0x1CB09A Kw_Wu8 1.000 OneToOne 0.00 1.000 FORMAT "%5.3" EXTENDED_LIMITS 0.00 255.0 /end CHARACTERISTIC
/begin CHARACTERISTIC ASDdc_stNewNeg_mp_Vector "Konfigurationslabel für Bypass Freischnitt" VALUE 0x1C0A46 Kw_Wu8 255.0 OneToOne 0.00 255.0 FORMAT "%5.1" /end CHARACTERISTIC
/begin CHARACTERISTIC ASDdc_stNewNeg_mp_Channel "Konfigurationslabel für Bypass Freischnitt" VALUE 0x1C0A47 Kw_Wu8 255.0 OneToOne 0.00 255.0 FORMAT "%5.1" /end CHARACTERISTIC
/begin CHARACTERISTIC ASDdc_stNewPos_mp_Vector "Konfigurationslabel für Bypass Freischnitt" VALUE 0x1C0A48 Kw_Wu8 255.0 OneToOne 0.00 255.0 FORMAT "%5.1" /end CHARACTERISTIC
/begin CHARACTERISTIC ASDdc_stNewPos_mp_Channel "Konfigurationslabel für Bypass Freischnitt" VALUE 0x1C0A49 Kw_Wu8 255.0 OneToOne 0.00 255.0 FORMAT "%5.1" /end CHARACTERISTIC
/begin CHARACTERISTIC ASDdc_stNGvnrExtInt_Vector "Konfigurationslabel für Bypass Freischnitt" VALUE 0x1C0A50 Kw_Wu8 255.0 OneToOne 0.00 255.0 FORMAT "%5.1" /end CHARACTERISTIC
/begin CHARACTERISTIC ASDdc_stNGvnrExtInt_Channel "Konfigurationslabel für Bypass Freischnitt" VALUE 0x1C0A51 Kw_Wu8 255.0 OneToOne 0.00 255.0 FORMAT "%5.1" /end CHARACTERISTIC
/begin CHARACTERISTIC ASDdc_sttrqMask_C "Bitmaske für die Berücksichtigung des LLR - Moments" VALUE 0x1CB09B Kw_Wu8 7.000 OneToOne 0.00 7.000 FORMAT "%5.3" EXTENDED_LIMITS 0.00 255.0 /end CHARACTERISTIC
/begin CHARACTERISTIC ASDdc_swtCalcN_C "Wählt Motorgeschwindigkeit für Parameter- Map. 1: ASDdc_nAvrg_mp = Eng_nAvrg;   0: ASDdc_nAvrg_mp = Eng_nAvrg - LIGov_nSetpoint" VALUE 0x1CB3AC Kw_Wu8 255.0 OneToOne 0.00 255.0 FORMAT "%5.1" /end CHARACTERISTIC
/begin CHARACTERISTIC ASDdc_swtConvOff_C "Schalter zur Auswahl der Kupplungsbedingung für Parameterauswahl" VALUE 0x1CB3AD Kw_Wu8 1.000 OneToOne 0.00 1.000 FORMAT "%5.3" EXTENDED_LIMITS 0.00 255.0 /end CHARACTERISTIC
/begin CHARACTERISTIC ASDdc_swtGearbx_C "Schalter um verwendete Methode für Erkennung von externen Eingriff zu bestimmen (0:Gearbx_stTSC.5, 1:FrmMng_stTSC.8, 2:Gangwechs" VALUE 0x1CB3AE Kw_Wu8 2.000 OneToOne 0.00 2.000 FORMAT "%5.3" EXTENDED_LIMITS 0.00 255.0 /end CHARACTERISTIC
/begin CHARACTERISTIC ASDdc_swtGearSel_C "Software - Schalter für Gangwahl (vor/nach Schaltung beendet)" VALUE 0x1CB09C Kw_Wu8 2.000 OneToOne 0.00 2.000 FORMAT "%5.3" EXTENDED_LIMITS 0.00 255.0 /end CHARACTERISTIC
/begin CHARACTERISTIC ASDdc_swtIFreeze_C "Schalter zur Aktivierung des Einfrieren des Integrators" VALUE 0x1CB09D Kw_Wu8 1.000 OneToOne 0.00 1.000 FORMAT "%5.3" EXTENDED_LIMITS 0.00 255.0 /end CHARACTERISTIC
/begin CHARACTERISTIC ASDdc_swtInitPS_C "Schalter zur 1: Aktivierung, 0: Deaktivierung der kontinuierlichen Initialisierung aufgrund Parametersatzwechsels" VALUE 0x1CB09E Kw_Wu8 255.0 OneToOne 0.00 255.0 FORMAT "%5.1" /end CHARACTERISTIC
/begin CHARACTERISTIC ASDdc_swtNGvnrGearbx_C "Schalter zur Auswahl des externen Getriebeeingriffes (-> Drehzahlregler)" VALUE 0x1CB3AF Kw_Wu8 2.000 OneToOne 0.00 2.000 FORMAT "%5.3" EXTENDED_LIMITS 0.00 255.0 /end CHARACTERISTIC
/begin CHARACTERISTIC ASDdc_swtNGvnrMn_C "Hauptschalter Drehzahlregler (1=activ)" VALUE 0x1CB09F Kw_Wu8 1.000 OneToOne 0.00 1.000 FORMAT "%5.3" EXTENDED_LIMITS 0.00 255.0 /end CHARACTERISTIC
/begin CHARACTERISTIC ASDdc_swtnNotFreeze_C "Deaktivierung der Einfrierung der Offsetdrehzahl für das PT1-Filter" VALUE 0x1CB0A0 Kw_Wu8 1.000 OneToOne 0.00 1.000 FORMAT "%5.3" EXTENDED_LIMITS 0.00 255.0 /end CHARACTERISTIC
/begin CHARACTERISTIC ASDdc_swtnTrbnSpdCANEna_C "Funktionsschalter für Turbinen Geschwindigkeit (0 = MSG; 1 = CAN Botschaft TSC6)" VALUE 0x1CB0A1 Kw_Wu8 1.000 OneToOne 0.00 1.000 FORMAT "%5.3" EXTENDED_LIMITS 0.00 255.0 /end CHARACTERISTIC
/begin CHARACTERISTIC ASDdc_swtPWG_C "Auswertung des ungefilterten PWG - Wertes" VALUE 0x1CB0A2 Kw_Wu8 255.0 OneToOne 0.00 255.0 FORMAT "%5.1" /end CHARACTERISTIC
/begin CHARACTERISTIC ASDdc_swtvRaw_C "Funktionsschalter für ungefilterte (=0) /gefilterte Geschwindgkeit (=1)" VALUE 0x1CB0A3 Kw_Wu8 1.000 OneToOne 0.00 1.000 FORMAT "%5.3" EXTENDED_LIMITS 0.00 255.0 /end CHARACTERISTIC
/begin CHARACTERISTIC ASDdc_T1Grip_MAP "Zeitkonstante T1 des ARD-SR (ASDdc) für den Zustand Kraftschluss" MAP 0x1CB3B0 Kf_Xs16_Ys16_Ws16 1.498917 TimeDelay_s_Lin_16 0.001068148 1.499985 FORMAT "%8.6" EXTENDED_LIMITS -5.000153 5.000000
 /begin AXIS_DESCR STD_AXIS DrvTrn_rTransDT TransR 16 0.00 100.0000 FORMAT "%8.4" EXTENDED_LIMITS -327.6800 327.6700 DEPOSIT ABSOLUTE /end AXIS_DESCR
 /begin AXIS_DESCR STD_AXIS ASDdc_nAvrg_mp EngN 10 -32768.00 32767.00 FORMAT "%8.2" DEPOSIT ABSOLUTE /end AXIS_DESCR
/end CHARACTERISTIC
/begin CHARACTERISTIC ASDdc_T1PwrOnOff_MAP "Zeitkonstante des D2T2-filters im Lastschlagfall" MAP 0x1CB528 Kf_Xs16_Ys16_Ws16 1.498917 TimeDelay_s_Lin_16 0.001068148 1.499985 FORMAT "%8.6" EXTENDED_LIMITS -5.000153 5.000000
 /begin AXIS_DESCR STD_AXIS ASDdc_stPosNeg_mp OneToOne 2 0.00 1.000 FORMAT "%5.3" EXTENDED_LIMITS 0.00 255.0 DEPOSIT ABSOLUTE /end AXIS_DESCR
 /begin AXIS_DESCR STD_AXIS ASDdc_nAvrg_mp EngN 10 -32768.00 32767.00 FORMAT "%8.2" DEPOSIT ABSOLUTE /end AXIS_DESCR
/end CHARACTERISTIC
/begin CHARACTERISTIC ASDdc_tEngThres_C "Motortemperaturschwelle" VALUE 0x1CB0A4 Kw_Ws16 250.0000 Temp_Cels -50.14000 199.8600 FORMAT "%8.4" EXTENDED_LIMITS -3549.940 3003.560 /end CHARACTERISTIC
/begin CHARACTERISTIC ASDdc_tiActvRmpNHi_C "Wartezeit bis die Rampe gestartet wird bei hoher Motordrehzahl" VALUE 0x1CB0A6 Kw_Wu16 655350.0 Time_ms 0.00 655350.0 FORMAT "%8.1" /end CHARACTERISTIC
/begin CHARACTERISTIC ASDdc_tiActvRmpNLo_C "Wartezeit bis die Rampe gestartet wird bei niedriger Motordrehzahl" VALUE 0x1CB0A8 Kw_Wu16 655350.0 Time_ms 0.00 655350.0 FORMAT "%8.1" /end CHARACTERISTIC
/begin CHARACTERISTIC ASDdc_tiBlkTmr_C "Retrigger Sperrzeit und Begrenzungszeit" VALUE 0x1CB56C Kw_Wu16 655350.0 Time_ms 0.00 655350.0 FORMAT "%8.1" /end CHARACTERISTIC
/begin CHARACTERISTIC ASDdc_tidNDT1_C "Zeitkonstante für DT1 Glied für Drehzahlgradient" VALUE 0x1CB0AC Kw_Wu32 1073.7408 TimeDelay_s 0.0010000001 1073.7418 FORMAT "%9.4" EXTENDED_LIMITS 0.0000010000000 4294.9673 /end CHARACTERISTIC
/begin CHARACTERISTIC ASDdc_tiGripTmr_C "Verzögerungszeit für Rücksetzen des Kupplungsbits" VALUE 0x1CB56E Kw_Wu16 655350.0 Time_ms 0.00 655350.0 FORMAT "%8.1" /end CHARACTERISTIC
/begin CHARACTERISTIC ASDdc_tiMaxLdRevlPos_C "maximale Zeit des Zustandes postiver Lastschlag" VALUE 0x1CB0B0 Kw_Wu16 655350.0 Time_ms 0.00 655350.0 FORMAT "%8.1" /end CHARACTERISTIC
/begin CHARACTERISTIC ASDdc_tiMaxRmpNHi_C "maximale Zeit der Schubabschaltung bei hoher Motordrehzahl" VALUE 0x1CB0B2 Kw_Wu16 655350.0 Time_ms 0.00 655350.0 FORMAT "%8.1" /end CHARACTERISTIC
/begin CHARACTERISTIC ASDdc_tiMaxRmpNLo_C "maximale Zeit der Schubabschaltung bei niedriger Motordrehzahl" VALUE 0x1CB0B4 Kw_Wu16 655350.0 Time_ms 0.00 655350.0 FORMAT "%8.1" /end CHARACTERISTIC
/begin CHARACTERISTIC ASDdc_tiMinLdRevlNeg_C "minimale Aktivierungszeit fuer negativen Lastschlag" VALUE 0x1CB0B6 Kw_Wu16 655350.0 Time_ms 0.00 655350.0 FORMAT "%8.1" /end CHARACTERISTIC
/begin CHARACTERISTIC ASDdc_tiMinLdRevlPos_C "minimale Aktivierungszeit des positiven Lastschlages" VALUE 0x1CB0B8 Kw_Wu16 655350.0 Time_ms 0.00 655350.0 FORMAT "%8.1" /end CHARACTERISTIC
/begin CHARACTERISTIC ASDdc_tiMinTmrDnAvrg_C "minimale Aktivierungszeit bis die Abbruchbedingung abgeleitete Motordrehzahl aktiv wird" VALUE 0x1CB0BA Kw_Wu16 655350.0 Time_ms 0.00 655350.0 FORMAT "%8.1" /end CHARACTERISTIC
/begin CHARACTERISTIC ASDdc_tiNGvnrDT1Neg_C "Zeitkonstante des DT1 Gliedes für negativen Lastschlag" VALUE 0x1CB0BC Kw_Wu32 10.010579 TimeDelay_s 0.0010000001 10.011579 FORMAT "%9.6" EXTENDED_LIMITS 0.0000010000000 4294.9673 /end CHARACTERISTIC
/begin CHARACTERISTIC ASDdc_tiNGvnrDT1Pos_C "Zeitkonstante des D-Reglers für positiven Lastschlag" VALUE 0x1CB0C0 Kw_Wu32 10.010579 TimeDelay_s 0.0010000001 10.011579 FORMAT "%9.6" EXTENDED_LIMITS 0.0000010000000 4294.9673 /end CHARACTERISTIC
/begin CHARACTERISTIC ASDdc_tiPT1Neg_CUR "Filterzeitkonstante PT1 für negativen Lastschlag" CURVE 0x1CB0C4 Kl_Xs16_Ws16 4.997406 TimeDelay_s_Lin_16_3 0.00 4.997406 FORMAT "%8.6" EXTENDED_LIMITS -250.0076 250.0000
 /begin AXIS_DESCR STD_AXIS ASDdc_stActGear_mp OneToOne 6 0.00 6.000 FORMAT "%5.3" EXTENDED_LIMITS -128.0 127.0 DEPOSIT ABSOLUTE /end AXIS_DESCR
/end CHARACTERISTIC
/begin CHARACTERISTIC ASDdc_tiPT1Pos_CUR "Filterzeitkonstante PT1 für positiven Lastschlag" CURVE 0x1CB0DE Kl_Xs16_Ws16 4.997406 TimeDelay_s_Lin_16_3 0.00 4.997406 FORMAT "%8.6" EXTENDED_LIMITS -250.0076 250.0000
 /begin AXIS_DESCR STD_AXIS ASDdc_stActGear_mp OneToOne 6 0.00 6.000 FORMAT "%5.3" EXTENDED_LIMITS -128.0 127.0 DEPOSIT ABSOLUTE /end AXIS_DESCR
/end CHARACTERISTIC
/begin CHARACTERISTIC ASDdc_tiPT1TrbnSpd_C "Zeitkonstante des PT1-Filters - Drehzahlsignal" VALUE 0x1CB0F8 Kw_Wu32 4294.9673 TimeDelay_s 0.0000010000000 4294.9673 FORMAT "%9.4" /end CHARACTERISTIC
/begin CHARACTERISTIC ASDdc_tiPT1Trq_C "Zeitkonstante für PT1 element" VALUE 0x1CB570 Kw_Wu32 1.9004513 TimeDelay_s 0.099999239 2.0004505 FORMAT "%9.7" EXTENDED_LIMITS 0.0000010000000 4294.9673 /end CHARACTERISTIC
/begin CHARACTERISTIC ASDdc_tiPwrOnOff_C "Wirkzeit für Lastschlagparametersatz" VALUE 0x1CB574 Kw_Wu16 655350.0 Time_ms 0.00 655350.0 FORMAT "%8.1" /end CHARACTERISTIC
/begin CHARACTERISTIC ASDdc_tiRmpStrt_MAP "Kennfeld für Wartezeit bis Rampe startet" MAP 0x1CB576 Kf_Xs16_Ys16_Ws16 1.500000 Time_s 0.00 1.500000 FORMAT "%8.6" EXTENDED_LIMITS -327.6800 327.6700
 /begin AXIS_DESCR STD_AXIS DrvTrn_rTransDT TransR 6 0.00 100.0000 FORMAT "%8.4" EXTENDED_LIMITS -327.6800 327.6700 DEPOSIT ABSOLUTE /end AXIS_DESCR
 /begin AXIS_DESCR STD_AXIS Eng_nAvrg EngN 4 0.00 6000.000 FORMAT "%8.3" EXTENDED_LIMITS -32768.00 32767.00 DEPOSIT ABSOLUTE /end AXIS_DESCR
/end CHARACTERISTIC
/begin CHARACTERISTIC ASDdc_tiSwtOff_CUR "Kennlinie für die drehzahlabhängige Zeit, nach der die Schubabschalterampe hart auf Null gechaltet wird." CURVE 0x1CB5BE Kl_Xs16_Ws16 327670.0 Time_ms 0.00 327670.0 FORMAT "%8.1" EXTENDED_LIMITS -327680.0 327670.0
 /begin AXIS_DESCR STD_AXIS Eng_nAvrg EngN 4 0.00 6000.000 FORMAT "%8.3" EXTENDED_LIMITS -32768.00 32767.00 DEPOSIT ABSOLUTE /end AXIS_DESCR
/end CHARACTERISTIC
/begin CHARACTERISTIC ASDdc_tiTmrNCond_C "minimale Aktivierungszeit bis die Abbruchbedingung Motordrehzahl aktiv wird" VALUE 0x1CB0FC Kw_Wu16 655350.0 Time_ms 0.00 655350.0 FORMAT "%8.1" /end CHARACTERISTIC
/begin CHARACTERISTIC ASDdc_tiTmrTrqInrCond_C "minimale Aktivierungszeit bis die Abbruchbedingung inneres Moment aktiv wird" VALUE 0x1CB0FE Kw_Wu16 655350.0 Time_ms 0.00 655350.0 FORMAT "%8.1" /end CHARACTERISTIC
/begin CHARACTERISTIC ASDdc_T1TMFWRO_C "ARD Störungsregler T1, ausollen" VALUE 0x1CB5D0 Kw_Wr32 1.50000000 ASD_GvrnDT1T1_float 0.00 1.50000000 FORMAT "%10.8" EXTENDED_LIMITS -1.00000000E+37 1.00000000E+37 /end CHARACTERISTIC
/begin CHARACTERISTIC ASDdc_KdTMFWRO_C "ARD Störungsregler Kd=sqrt(Td)/T1, ausrollen" VALUE 0x1CB5D4 Kw_Wr32 5.00000000 ASD_GvrnDT1Kd_float 0.00 5.00000000 FORMAT "%10.8" EXTENDED_LIMITS -1.00000000E+37 1.00000000E+37 /end CHARACTERISTIC
/begin CHARACTERISTIC ASDdc_trqDpnOfsNegEnd_C "Offset für Verlustmoment für Deaktivierungsbedingung bei positiven Lastschlag" VALUE 0x1CB100 Kw_Ws16 1500.000 Trq -500.0000 1000.000 FORMAT "%8.3" EXTENDED_LIMITS -3276.800 3276.700 /end CHARACTERISTIC
/begin CHARACTERISTIC ASDdc_trqDpnOfsNeg_C "Offset für Verlustmoment für Aktivierungsbedingung bei negativen Lastschlag" VALUE 0x1CB102 Kw_Ws16 1500.000 Trq -500.0000 1000.000 FORMAT "%8.3" EXTENDED_LIMITS -3276.800 3276.700 /end CHARACTERISTIC
/begin CHARACTERISTIC ASDdc_trqDpnOfsPosEnd_C "Offset für Verlustmoment für Aktivierungsbedingung bei positiven Lastschlag" VALUE 0x1CB104 Kw_Ws16 1500.000 Trq -500.0000 1000.000 FORMAT "%8.3" EXTENDED_LIMITS -3276.800 3276.700 /end CHARACTERISTIC
/begin CHARACTERISTIC ASDdc_trqDpnOfsPos_C "Offset für Verlustmoment für Aktivierungsbedingung bei positiven Lastschlag" VALUE 0x1CB106 Kw_Ws16 1500.000 Trq -500.0000 1000.000 FORMAT "%8.3" EXTENDED_LIMITS -3276.800 3276.700 /end CHARACTERISTIC
/begin CHARACTERISTIC ASDdc_trqInrLtdThres_C "Schwelle inners Moment" VALUE 0x1CB108 Kw_Ws16 1500.000 Trq -500.0000 1000.000 FORMAT "%8.3" EXTENDED_LIMITS -3276.800 3276.700 /end CHARACTERISTIC
/begin CHARACTERISTIC ASDdc_trqLimHiPwrOnOff_CUR "obere Begrenzung des Störreglerausgangs im Lastschlagfall" CURVE 0x1CB10A Kl_Xs16_Ws16 1500.000 Trq -500.0000 1000.000 FORMAT "%8.3" EXTENDED_LIMITS -3276.800 3276.700
 /begin AXIS_DESCR STD_AXIS Eng_nAvrg EngN 5 0.00 6000.000 FORMAT "%8.3" EXTENDED_LIMITS -32768.00 32767.00 DEPOSIT ABSOLUTE /end AXIS_DESCR
/end CHARACTERISTIC
/begin CHARACTERISTIC ASDdc_trqLimHi_CUR "obere Begrenzung des Störreglerausgangs" CURVE 0x1CB120 Kl_Xs16_Ws16 1500.000 Trq -500.0000 1000.000 FORMAT "%8.3" EXTENDED_LIMITS -3276.800 3276.700
 /begin AXIS_DESCR STD_AXIS Eng_nAvrg EngN 5 0.00 6000.000 FORMAT "%8.3" EXTENDED_LIMITS -32768.00 32767.00 DEPOSIT ABSOLUTE /end AXIS_DESCR
/end CHARACTERISTIC
/begin CHARACTERISTIC ASDdc_trqLimLoPwrOnOff_CUR "untere Begrenzung des Störreglerausgangs im Lastschlagfall" CURVE 0x1CB136 Kl_Xs16_Ws16 1500.000 Trq -500.0000 1000.000 FORMAT "%8.3" EXTENDED_LIMITS -3276.800 3276.700
 /begin AXIS_DESCR STD_AXIS Eng_nAvrg EngN 5 0.00 6000.000 FORMAT "%8.3" EXTENDED_LIMITS -32768.00 32767.00 DEPOSIT ABSOLUTE /end AXIS_DESCR
/end CHARACTERISTIC
/begin CHARACTERISTIC ASDdc_trqLimLo_CUR "untere Begrenzung des Störreglerausgangs" CURVE 0x1CB14C Kl_Xs16_Ws16 1500.000 Trq -500.0000 1000.000 FORMAT "%8.3" EXTENDED_LIMITS -3276.800 3276.700
 /begin AXIS_DESCR STD_AXIS Eng_nAvrg EngN 5 0.00 6000.000 FORMAT "%8.3" EXTENDED_LIMITS -32768.00 32767.00 DEPOSIT ABSOLUTE /end AXIS_DESCR
/end CHARACTERISTIC
/begin CHARACTERISTIC ASDdc_trqMaxPosLdRevl_C "Vorgabewert für positives Moment im Falle neagtiven Lastschlages" VALUE 0x1CB162 Kw_Ws16 1500.000 Trq -500.0000 1000.000 FORMAT "%8.3" EXTENDED_LIMITS -3276.800 3276.700 /end CHARACTERISTIC
/begin CHARACTERISTIC ASDdc_trqNGvnrNeg_Vector "Konfigurationslabel für Bypass Freischnitt" VALUE 0x1C0A4A Kw_Wu8 255.0 OneToOne 0.00 255.0 FORMAT "%5.1" /end CHARACTERISTIC
/begin CHARACTERISTIC ASDdc_trqNGvnrNeg_Channel "Konfigurationslabel für Bypass Freischnitt" VALUE 0x1C0A4B Kw_Wu8 255.0 OneToOne 0.00 255.0 FORMAT "%5.1" /end CHARACTERISTIC
/begin CHARACTERISTIC ASDdc_trqNGvnrPos_Vector "Konfigurationslabel für Bypass Freischnitt" VALUE 0x1C0A4C Kw_Wu8 255.0 OneToOne 0.00 255.0 FORMAT "%5.1" /end CHARACTERISTIC
/begin CHARACTERISTIC ASDdc_trqNGvnrPos_Channel "Konfigurationslabel für Bypass Freischnitt" VALUE 0x1C0A4D Kw_Wu8 255.0 OneToOne 0.00 255.0 FORMAT "%5.1" /end CHARACTERISTIC
/begin CHARACTERISTIC ASDdc_trqPwrOnOffLimNeg_MAP "Momentschwelle für Aktivierung des Lastschlagparametersatzes für neg. Mengentendenz" MAP 0x1CB5D8 Kf_Xs16_Ys16_Ws16 1500.000 Trq -500.0000 1000.000 FORMAT "%8.3" EXTENDED_LIMITS -3276.800 3276.700
 /begin AXIS_DESCR STD_AXIS Eng_nAvrg EngN 8 0.00 6000.000 FORMAT "%8.3" EXTENDED_LIMITS -32768.00 32767.00 DEPOSIT ABSOLUTE /end AXIS_DESCR
 /begin AXIS_DESCR STD_AXIS DrvTrn_rTransDT TransR 12 -327.6800 327.6700 FORMAT "%8.4" DEPOSIT ABSOLUTE /end AXIS_DESCR
/end CHARACTERISTIC
/begin CHARACTERISTIC ASDdc_trqPwrOnOffLimPos_MAP "Momentschwelle für Aktivierung des Lastschlagparametersatzes für pos. Mengentendenz" MAP 0x1CB6C4 Kf_Xs16_Ys16_Ws16 1500.000 Trq -500.0000 1000.000 FORMAT "%8.3" EXTENDED_LIMITS -3276.800 3276.700
 /begin AXIS_DESCR STD_AXIS Eng_nAvrg EngN 8 0.00 6000.000 FORMAT "%8.3" EXTENDED_LIMITS -32768.00 32767.00 DEPOSIT ABSOLUTE /end AXIS_DESCR
 /begin AXIS_DESCR STD_AXIS DrvTrn_rTransDT TransR 12 -327.6800 327.6700 FORMAT "%8.4" DEPOSIT ABSOLUTE /end AXIS_DESCR
/end CHARACTERISTIC
/begin CHARACTERISTIC ASDdc_trqPwrOnOffOffset_CUR "Kennlinie für Offset bei Triggerschwelle bei positiver Momententendenz" CURVE 0x1CB7B0 Kl_Xs16_Ws16 1500.000 Trq -500.0000 1000.000 FORMAT "%8.3" EXTENDED_LIMITS -3276.800 3276.700
 /begin AXIS_DESCR STD_AXIS ASDrf_rAPP1Flt Prc 8 0.00 100.0000 FORMAT "%8.4" EXTENDED_LIMITS -327.6800 327.6700 DEPOSIT ABSOLUTE /end AXIS_DESCR
/end CHARACTERISTIC
/begin CHARACTERISTIC ASDdc_trqThresNegOff_C "Momentenschwelle für Beendigung des negativen Lastschlages" VALUE 0x1CB164 Kw_Ws16 1500.000 Trq -500.0000 1000.000 FORMAT "%8.3" EXTENDED_LIMITS -3276.800 3276.700 /end CHARACTERISTIC
/begin CHARACTERISTIC ASDdc_vLimIni_C "ARD Geschwindigkeitsschwelle f. Initialisierung Störregler" VALUE 0x1CB166 Kw_Ws16 655.3500 Vel -327.6800 327.6700 FORMAT "%8.4" /end CHARACTERISTIC
/begin CHARACTERISTIC ASDrf_dtrqInrLtdLim_CUR "Kurve zur Begrenzung der zeitl. Ableitung von CoEng_trqInrLtd" CURVE 0x1CB7D4 Kl_Xs16_Ws16 4000.000 dTrq -2000.000 2000.000 FORMAT "%8.3" EXTENDED_LIMITS -3276.800 3276.700
 /begin AXIS_DESCR STD_AXIS ASDrf_dtrqInrLtd_mp dTrq 7 -2000.000 2000.000 FORMAT "%8.3" EXTENDED_LIMITS -3276.800 3276.700 DEPOSIT ABSOLUTE /end AXIS_DESCR
/end CHARACTERISTIC
/begin CHARACTERISTIC ASDrf_dtrqNeg_MAP "Rampensteigung bei neg. Gradient" MAP 0x1CB7F2 Kf_Xs16_Ys16_Ws16 1599.609 RmpTrqdHigh 0.00 1599.609 FORMAT "%8.3" EXTENDED_LIMITS -48000.00 47998.54
 /begin AXIS_DESCR STD_AXIS Eng_nAvrg EngN 8 40.00000 6000.000 FORMAT "%8.3" EXTENDED_LIMITS -32768.00 32767.00 DEPOSIT ABSOLUTE /end AXIS_DESCR
 /begin AXIS_DESCR STD_AXIS DrvTrn_rTransDT TransR 12 -327.6800 100.0000 FORMAT "%8.4" EXTENDED_LIMITS -327.6800 327.6700 DEPOSIT ABSOLUTE /end AXIS_DESCR
/end CHARACTERISTIC
/begin CHARACTERISTIC ASDrf_dtrqPos_MAP "Rampensteigung bei pos. Gradient" MAP 0x1CB8DE Kf_Xs16_Ys16_Ws16 1599.609 RmpTrqdHigh 0.00 1599.609 FORMAT "%8.3" EXTENDED_LIMITS -48000.00 47998.54
 /begin AXIS_DESCR STD_AXIS Eng_nAvrg EngN 8 40.00000 6000.000 FORMAT "%8.3" EXTENDED_LIMITS -32768.00 32767.00 DEPOSIT ABSOLUTE /end AXIS_DESCR
 /begin AXIS_DESCR STD_AXIS DrvTrn_rTransDT TransR 12 -327.6800 100.0000 FORMAT "%8.4" EXTENDED_LIMITS -327.6800 327.6700 DEPOSIT ABSOLUTE /end AXIS_DESCR
/end CHARACTERISTIC
/begin CHARACTERISTIC ASDrf_dtrqSteepNeg_C "Obergrenze für Initialisierung bei steilen Eingangssignalgradienten" VALUE 0x1CB9CA Kw_Ws16 2000.000 dTrq -2000.000 0.00 FORMAT "%8.3" EXTENDED_LIMITS -3276.800 3276.700 /end CHARACTERISTIC
/begin CHARACTERISTIC ASDrf_dtrqSteepPos_C "Untergrenze für Initialisierung bei steilen Eingangssignalgradienten" VALUE 0x1CB9CC Kw_Ws16 2000.000 dTrq 0.00 2000.000 FORMAT "%8.3" EXTENDED_LIMITS -3276.800 3276.700 /end CHARACTERISTIC
/begin CHARACTERISTIC ASDrf_T1ExtInt_C "ARD Führungsformer T1, externer Eingriff" VALUE 0x1CBAC8 Kw_Wu32 4294.9673 TimeDelay_s 0.0000010000000 4294.9673 FORMAT "%9.4" /end CHARACTERISTIC
/begin CHARACTERISTIC ASDrf_KdExtInt_C "ARD Führungsformer Kd=Td/T1, externer Eingriff" VALUE 0x1CBACC Kw_Ws32 32769.0000000 Kd -32768.0000000 1.00000000000 FORMAT "%13.7" EXTENDED_LIMITS -32768.0000000 32767.9999847 /end CHARACTERISTIC
/begin CHARACTERISTIC ASDrf_facdtrqPos_CUR "Kennlinie für Steigungsbegrenzungsfaktor" CURVE 0x1CB9CE Kl_Xs16_Ws16 1.000000 Fact1 0.00 1.000000 FORMAT "%8.6" EXTENDED_LIMITS -256.0000 255.9922
 /begin AXIS_DESCR STD_AXIS ASDrf_rAPP1Flt Prc 8 0.00 100.0000 FORMAT "%8.4" EXTENDED_LIMITS -327.6800 327.6700 DEPOSIT ABSOLUTE /end AXIS_DESCR
/end CHARACTERISTIC
/begin CHARACTERISTIC ASDrf_facKdGripPos_CUR "Kennlinie für Multiplikationsfaktor für Gripparameter bei positiver Wunschmomententendenz" CURVE 0x1CBAD0 Kl_Xs16_Ws16 1.000000 Fact1 0.00 1.000000 FORMAT "%8.6" EXTENDED_LIMITS -256.0000 255.9922
 /begin AXIS_DESCR STD_AXIS ASDrf_rAPP1Flt Prc 8 0.00 100.0000 FORMAT "%8.4" EXTENDED_LIMITS -327.6800 327.6700 DEPOSIT ABSOLUTE /end AXIS_DESCR
/end CHARACTERISTIC
/begin CHARACTERISTIC ASDrf_T1Flt_C "Zeitkonstante PT1 Glied zur Filterung von CoEng_trqInrLtd vor der Ableitung." VALUE 0x1CB9F0 Kw_Wu32 4294.9673 TimeDelay_s 0.0000010000000 4294.9673 FORMAT "%9.4" /end CHARACTERISTIC
/begin CHARACTERISTIC ASDrf_KdCluNeg_CUR "Kupplungsparameter Kd, negativ" CURVE 0x1CBAF2 Kl_Xs16_Ws16 1.000000 Kd_Lin_16 0.00 1.000000 FORMAT "%8.6" EXTENDED_LIMITS -1.000031 1.000000
 /begin AXIS_DESCR STD_AXIS Eng_nAvrg EngN 4 0.00 6000.000 FORMAT "%8.3" EXTENDED_LIMITS -32768.00 32767.00 DEPOSIT ABSOLUTE /end AXIS_DESCR
/end CHARACTERISTIC
/begin CHARACTERISTIC ASDrf_KdCluPos_CUR "Kupplungsparameter Kd, positiv" CURVE 0x1CBB04 Kl_Xs16_Ws16 1.000000 Kd_Lin_16 0.00 1.000000 FORMAT "%8.6" EXTENDED_LIMITS -1.000031 1.000000
 /begin AXIS_DESCR STD_AXIS Eng_nAvrg EngN 4 0.00 6000.000 FORMAT "%8.3" EXTENDED_LIMITS -32768.00 32767.00 DEPOSIT ABSOLUTE /end AXIS_DESCR
/end CHARACTERISTIC
/begin CHARACTERISTIC ASDrf_KdGripNeg_MAP "Kd bei geschlossenem Antreibsstrang und negativem Gradienten" MAP 0x1CBB48 Kf_Xs16_Ys16_Ws16 1.000000 Kd_Lin_16 0.00 1.000000 FORMAT "%8.6" EXTENDED_LIMITS -1.000031 1.000000
 /begin AXIS_DESCR STD_AXIS DrvTrn_rTransDT TransR 12 0.00 100.0000 FORMAT "%8.4" EXTENDED_LIMITS -327.6800 327.6700 DEPOSIT ABSOLUTE /end AXIS_DESCR
 /begin AXIS_DESCR STD_AXIS Eng_nAvrg EngN 8 0.00 6000.000 FORMAT "%8.3" EXTENDED_LIMITS -32768.00 32767.00 DEPOSIT ABSOLUTE /end AXIS_DESCR
/end CHARACTERISTIC
/begin CHARACTERISTIC ASDrf_KdGripPos_MAP "Kd bei geschlossenem Antriebstrang und positivem Gradienten" MAP 0x1CBC34 Kf_Xs16_Ys16_Ws16 1.000000 Kd_Lin_16 0.00 1.000000 FORMAT "%8.6" EXTENDED_LIMITS -1.000031 1.000000
 /begin AXIS_DESCR STD_AXIS DrvTrn_rTransDT TransR 12 0.00 100.0000 FORMAT "%8.4" EXTENDED_LIMITS -327.6800 327.6700 DEPOSIT ABSOLUTE /end AXIS_DESCR
 /begin AXIS_DESCR STD_AXIS Eng_nAvrg EngN 8 0.00 6000.000 FORMAT "%8.3" EXTENDED_LIMITS -32768.00 32767.00 DEPOSIT ABSOLUTE /end AXIS_DESCR
/end CHARACTERISTIC
/begin CHARACTERISTIC ASDrf_nTMFWRO_C "Drehzahlschwelle zum Erkennen von Ausrollen" VALUE 0x1CBB16 Kw_Ws16 6000.000 EngN 0.00 6000.000 FORMAT "%8.3" EXTENDED_LIMITS -32768.00 32767.00 /end CHARACTERISTIC
/begin CHARACTERISTIC ASDrf_T1PCRsafe_C "T1 für Parametersatz bei sicheren Betriebdes Turboladers" VALUE 0x1CBB18 Kw_Wu32 4294.9673 TimeDelay_s 0.0000010000000 4294.9673 FORMAT "%9.4" /end CHARACTERISTIC
/begin CHARACTERISTIC ASDrf_KdPCRsafe_C "Kd-Faktor für Parametersatz bei sicheren Betriebdes Turboladers" VALUE 0x1CBB1C Kw_Ws32 32769.0000000 Kd -32768.0000000 1.00000000000 FORMAT "%13.7" EXTENDED_LIMITS -32768.0000000 32767.9999847 /end CHARACTERISTIC
/begin CHARACTERISTIC ASDrf_swtConvOff_C "Schalter zur Abschaltung der Kupplungsbedingung für Führungsformer und Steigungsbegrenzung" VALUE 0x1CBB20 Kw_Wu8 1.000 OneToOne 0.00 1.000 FORMAT "%5.3" EXTENDED_LIMITS 0.00 255.0 /end CHARACTERISTIC
/begin CHARACTERISTIC ASDrf_swtFlt_C "Schalter zur Auswahl des Filters für CoEng_trqInrLtd (0  Filterung / >0 keine Filterung)." VALUE 0x1CB9F4 Kw_Wu8 255.0 OneToOne 0.00 255.0 FORMAT "%5.1" /end CHARACTERISTIC
/begin CHARACTERISTIC ASDrf_swtGearbx_C "Schalter zur Auswahl des externen Getriebeeingriffes" VALUE 0x1CBB21 Kw_Wu8 2.000 OneToOne 0.00 2.000 FORMAT "%5.3" EXTENDED_LIMITS 0.00 255.0 /end CHARACTERISTIC
/begin CHARACTERISTIC ASDrf_swtInitPS_C "Schalter zur Aktivierung/Deaktivierung der kontinuierlichen Initialisierung aufgrund Parametersatzwechsels (>128: keine init.)" VALUE 0x1CB9F5 Kw_Wu8 255.0 OneToOne 0.00 255.0 FORMAT "%5.1" /end CHARACTERISTIC
/begin CHARACTERISTIC ASDrf_swtLIGovCompEna_C "Schalter zur Aktivierung der Leerlaufreglermomentenkompensation" VALUE 0x1CB9F6 Kw_Wu8 255.0 OneToOne 0.00 255.0 FORMAT "%5.1" /end CHARACTERISTIC
/begin CHARACTERISTIC ASDrf_swtPCRsafe_C " Schalter zum Deaktivieren der Anforderung für externen Parametersatz bei gleichzeitig aktiven Turboladerschutz." VALUE 0x1CBB22 Kw_Wu8 1.000 OneToOne 0.00 1.000 FORMAT "%5.3" EXTENDED_LIMITS 0.00 255.0 /end CHARACTERISTIC
/begin CHARACTERISTIC ASDrf_swtRmpNoGrip_C "Schalter um Zug-Schub-Rampe auch im Fall von NoGrip zu aktivieren" VALUE 0x1CB9F7 Kw_Wu8 255.0 OneToOne 0.00 255.0 FORMAT "%5.1" /end CHARACTERISTIC
/begin CHARACTERISTIC ASDrf_T1CluNeg_C "ARD Führungsformer T1 Kupplung neg. Gradient" VALUE 0x1CBB24 Kw_Wu32 4294.9673 TimeDelay_s 0.0000010000000 4294.9673 FORMAT "%9.4" /end CHARACTERISTIC
/begin CHARACTERISTIC ASDrf_T1CluPos_C "ARD Führungsformer T1 Kupplung pos. Gradient" VALUE 0x1CBB28 Kw_Wu32 4294.9673 TimeDelay_s 0.0000010000000 4294.9673 FORMAT "%9.4" /end CHARACTERISTIC
/begin CHARACTERISTIC ASDrf_T1GripNeg_MAP "T1 bei geschlossenem Antreibsstrang und negativem Gradienten" MAP 0x1CBD20 Kf_Xs16_Ys16_Ws16 1.499985 TimeDelay_s_Lin_16 0.00 1.499985 FORMAT "%8.6" EXTENDED_LIMITS -5.000153 5.000000
 /begin AXIS_DESCR STD_AXIS DrvTrn_rTransDT TransR 12 0.00 100.0000 FORMAT "%8.4" EXTENDED_LIMITS -327.6800 327.6700 DEPOSIT ABSOLUTE /end AXIS_DESCR
 /begin AXIS_DESCR STD_AXIS Eng_nAvrg EngN 8 0.00 6000.000 FORMAT "%8.3" EXTENDED_LIMITS -32768.00 32767.00 DEPOSIT ABSOLUTE /end AXIS_DESCR
/end CHARACTERISTIC
/begin CHARACTERISTIC ASDrf_T1GripPos_MAP "T1 bei geschlossenem Antriebstrang und positivem Gradienten" MAP 0x1CBE0C Kf_Xs16_Ys16_Ws16 1.499985 TimeDelay_s_Lin_16 0.00 1.499985 FORMAT "%8.6" EXTENDED_LIMITS -5.000153 5.000000
 /begin AXIS_DESCR STD_AXIS DrvTrn_rTransDT TransR 12 0.00 100.0000 FORMAT "%8.4" EXTENDED_LIMITS -327.6800 327.6700 DEPOSIT ABSOLUTE /end AXIS_DESCR
 /begin AXIS_DESCR STD_AXIS Eng_nAvrg EngN 8 0.00 6000.000 FORMAT "%8.3" EXTENDED_LIMITS -32768.00 32767.00 DEPOSIT ABSOLUTE /end AXIS_DESCR
/end CHARACTERISTIC
/begin CHARACTERISTIC ASDrf_tiAPP1PT1_C "PT1 Filterzeitkonstante zur PWG - Filterung" VALUE 0x1CBB2C Kw_Wu32 4294967.3 TimeDelay_ms 0.0010000000 4294967.3 FORMAT "%9.1" /end CHARACTERISTIC
/begin CHARACTERISTIC ASDrf_tiTMFWRO_C "Entprellzeit zum Erkennen von Ausrollen" VALUE 0x1CBB30 Kw_Wu16 655350.0 Time_ms 0.00 655350.0 FORMAT "%8.1" /end CHARACTERISTIC
/begin CHARACTERISTIC ASDrf_T1TMFWRONeg_C "ARD Führungsformer T1 Ausrollen neg. Gradient" VALUE 0x1CBB34 Kw_Wu32 4294.9673 TimeDelay_s 0.0000010000000 4294.9673 FORMAT "%9.4" /end CHARACTERISTIC
/begin CHARACTERISTIC ASDrf_KdTMFWRONeg_C "ARD Führungsformer Kd=Td/T1 Ausrollen neg. Gradient" VALUE 0x1CBB38 Kw_Ws32 32769.0000000 Kd -32768.0000000 1.00000000000 FORMAT "%13.7" EXTENDED_LIMITS -32768.0000000 32767.9999847 /end CHARACTERISTIC
/begin CHARACTERISTIC ASDrf_T1TMFWROPos_C "ARD Führungsformer T1 Ausrollen pos. Gradient" VALUE 0x1CBB3C Kw_Wu32 4294.9673 TimeDelay_s 0.0000010000000 4294.9673 FORMAT "%9.4" /end CHARACTERISTIC
/begin CHARACTERISTIC ASDrf_KdTMFWROPos_C "ARD Führungsformer Kd=Td/T1 Ausrollen pos. Gradient" VALUE 0x1CBB40 Kw_Ws32 32769.0000000 Kd -32768.0000000 1.00000000000 FORMAT "%13.7" EXTENDED_LIMITS -32768.0000000 32767.9999847 /end CHARACTERISTIC
/begin CHARACTERISTIC ASDrf_trqFltLim_C "Grenzwert der logischen Filter für CoEng_trqInrLtd vor der Ableitung" VALUE 0x1CB9F8 Kw_Ws16 6553.500 Trq -3276.800 3276.700 FORMAT "%8.3" /end CHARACTERISTIC
/begin CHARACTERISTIC ASDrf_trqPullNeg_CUR "pos. Offset auf Verlustmoment bei neg. Lastwechsel" CURVE 0x1CB9FA Kl_Xs16_Ws16 1500.000 Trq -500.0000 1000.000 FORMAT "%8.3" EXTENDED_LIMITS -3276.800 3276.700
 /begin AXIS_DESCR STD_AXIS Eng_nAvrg EngN 12 40.00000 6000.000 FORMAT "%8.3" EXTENDED_LIMITS -32768.00 32767.00 DEPOSIT ABSOLUTE /end AXIS_DESCR
/end CHARACTERISTIC
/begin CHARACTERISTIC ASDrf_trqPullPos_CUR "pos. Offset auf Verlustmoment bei pos. Lastwechsel" CURVE 0x1CBA2C Kl_Xs16_Ws16 1500.000 Trq -500.0000 1000.000 FORMAT "%8.3" EXTENDED_LIMITS -3276.800 3276.700
 /begin AXIS_DESCR STD_AXIS Eng_nAvrg EngN 12 40.00000 6000.000 FORMAT "%8.3" EXTENDED_LIMITS -32768.00 32767.00 DEPOSIT ABSOLUTE /end AXIS_DESCR
/end CHARACTERISTIC
/begin CHARACTERISTIC ASDrf_trqPushNeg_CUR "neg. Offset auf Verlustmoment bei neg. Lastwechsel" CURVE 0x1CBA5E Kl_Xs16_Ws16 1500.000 Trq -500.0000 1000.000 FORMAT "%8.3" EXTENDED_LIMITS -3276.800 3276.700
 /begin AXIS_DESCR STD_AXIS Eng_nAvrg EngN 12 40.00000 6000.000 FORMAT "%8.3" EXTENDED_LIMITS -32768.00 32767.00 DEPOSIT ABSOLUTE /end AXIS_DESCR
/end CHARACTERISTIC
/begin CHARACTERISTIC ASDrf_trqPushPos_CUR "neg. Offset auf Verlusmenge bei Pos. Lastwechsel" CURVE 0x1CBA90 Kl_Xs16_Ws16 1500.000 Trq -500.0000 1000.000 FORMAT "%8.3" EXTENDED_LIMITS -3276.800 3276.700
 /begin AXIS_DESCR STD_AXIS Eng_nAvrg EngN 12 40.00000 6000.000 FORMAT "%8.3" EXTENDED_LIMITS -32768.00 32767.00 DEPOSIT ABSOLUTE /end AXIS_DESCR
/end CHARACTERISTIC
/begin CHARACTERISTIC ASDrf_trqThresNeg_C "ARD Führungsformer Hystereseschwelle Wunschmomentgradient 'neg' alle Ganggrp." VALUE 0x1CBAC2 Kw_Ws16 1500.000 Trq -500.0000 1000.000 FORMAT "%8.3" EXTENDED_LIMITS -3276.800 3276.700 /end CHARACTERISTIC
/begin CHARACTERISTIC ASDrf_trqThresPos_C "ARD Führungsformer Hystereseschwelle Wunschmomentgradient 'pos' alle Ganggrp." VALUE 0x1CBAC4 Kw_Ws16 1500.000 Trq -500.0000 1000.000 FORMAT "%8.3" EXTENDED_LIMITS -3276.800 3276.700 /end CHARACTERISTIC
/begin CHARACTERISTIC ASDrf_trqTMFWRO_C "Drehmomentschwelle zum Erkennen von Ausrollen" VALUE 0x1CBB44 Kw_Ws32 104856.000000 TrqPrpHigh -52428.8000000 52427.2000000 FORMAT "%13.7" EXTENDED_LIMITS -214748364.800 214748364.700 /end CHARACTERISTIC
/begin CHARACTERISTIC UAcc_LogReqPWASModRst_C "Anmeldekennwort zur Neuintialisierung der Korrekturfaktoren beim Ladedruckfühleraustausch" VALUE 0x1C1492 Kw_Wu16 55535.00 OneToOne 10000.00 65535.00 FORMAT "%8.2" EXTENDED_LIMITS 0.00 65535.00 /end CHARACTERISTIC
/begin COMPU_METHOD AirMassPerCyl "Luftmasse pro Zylinder" RAT_FUNC "%6.3" "[mg/Hub Luft]" COEFFS 0 10 0 0 0 1 /end COMPU_METHOD
/begin COMPU_METHOD AirMassPerTime "Luftmasse pro Zeit" RAT_FUNC "%6.3" "[Kg/h Luft]" COEFFS 0 10 0 0 0 1 /end COMPU_METHOD
/begin COMPU_METHOD ASD_GvrnDT1Kd_float "Differentialverstärkung Kd (Motordrehzahl EngN zu Motormoment Trq)" RAT_FUNC "%6.2" "(Nm/rpm)^0.5" COEFFS 0 1 0 0 0 1 /end COMPU_METHOD
/begin COMPU_METHOD ASD_GvrnDT1T1_float "Zeitkonstante T1 (in s) für PT1, DT1 beim ARD" RAT_FUNC "%6.2" "s" COEFFS 0 1 0 0 0 1 /end COMPU_METHOD
/begin COMPU_METHOD dFlConsum "Ableitung des Kraftstoffverbrauchs" RAT_FUNC "%6.4" "[l/h/s]" COEFFS 0 100 0 0 0 1 /end COMPU_METHOD
/begin COMPU_METHOD dTrq "Umrtechnungsformel dTrq/dTime" RAT_FUNC "%6.3" "Nm/s" COEFFS 0 10 0 0 0 1 /end COMPU_METHOD
/begin COMPU_METHOD DtyCyc "Tastverhaeltnis" RAT_FUNC "%6.4" "[%]" COEFFS 0 100 0 0 0 1 /end COMPU_METHOD
/begin COMPU_METHOD EngN "Motordrehzahl" RAT_FUNC "%6.2" "[rpm]" COEFFS 0 1 0 0 0 1 /end COMPU_METHOD
/begin COMPU_METHOD EngTempFldSel "Verbale Umrechnung für Auswahl aus dem Motortemperatur-Feld Eng_tFld" TAB_VERB "%6.3" "" COMPU_TAB_REF EngTempFldSel /end COMPU_METHOD
/begin COMPU_VTAB EngTempFldSel "Verbale Umrechnung für Auswahl aus dem Motortemperatur-Feld Eng_tFld" TAB_VERB 5 0 "Coolant_Temperature" 1 "Oil_Temperature" 2 "Engine_Temperature" 3 "Fuel_Temperature" 4 "Coolant_Temperature_CAN" /end COMPU_VTAB
/begin COMPU_METHOD Eng_dN "Motorbeschleunigung" RAT_FUNC "%6.2" "rpm/s" COEFFS 0 1 0 0 0 1 /end COMPU_METHOD
/begin COMPU_METHOD Fact "Faktor mit Auflösung 1 / 8192, hauptsächlich für einen Faktorenbereich 0...1 verwendet" RAT_FUNC "%6.5" "[-]" COEFFS 0 8192 0 0 0 1 /end COMPU_METHOD
/begin COMPU_METHOD Fact1 "Faktor mit Auflösung 0,01 (100 mal höherer Bereich als Fact)" RAT_FUNC "%6.4" "[-]" COEFFS 0 128 0 0 0 1 /end COMPU_METHOD
/begin COMPU_METHOD FactLow "Faktor mit Auflösung 1/1024, hauptsächlich für einen Faktorenbereich 1...50 verwendet" RAT_FUNC "%6.5" "[-]" COEFFS 0 1024 0 0 0 1 /end COMPU_METHOD
/begin COMPU_METHOD InjMass "Einspritzmenge" RAT_FUNC "%6.4" "[mg/hub]" COEFFS 0 100 0 0 0 1 /end COMPU_METHOD
/begin COMPU_METHOD Kd "Differentialverstärkung Kd (gleiche Einheit/Umrechnungsformel an Ein- und Ausgang)" RAT_FUNC "%7.6" "[1/1]" COEFFS 0 65536 0 0 0 1 /end COMPU_METHOD
/begin COMPU_METHOD Kd16_sqr_rpm2Nm "Wurzeldifferentialverstärkung Kd^0,5 für D2T2 (zweifach DT1), Motordrehzahl EngN zu Motormoment Trq" RAT_FUNC "%6.5" "(Nm/rpm)^0.5" COEFFS 0 1024 0 0 0 1 /end COMPU_METHOD
/begin COMPU_METHOD Kd_Lin_16 "Kd Verstärkung von linearen Kennlinien/-feldern" RAT_FUNC "%7.6" "1/1" COEFFS 0 32767 0 0 0 1 /end COMPU_METHOD
/begin COMPU_METHOD KD_RPM2NM_4 "Verstärkungsfaktor" RAT_FUNC "%6.5" "[(Nm*s)/rpm]" COEFFS 0 5120 0 0 0 1 /end COMPU_METHOD
/begin COMPU_METHOD Ki "Integrale Verstärkung Ki (gleiche Einheit/Umrechnungsregel an Ein- und Ausgang)" RAT_FUNC "%6.5" "[1/s]" COEFFS 0 4294.967296 0 0 0 1 /end COMPU_METHOD
/begin COMPU_METHOD KI_RPM2NM_2 "Verstärkungsfaktor zur Anpassung von 16 Bit an 32 Bit Werte (mit KI_RPM2NM_2_NRM schieben)" RAT_FUNC "%6.5" "[Nm/rpm]" COEFFS 0 2684.35456 0 0 0 1 /end COMPU_METHOD
/begin COMPU_METHOD KP_RPM2NM_2 "Verstärkungsfaktor zur Anpassung von 16 Bit an 32 Bit Werte (mit KP_RPM2NM_2_NRM schieben)" RAT_FUNC "%7.6" "[Nm/rpm]" COEFFS 0 20480 0 0 0 1 /end COMPU_METHOD
/begin COMPU_METHOD KP_RPM2NM_4 "Verstärkungsfaktor" RAT_FUNC "%6.5" "[Nm/rpm]" COEFFS 0 5120 0 0 0 1 /end COMPU_METHOD
/begin COMPU_METHOD Map_Select "Umsetzungsfaktor von Kennfeldern fuer vierdimensionale Raeume" RAT_FUNC "%6.4" "[-]" COEFFS 0 256 0 0 0 1 /end COMPU_METHOD
/begin COMPU_METHOD NumPinAdc "verbale Umrechnung für ADC Signale" TAB_VERB "%6.3" "" COMPU_TAB_REF NumPinAdc /end COMPU_METHOD
/begin COMPU_VTAB NumPinAdc "verbale Umrechnung für ADC Signale" TAB_VERB 5 2 "Exhaust_Gas_Recirculation_Sensor" 14 "Throttle_Valve_Position_Sensor" 17 "Fuel_Temperature_Sensor" 24 "1st_APP_Sensor" 25 "2nd_APP_Sensor" /end COMPU_VTAB
/begin COMPU_METHOD OneToOne "eins zu eins (physikalischer Wert ist gleich dem internen Wert)" RAT_FUNC "%6.2" "[-]" COEFFS 0 1 0 0 0 1 /end COMPU_METHOD
/begin COMPU_METHOD Prc "Prozent, gleiche interne Auflösung wie Fact, aber Darstellung in Prozent (0...100%)" RAT_FUNC "%6.4" "[%]" COEFFS 0 100 0 0 0 1 /end COMPU_METHOD
/begin COMPU_METHOD PrcPerSec "Prozentänderung pro Sekunde für 20ms-Tasks" RAT_FUNC "%6.3" "[%/s]" COEFFS 0 2 0 0 0 1 /end COMPU_METHOD
/begin COMPU_METHOD Prc_D20ms "Prozent (0...100%/s) fuer 20ms - Task" RAT_FUNC "%6.3" "[%/s]" COEFFS 0 2 0 0 0 1 /end COMPU_METHOD
/begin COMPU_METHOD PresAC_hPa "Druck (Klimatisierung) angezeigt in [hPa]" RAT_FUNC "%6.2" "[hPa]" COEFFS 0 0.5 0 0 0 1 /end COMPU_METHOD
/begin COMPU_METHOD Pres_hPa "Druck (angezeigt in [hPa])" RAT_FUNC "%6.2" "[hPa]" COEFFS 0 1 0 0 0 1 /end COMPU_METHOD
/begin COMPU_METHOD rev_acc "Drehzahlbeschleunigung" RAT_FUNC "%6.2" "[rmp/s]" COEFFS 0 1 0 0 0 1 /end COMPU_METHOD
/begin COMPU_METHOD RmpEngN "Rampengradient für Motordrehzahl" RAT_FUNC "%6.4" "[rpm/s]" COEFFS 0 65.536 0 0 0 1 /end COMPU_METHOD
/begin COMPU_METHOD RmpEngN_2 "Umrechnung für Anfahrregler" RAT_FUNC "%6.2" "[rpm/s]" COEFFS 0 0.512 0 0 0 1 /end COMPU_METHOD
/begin COMPU_METHOD RmpFactLow "Ramp Factor (Low) Umrechnung" RAT_FUNC "%7.6" "[Fact/s]" COEFFS 0 67108.864 0 0 0 1 /end COMPU_METHOD
/begin COMPU_METHOD RmpPrc "Prozent Rampengradient" RAT_FUNC "%6.5" "[%/s]" COEFFS 0 6553.6 0 0 0 1 /end COMPU_METHOD
/begin COMPU_METHOD RmpPres_hPa "Rampengradient für Druck angezeigt in [hPa/s]" RAT_FUNC "%6.4" "[hPa/s]" COEFFS 0 65.536 0 0 0 1 /end COMPU_METHOD
/begin COMPU_METHOD RmpTrqdHigh "Rampengradient für Momente mit großen Steigungen" RAT_FUNC "%6.2" "[Nm/s]" COEFFS 0 0.682666666666667 0 0 0 1 /end COMPU_METHOD
/begin COMPU_METHOD RmpVoltSens "Rampengradient für Geschwindigkeit" RAT_FUNC "%6.4" "mV/s" COEFFS 0 13.4086656 0 0 0 1 /end COMPU_METHOD
/begin COMPU_METHOD Rmp_Fact16 "Rampenfaktorgradient" RAT_FUNC "%6.5" "[1/s]" COEFFS 0 4194.304 0 0 0 1 /end COMPU_METHOD
/begin COMPU_METHOD TempDiff_Kelv "Offsettemperatur dargestellt in [K]" RAT_FUNC "%6.3" "[ deg C ]" COEFFS 0 10 0 0 0 1 /end COMPU_METHOD
/begin COMPU_METHOD Temp_Cels "Temperatur dargestellt in °C (gleiche interne Darstellung wie Temp_Kelv)" RAT_FUNC "%6.1" "[deg C]" COEFFS 0 10 2731.4 0 0 1 /end COMPU_METHOD
/begin COMPU_METHOD TimeDeb "Entprellzeit in Millisekunden für Libraryfunktion Debounce" RAT_FUNC "%6.1" "[ms]" COEFFS 0 0.1 0 0 0 1 /end COMPU_METHOD
/begin COMPU_METHOD TimeDelay_ms "Zeitkonstante T1 fuer die Bibliotheksfunktionen PT1, DT1, etc.,  in ms angegeben" RAT_FUNC "%9.0" "[ms]" COEFFS 0 0 1 0 2.3283064365387e-07 0 /end COMPU_METHOD
/begin COMPU_METHOD TimeDelay_s "Zeitkonstante T1 (in s) für PT1, DT1, etc." RAT_FUNC "%9.3" "[s]" COEFFS 0 0 1 0 0.00023283064365387 0 /end COMPU_METHOD
/begin COMPU_METHOD TimeDelay_s_Lin_16 "Zeitkonstante T1 (in s) für PT1, DT1, etc. für SINT16, kein Kehrwert" RAT_FUNC "%6.5" "s" COEFFS 0 6553.4 0 0 0 1 /end COMPU_METHOD
/begin COMPU_METHOD TimeDelay_s_Lin_16_3 "Zeitkonstante T1 (in s) für PT1, DT1, etc. für SINT16, kein Kehrwert" RAT_FUNC "%6.4" "s" COEFFS 0 131.068 0 0 0 1 /end COMPU_METHOD
/begin COMPU_METHOD Time_ms "Zeit in ms für Fehlerentprellung (DSM) und SW-Timer" RAT_FUNC "%6.1" "[ms]" COEFFS 0 0.1 0 0 0 1 /end COMPU_METHOD
/begin COMPU_METHOD Time_ms_20ms "Zeitzähler im 20 ms Raster, dargestellt in ms" RAT_FUNC "%6.1" "ms" COEFFS 0 0.05 0 0 0 1 /end COMPU_METHOD
/begin COMPU_METHOD Time_s "Zeit in s für Fehlerentprellung (DSM) und SW-Timer" RAT_FUNC "%6.4" "[s]" COEFFS 0 100 0 0 0 1 /end COMPU_METHOD
/begin COMPU_METHOD TransR "Übersetzungsverhältnis (Getriebe etc.)" RAT_FUNC "%6.4" "[-]" COEFFS 0 100 0 0 0 1 /end COMPU_METHOD
/begin COMPU_METHOD Trq "Motormoment" RAT_FUNC "%6.3" "[Nm]" COEFFS 0 10 0 0 0 1 /end COMPU_METHOD
/begin COMPU_METHOD TrqPrp "Vortriebsmoment" RAT_FUNC "%6.2" "[Nm]" COEFFS 0 0.625 0 0 0 1 /end COMPU_METHOD
/begin COMPU_METHOD TrqPrpHigh "vortriebsmoment" RAT_FUNC "%6.3" "[Nm]" COEFFS 0 10 0 0 0 1 /end COMPU_METHOD
/begin COMPU_METHOD Vel "Fahrzeuggeschwindigkeit, gleiche interne Auflösung wie Vel_SI" RAT_FUNC "%6.4" "[km/h]" COEFFS 0 100 0 0 0 1 /end COMPU_METHOD
/begin COMPU_METHOD VelToN "Verhältnis Fahrzeuggeschwindigkeit zu Motordrehzahl v/n" RAT_FUNC "%8.7" "[(km/h)/rpm]" COEFFS 0 100000 0 0 0 1 /end COMPU_METHOD
/begin COMPU_METHOD Volt "Spannung in V (von ADC)" RAT_FUNC "%6.2" "[mV]" COEFFS 0 0.2046 0 0 0 1 /end COMPU_METHOD
/begin COMPU_METHOD Volt_Batt "Batteriespannung" RAT_FUNC "%6.1" "[mV]" COEFFS 0 0.0492252911173131 0 0 0 1 /end COMPU_METHOD
/begin RECORD_LAYOUT Kf_Xs16_Ys16_Ws16 NO_AXIS_PTS_X 1 SWORD NO_AXIS_PTS_Y 2 SWORD AXIS_PTS_X 3 SWORD INDEX_INCR DIRECT AXIS_PTS_Y 4 SWORD INDEX_INCR DIRECT FNC_VALUES 5 SWORD COLUMN_DIR DIRECT /end RECORD_LAYOUT
/begin RECORD_LAYOUT Kl_Xs16_Ws16 NO_AXIS_PTS_X 1 SWORD AXIS_PTS_X 2 SWORD INDEX_INCR DIRECT FNC_VALUES 3 SWORD COLUMN_DIR DIRECT /end RECORD_LAYOUT
/begin RECORD_LAYOUT Kw_Wr32 FNC_VALUES 1 FLOAT32_IEEE COLUMN_DIR DIRECT /end RECORD_LAYOUT
/begin RECORD_LAYOUT Kw_Ws16 FNC_VALUES 1 SWORD COLUMN_DIR DIRECT /end RECORD_LAYOUT
/begin RECORD_LAYOUT Kw_Ws32 FNC_VALUES 1 SLONG COLUMN_DIR DIRECT /end RECORD_LAYOUT
/begin RECORD_LAYOUT Kw_Ws8 FNC_VALUES 1 SBYTE COLUMN_DIR DIRECT /end RECORD_LAYOUT
/begin RECORD_LAYOUT Kw_Wu16 FNC_VALUES 1 UWORD COLUMN_DIR DIRECT /end RECORD_LAYOUT
/begin RECORD_LAYOUT Kw_Wu32 FNC_VALUES 1 ULONG COLUMN_DIR DIRECT /end RECORD_LAYOUT
/begin RECORD_LAYOUT Kw_Wu8 FNC_VALUES 1 UBYTE COLUMN_DIR DIRECT /end RECORD_LAYOUT
/begin FUNCTION ACCtl_Hys "Abschaltbedingungen des Klimakompressors"
 /begin DEF_CHARACTERISTIC ACCtl_drAccPedHi_C ACCtl_drAccPedLo_C ACCtl_nAccVehHi_C ACCtl_nAccVehLo_C ACCtl_nDAEngHi_C ACCtl_nDAEngLo_C ACCtl_nLIGovHi_C ACCtl_nLIGovLo_C ACCtl_nLIGovRelHi_C ACCtl_nLIGovRelLo_C ACCtl_nSysErrHi_C ACCtl_nSysErrLo_C ACCtl_pACPMaxHi_C ACCtl_pACPMaxLo_C ACCtl_pACPMinHi_C ACCtl_pACPMinLo_C ACCtl_pAccValHi_C ACCtl_pAccValLo_C ACCtl_rAccPedHi_C ACCtl_rAccPedLo_C ACCtl_stDAGearHi_C ACCtl_stDAGearLo_C ACCtl_swtFanErrEna_C ACCtl_swtTempACOff_C ACCtl_swtTempHys_C ACCtl_swtVehStopEna_C ACCtl_swtnLIGovRelEna_C ACCtl_tACPairHi_C ACCtl_tACPairLo_C ACCtl_tAccAir1Hi_C ACCtl_tAccAir1Lo_C ACCtl_tAccAir2Hi_C ACCtl_tAccAir2Lo_C ACCtl_tTempRedHi_C ACCtl_tTempRedLo_C ACCtl_tWTHi_CUR ACCtl_tWTSubthresh_C ACCtl_tiACOnDly_C ACCtl_tiACPmin_C ACCtl_tiACStrtDly_CUR ACCtl_tiAccAirMin_C ACCtl_tiCANESCU_C ACCtl_tiCANGearbx_C ACCtl_tiDAmax_MAP ACCtl_tiDAmin_MAP ACCtl_tiLIGov_C ACCtl_tiSysErrmin_C ACCtl_tiTempRedMin_C ACCtl_tiWTmin_C ACCtl_vAccVehHi_C ACCtl_vAccVehLo_C ACCtl_vDAVehHi_C ACCtl_vDAVehLo_C ACCtl_vVehStop_C /end DEF_CHARACTERISTIC
/end FUNCTION
/begin FUNCTION ACCtl_Logic "Klimakompressor Zustandssteuerung"
 /begin DEF_CHARACTERISTIC ACCtl_nKliIdlSpd_C ACCtl_nOffset_C ACCtl_stShtOffMinSwtOnTime_C ACCtl_swtEnableRequest_C ACCtl_swtSelAirTemp_C ACCtl_swtVehStand_C ACCtl_swtoff_mode_C ACCtl_tClntMin_C ACCtl_tiAccMin_C ACCtl_tiMaxTSCfreezeReduction_C ACCtl_tiMaxTSCfreeze_C ACCtl_tiMinSwitchOn_C ACCtl_tiMinSwitchReduction_C ACCtl_tiStrtOn_C /end DEF_CHARACTERISTIC
/end FUNCTION
/begin FUNCTION ACTrqC "Klimaanlage Momentenregelung" /begin SUB_FUNCTION ACTrqC_ACTrqCorr /end SUB_FUNCTION /end FUNCTION
/begin FUNCTION ACTrqC_ACTrqCorr "Vorsteuerung und Momentenkorrektur Klimakompressor"
 /begin DEF_CHARACTERISTIC ACTrqC_dDT1TrqDynfact_C ACTrqC_factDiv_C ACTrqC_factMul_C ACTrqC_swtCANtrq_C ACTrqC_swtCalc_C ACTrqC_tiDT1TrqDyn_C ACTrqC_trqConvp_MAP ACTrqC_trqConvt_MAP /end DEF_CHARACTERISTIC
/end FUNCTION
/begin FUNCTION AC_PwrDem "Leistungsanforderung Klimatisierung"
 /begin DEF_CHARACTERISTIC AC_pwrAdjValDef_C AC_pwrAdjValMax_C AC_pwrAdjValMin_C AC_rTrans_C /end DEF_CHARACTERISTIC
/end FUNCTION
/begin FUNCTION ADCMon "ADC Überwachung" /begin SUB_FUNCTION ADC_Mon /end SUB_FUNCTION /end FUNCTION
/begin FUNCTION ADC_Mon "ADC Überwachung"
 /begin DEF_CHARACTERISTIC ADCMon_DebQueueDef_C ADCMon_DebRefVltgSRCDef_C ADCMon_DebTstImpDef_C ADCMon_nQueueMon_C ADCMon_tiQueueMon_C ADCMon_tiSendTstImp_C ADCMon_uRefSRCMax_C ADCMon_uRefSRCMin_C ADCMon_uTstImpSRCMax_C /end DEF_CHARACTERISTIC
/end FUNCTION
/begin FUNCTION AFSCD_Co "Luftmassenmesser"
 /begin DEF_CHARACTERISTIC AFSCD_DebPlHiOffsDrftDef_C AFSCD_DebPlHiOffsDrftOk_C AFSCD_DebPlLoOffsDrftDef_C AFSCD_DebPlLoOffsDrftOk_C AFSCD_DebSRCHiAirmDef_C AFSCD_DebSRCHiAirmOk_C AFSCD_DebSRCHiSplyVltgDef_C AFSCD_DebSRCHiSplyVltgOk_C AFSCD_DebSRCLoAirmDef_C AFSCD_DebSRCLoAirmOk_C AFSCD_DebSRCLoSplyVltgDef_C AFSCD_DebSRCLoSplyVltgOk_C AFSCD_dmAirPerTimeDfl_C AFSCD_dmAirThrSRCHi_C AFSCD_dmAirThrSRCLo_C AFSCD_dmCorrAirPerTime_CUR AFSCD_dmLin_CUR AFSCD_facAirPerCylCor_MAP AFSCD_facCorrVal_MAP AFSCD_facPlsCor_MAP AFSCD_facSwtOnCor_C AFSCD_mAirPerCylDfl_MAP AFSCD_nAvrgThrHiPlHiShtrp_C AFSCD_nAvrgThrHiPlLoShtrp_C AFSCD_nAvrgThrHiSRCLo_C AFSCD_nAvrgThrLoPlHiShtrp_C AFSCD_nAvrgThrLoPlLoShtrp_C AFSCD_nAvrgThrLoSRCLo_C AFSCD_pAirThrLoShtrp_C AFSCD_pNormAir_C AFSCD_qAirmThrSRCHiActv_CUR AFSCD_qRawThrHiShtrp_C AFSCD_rAirThrHiPlHiShtrp_C AFSCD_rAirThrHiPlHi_C AFSCD_rAirThrLoPlLoShtrp_C AFSCD_rTVAPThrHi_C AFSCD_swtAirSysType_C AFSCD_swtAirSysVal_C AFSCD_swtDebCfg_C AFSCD_swtSwtOnCor_C AFSCD_tAirTempCorr_CUR AFSCD_tClntThrLoShtrp_C AFSCD_tNormAir_C AFSCD_tiDlyActvSRCHiAirm_C AFSCD_tiLPFilt_C AFSCD_tiOffsDrftTstLim_C AFSCD_tiSwtOnCor_C AFSCD_uThrHiPlOffsDrft_C AFSCD_uThrLoPlOffsDrft_C /end DEF_CHARACTERISTIC
/end FUNCTION
/begin FUNCTION AFSCD_Mon "AFSCD Monitoring fucntion"
 /begin DEF_CHARACTERISTIC AFSCD_DebPlHiSetyDrftDef_C AFSCD_DebPlHiSetyDrftOk_C AFSCD_DebPlLoSetyDrftDef_C AFSCD_DebPlLoSetyDrftOk_C AFSCD_dmPlsCor_MAP AFSCD_mPlsCor_MAP AFSCD_nAvrgThrHiPlHi_C AFSCD_nAvrgThrHiPlLo_C AFSCD_nAvrgThrLoPlHi_C AFSCD_nAvrgThrLoPlLo_C AFSCD_pAirThrLo_C AFSCD_pBstThrHiPlHi_C AFSCD_pBstThrLoPlLo_C AFSCD_qRawThrHi_C AFSCD_rAirThrLoPlLo_C AFSCD_rEGRPThrHi_C AFSCD_rSwirlThrHi_C AFSCD_tClntThrHi_C AFSCD_tClntThrLo_C AFSCD_tiDlyEGRPPlSetyDrft_C AFSCD_tiDlyStrPlSetyDrft_C AFSCD_tiPT1rAirNorm_C /end DEF_CHARACTERISTIC
/end FUNCTION
/begin FUNCTION AFSCD_Sec_Co "zweiter Luftmassenmesser" /begin DEF_CHARACTERISTIC AFSCD_dmCorrAirPerTime2_CUR /end DEF_CHARACTERISTIC /end FUNCTION
/begin FUNCTION AFVCD_Co "Koordinator für Luftfilterventil Komponententreiber"
 /begin DEF_CHARACTERISTIC AFVCD_DebExcTempDef_C AFVCD_DebExcTempOk_C AFVCD_DebNoLdDef_C AFVCD_DebNoLdOk_C AFVCD_DebShCirBattDef_C AFVCD_DebShCirBattOk_C AFVCD_DebShCirGndDef_C AFVCD_DebShCirGndOk_C AFVCD_ctPwrStgOnMax_C AFVCD_stActrInvOut_C AFVCD_stPwrStgActrActv_C AFVCD_stPwrStgActrDia_C AFVCD_stSPICtl_C AFVCD_tiBtwTst_C AFVCD_tiPwrStgOn_C /end DEF_CHARACTERISTIC
/end FUNCTION
/begin FUNCTION AFVCtl_Logic "Logik für Luftfilterventilsteuerung"
 /begin DEF_CHARACTERISTIC AFVCtl_dmAcouHighOff_C AFVCtl_dmAcouHighOn_C AFVCtl_dmAcouLowOff_C AFVCtl_dmAcouLowOn_C AFVCtl_dmHeightOff_C AFVCtl_dmHeightOn_C AFVCtl_dmPwrOff_C AFVCtl_dmPwrOn_C AFVCtl_dmRainHighOff_C AFVCtl_dmRainHighOn_C AFVCtl_dmRainLowOff_C AFVCtl_dmRainLowOn_C AFVCtl_dmSnowHighOff_C AFVCtl_dmSnowHighOn_C AFVCtl_dmSnowLowOff_C AFVCtl_dmSnowLowOn_C AFVCtl_nAcouHighOff_C AFVCtl_nAcouHighOn_C AFVCtl_nAcouLowOff_C AFVCtl_nAcouLowOn_C AFVCtl_pHeightOff_C AFVCtl_pHeightOn_C AFVCtl_tAirSnowOff_C AFVCtl_tAirSnowOn_C AFVCtl_tIndPwrOff_C AFVCtl_tIndPwrOn_C AFVCtl_tIndSnowOff_C AFVCtl_tIndSnowOn_C AFVCtl_tiRainWiperHoldNeg_C AFVCtl_tiRainWiperHoldPos_C AFVCtl_vRainHighOff_C AFVCtl_vRainHighOn_C AFVCtl_vRainLowOff_C AFVCtl_vRainLowOn_C AFVCtl_vSnowHighOff_C AFVCtl_vSnowHighOn_C AFVCtl_vSnowLowOff_C AFVCtl_vSnowLowOn_C /end DEF_CHARACTERISTIC
/end FUNCTION
/begin FUNCTION ALL_FUNCTIONS "Alle Funktionen im Projekt ohne Hierarchie"
 /begin SUB_FUNCTION ACCD_DigOut ACCD_MNSwt ACCD_Pres ACC_State ACC_TrqIntv ACCtl_AntiClunk ACCtl_Hys ACCtl_Logic ACTrqC_ACTrqCorr AC_PwrDem ADC_Mon AFSCD_Co AFSCD_Mon AFSCD_Sec_Co AFVCD_Co AFVCtl_Logic AOHtCD_Co AOHt_Logic APPCD_Co APPCD_KickDwn APSCD_Co ARnMon ASDdc_Governor ASDdc_SelectParameter ASDrf_Governor ASDrf_SelectParameter ASMod_ObsvrPIndVol AccPed_APCheck AccPed_DrvDem AirCtl_BPDem AirCtl_ClntByp AirCtl_ControlMonitor AirCtl_CtlValCalc AirCtl_DesValCalc AirCtl_Governor AirCtl_Monitor AirSys_Co AirbCD_Co AltCD_DigOut AltCD_Excitement AltCD_Load AltCD_Out_Proc Alt_DetAltPwr Alt_excitement BIPCD_BIPDet BIP_Base BIP_Control BIP_Monitor BIP_WinCo BIP_WinState BPACD_Co BPASCD_Co BPSCD_Co BasAdj_TogVal BattCD Batt_CorFac_Proc BrkCD_Co Bypass CCP_Config COTSCD_Co CTSCD_Co CaSCD_Co CaSCD_Pos CaSCD_Spd Calibration_Interface Carb_Co Clg_DynTst CmbChb_Misfire CoDT_CheckGrip CoDT_DrvTrnCord CoDT_PrpTrqRngCalc CoEng_ActrPrt CoEng_AftRunExtWait CoEng_Afterrun CoEng_FlConsum CoEng_Mon CoEng_OvrRunCoord CoEng_PwrStgStateCalc CoEng_ShOff CoEng_TMFWShOff CoEng_TrqCalc CoEng_TrqLimCalc CoEng_TrqSlpLimCalc CoEng_TstCo CoEng_stEngCalc CoVM_DemCheck CoVM_DemCord CoVM_StabDem CoVeh_AcsMng CoVeh_DrvTrnOrd CoVeh_Idlstop ConvCD_Co ConvCD_Ils Conv_ClthPrt CrCCD_Co CrCCD_KeyDet CrCtl_Gov CrCtl_Plus CrCtl_ShutOff CrCtl_State CrCtl_UpdateDem CrCtl_vCrtl CrSCD_Pos CrSCD_Spd CrS_ChkStrtSpd CtApCD_Co CtTCD_Co CtTCtl_Co CtT_Co DCC_UpdateDem DIUMPR DSM_CDC DSM_CDK DSM_Cla DSM_Dur DSM_Env DSM_FMK DSM_Inh DSM_Rdi DSM_SimCond DSM_Typ DSM_class DSM_global Diff_TrqLim DrvTrn_CalcRTransDT EATSCD_Co ECU_SwtToBoot EEPCD_VarMng EGPpCD_GetTempPreTrbn EGPp_PresCalc EGRCD_ClgByp EGRCD_ClntByp EGRCD_Co EGRCD_Monitor_Proc EGRSCD_Co EGRVlv_Mon EGRVlv_PosGvnr EGSys_DewDet EGSys_IntfcDiaLSU EGSys_Lib EGSys_ModPreTrbn EGSys_mdlbackpres EGSys_tEGCo EGSys_tEGMod EGSys_tNSCMod EGSys_tOxiCatMod EGSys_tStrtCalc EGSys_tTrbMod EGSys_tTubeMod EGT_CoRgn EGT_CoRgnTSync EGT_Copy2NSync EMCCD_Co ESS_GetNMin ESS_nMinDem EepInit_CpyDs EepInit_Develop EngM_AngDiag EngM_BackUp EngM_CaSOfs EngM_EngDat EngM_EngMntCtl EngM_Sched EngM_Sync EngM_trqFrcCalc EngMon_IrrCmb EngPrt_OvrSpd EngPrt_PrtLim Eng_Spd Eng_TrqSpdCrv Eng_tEngCalc ErLpCD_Co FBC_equal FBC_wheellrn FMA_CtlCalc FMA_ErrMod FMA_Monitor FMTC_etaCalc FMTC_q2trq FMTC_q2trqLimSmk FMTC_trq2q FQSVCD_Co FQTSCD_Co FTSCD_TempEval FanCD_Co FanCtl_AR FanCtl_Co FlMng_FullLdRgl FlMng_InjMassLim FlPpCD_Co FlSCD_Co FlSys_CalcCnvFac FlSys_LogicFlPp FlSys_Temp FrmMng_CCtl FrmMng_Co FrmMng_ENG01 FrmMng_ENG03 FrmMng_General FrmMng_RecAC FrmMng_RecACC FrmMng_RecAIRBG FrmMng_RecAWD FrmMng_RecBEM FrmMng_RecBrk FrmMng_RecCGW FrmMng_RecDsp FrmMng_RecEPB FrmMng_RecESCU FrmMng_RecNIVEAU FrmMng_RecSA FrmMng_RecStIgn FrmMng_RecTOS FrmMng_RecTSC FrmMng_Send FrmMng_SendEngFlx FrmMng_rxChrgr FrmMng_txEngActr GbSSCD Gearbx_Data Gearbx_Geardet Gearbx_GetnMin Gearbx_TrqIntv Gearbx_TrqLim GlwCD_Actr GlwCD_DigIn GlwCD_GlwUn GlwCD_Lamp GlwCtl_GlwUn GlwCtl_Logic GlwCtl_PwrCtl GlwCtl_Rly HDSCD_Co HWEMon IATSCD_Co IFCD_Co IFCtl_Co ImmCtl_Co ImmCtl_Learn IndSys_CalcSwirl IndSys_MonIntMnf IndSys_MonVac IndSys_pAdj InjCrv_Co InjCrv_MI1Phi InjCrv_MI1PhiAddCor InjCrv_MI1PhiAddCorSlow InjCrv_MI1PhiCor InjCrv_MI1PhiEgt InjCrv_MI1PiI1Cor InjCrv_MI1QEGTCor InjCrv_MI1QPoI2Cor InjCrv_PiI InjCrv_PiI1 InjCrv_PiI1Rls InjCrv_PoI2 InjCrv_PoI2Lmbd InjCrv_PoI2LmbdT3Dia InjCrv_PoI2Q InjCrv_PoI2TPst InjCtl_qCo InjCtl_qLimErrCalc InjUn_FlTempCor InjVCD_ProgMI InjVCD_ProgPiI InjVCD_ProgPoI InjVCD_dynWUP InjVCD_stInj InjVlv_CalcInjDurMI1 InjVlv_CalcInjDurPiI1 InjVlv_CalcInjDurPoI2 InjVlv_ErrDet InjVlv_MonShOff InjVlv_qMin InjVlv_tiMin InjVlv_tiMinPiI1 KWP2000 LASCD LIGov_CalcSetPoint LIGov_CalcState LIGov_Governor LIGov_SelectParameter LSUCD_Adaption LSUCD_ElecDia LSUCD_Heater LSUCD_IpRefCtl LSUCD_O2Raw LSUCD_PresComp LSUCD_Ri LSUCD_SPICtl LSUCD_WireDia LSUCtl_Fnc LSU_ClbSched LSU_LmbdCalc LSU_Mon LockCnt MRlyCD_Co MSid_Co McMess MemMon_Error NSC_Temp NetMng_Co OTSCD_Co OvRMon_ACC OvRMon_Brk OvRMon_Co OvRMon_CrCtlplus OvRMon_EngSpdSens OvRMon_GetSumInj OxiCCD_GetTempPre PCR_Cmpr PCR_CtlValCalc PCR_CtrlValCalc PCR_DesValCalc PCR_Governor PCR_Monitor PFltCD_EvalTPst PFltCD_GetPDiff PFltCD_GetTPre PFltCD_GetTPst PFltCD_GettDiff PFltCD_Htg PFlt_AshCor_Proc PFlt_CoRgn PFlt_CoRgn2 PFlt_Diag PFlt_EngPOpCalc PFlt_EngPOpPrj PFlt_ExhGsPpty PFlt_HtgActv PFlt_MassCalc PFlt_Monitor PFlt_Monitor_Proj PFlt_SensAdapt PFlt_SotSim PFlt_StatMod PFlt_TempMod PSPCD_ActrOut PSPCD_Co PSP_Logic PrpCtl_MaxSpdLim PrpCtl_MaxSpdLimExt PrpCtl_SpdLimMode Prp_DemSel Prp_VirtAPP Rail_SetPointEnvCorSlowPermRgn Remote_Control Rtmo SSpMon Signals_Base SopTst SrvPmp_DetSrvPmpPwr StSysCtl_Logic StSysCtl_StrtCtl StSys_Strt StSys_StrtBas StSys_StrtCtl StSys_StrtRmp StSys_TrqShutOff StrtCD_OffRly StrtCD_OnRly SvLp SvLpCD SvLp_Co T15CD_Co T50CD_Co T50CD_Rx TAA_Adapt TAA_Ctrl TP20 TPUMon TVACD_Co TVASCD_Co ThrVlv_Co ThrVlv_Governor ThrVlv_Monitor TstTog_Co UAcc_FuncCode_Proc VSACD_Co VSSCD_Co VehDa_LoadCalc VehDa_lSumCalc VehDa_rVnCalc VehDa_tiEngOnCalc WDALCD WDASCD WDCom_Co sig_can sig_dia sig_dsm signals_Co signals_TstDem uacc_adjval uacc_eopd uacc_evalsigblk uacc_funccode uacc_logreq uacc_rsignalblock uacc_writecode ukey_custom /end SUB_FUNCTION
/end FUNCTION
/begin FUNCTION AOHt "Zuheizer" /begin SUB_FUNCTION AOHtCD AOHt_Logic /end SUB_FUNCTION /end FUNCTION
/begin FUNCTION AOHtCD "Zuheizer Komponententreiber" /begin SUB_FUNCTION AOHtCD_Co /end SUB_FUNCTION /end FUNCTION
/begin FUNCTION AOHtCD_Co "Zuheizer Komponententreiber Koordination"
 /begin DEF_CHARACTERISTIC AOHtCD_DebBattDefHt1_C AOHtCD_DebBattDefHt2_C AOHtCD_DebBattDefHt3_C AOHtCD_DebBattOkHt1_C AOHtCD_DebBattOkHt2_C AOHtCD_DebBattOkHt3_C AOHtCD_DebGndDefHt1_C AOHtCD_DebGndDefHt2_C AOHtCD_DebGndDefHt3_C AOHtCD_DebGndOkHt1_C AOHtCD_DebGndOkHt2_C AOHtCD_DebGndOkHt3_C AOHtCD_DebNoLoadDefHt1_C AOHtCD_DebNoLoadDefHt2_C AOHtCD_DebNoLoadDefHt3_C AOHtCD_DebNoLoadOkHt1_C AOHtCD_DebNoLoadOkHt2_C AOHtCD_DebNoLoadOkHt3_C AOHtCD_DebTempDefHt1_C AOHtCD_DebTempDefHt2_C AOHtCD_DebTempDefHt3_C AOHtCD_DebTempOkHt1_C AOHtCD_DebTempOkHt2_C AOHtCD_DebTempOkHt3_C AOHtCD_VolPerImp_C AOHtCD_ctPwrStgOnMaxHt1_C AOHtCD_ctPwrStgOnMaxHt2_C AOHtCD_ctPwrStgOnMaxHt3_C AOHtCD_stDigInvHt1_C AOHtCD_stDigInvHt2_C AOHtCD_stDigInvHt3_C AOHtCD_stPwmInInv_C AOHtCD_stSPICtlHt1_C AOHtCD_stSPICtlHt2_C AOHtCD_stSPICtlHt3_C AOHtCD_stUsrSwtInvIn_C AOHtCD_swtHeater12EnaType_C AOHtCD_swtHeater12EnaVal_C AOHtCD_tiBtwTstHt1_C AOHtCD_tiBtwTstHt2_C AOHtCD_tiBtwTstHt3_C AOHtCD_tiMax_C AOHtCD_tiPwrStgOnHt1_C AOHtCD_tiPwrStgOnHt2_C AOHtCD_tiPwrStgOnHt3_C AOHtCD_tiUsrSwtDebNeg_C AOHtCD_tiUsrSwtDebPos_C /end DEF_CHARACTERISTIC
/end FUNCTION
/begin FUNCTION AOHt_Logic "Zuheizerlogik"
 /begin DEF_CHARACTERISTIC AOHt_NumHeat_C AOHt_nEngHigh_C AOHt_nEngLow_C AOHt_nEngOffs_C AOHt_nMin_C AOHt_rOff_CUR AOHt_rOn_CUR AOHt_rSE_C AOHt_stCAN_C AOHt_stESCUShtOffDfl_C AOHt_stESCUShtOff_C AOHt_stSwt_C AOHt_stUsrSwtEnable_C AOHt_swtFrztAirEna_C AOHt_swtSensAir_C AOHt_swtSigCan_C AOHt_swtTemp_C AOHt_tAirUpLi_CUR AOHt_tEnvHigh_C AOHt_tEnvLow_C AOHt_tHysRng_C AOHt_tiSE_C AOHt_tiStrt_C AOHt_tiVER_C AOHt_uBattHigh_C AOHt_uBattLow_C /end DEF_CHARACTERISTIC
/end FUNCTION
/begin FUNCTION APPCD "Fahrpedal Komponententreiber" /begin SUB_FUNCTION APPCD_Co /end SUB_FUNCTION /end FUNCTION
/begin FUNCTION APPCD_Co "Fahrpedal Komponententreiber"
 /begin DEF_CHARACTERISTIC APPCD_DebSRCHighDef_C APPCD_DebSRCHighOk_C APPCD_DebSRCLowDef_C APPCD_DebSRCLowOk_C APPCD_DebSyncDef_C APPCD_DebSyncOk_C APPCD_SSpMonAPP1_C APPCD_SSpMonAPP2_C APPCD_cntDebMax_C APPCD_drAPPJit1_C APPCD_drAPPJit2_C APPCD_duAPPJit_C APPCD_facrAPP1APP2_C APPCD_numAdcAPP1_C APPCD_numAdcAPP2_C APPCD_rKickDownErrThres_C APPCD_rKickDownlrnThres_C APPCD_rLinAPP1_CUR APPCD_rLinAPP2_CUR APPCD_rLinAPPPre_CUR APPCD_rLinAPP_CUR APPCD_rThrFltLowNeg_C APPCD_rThrFltLowPos_C APPCD_rThrFltMidNeg_C APPCD_rThrFltMidPos_C APPCD_stDigInInvKickDown_C APPCD_stLowIdlSwtInvIn_C APPCD_swtDigInPresent_C APPCD_swtEnaPeakFlt_C APPCD_swtEnaUnJitPre1_C APPCD_swtEnaUnJitPre2_C APPCD_swtEnaUnJit_C APPCD_swtExtIntEna_C APPCD_swtKickDownHighAPP_C APPCD_swtKickDown_C APPCD_swtNoFlt_C APPCD_swtPrefillEna_C APPCD_swtTypeType_C APPCD_swtTypeVal_C APPCD_tiDebKickDownDef_C APPCD_tiDebKickDownOk_C APPCD_tiDebPWGDrftDef_C APPCD_tiDebPWGDrftOk_C APPCD_tiDisplayTimeOut_C APPCD_tiKickDownSwtDebNeg_C APPCD_tiKickDownSwtDebPos_C APPCD_tiKickDownTolcLim_C APPCD_tiKickDownlrnTimeout_C APPCD_tiLowNegPT1_C APPCD_tiLowPosPT1_C APPCD_tiMidNegPT1_C APPCD_tiMidPosPT1_C APPCD_tiNegExtIntPT1_C APPCD_tiPosExtIntPT1_C APPCD_tiUppNegPT1_C APPCD_tiUppPosPT1_C APPCD_uAPP1_SRCMax_C APPCD_uAPP1_SRCMin_C APPCD_uAPP2_SRCMax_C APPCD_uAPP2_SRCMin_C APPCD_uAPPMin_C APPCD_uAPPPre_SRCMax_C APPCD_uAPPPre_SRCMin_C APPCD_uKickDownCorrVal_C APPCD_uKickDownHighAPP_C APPCD_uKickDownLowAPP_C APPCD_uKickDownThresDfl_C APPCD_uKickDownTolcLim_C APPCD_uMaxLowIdlePWG1_C APPCD_uMaxLowIdlePWG2_C APPCD_uMinSync_C APPCD_uPWG1_C APPCD_uPWG2_C APPCD_uRawAPP2dOff_C APPCD_uSync_CUR APPCD_vDflMin_C /end DEF_CHARACTERISTIC
/end FUNCTION
/begin FUNCTION APPCD_KickDwn "Accelerator pedal kickdown evaluation" /begin DEF_CHARACTERISTIC APPCD_DebKDDioPlaDef_C APPCD_DebKDDioPlaOk_C /end DEF_CHARACTERISTIC /end FUNCTION
/begin FUNCTION APSCD "Atmosphärendruckfühler Komponententreiber" /begin SUB_FUNCTION APSCD_Co /end SUB_FUNCTION /end FUNCTION
/begin FUNCTION APSCD_Co "Atmosphärendruckfühler Komponententreiber"
 /begin DEF_CHARACTERISTIC APSCD_DebSRCDef_C APSCD_DebSRCOk_C APSCD_DebSigDef_C APSCD_DebSigOk_C APSCD_dpRmpSlpDwn_C APSCD_dpRmpSlpUp_C APSCD_nLimHigh_C APSCD_pCor_MAP APSCD_pDfl_C APSCD_pLin_CUR APSCD_pVal_Channel APSCD_pVal_Vector APSCD_stSensIDWord_C APSCD_swtInst_C APSCD_swtSigVal_C APSCD_swtSrcpVal_C APSCD_tiDel_C APSCD_uSRCMax_C APSCD_uSRCMin_C /end DEF_CHARACTERISTIC
/end FUNCTION
/begin FUNCTION ARnMon "Überwachung Nachlaufzeit" /begin DEF_CHARACTERISTIC ARnMon_stInvIn_C ARnMon_stInvOut_C ARnMon_tiARnMax_C /end DEF_CHARACTERISTIC /end FUNCTION
/begin FUNCTION ASDdc "Aktive Ruckeldämpfung Störgrößenregler (ARD)" /begin SUB_FUNCTION ASDdc_Governor ASDdc_SelectParameter /end SUB_FUNCTION /end FUNCTION
/begin FUNCTION ASDdc_Governor "Aktiver Ruckeldämpfer, Störungsregler"
 /begin DEF_CHARACTERISTIC ASDdc_KdExtInt_C ASDdc_KddNDT1_C ASDdc_NGvnrDT1KdNeg_CUR ASDdc_NGvnrDT1KdPos_CUR ASDdc_NGvnrIKiNeg_CUR ASDdc_NGvnrIKiPos_CUR ASDdc_NGvnrPKpNeg_CUR ASDdc_NGvnrPKpPos_CUR ASDdc_NGvnrRstINeg_MAP ASDdc_NGvnrRstIPos0_MAP ASDdc_NGvnrRstIPos1_MAP ASDdc_NGvnrRstIPos2_MAP ASDdc_NGvnrRstIPos3_MAP ASDdc_NGvnrRstIPos4_MAP ASDdc_NGvnrRstIPos5_MAP ASDdc_T1ExtInt_C ASDdc_dAccPedThres_C ASDdc_dActGearFac_CUR ASDdc_dConvClthThres_C ASDdc_dFacNHiDwn_C ASDdc_dFacNLoDwn_C ASDdc_dNNegIKi_C ASDdc_dNPosIKi_C ASDdc_dnAvrgLtdExitNeg_CUR ASDdc_dnAvrgLtdExitPos_CUR ASDdc_dnAvrgLtdNeg_CUR ASDdc_dnAvrgLtdPos_CUR ASDdc_dnIntegLtdNeg_CUR ASDdc_dnIntegLtdPos_MAP ASDdc_dnTrbnSpdRmpSlpDwn_C ASDdc_dnTrbnSpdRmpSlpUp_C ASDdc_factrqDT1InitNeg_C ASDdc_factrqDT1InitPos_C ASDdc_nLtdExitNeg_CUR ASDdc_nLtdExitPos_CUR ASDdc_nLtdNegLdRevl_C ASDdc_nMaxNLdRevlNeg_CUR ASDdc_nMaxNLdRevlPos_MAP ASDdc_nMinNLdRevlNeg_CUR ASDdc_nMinNLdRevlPos_CUR ASDdc_nSPOfsNeg_CUR ASDdc_nSPOfsPos_MAP ASDdc_nThresHysNHi_C ASDdc_nThresHysNLo_C ASDdc_rAccPedFullLd_C ASDdc_rAccPedPartLd_C ASDdc_stAccPedFullLd_C ASDdc_stAccPedPartLd_C ASDdc_stActGear_CUR ASDdc_stCalcPT1FltNeg_C ASDdc_stCalcPT1FltPos_C ASDdc_stKickDown_C ASDdc_stNewNeg_mp_Channel ASDdc_stNewNeg_mp_Vector ASDdc_stNewPos_mp_Channel ASDdc_stNewPos_mp_Vector ASDdc_sttrqMask_C ASDdc_swtCalcN_C ASDdc_swtGearSel_C ASDdc_swtIFreeze_C ASDdc_swtNGvnrMn_C ASDdc_swtPWG_C ASDdc_swtnNotFreeze_C ASDdc_swtnTrbnSpdCANEna_C ASDdc_swtvRaw_C ASDdc_tEngThres_C ASDdc_tiActvRmpNHi_C ASDdc_tiActvRmpNLo_C ASDdc_tiMaxLdRevlPos_C ASDdc_tiMaxRmpNHi_C ASDdc_tiMaxRmpNLo_C ASDdc_tiMinLdRevlNeg_C ASDdc_tiMinLdRevlPos_C ASDdc_tiMinTmrDnAvrg_C ASDdc_tiNGvnrDT1Neg_C ASDdc_tiNGvnrDT1Pos_C ASDdc_tiPT1Neg_CUR ASDdc_tiPT1Pos_CUR ASDdc_tiPT1TrbnSpd_C ASDdc_tiTmrNCond_C ASDdc_tiTmrTrqInrCond_C ASDdc_tidNDT1_C ASDdc_trqDpnOfsNegEnd_C ASDdc_trqDpnOfsNeg_C ASDdc_trqDpnOfsPosEnd_C ASDdc_trqDpnOfsPos_C ASDdc_trqInrLtdThres_C ASDdc_trqLimHiPwrOnOff_CUR ASDdc_trqLimHi_CUR ASDdc_trqLimLoPwrOnOff_CUR ASDdc_trqLimLo_CUR ASDdc_trqMaxPosLdRevl_C ASDdc_trqNGvnrNeg_Channel ASDdc_trqNGvnrNeg_Vector ASDdc_trqNGvnrPos_Channel ASDdc_trqNGvnrPos_Vector ASDdc_trqThresNegOff_C ASDdc_vLimIni_C ASDrf_swtLIGovCompEna_C /end DEF_CHARACTERISTIC
/end FUNCTION
/begin FUNCTION ASDdc_SelectParameter "Parametersatzauswahl, ARD Störungsregler"
 /begin DEF_CHARACTERISTIC ASDdc_KdClu_C ASDdc_KdGrip_MAP ASDdc_KdPwrOnOff_MAP ASDdc_KdTMFWRO_C ASDdc_T1Clu_C ASDdc_T1Grip_MAP ASDdc_T1PwrOnOff_MAP ASDdc_T1TMFWRO_C ASDdc_dDT1TrqDynfact_C ASDdc_dfacRmp_MAP ASDdc_dtrqNeg_C ASDdc_dtrqPos_C ASDdc_facKdGripPos_CUR ASDdc_nPwrOnOffLim_C ASDdc_stNGvnrExtInt_Channel ASDdc_stNGvnrExtInt_Vector ASDdc_swtConvOff_C ASDdc_swtGearbx_C ASDdc_swtNGvnrGearbx_C ASDdc_tiBlkTmr_C ASDdc_tiDT1TrqDyn_C ASDdc_tiGripTmr_C ASDdc_tiPT1Trq_C ASDdc_tiPwrOnOff_C ASDdc_tiRmpStrt_MAP ASDdc_tiSwtOff_CUR ASDdc_trqPwrOnOffLimNeg_MAP ASDdc_trqPwrOnOffLimPos_MAP ASDdc_trqPwrOnOffOffset_CUR /end DEF_CHARACTERISTIC
/end FUNCTION
/begin FUNCTION ASDrf "Aktive Ruckeldämpfung Führungsformer" /begin SUB_FUNCTION ASDrf_Governor ASDrf_SelectParameter /end SUB_FUNCTION /end FUNCTION
/begin FUNCTION ASDrf_Governor "ARD-Regelalgoithmus, Führungsformer"
 /begin DEF_CHARACTERISTIC ASDdc_swtInitPS_C ASDrf_T1Flt_C ASDrf_dtrqInrLtdLim_CUR ASDrf_dtrqNeg_MAP ASDrf_dtrqPos_MAP ASDrf_dtrqSteepNeg_C ASDrf_dtrqSteepPos_C ASDrf_facdtrqPos_CUR ASDrf_swtFlt_C ASDrf_swtInitPS_C ASDrf_swtRmpNoGrip_C ASDrf_trqFltLim_C ASDrf_trqPullNeg_CUR ASDrf_trqPullPos_CUR ASDrf_trqPushNeg_CUR ASDrf_trqPushPos_CUR /end DEF_CHARACTERISTIC
/end FUNCTION
/begin FUNCTION ASDrf_SelectParameter "Parametersatzauswahl ARD Führungsformer"
 /begin DEF_CHARACTERISTIC ASDrf_KdCluNeg_CUR ASDrf_KdCluPos_CUR ASDrf_KdExtInt_C ASDrf_KdGripNeg_MAP ASDrf_KdGripPos_MAP ASDrf_KdPCRsafe_C ASDrf_KdTMFWRONeg_C ASDrf_KdTMFWROPos_C ASDrf_T1CluNeg_C ASDrf_T1CluPos_C ASDrf_T1ExtInt_C ASDrf_T1GripNeg_MAP ASDrf_T1GripPos_MAP ASDrf_T1PCRsafe_C ASDrf_T1TMFWRONeg_C ASDrf_T1TMFWROPos_C ASDrf_facKdGripPos_CUR ASDrf_nTMFWRO_C ASDrf_swtConvOff_C ASDrf_swtGearbx_C ASDrf_swtPCRsafe_C ASDrf_tiAPP1PT1_C ASDrf_tiTMFWRO_C ASDrf_trqTMFWRO_C ASDrf_trqThresNeg_C ASDrf_trqThresPos_C /end DEF_CHARACTERISTIC
/end FUNCTION
/begin FUNCTION ASMod_ObsvrPIndVol "Beobachter für Ladedruck" /begin DEF_CHARACTERISTIC UAcc_LogReqPWASModRst_C /end DEF_CHARACTERISTIC /end FUNCTION
/begin FUNCTION AccPed "Fahrpedal" /begin SUB_FUNCTION APPCD AccPed_DrvDem /end SUB_FUNCTION /end FUNCTION
/begin FUNCTION AccPed_APCheck "Fahrpedalprüfung"
 /begin DEF_CHARACTERISTIC APPCD_duLimErrNeg_C APPCD_duLimErrPos_C AccPed_drAPPUnFltLim_C AccPed_drLimDwn_C AccPed_drLimUp_C AccPed_drLimpMax_C AccPed_nLimMisUse_C AccPed_nLim_C AccPed_rErrValPlaus_C AccPed_rLimpMax_C AccPed_rPlaMaxVal_C AccPed_rThPlaus_C AccPed_rThresSfty_C AccPed_stBrkPlausMSK_C AccPed_swtAliveDetEna_C AccPed_swtAppGradEna_C AccPed_swtBrkDet_C AccPed_swtBrkReset_C AccPed_swtEPBEna_C AccPed_swtMisUseEna_C AccPed_swtPlausCheckReqd_C AccPed_swtVehDynReqd_C AccPed_tiChkDebNeg_C AccPed_tiChkDebPos_C AccPed_tiDebAliveDef_C AccPed_tiDebAliveOk_C AccPed_tiDebMisUseDef_C AccPed_tiDebMisUseOk_C AccPed_tiDebPlaDet_C AccPed_tiDebPlaRst_C AccPed_tiDebPladrLckDef_C AccPed_tiDebPladrLckOk_C AccPed_tiPlaAPPBrkCANwaitHW_C AccPed_vLim_C /end DEF_CHARACTERISTIC
/end FUNCTION
/begin FUNCTION AccPed_DrvDem "Fahrerwunschermittlung"
 /begin DEF_CHARACTERISTIC AccPed_PKpDO_CUR AccPed_PKpSigDO_CUR AccPed_dfacRampSlope_C AccPed_dnDORmpSlpPos_CUR AccPed_dnDOSetP_MAP AccPed_facAppWntrMode0_MAP AccPed_nDOMax_C AccPed_nErr_C AccPed_nLIMinBrk_C AccPed_nLIMinvHigh_C AccPed_nLIMinvLow_C AccPed_nLimNMR_C AccPed_nPWinDO_CUR AccPed_nPlaAPPBrk_C AccPed_rAppWntrMode0_MAP AccPed_rThresPrpMin_C AccPed_rThresPrp_C AccPed_rZero_C AccPed_stGearSel_CUR AccPed_stTipSlit_C AccPed_swtActvKD_C AccPed_swtClthEna_C AccPed_swtClthPrtEna_C AccPed_swtClthPrtviaDOEna_C AccPed_swtDOEna_C AccPed_swtESPEna_C AccPed_swtTipSlitIsSport_C AccPed_swtTrqRampEna_C AccPed_swtTrqTransType_C AccPed_swtrVnFltEna_C AccPed_swtrVnFreeze_C AccPed_tEngTrq0ColdHigh_C AccPed_tEngTrq0ColdLow_C AccPed_tiPlausBrkDebNeg_C AccPed_tiPlausBrkDebPos_C AccPed_tiVnTrqEngPT1_C AccPed_trqEng0Cold_MAP AccPed_trqEng0_MAP AccPed_trqEng1_MAP AccPed_trqEng2_MAP AccPed_trqEng3_MAP AccPed_trqEng4_MAP AccPed_trqEng5_MAP AccPed_trqEng6_MAP AccPed_trqEngLim_MAP AccPed_trqEngLow_MAP AccPed_trqNMRMax_C AccPed_trqPrpSport_MAP AccPed_trqPrp_MAP AccPed_vDODne_C AccPed_vDOEna_C AccPed_vThresLI_C /end DEF_CHARACTERISTIC
/end FUNCTION
/begin FUNCTION Accessoires "Nebenaggregate" /begin SUB_FUNCTION Alt Batt CoVeh_AcsMng Fan PSP SrvPmp /end SUB_FUNCTION /end FUNCTION
/end MODULE
/end PROJECT
