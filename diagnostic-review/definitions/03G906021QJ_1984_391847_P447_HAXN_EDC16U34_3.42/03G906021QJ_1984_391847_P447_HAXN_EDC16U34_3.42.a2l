ASAP2_VERSION 1 3
/begin PROJECT X447 "EDC16U34"
/begin HEADER "" VERSION "VAA1" PROJECT_NO X447 /end HEADER
/begin MODULE DIM ""
/begin MOD_COMMON "" BYTE_ORDER MSB_FIRST ALIGNMENT_BYTE 1 ALIGNMENT_WORD 2 ALIGNMENT_LONG 4 ALIGNMENT_FLOAT32_IEEE 4 /end MOD_COMMON
/begin CHARACTERISTIC DSMDur_DfctDur1Mode_C "Betriebsart des globalen Fehlerdauerzählers 1" VALUE 0x1D2518 Kw_Wu8 2.000 OneToOne 0.00 2.000 FORMAT "%5.3" EXTENDED_LIMITS 0.00 255.0 /end CHARACTERISTIC
/begin CHARACTERISTIC DSMDur_DfctDur2Mode_C "Betriebsart des globalen Fehlerdauerzählers 2" VALUE 0x1D2519 Kw_Wu8 2.000 OneToOne 0.00 2.000 FORMAT "%5.3" EXTENDED_LIMITS 0.00 255.0 /end CHARACTERISTIC
/begin CHARACTERISTIC DSMDur_stDfctDur1Enable_C "Aktivierungsbedingungen für den globalen Defektdauerzähler 1" VALUE 0x1D251A Kw_Wu8 255.0 OneToOne 0.00 255.0 FORMAT "%5.1" /end CHARACTERISTIC
/begin CHARACTERISTIC DSMDur_stDfctDur2Enable_C "Aktivierungsbedingungen für den globalen Defektdauerzähler 2" VALUE 0x1D251B Kw_Wu8 255.0 OneToOne 0.00 255.0 FORMAT "%5.1" /end CHARACTERISTIC
/begin CHARACTERISTIC DSMDur_stDfctDur1Reset_C "Rücksetzbedingungen für den globalen Defektdauerzähler 1" VALUE 0x1D251C Kw_Wu8 255.0 OneToOne 0.00 255.0 FORMAT "%5.1" /end CHARACTERISTIC
/begin CHARACTERISTIC DSMDur_stDfctDur2Reset_C "Rücksetzbedingungen für den globalen Defektdauerzähler 2" VALUE 0x1D251D Kw_Wu8 255.0 OneToOne 0.00 255.0 FORMAT "%5.1" /end CHARACTERISTIC
/begin CHARACTERISTIC DSMDur_FcmDfctDur1Mode_C "Betriebsart des Fehlerspeichereintrags  Dauerzählers 1" VALUE 0x1D251E Kw_Wu8 2.000 OneToOne 0.00 2.000 FORMAT "%5.3" EXTENDED_LIMITS 0.00 255.0 /end CHARACTERISTIC
/begin CHARACTERISTIC DSMDur_FcmDfctDur2Mode_C "Betriebsart des Fehlerspeichereintrags  Dauerzählers 2" VALUE 0x1D251F Kw_Wu8 2.000 OneToOne 0.00 2.000 FORMAT "%5.3" EXTENDED_LIMITS 0.00 255.0 /end CHARACTERISTIC
/begin CHARACTERISTIC DSMDur_stFcmDfctDur1Enable_C "Aktivierungsbedingung des Fehlerspeichereintrags  Dauerzählers 1" VALUE 0x1D2520 Kw_Wu16 65535.00 OneToOne 0.00 65535.00 FORMAT "%8.2" /end CHARACTERISTIC
/begin CHARACTERISTIC DSMDur_stFcmDfctDur2Enable_C "Aktivierungsbedingung des Fehlerspeichereintrags  Dauerzählers 2" VALUE 0x1D2522 Kw_Wu16 65535.00 OneToOne 0.00 65535.00 FORMAT "%8.2" /end CHARACTERISTIC
/begin CHARACTERISTIC DSMDur_stFcmDfctDur1Reset_C "Rücksetzbedingung des Fehlerspeichereintrags  Dauerzählers 1" VALUE 0x1D2524 Kw_Wu8 255.0 OneToOne 0.00 255.0 FORMAT "%5.1" /end CHARACTERISTIC
/begin CHARACTERISTIC DSMDur_stFcmDfctDur2Reset_C "Rücksetzbedingung des Fehlerspeichereintrags  Dauerzählers 2" VALUE 0x1D2525 Kw_Wu8 255.0 OneToOne 0.00 255.0 FORMAT "%5.1" /end CHARACTERISTIC
/begin CHARACTERISTIC DSM_ctNoMILWUCThresh_C "Nötige Anzahl von WUC's ohne MIL um die DSMDur Zähler zurückzusetzen" VALUE 0x1CD73E Kw_Wu8 253.0 OneToOne 1.000 254.0 FORMAT "%5.1" EXTENDED_LIMITS 0.00 255.0 /end CHARACTERISTIC
/begin CHARACTERISTIC DSM_ClaDfp_ACCCD_C "Fehlerklasse fuer Fehlerpfad Dfp_ACCCD" VALUE 0x1CF2AC Kw_Wu8 20.00 OneToOne 0.00 20.00 FORMAT "%5.2" EXTENDED_LIMITS 0.00 255.0 /end CHARACTERISTIC
/begin CHARACTERISTIC DSM_ClaDfp_ACCCDBrkErr_C "Fehlerklasse fuer Fehlerpfad Dfp_ACCCDBrkErr" VALUE 0x1CF2AD Kw_Wu8 20.00 OneToOne 0.00 20.00 FORMAT "%5.2" EXTENDED_LIMITS 0.00 255.0 /end CHARACTERISTIC
/begin CHARACTERISTIC DSM_ClaDfp_ACCCDBrkNPL_C "Fehlerklasse fuer Fehlerpfad Dfp_ACCCDBrkNPL" VALUE 0x1CF2AE Kw_Wu8 20.00 OneToOne 0.00 20.00 FORMAT "%5.2" EXTENDED_LIMITS 0.00 255.0 /end CHARACTERISTIC
/begin CHARACTERISTIC DSM_ClaDfp_ACCCDSensErr_C "Fehlerklasse fuer Fehlerpfad Dfp_ACCCDSensErr" VALUE 0x1CF2AF Kw_Wu8 20.00 OneToOne 0.00 20.00 FORMAT "%5.2" EXTENDED_LIMITS 0.00 255.0 /end CHARACTERISTIC
/begin CHARACTERISTIC DSM_ClaDfp_ACCCDWrongCoded_C "Fehlerklasse fuer Fehlerpfad Dfp_ACCCDWrongCoded" VALUE 0x1CF2B0 Kw_Wu8 20.00 OneToOne 0.00 20.00 FORMAT "%5.2" EXTENDED_LIMITS 0.00 255.0 /end CHARACTERISTIC
/begin CHARACTERISTIC DSM_ClaDfp_ACCD_C "Fehlerklasse fuer Fehlerpfad Dfp_ACCD" VALUE 0x1CF2B1 Kw_Wu8 20.00 OneToOne 0.00 20.00 FORMAT "%5.2" EXTENDED_LIMITS 0.00 255.0 /end CHARACTERISTIC
/begin CHARACTERISTIC DSM_ClaDfp_ACCD_PAC_C "Fehlerklasse fuer Fehlerpfad Dfp_ACCD_PAC" VALUE 0x1CF2B2 Kw_Wu8 20.00 OneToOne 0.00 20.00 FORMAT "%5.2" EXTENDED_LIMITS 0.00 255.0 /end CHARACTERISTIC
/begin CHARACTERISTIC DSM_ClaDfp_ACCD_pCAN_C "Fehlerklasse fuer Fehlerpfad Dfp_ACCD_pCAN" VALUE 0x1CF2B3 Kw_Wu8 20.00 OneToOne 0.00 20.00 FORMAT "%5.2" EXTENDED_LIMITS 0.00 255.0 /end CHARACTERISTIC
/begin CHARACTERISTIC DSM_ClaDfp_ACCD_trqCAN_C "Fehlerklasse fuer Fehlerpfad Dfp_ACCD_trqCAN" VALUE 0x1CF2B4 Kw_Wu8 20.00 OneToOne 0.00 20.00 FORMAT "%5.2" EXTENDED_LIMITS 0.00 255.0 /end CHARACTERISTIC
/begin CHARACTERISTIC DSM_ClaDfp_ACCIRevPanErr_C "Fehlerklasse fuer Fehlerpfad Dfp_ACCIRevPanErr" VALUE 0x1CF2B5 Kw_Wu8 20.00 OneToOne 0.00 20.00 FORMAT "%5.2" EXTENDED_LIMITS 0.00 255.0 /end CHARACTERISTIC
/begin CHARACTERISTIC DSM_ClaDfp_ACCIRevShOff_C "Fehlerklasse fuer Fehlerpfad Dfp_ACCIRevShOff" VALUE 0x1CF2B6 Kw_Wu8 20.00 OneToOne 0.00 20.00 FORMAT "%5.2" EXTENDED_LIMITS 0.00 255.0 /end CHARACTERISTIC
/begin CHARACTERISTIC DSM_ClaDfp_ACCnotPlaus_C "Fehlerklasse fuer Fehlerpfad Dfp_ACCnotPlaus" VALUE 0x1CF2B7 Kw_Wu8 20.00 OneToOne 0.00 20.00 FORMAT "%5.2" EXTENDED_LIMITS 0.00 255.0 /end CHARACTERISTIC
/begin CHARACTERISTIC DSM_ClaDfp_ADCMon_C "Fehlerklasse fuer Fehlerpfad Dfp_ADCMon" VALUE 0x1CF2B8 Kw_Wu8 20.00 OneToOne 0.00 20.00 FORMAT "%5.2" EXTENDED_LIMITS 0.00 255.0 /end CHARACTERISTIC
/begin CHARACTERISTIC DSM_ClaDfp_AFSCD_PlOffsDrft_C "Fehlerklasse fuer Fehlerpfad Dfp_AFSCD_PlOffsDrft" VALUE 0x1CF2B9 Kw_Wu8 20.00 OneToOne 0.00 20.00 FORMAT "%5.2" EXTENDED_LIMITS 0.00 255.0 /end CHARACTERISTIC
/begin CHARACTERISTIC DSM_ClaDfp_AFSCD_PlSetyDrft_C "Fehlerklasse fuer Fehlerpfad Dfp_AFSCD_PlSetyDrft" VALUE 0x1CF2BA Kw_Wu8 20.00 OneToOne 0.00 20.00 FORMAT "%5.2" EXTENDED_LIMITS 0.00 255.0 /end CHARACTERISTIC
/begin CHARACTERISTIC DSM_ClaDfp_AFSCD_SRCAirm_C "Fehlerklasse fuer Fehlerpfad Dfp_AFSCD_SRCAirm" VALUE 0x1CF2BB Kw_Wu8 20.00 OneToOne 0.00 20.00 FORMAT "%5.2" EXTENDED_LIMITS 0.00 255.0 /end CHARACTERISTIC
/begin CHARACTERISTIC DSM_ClaDfp_AFVCD_Actr_C "Fehlerklasse fuer Fehlerpfad Dfp_AFVCD_Actr" VALUE 0x1CF2BC Kw_Wu8 20.00 OneToOne 0.00 20.00 FORMAT "%5.2" EXTENDED_LIMITS 0.00 255.0 /end CHARACTERISTIC
/begin CHARACTERISTIC DSM_ClaDfp_AOHtCDHt1_C "Fehlerklasse fuer Fehlerpfad Dfp_AOHtCDHt1" VALUE 0x1CF2BD Kw_Wu8 20.00 OneToOne 0.00 20.00 FORMAT "%5.2" EXTENDED_LIMITS 0.00 255.0 /end CHARACTERISTIC
/begin CHARACTERISTIC DSM_ClaDfp_AOHtCDHt2_C "Fehlerklasse fuer Fehlerpfad Dfp_AOHtCDHt2" VALUE 0x1CF2BE Kw_Wu8 20.00 OneToOne 0.00 20.00 FORMAT "%5.2" EXTENDED_LIMITS 0.00 255.0 /end CHARACTERISTIC
/begin CHARACTERISTIC DSM_ClaDfp_AOHtCDHt3_C "Fehlerklasse fuer Fehlerpfad Dfp_AOHtCDHt3" VALUE 0x1CF2BF Kw_Wu8 20.00 OneToOne 0.00 20.00 FORMAT "%5.2" EXTENDED_LIMITS 0.00 255.0 /end CHARACTERISTIC
/begin CHARACTERISTIC DSM_ClaDfp_APP1_C "Fehlerklasse fuer Fehlerpfad Dfp_APP1" VALUE 0x1CF2C0 Kw_Wu8 20.00 OneToOne 0.00 20.00 FORMAT "%5.2" EXTENDED_LIMITS 0.00 255.0 /end CHARACTERISTIC
/begin CHARACTERISTIC DSM_ClaDfp_APP2_C "Fehlerklasse fuer Fehlerpfad Dfp_APP2" VALUE 0x1CF2C1 Kw_Wu8 20.00 OneToOne 0.00 20.00 FORMAT "%5.2" EXTENDED_LIMITS 0.00 255.0 /end CHARACTERISTIC
/begin CHARACTERISTIC DSM_ClaDfp_APPCD_KickDown_C "Fehlerklasse fuer Fehlerpfad Dfp_APPCD_KickDown" VALUE 0x1CF2C2 Kw_Wu8 20.00 OneToOne 0.00 20.00 FORMAT "%5.2" EXTENDED_LIMITS 0.00 255.0 /end CHARACTERISTIC
/begin CHARACTERISTIC DSM_ClaDfp_APPCD_PWGDrft_C "Fehlerklasse fuer Fehlerpfad Dfp_APPCD_PWGDrft" VALUE 0x1CF2C3 Kw_Wu8 20.00 OneToOne 0.00 20.00 FORMAT "%5.2" EXTENDED_LIMITS 0.00 255.0 /end CHARACTERISTIC
/begin CHARACTERISTIC DSM_ClaDfp_APPSync_C "Fehlerklasse fuer Fehlerpfad Dfp_APPSync" VALUE 0x1CF2C4 Kw_Wu8 20.00 OneToOne 0.00 20.00 FORMAT "%5.2" EXTENDED_LIMITS 0.00 255.0 /end CHARACTERISTIC
/begin CHARACTERISTIC DSM_ClaDfp_APP_Npl_C "Fehlerklasse fuer Fehlerpfad Dfp_APP_Npl" VALUE 0x1CF2C5 Kw_Wu8 20.00 OneToOne 0.00 20.00 FORMAT "%5.2" EXTENDED_LIMITS 0.00 255.0 /end CHARACTERISTIC
/begin CHARACTERISTIC DSM_ClaDfp_APSCD_C "Fehlerklasse fuer Fehlerpfad Dfp_APSCD" VALUE 0x1CF2C6 Kw_Wu8 20.00 OneToOne 0.00 20.00 FORMAT "%5.2" EXTENDED_LIMITS 0.00 255.0 /end CHARACTERISTIC
/begin CHARACTERISTIC DSM_ClaDfp_AccPedPlausBrk_C "Fehlerklasse fuer Fehlerpfad Dfp_AccPedPlausBrk" VALUE 0x1CF2C7 Kw_Wu8 20.00 OneToOne 0.00 20.00 FORMAT "%5.2" EXTENDED_LIMITS 0.00 255.0 /end CHARACTERISTIC
/begin CHARACTERISTIC DSM_ClaDfp_AirCtl_GovDevMax_C "Fehlerklasse fuer Fehlerpfad Dfp_AirCtl_GovDevMax" VALUE 0x1CF2C8 Kw_Wu8 20.00 OneToOne 0.00 20.00 FORMAT "%5.2" EXTENDED_LIMITS 0.00 255.0 /end CHARACTERISTIC
/begin CHARACTERISTIC DSM_ClaDfp_AirCtl_GovDevMin_C "Fehlerklasse fuer Fehlerpfad Dfp_AirCtl_GovDevMin" VALUE 0x1CF2C9 Kw_Wu8 20.00 OneToOne 0.00 20.00 FORMAT "%5.2" EXTENDED_LIMITS 0.00 255.0 /end CHARACTERISTIC
/begin CHARACTERISTIC DSM_ClaDfp_AirCtl_GovDevRgnMax_C "Fehlerklasse fuer Fehlerpfad Dfp_AirCtl_GovDevRgnMax" VALUE 0x1CF2CA Kw_Wu8 20.00 OneToOne 0.00 20.00 FORMAT "%5.2" EXTENDED_LIMITS 0.00 255.0 /end CHARACTERISTIC
/begin CHARACTERISTIC DSM_ClaDfp_AirCtl_GovDevRgnMin_C "Fehlerklasse fuer Fehlerpfad Dfp_AirCtl_GovDevRgnMin" VALUE 0x1CF2CB Kw_Wu8 20.00 OneToOne 0.00 20.00 FORMAT "%5.2" EXTENDED_LIMITS 0.00 255.0 /end CHARACTERISTIC
/begin CHARACTERISTIC DSM_ClaDfp_AirbCDCrash_C "Fehlerklasse fuer Fehlerpfad Dfp_AirbCDCrash" VALUE 0x1CF2CC Kw_Wu8 20.00 OneToOne 0.00 20.00 FORMAT "%5.2" EXTENDED_LIMITS 0.00 255.0 /end CHARACTERISTIC
/begin CHARACTERISTIC DSM_ClaDfp_AirbCDCrashCrCtl_C "Fehlerklasse fuer Fehlerpfad Dfp_AirbCDCrashCrCtl" VALUE 0x1CF2CD Kw_Wu8 20.00 OneToOne 0.00 20.00 FORMAT "%5.2" EXTENDED_LIMITS 0.00 255.0 /end CHARACTERISTIC
/begin CHARACTERISTIC DSM_ClaDfp_AirbCDCrashPSP_C "Fehlerklasse fuer Fehlerpfad Dfp_AirbCDCrashPSP" VALUE 0x1CF2CE Kw_Wu8 20.00 OneToOne 0.00 20.00 FORMAT "%5.2" EXTENDED_LIMITS 0.00 255.0 /end CHARACTERISTIC
/begin CHARACTERISTIC DSM_ClaDfp_AltCDExc_C "Fehlerklasse fuer Fehlerpfad Dfp_AltCDExc" VALUE 0x1CF2CF Kw_Wu8 20.00 OneToOne 0.00 20.00 FORMAT "%5.2" EXTENDED_LIMITS 0.00 255.0 /end CHARACTERISTIC
/begin CHARACTERISTIC DSM_ClaDfp_AltCD_Load_C "Fehlerklasse fuer Fehlerpfad Dfp_AltCD_Load" VALUE 0x1CF2D0 Kw_Wu8 20.00 OneToOne 0.00 20.00 FORMAT "%5.2" EXTENDED_LIMITS 0.00 255.0 /end CHARACTERISTIC
/begin CHARACTERISTIC DSM_ClaDfp_AltPwrCan_C "Fehlerklasse fuer Fehlerpfad Dfp_AltPwrCan" VALUE 0x1CF2D1 Kw_Wu8 20.00 OneToOne 0.00 20.00 FORMAT "%5.2" EXTENDED_LIMITS 0.00 255.0 /end CHARACTERISTIC
/begin CHARACTERISTIC DSM_ClaDfp_BIP01_C "Fehlerklasse fuer Fehlerpfad Dfp_BIP01" VALUE 0x1CF2D2 Kw_Wu8 20.00 OneToOne 0.00 20.00 FORMAT "%5.2" EXTENDED_LIMITS 0.00 255.0 /end CHARACTERISTIC
/begin CHARACTERISTIC DSM_ClaDfp_BIP02_C "Fehlerklasse fuer Fehlerpfad Dfp_BIP02" VALUE 0x1CF2D3 Kw_Wu8 20.00 OneToOne 0.00 20.00 FORMAT "%5.2" EXTENDED_LIMITS 0.00 255.0 /end CHARACTERISTIC
/begin CHARACTERISTIC DSM_ClaDfp_BIP03_C "Fehlerklasse fuer Fehlerpfad Dfp_BIP03" VALUE 0x1CF2D4 Kw_Wu8 20.00 OneToOne 0.00 20.00 FORMAT "%5.2" EXTENDED_LIMITS 0.00 255.0 /end CHARACTERISTIC
/begin CHARACTERISTIC DSM_ClaDfp_BIP04_C "Fehlerklasse fuer Fehlerpfad Dfp_BIP04" VALUE 0x1CF2D5 Kw_Wu8 20.00 OneToOne 0.00 20.00 FORMAT "%5.2" EXTENDED_LIMITS 0.00 255.0 /end CHARACTERISTIC
/begin CHARACTERISTIC DSM_ClaDfp_BIP05_C "Fehlerklasse fuer Fehlerpfad Dfp_BIP05" VALUE 0x1CF2D6 Kw_Wu8 20.00 OneToOne 0.00 20.00 FORMAT "%5.2" EXTENDED_LIMITS 0.00 255.0 /end CHARACTERISTIC
/begin CHARACTERISTIC DSM_ClaDfp_BIP06_C "Fehlerklasse fuer Fehlerpfad Dfp_BIP06" VALUE 0x1CF2D7 Kw_Wu8 20.00 OneToOne 0.00 20.00 FORMAT "%5.2" EXTENDED_LIMITS 0.00 255.0 /end CHARACTERISTIC
/begin CHARACTERISTIC DSM_ClaDfp_BIP07_C "Fehlerklasse fuer Fehlerpfad Dfp_BIP07" VALUE 0x1CF2D8 Kw_Wu8 20.00 OneToOne 0.00 20.00 FORMAT "%5.2" EXTENDED_LIMITS 0.00 255.0 /end CHARACTERISTIC
/begin CHARACTERISTIC DSM_ClaDfp_BIP08_C "Fehlerklasse fuer Fehlerpfad Dfp_BIP08" VALUE 0x1CF2D9 Kw_Wu8 20.00 OneToOne 0.00 20.00 FORMAT "%5.2" EXTENDED_LIMITS 0.00 255.0 /end CHARACTERISTIC
/begin CHARACTERISTIC DSM_ClaDfp_BIP09_C "Fehlerklasse fuer Fehlerpfad Dfp_BIP09" VALUE 0x1CF2DA Kw_Wu8 20.00 OneToOne 0.00 20.00 FORMAT "%5.2" EXTENDED_LIMITS 0.00 255.0 /end CHARACTERISTIC
/begin CHARACTERISTIC DSM_ClaDfp_BIP10_C "Fehlerklasse fuer Fehlerpfad Dfp_BIP10" VALUE 0x1CF2DB Kw_Wu8 20.00 OneToOne 0.00 20.00 FORMAT "%5.2" EXTENDED_LIMITS 0.00 255.0 /end CHARACTERISTIC
/begin CHARACTERISTIC DSM_ClaDfp_BIP11_C "Fehlerklasse fuer Fehlerpfad Dfp_BIP11" VALUE 0x1CF2DC Kw_Wu8 20.00 OneToOne 0.00 20.00 FORMAT "%5.2" EXTENDED_LIMITS 0.00 255.0 /end CHARACTERISTIC
/begin CHARACTERISTIC DSM_ClaDfp_BIP12_C "Fehlerklasse fuer Fehlerpfad Dfp_BIP12" VALUE 0x1CF2DD Kw_Wu8 20.00 OneToOne 0.00 20.00 FORMAT "%5.2" EXTENDED_LIMITS 0.00 255.0 /end CHARACTERISTIC
/begin CHARACTERISTIC DSM_ClaDfp_BIP_Con_C "Fehlerklasse fuer Fehlerpfad Dfp_BIP_Con" VALUE 0x1CF2DE Kw_Wu8 20.00 OneToOne 0.00 20.00 FORMAT "%5.2" EXTENDED_LIMITS 0.00 255.0 /end CHARACTERISTIC
/begin CHARACTERISTIC DSM_ClaDfp_BPACD_Max_C "Fehlerklasse fuer Fehlerpfad Dfp_BPACD_Max" VALUE 0x1CF2DF Kw_Wu8 20.00 OneToOne 0.00 20.00 FORMAT "%5.2" EXTENDED_LIMITS 0.00 255.0 /end CHARACTERISTIC
/begin CHARACTERISTIC DSM_ClaDfp_BPACD_Max2_C "Fehlerklasse fuer Fehlerpfad Dfp_BPACD_Max2" VALUE 0x1CF2E0 Kw_Wu8 20.00 OneToOne 0.00 20.00 FORMAT "%5.2" EXTENDED_LIMITS 0.00 255.0 /end CHARACTERISTIC
/begin CHARACTERISTIC DSM_ClaDfp_BPACD_Min_C "Fehlerklasse fuer Fehlerpfad Dfp_BPACD_Min" VALUE 0x1CF2E1 Kw_Wu8 20.00 OneToOne 0.00 20.00 FORMAT "%5.2" EXTENDED_LIMITS 0.00 255.0 /end CHARACTERISTIC
/begin CHARACTERISTIC DSM_ClaDfp_BPACD_Min2_C "Fehlerklasse fuer Fehlerpfad Dfp_BPACD_Min2" VALUE 0x1CF2E2 Kw_Wu8 20.00 OneToOne 0.00 20.00 FORMAT "%5.2" EXTENDED_LIMITS 0.00 255.0 /end CHARACTERISTIC
/begin CHARACTERISTIC DSM_ClaDfp_BPACD_SigNpl_C "Fehlerklasse fuer Fehlerpfad Dfp_BPACD_SigNpl" VALUE 0x1CF2E3 Kw_Wu8 20.00 OneToOne 0.00 20.00 FORMAT "%5.2" EXTENDED_LIMITS 0.00 255.0 /end CHARACTERISTIC
/begin CHARACTERISTIC DSM_ClaDfp_BPACD_SigNpl2_C "Fehlerklasse fuer Fehlerpfad Dfp_BPACD_SigNpl2" VALUE 0x1CF2E4 Kw_Wu8 20.00 OneToOne 0.00 20.00 FORMAT "%5.2" EXTENDED_LIMITS 0.00 255.0 /end CHARACTERISTIC
/begin CHARACTERISTIC DSM_ClaDfp_BPASCD_C "Fehlerklasse fuer Fehlerpfad Dfp_BPASCD" VALUE 0x1CF2E5 Kw_Wu8 20.00 OneToOne 0.00 20.00 FORMAT "%5.2" EXTENDED_LIMITS 0.00 255.0 /end CHARACTERISTIC
/begin CHARACTERISTIC DSM_ClaDfp_BPSCD_C "Fehlerklasse fuer Fehlerpfad Dfp_BPSCD" VALUE 0x1CF2E6 Kw_Wu8 20.00 OneToOne 0.00 20.00 FORMAT "%5.2" EXTENDED_LIMITS 0.00 255.0 /end CHARACTERISTIC
/begin CHARACTERISTIC DSM_ClaDfp_BattCD_C "Fehlerklasse fuer Fehlerpfad Dfp_BattCD" VALUE 0x1CF2E8 Kw_Wu8 20.00 OneToOne 0.00 20.00 FORMAT "%5.2" EXTENDED_LIMITS 0.00 255.0 /end CHARACTERISTIC
/begin CHARACTERISTIC DSM_ClaDfp_BrkCD_C "Fehlerklasse fuer Fehlerpfad Dfp_BrkCD" VALUE 0x1CF2E9 Kw_Wu8 20.00 OneToOne 0.00 20.00 FORMAT "%5.2" EXTENDED_LIMITS 0.00 255.0 /end CHARACTERISTIC
/begin CHARACTERISTIC DSM_ClaDfp_BrkCDBPTInvld_C "Fehlerklasse fuer Fehlerpfad Dfp_BrkCDBPTInvld" VALUE 0x1CF2EA Kw_Wu8 20.00 OneToOne 0.00 20.00 FORMAT "%5.2" EXTENDED_LIMITS 0.00 255.0 /end CHARACTERISTIC
/begin CHARACTERISTIC DSM_ClaDfp_BrkCDdynPl_C "Fehlerklasse fuer Fehlerpfad Dfp_BrkCDdynPl" VALUE 0x1CF2EB Kw_Wu8 20.00 OneToOne 0.00 20.00 FORMAT "%5.2" EXTENDED_LIMITS 0.00 255.0 /end CHARACTERISTIC
/begin CHARACTERISTIC DSM_ClaDfp_CANA_C "Fehlerklasse fuer Fehlerpfad Dfp_CANA" VALUE 0x1CF2EC Kw_Wu8 20.00 OneToOne 0.00 20.00 FORMAT "%5.2" EXTENDED_LIMITS 0.00 255.0 /end CHARACTERISTIC
/begin CHARACTERISTIC DSM_ClaDfp_CANB_C "Fehlerklasse fuer Fehlerpfad Dfp_CANB" VALUE 0x1CF2ED Kw_Wu8 20.00 OneToOne 0.00 20.00 FORMAT "%5.2" EXTENDED_LIMITS 0.00 255.0 /end CHARACTERISTIC
/begin CHARACTERISTIC DSM_ClaDfp_CANBus1_C "Fehlerklasse fuer Fehlerpfad Dfp_CANBus1" VALUE 0x1CF2EE Kw_Wu8 20.00 OneToOne 0.00 20.00 FORMAT "%5.2" EXTENDED_LIMITS 0.00 255.0 /end CHARACTERISTIC
/begin CHARACTERISTIC DSM_ClaDfp_CANBus2_C "Fehlerklasse fuer Fehlerpfad Dfp_CANBus2" VALUE 0x1CF2EF Kw_Wu8 20.00 OneToOne 0.00 20.00 FORMAT "%5.2" EXTENDED_LIMITS 0.00 255.0 /end CHARACTERISTIC
/begin CHARACTERISTIC DSM_ClaDfp_CANBus3_C "Fehlerklasse fuer Fehlerpfad Dfp_CANBus3" VALUE 0x1CF2F0 Kw_Wu8 20.00 OneToOne 0.00 20.00 FORMAT "%5.2" EXTENDED_LIMITS 0.00 255.0 /end CHARACTERISTIC
/begin CHARACTERISTIC DSM_ClaDfp_CANC_C "Fehlerklasse fuer Fehlerpfad Dfp_CANC" VALUE 0x1CF2F1 Kw_Wu8 20.00 OneToOne 0.00 20.00 FORMAT "%5.2" EXTENDED_LIMITS 0.00 255.0 /end CHARACTERISTIC
/begin CHARACTERISTIC DSM_ClaDfp_CANErrActA_C "Fehlerklasse fuer Fehlerpfad Dfp_CANErrActA" VALUE 0x1CF2F2 Kw_Wu8 20.00 OneToOne 0.00 20.00 FORMAT "%5.2" EXTENDED_LIMITS 0.00 255.0 /end CHARACTERISTIC
/begin CHARACTERISTIC DSM_ClaDfp_CANErrActB_C "Fehlerklasse fuer Fehlerpfad Dfp_CANErrActB" VALUE 0x1CF2F3 Kw_Wu8 20.00 OneToOne 0.00 20.00 FORMAT "%5.2" EXTENDED_LIMITS 0.00 255.0 /end CHARACTERISTIC
/begin CHARACTERISTIC DSM_ClaDfp_CANErrActC_C "Fehlerklasse fuer Fehlerpfad Dfp_CANErrActC" VALUE 0x1CF2F4 Kw_Wu8 20.00 OneToOne 0.00 20.00 FORMAT "%5.2" EXTENDED_LIMITS 0.00 255.0 /end CHARACTERISTIC
/begin CHARACTERISTIC DSM_ClaDfp_COTSCD_C "Fehlerklasse fuer Fehlerpfad Dfp_COTSCD" VALUE 0x1CF2F5 Kw_Wu8 20.00 OneToOne 0.00 20.00 FORMAT "%5.2" EXTENDED_LIMITS 0.00 255.0 /end CHARACTERISTIC
/begin CHARACTERISTIC DSM_ClaDfp_CTSCD_C "Fehlerklasse fuer Fehlerpfad Dfp_CTSCD" VALUE 0x1CF2F6 Kw_Wu8 20.00 OneToOne 0.00 20.00 FORMAT "%5.2" EXTENDED_LIMITS 0.00 255.0 /end CHARACTERISTIC
/begin CHARACTERISTIC DSM_ClaDfp_CTSCDCanInac_C "Fehlerklasse fuer Fehlerpfad Dfp_CTSCDCanInac" VALUE 0x1CF2F7 Kw_Wu8 20.00 OneToOne 0.00 20.00 FORMAT "%5.2" EXTENDED_LIMITS 0.00 255.0 /end CHARACTERISTIC
/begin CHARACTERISTIC DSM_ClaDfp_CTSCDCanSig_C "Fehlerklasse fuer Fehlerpfad Dfp_CTSCDCanSig" VALUE 0x1CF2F8 Kw_Wu8 20.00 OneToOne 0.00 20.00 FORMAT "%5.2" EXTENDED_LIMITS 0.00 255.0 /end CHARACTERISTIC
/begin CHARACTERISTIC DSM_ClaDfp_Clg_DynTst_C "Fehlerklasse fuer Fehlerpfad Dfp_Clg_DynTst" VALUE 0x1CF2F9 Kw_Wu8 20.00 OneToOne 0.00 20.00 FORMAT "%5.2" EXTENDED_LIMITS 0.00 255.0 /end CHARACTERISTIC
/begin CHARACTERISTIC DSM_ClaDfp_CmbChbMisfire1_C "Fehlerklasse fuer Fehlerpfad Dfp_CmbChbMisfire1" VALUE 0x1CF2FA Kw_Wu8 20.00 OneToOne 0.00 20.00 FORMAT "%5.2" EXTENDED_LIMITS 0.00 255.0 /end CHARACTERISTIC
/begin CHARACTERISTIC DSM_ClaDfp_CmbChbMisfire2_C "Fehlerklasse fuer Fehlerpfad Dfp_CmbChbMisfire2" VALUE 0x1CF2FB Kw_Wu8 20.00 OneToOne 0.00 20.00 FORMAT "%5.2" EXTENDED_LIMITS 0.00 255.0 /end CHARACTERISTIC
/begin CHARACTERISTIC DSM_ClaDfp_CmbChbMisfire3_C "Fehlerklasse fuer Fehlerpfad Dfp_CmbChbMisfire3" VALUE 0x1CF2FC Kw_Wu8 20.00 OneToOne 0.00 20.00 FORMAT "%5.2" EXTENDED_LIMITS 0.00 255.0 /end CHARACTERISTIC
/begin CHARACTERISTIC DSM_ClaDfp_CmbChbMisfire4_C "Fehlerklasse fuer Fehlerpfad Dfp_CmbChbMisfire4" VALUE 0x1CF2FD Kw_Wu8 20.00 OneToOne 0.00 20.00 FORMAT "%5.2" EXTENDED_LIMITS 0.00 255.0 /end CHARACTERISTIC
/begin CHARACTERISTIC DSM_ClaDfp_CmbChbMisfire5_C "Fehlerklasse fuer Fehlerpfad Dfp_CmbChbMisfire5" VALUE 0x1CF2FE Kw_Wu8 20.00 OneToOne 0.00 20.00 FORMAT "%5.2" EXTENDED_LIMITS 0.00 255.0 /end CHARACTERISTIC
/begin CHARACTERISTIC DSM_ClaDfp_CmbChbMisfire6_C "Fehlerklasse fuer Fehlerpfad Dfp_CmbChbMisfire6" VALUE 0x1CF2FF Kw_Wu8 20.00 OneToOne 0.00 20.00 FORMAT "%5.2" EXTENDED_LIMITS 0.00 255.0 /end CHARACTERISTIC
/begin CHARACTERISTIC DSM_ClaDfp_CmbChbMisfireMul_C "Fehlerklasse fuer Fehlerpfad Dfp_CmbChb_MisfireMul" VALUE 0x1CF300 Kw_Wu8 20.00 OneToOne 0.00 20.00 FORMAT "%5.2" EXTENDED_LIMITS 0.00 255.0 /end CHARACTERISTIC
/begin CHARACTERISTIC DSM_ClaDfp_CoVMDCSh_C "Fehlerklasse fuer Fehlerpfad Dfp_CoVMDCSh" VALUE 0x1CF302 Kw_Wu8 20.00 OneToOne 0.00 20.00 FORMAT "%5.2" EXTENDED_LIMITS 0.00 255.0 /end CHARACTERISTIC
/begin CHARACTERISTIC DSM_ClaDfp_CoVMDCSp_C "Fehlerklasse fuer Fehlerpfad Dfp_CoVMDCSp" VALUE 0x1CF303 Kw_Wu8 20.00 OneToOne 0.00 20.00 FORMAT "%5.2" EXTENDED_LIMITS 0.00 255.0 /end CHARACTERISTIC
/begin CHARACTERISTIC DSM_ClaDfp_CoVehLvl2_C "Fehlerklasse fuer Fehlerpfad Dfp_CoVehLvl2" VALUE 0x1CF306 Kw_Wu8 20.00 OneToOne 0.00 20.00 FORMAT "%5.2" EXTENDED_LIMITS 0.00 255.0 /end CHARACTERISTIC
/begin CHARACTERISTIC DSM_ClaDfp_ConvCD_C "Fehlerklasse fuer Fehlerpfad Dfp_ConvCD" VALUE 0x1CF307 Kw_Wu8 20.00 OneToOne 0.00 20.00 FORMAT "%5.2" EXTENDED_LIMITS 0.00 255.0 /end CHARACTERISTIC
/begin CHARACTERISTIC DSM_ClaDfp_ConvCD_ConvErr_C "Fehlerklasse fuer Fehlerpfad Dfp_ConvCD_ConvErr" VALUE 0x1CF308 Kw_Wu8 20.00 OneToOne 0.00 20.00 FORMAT "%5.2" EXTENDED_LIMITS 0.00 255.0 /end CHARACTERISTIC
/begin CHARACTERISTIC DSM_ClaDfp_ConvCD_EPB1_C "Fehlerklasse fuer Fehlerpfad Dfp_ConvCD_EPB1" VALUE 0x1CF309 Kw_Wu8 20.00 OneToOne 0.00 20.00 FORMAT "%5.2" EXTENDED_LIMITS 0.00 255.0 /end CHARACTERISTIC
/begin CHARACTERISTIC DSM_ClaDfp_CrCCDPanErrMSG_C "Fehlerklasse fuer Fehlerpfad Dfp_CrCCDPanErrMSG" VALUE 0x1CF30A Kw_Wu8 20.00 OneToOne 0.00 20.00 FORMAT "%5.2" EXTENDED_LIMITS 0.00 255.0 /end CHARACTERISTIC
/begin CHARACTERISTIC DSM_ClaDfp_CrCCDPanErrSMLS_C "Fehlerklasse fuer Fehlerpfad Dfp_CrCCDPanErrSMLS" VALUE 0x1CF30B Kw_Wu8 20.00 OneToOne 0.00 20.00 FORMAT "%5.2" EXTENDED_LIMITS 0.00 255.0 /end CHARACTERISTIC
/begin CHARACTERISTIC DSM_ClaDfp_CrCCDPanMainSwtErr_C "Fehlerklasse fuer Fehlerpfad Dfp_CrCCDPanMainSwtErr" VALUE 0x1CF30C Kw_Wu8 20.00 OneToOne 0.00 20.00 FORMAT "%5.2" EXTENDED_LIMITS 0.00 255.0 /end CHARACTERISTIC
/begin CHARACTERISTIC DSM_ClaDfp_CrCtlDsplNotPlaus_C "Fehlerklasse fuer Fehlerpfad Dfp_CrCtlDsplNotPlaus" VALUE 0x1CF30E Kw_Wu8 20.00 OneToOne 0.00 20.00 FORMAT "%5.2" EXTENDED_LIMITS 0.00 255.0 /end CHARACTERISTIC
/begin CHARACTERISTIC DSM_ClaDfp_CrCtlPECDErr_C "Fehlerklasse fuer Fehlerpfad Dfp_CrCtlPECDErr" VALUE 0x1CF30F Kw_Wu8 20.00 OneToOne 0.00 20.00 FORMAT "%5.2" EXTENDED_LIMITS 0.00 255.0 /end CHARACTERISTIC
/begin CHARACTERISTIC DSM_ClaDfp_CrCtlPLmpDef_C "Fehlerklassen fuer Fehlerpfad Dfp_CrCtlPLmpDef" VALUE 0x1CF310 Kw_Wu8 20.00 OneToOne 0.00 20.00 FORMAT "%5.2" EXTENDED_LIMITS 0.00 255.0 /end CHARACTERISTIC
/begin CHARACTERISTIC DSM_ClaDfp_CrCtlPShutOff_C "Fehlerklassen fuer Fehlerpfad Fehlerklassen fuer Fehlerpfad" VALUE 0x1CF311 Kw_Wu8 20.00 OneToOne 0.00 20.00 FORMAT "%5.2" EXTENDED_LIMITS 0.00 255.0 /end CHARACTERISTIC
/begin CHARACTERISTIC DSM_ClaDfp_CrCtlPTlrDef_C "Fehlerklasse fuer Fehlerpfad Dfp_CrCtlPTlrDef" VALUE 0x1CF312 Kw_Wu8 20.00 OneToOne 0.00 20.00 FORMAT "%5.2" EXTENDED_LIMITS 0.00 255.0 /end CHARACTERISTIC
/begin CHARACTERISTIC DSM_ClaDfp_CtApCD_C "Fehlerklasse fuer Fehlerpfad Dfp_CtApCD" VALUE 0x1CF314 Kw_Wu8 20.00 OneToOne 0.00 20.00 FORMAT "%5.2" EXTENDED_LIMITS 0.00 255.0 /end CHARACTERISTIC
/begin CHARACTERISTIC DSM_ClaDfp_CtTCD_C "Fehlerklasse fuer Fehlerpfad Dfp_CtTCD" VALUE 0x1CF315 Kw_Wu8 20.00 OneToOne 0.00 20.00 FORMAT "%5.2" EXTENDED_LIMITS 0.00 255.0 /end CHARACTERISTIC
/begin CHARACTERISTIC DSM_ClaDfp_CtT_Mon_C "Fehlerklasse fuer Fehlerpfad Dfp_CtT_Mon" VALUE 0x1CF316 Kw_Wu8 20.00 OneToOne 0.00 20.00 FORMAT "%5.2" EXTENDED_LIMITS 0.00 255.0 /end CHARACTERISTIC
/begin CHARACTERISTIC DSM_ClaDfp_DifftrqLimErrPat_C "Fehlerklasse fuer Fehlerpfad Dfp_DifftrqLimErrPat" VALUE 0x1CF317 Kw_Wu8 20.00 OneToOne 0.00 20.00 FORMAT "%5.2" EXTENDED_LIMITS 0.00 255.0 /end CHARACTERISTIC
/begin CHARACTERISTIC DSM_ClaDfp_EATSCD_C "Fehlerklasse fuer Fehlerpfad Dfp_EATSCD" VALUE 0x1CF318 Kw_Wu8 20.00 OneToOne 0.00 20.00 FORMAT "%5.2" EXTENDED_LIMITS 0.00 255.0 /end CHARACTERISTIC
/begin CHARACTERISTIC DSM_ClaDfp_EATSCDCanInac_C "Fehlerklasse fuer Fehlerpfad Dfp_EATSCDCanInac" VALUE 0x1CF319 Kw_Wu8 20.00 OneToOne 0.00 20.00 FORMAT "%5.2" EXTENDED_LIMITS 0.00 255.0 /end CHARACTERISTIC
/begin CHARACTERISTIC DSM_ClaDfp_EATSCDCanSig_C "Fehlerklasse fuer Fehlerpfad Dfp_EATSCDCanSig" VALUE 0x1CF31A Kw_Wu8 20.00 OneToOne 0.00 20.00 FORMAT "%5.2" EXTENDED_LIMITS 0.00 255.0 /end CHARACTERISTIC
/begin CHARACTERISTIC DSM_ClaDfp_EEPCDVarMng_C "Fehlerklasse fuer Fehlerpfad Dfp_EEPCDVarMng" VALUE 0x1CF31B Kw_Wu8 20.00 OneToOne 0.00 20.00 FORMAT "%5.2" EXTENDED_LIMITS 0.00 255.0 /end CHARACTERISTIC
/begin CHARACTERISTIC DSM_ClaDfp_EGPpCDTPreTrbn_C "Fehlerklasse fuer Fehlerpfad Dfp_EgPpCDTPreTrbn" VALUE 0x1CF31C Kw_Wu8 20.00 OneToOne 0.00 20.00 FORMAT "%5.2" EXTENDED_LIMITS 0.00 255.0 /end CHARACTERISTIC
/begin CHARACTERISTIC DSM_ClaDfp_EGRCD_CBV_C "Fehlerklasse fuer Fehlerpfad Dfp_EGRCD_CBV" VALUE 0x1CF31D Kw_Wu8 20.00 OneToOne 0.00 20.00 FORMAT "%5.2" EXTENDED_LIMITS 0.00 255.0 /end CHARACTERISTIC
/begin CHARACTERISTIC DSM_ClaDfp_EGRCD_Max_C "Fehlerklasse fuer Fehlerpfad Dfp_EGRCD_Max" VALUE 0x1CF31E Kw_Wu8 20.00 OneToOne 0.00 20.00 FORMAT "%5.2" EXTENDED_LIMITS 0.00 255.0 /end CHARACTERISTIC
/begin CHARACTERISTIC DSM_ClaDfp_EGRCD_Min_C "Fehlerklasse fuer Fehlerpfad Dfp_EGRCD_Min" VALUE 0x1CF31F Kw_Wu8 20.00 OneToOne 0.00 20.00 FORMAT "%5.2" EXTENDED_LIMITS 0.00 255.0 /end CHARACTERISTIC
/begin CHARACTERISTIC DSM_ClaDfp_EGRCD_Sig_C "Fehlerklasse fuer Fehlerpfad Dfp_EGRCD_Sig" VALUE 0x1CF320 Kw_Wu8 20.00 OneToOne 0.00 20.00 FORMAT "%5.2" EXTENDED_LIMITS 0.00 255.0 /end CHARACTERISTIC
/begin CHARACTERISTIC DSM_ClaDfp_EGRCD_SigNpl_C "Fehlerklasse fuer Fehlerpfad Dfp_EGRCD_SigNpl" VALUE 0x1CF321 Kw_Wu8 20.00 OneToOne 0.00 20.00 FORMAT "%5.2" EXTENDED_LIMITS 0.00 255.0 /end CHARACTERISTIC
/begin CHARACTERISTIC DSM_ClaDfp_EGRSCD_C "Fehlerklasse fuer Fehlerpfad Dfp_EGRSCD" VALUE 0x1CF322 Kw_Wu8 20.00 OneToOne 0.00 20.00 FORMAT "%5.2" EXTENDED_LIMITS 0.00 255.0 /end CHARACTERISTIC
/begin CHARACTERISTIC DSM_ClaDfp_EGRSCD_JamVlv_C "Fehlerklasse fuer Fehlerpfad Dfp_EGRSCD_JamVlv" VALUE 0x1CF323 Kw_Wu8 20.00 OneToOne 0.00 20.00 FORMAT "%5.2" EXTENDED_LIMITS 0.00 255.0 /end CHARACTERISTIC
/begin CHARACTERISTIC DSM_ClaDfp_EGRSCD_LgTimeDrft_C "Fehlerklasse fuer Fehlerpfad Dfp_EGRSCD_LgTimeDrft" VALUE 0x1CF324 Kw_Wu8 20.00 OneToOne 0.00 20.00 FORMAT "%5.2" EXTENDED_LIMITS 0.00 255.0 /end CHARACTERISTIC
/begin CHARACTERISTIC DSM_ClaDfp_EGRSCD_ShTimeDrft_C "Fehlerklasse fuer Fehlerpfad Dfp_EGRSCD_ShTimeDrft" VALUE 0x1CF325 Kw_Wu8 20.00 OneToOne 0.00 20.00 FORMAT "%5.2" EXTENDED_LIMITS 0.00 255.0 /end CHARACTERISTIC
/begin CHARACTERISTIC DSM_ClaDfp_EGRVlvGvnrDvt_C "Fehlerklasse fuer Fehlerpfad Dfp_EGRVlvGvnrDvt" VALUE 0x1CF326 Kw_Wu8 20.00 OneToOne 0.00 20.00 FORMAT "%5.2" EXTENDED_LIMITS 0.00 255.0 /end CHARACTERISTIC
/begin CHARACTERISTIC DSM_ClaDfp_EGRVlv_JamVlv_C "Fehlerklasse fuer Fehlerpfad Dfp_EGRVlv_JamVlv" VALUE 0x1CF327 Kw_Wu8 20.00 OneToOne 0.00 20.00 FORMAT "%5.2" EXTENDED_LIMITS 0.00 255.0 /end CHARACTERISTIC
/begin CHARACTERISTIC DSM_ClaDfp_EMCCD_MLS1_C "Fehlerklasse fuer Fehlerpfad Dfp_EMCCD_MLS1" VALUE 0x1CF328 Kw_Wu8 20.00 OneToOne 0.00 20.00 FORMAT "%5.2" EXTENDED_LIMITS 0.00 255.0 /end CHARACTERISTIC
/begin CHARACTERISTIC DSM_ClaDfp_EngMBackUp_C "Fehlerklasse fuer Fehlerpfad Dfp_EngMBackUp" VALUE 0x1CF329 Kw_Wu8 20.00 OneToOne 0.00 20.00 FORMAT "%5.2" EXTENDED_LIMITS 0.00 255.0 /end CHARACTERISTIC
/begin CHARACTERISTIC DSM_ClaDfp_EngMCaS1_C "Fehlerklasse fuer Fehlerpfad Dfp_EngMCaS1" VALUE 0x1CF32A Kw_Wu8 20.00 OneToOne 0.00 20.00 FORMAT "%5.2" EXTENDED_LIMITS 0.00 255.0 /end CHARACTERISTIC
/begin CHARACTERISTIC DSM_ClaDfp_EngMCaSDrv_C "Fehlerklasse fuer Fehlerpfad Dfp_EngMCaSDrv" VALUE 0x1CF32B Kw_Wu8 20.00 OneToOne 0.00 20.00 FORMAT "%5.2" EXTENDED_LIMITS 0.00 255.0 /end CHARACTERISTIC
/begin CHARACTERISTIC DSM_ClaDfp_EngMCrS1_C "Fehlerklasse fuer Fehlerpfad Dfp_EngMCrS1" VALUE 0x1CF32C Kw_Wu8 20.00 OneToOne 0.00 20.00 FORMAT "%5.2" EXTENDED_LIMITS 0.00 255.0 /end CHARACTERISTIC
/begin CHARACTERISTIC DSM_ClaDfp_EngMOfsCaSCrS_C "Fehlerklasse fuer Fehlerpfad Dfp_EngMOfsCaSCrS" VALUE 0x1CF32D Kw_Wu8 20.00 OneToOne 0.00 20.00 FORMAT "%5.2" EXTENDED_LIMITS 0.00 255.0 /end CHARACTERISTIC
/begin CHARACTERISTIC DSM_ClaDfp_EngMonIrrCmb_C "Fehlerklasse fuer Fehlerpfad Dfp_EngMonIrrCmb" VALUE 0x1CF32E Kw_Wu8 20.00 OneToOne 0.00 20.00 FORMAT "%5.2" EXTENDED_LIMITS 0.00 255.0 /end CHARACTERISTIC
/begin CHARACTERISTIC DSM_ClaDfp_EngPrt_C "Fehlerklasse fuer Fehlerpfad Dfp_EngPrt" VALUE 0x1CF32F Kw_Wu8 20.00 OneToOne 0.00 20.00 FORMAT "%5.2" EXTENDED_LIMITS 0.00 255.0 /end CHARACTERISTIC
/begin CHARACTERISTIC DSM_ClaDfp_ErLpCDMILReqON_C "Fehlerklasse fuer Fehlerpfad Dfp_ErLpCDMILReqON" VALUE 0x1CF330 Kw_Wu8 20.00 OneToOne 0.00 20.00 FORMAT "%5.2" EXTENDED_LIMITS 0.00 255.0 /end CHARACTERISTIC
/begin CHARACTERISTIC DSM_ClaDfp_FMAErrMod_C "Fehlerklasse fuer Fehlerpfad Dfp_FMAErrMod" VALUE 0x1CF331 Kw_Wu8 20.00 OneToOne 0.00 20.00 FORMAT "%5.2" EXTENDED_LIMITS 0.00 255.0 /end CHARACTERISTIC
/begin CHARACTERISTIC DSM_ClaDfp_FMTC_NonMonotonMap_C "Fehlerklasse fuer Fehlerpfad Dfp_FMTC_NonMonotonMap" VALUE 0x1CF332 Kw_Wu8 20.00 OneToOne 0.00 20.00 FORMAT "%5.2" EXTENDED_LIMITS 0.00 255.0 /end CHARACTERISTIC
/begin CHARACTERISTIC DSM_ClaDfp_FQTSCD_C "Fehlerklasse fuer Fehlerpfad Dfp_FQTSCD" VALUE 0x1CF333 Kw_Wu8 20.00 OneToOne 0.00 20.00 FORMAT "%5.2" EXTENDED_LIMITS 0.00 255.0 /end CHARACTERISTIC
/begin CHARACTERISTIC DSM_ClaDfp_FQlSCD_C "Fehlerklasse fuer Fehlerpfad Dfp_FQlSCD" VALUE 0x1CF334 Kw_Wu8 20.00 OneToOne 0.00 20.00 FORMAT "%5.2" EXTENDED_LIMITS 0.00 255.0 /end CHARACTERISTIC
/begin CHARACTERISTIC DSM_ClaDfp_FTSCD_C "Fehlerklasse fuer Fehlerpfad Dfp_FTSCD" VALUE 0x1CF335 Kw_Wu8 20.00 OneToOne 0.00 20.00 FORMAT "%5.2" EXTENDED_LIMITS 0.00 255.0 /end CHARACTERISTIC
/begin CHARACTERISTIC DSM_ClaDfp_FTSCDNpl_C "Fehlerklasse fuer Fehlerpfad Dfp_FTSCDNpl" VALUE 0x1CF336 Kw_Wu8 20.00 OneToOne 0.00 20.00 FORMAT "%5.2" EXTENDED_LIMITS 0.00 255.0 /end CHARACTERISTIC
/begin CHARACTERISTIC DSM_ClaDfp_FanCD_Fan1Ctlr1_C "Fehlerklasse fuer Fehlerpfad Dfp_FanCD_Fan1Ctlr1" VALUE 0x1CF337 Kw_Wu8 20.00 OneToOne 0.00 20.00 FORMAT "%5.2" EXTENDED_LIMITS 0.00 255.0 /end CHARACTERISTIC
/begin CHARACTERISTIC DSM_ClaDfp_FanCD_Fan1Ctlr2_C "Fehlerklasse fuer Fehlerpfad Dfp_FanCD_Fan1Ctlr2" VALUE 0x1CF338 Kw_Wu8 20.00 OneToOne 0.00 20.00 FORMAT "%5.2" EXTENDED_LIMITS 0.00 255.0 /end CHARACTERISTIC
/begin CHARACTERISTIC DSM_ClaDfp_FanCD_Fan2Ctlr1_C "Fehlerklasse fuer Fehlerpfad Dfp_FanCD_Fan2Ctlr1" VALUE 0x1CF339 Kw_Wu8 20.00 OneToOne 0.00 20.00 FORMAT "%5.2" EXTENDED_LIMITS 0.00 255.0 /end CHARACTERISTIC
/begin CHARACTERISTIC DSM_ClaDfp_FanCD_Fan2Ctlr2_C "Fehlerklasse fuer Fehlerpfad Dfp_FanCD_Fan2Ctlr2" VALUE 0x1CF33A Kw_Wu8 20.00 OneToOne 0.00 20.00 FORMAT "%5.2" EXTENDED_LIMITS 0.00 255.0 /end CHARACTERISTIC
/begin CHARACTERISTIC DSM_ClaDfp_FanCD_FanCtlr1_C "Fehlerklasse fuer Fehlerpfad Dfp_FanCD_FanCtlr1" VALUE 0x1CF33B Kw_Wu8 20.00 OneToOne 0.00 20.00 FORMAT "%5.2" EXTENDED_LIMITS 0.00 255.0 /end CHARACTERISTIC
/begin CHARACTERISTIC DSM_ClaDfp_FanCD_FanCtlr2_C "Fehlerklasse fuer Fehlerpfad Dfp_FanCD_FanCtlr2" VALUE 0x1CF33C Kw_Wu8 20.00 OneToOne 0.00 20.00 FORMAT "%5.2" EXTENDED_LIMITS 0.00 255.0 /end CHARACTERISTIC
/begin CHARACTERISTIC DSM_ClaDfp_FanCD_OutFanCtlr1_C "Fehlerklasse fuer Fehlerpfad Dfp_FanCD_OutFanCtlr1" VALUE 0x1CF33D Kw_Wu8 20.00 OneToOne 0.00 20.00 FORMAT "%5.2" EXTENDED_LIMITS 0.00 255.0 /end CHARACTERISTIC
/begin CHARACTERISTIC DSM_ClaDfp_FanCD_OutFanCtlr2_C "Fehlerklasse fuer Fehlerpfad Dfp_FanCD_OutFanCtlr2" VALUE 0x1CF33E Kw_Wu8 20.00 OneToOne 0.00 20.00 FORMAT "%5.2" EXTENDED_LIMITS 0.00 255.0 /end CHARACTERISTIC
/begin CHARACTERISTIC DSM_ClaDfp_FlPpCD_C "Fehlerklasse fuer Fehlerpfad Dfp_FlPpCD" VALUE 0x1CF340 Kw_Wu8 20.00 OneToOne 0.00 20.00 FORMAT "%5.2" EXTENDED_LIMITS 0.00 255.0 /end CHARACTERISTIC
/begin CHARACTERISTIC DSM_ClaDfp_FlSCDT1_C "Fehlerklasse fuer Fehlerpfad Dfp_FlSCDT1" VALUE 0x1CF341 Kw_Wu8 20.00 OneToOne 0.00 20.00 FORMAT "%5.2" EXTENDED_LIMITS 0.00 255.0 /end CHARACTERISTIC
/begin CHARACTERISTIC DSM_ClaDfp_FrmMngAAGNpl_C "Fehlerklasse fuer Fehlerpfad Dfp_FrmMngAAGNpl" VALUE 0x1CF342 Kw_Wu8 20.00 OneToOne 0.00 20.00 FORMAT "%5.2" EXTENDED_LIMITS 0.00 255.0 /end CHARACTERISTIC
/begin CHARACTERISTIC DSM_ClaDfp_FrmMngAAGTO_C "Fehlerklasse fuer Fehlerpfad Dfp_FrmMngAAGTO" VALUE 0x1CF343 Kw_Wu8 20.00 OneToOne 0.00 20.00 FORMAT "%5.2" EXTENDED_LIMITS 0.00 255.0 /end CHARACTERISTIC
/begin CHARACTERISTIC DSM_ClaDfp_FrmMngAC1Npl_C "Fehlerklasse fuer Fehlerpfad Dfp_FrmMngAC1Npl" VALUE 0x1CF344 Kw_Wu8 20.00 OneToOne 0.00 20.00 FORMAT "%5.2" EXTENDED_LIMITS 0.00 255.0 /end CHARACTERISTIC
/begin CHARACTERISTIC DSM_ClaDfp_FrmMngAC1TO_C "Fehlerklasse fuer Fehlerpfad Dfp_FrmMngAC1TO" VALUE 0x1CF345 Kw_Wu8 20.00 OneToOne 0.00 20.00 FORMAT "%5.2" EXTENDED_LIMITS 0.00 255.0 /end CHARACTERISTIC
/begin CHARACTERISTIC DSM_ClaDfp_FrmMngACCNpl_C "Fehlerklasse fuer Fehlerpfad Dfp_FrmMngACCNpl" VALUE 0x1CF346 Kw_Wu8 20.00 OneToOne 0.00 20.00 FORMAT "%5.2" EXTENDED_LIMITS 0.00 255.0 /end CHARACTERISTIC
/begin CHARACTERISTIC DSM_ClaDfp_FrmMngACCTO_C "Fehlerklasse fuer Fehlerpfad Dfp_FrmMngACCTO" VALUE 0x1CF347 Kw_Wu8 20.00 OneToOne 0.00 20.00 FORMAT "%5.2" EXTENDED_LIMITS 0.00 255.0 /end CHARACTERISTIC
/begin CHARACTERISTIC DSM_ClaDfp_FrmMngAIRBGNpl_C "Fehlerklasse fuer Fehlerpfad Dfp_FrmMngAIRBGNpl" VALUE 0x1CF348 Kw_Wu8 20.00 OneToOne 0.00 20.00 FORMAT "%5.2" EXTENDED_LIMITS 0.00 255.0 /end CHARACTERISTIC
/begin CHARACTERISTIC DSM_ClaDfp_FrmMngAIRBGTO_C "Fehlerklasse fuer Fehlerpfad Dfp_FrmMngAIRBGTO" VALUE 0x1CF349 Kw_Wu8 20.00 OneToOne 0.00 20.00 FORMAT "%5.2" EXTENDED_LIMITS 0.00 255.0 /end CHARACTERISTIC
/begin CHARACTERISTIC DSM_ClaDfp_FrmMngAWD1Npl_C "Fehlerklasse fuer Fehlerpfad Dfp_FrmMngAWD1Npl" VALUE 0x1CF34A Kw_Wu8 20.00 OneToOne 0.00 20.00 FORMAT "%5.2" EXTENDED_LIMITS 0.00 255.0 /end CHARACTERISTIC
/begin CHARACTERISTIC DSM_ClaDfp_FrmMngAWD1TO_C "Fehlerklasse fuer Fehlerpfad Dfp_FrmMngAWD1TO" VALUE 0x1CF34B Kw_Wu8 20.00 OneToOne 0.00 20.00 FORMAT "%5.2" EXTENDED_LIMITS 0.00 255.0 /end CHARACTERISTIC
/begin CHARACTERISTIC DSM_ClaDfp_FrmMngBEM1Npl_C "Fehlerklasse für Fehlerpfad Dfp_FrmMngBEM1Npl" VALUE 0x1CF34C Kw_Wu8 20.00 OneToOne 0.00 20.00 FORMAT "%5.2" EXTENDED_LIMITS 0.00 255.0 /end CHARACTERISTIC
/begin CHARACTERISTIC DSM_ClaDfp_FrmMngBEM1TO_C "Fehlerklasse fuer Fehlerpfad Dfp_FrmMngBEM1TO" VALUE 0x1CF34D Kw_Wu8 20.00 OneToOne 0.00 20.00 FORMAT "%5.2" EXTENDED_LIMITS 0.00 255.0 /end CHARACTERISTIC
/begin CHARACTERISTIC DSM_ClaDfp_FrmMngBRK1Npl_C "Fehlerklasse fuer Fehlerpfad Dfp_FrmMngBRK1Npl" VALUE 0x1CF34E Kw_Wu8 20.00 OneToOne 0.00 20.00 FORMAT "%5.2" EXTENDED_LIMITS 0.00 255.0 /end CHARACTERISTIC
/begin CHARACTERISTIC DSM_ClaDfp_FrmMngBRK1TO_C "Fehlerklasse fuer Fehlerpfad Dfp_FrmMngBRK1TO" VALUE 0x1CF34F Kw_Wu8 20.00 OneToOne 0.00 20.00 FORMAT "%5.2" EXTENDED_LIMITS 0.00 255.0 /end CHARACTERISTIC
/begin CHARACTERISTIC DSM_ClaDfp_FrmMngBRK2Npl_C "Fehlerklasse fuer Fehlerpfad Dfp_FrmMngBRK2Npl" VALUE 0x1CF350 Kw_Wu8 20.00 OneToOne 0.00 20.00 FORMAT "%5.2" EXTENDED_LIMITS 0.00 255.0 /end CHARACTERISTIC
/begin CHARACTERISTIC DSM_ClaDfp_FrmMngBRK2TO_C "Fehlerklasse fuer Fehlerpfad Dfp_FrmMngBRK2TO" VALUE 0x1CF351 Kw_Wu8 20.00 OneToOne 0.00 20.00 FORMAT "%5.2" EXTENDED_LIMITS 0.00 255.0 /end CHARACTERISTIC
/begin CHARACTERISTIC DSM_ClaDfp_FrmMngBRK8Npl_C "Fehlerklasse fuer Fehlerpfad Dfp_FrmMngBRK8Npl" VALUE 0x1CF352 Kw_Wu8 20.00 OneToOne 0.00 20.00 FORMAT "%5.2" EXTENDED_LIMITS 0.00 255.0 /end CHARACTERISTIC
/begin CHARACTERISTIC DSM_ClaDfp_FrmMngBRK8TO_C "Fehlerklasse fuer Fehlerpfad Dfp_FrmMngBRK8TO" VALUE 0x1CF353 Kw_Wu8 20.00 OneToOne 0.00 20.00 FORMAT "%5.2" EXTENDED_LIMITS 0.00 255.0 /end CHARACTERISTIC
/begin CHARACTERISTIC DSM_ClaDfp_FrmMngBSG3TO_C "Fehlerklasse fuer Fehlerpfad Dfp_FrmMngBSG3TO" VALUE 0x1CF354 Kw_Wu8 20.00 OneToOne 0.00 20.00 FORMAT "%5.2" EXTENDED_LIMITS 0.00 255.0 /end CHARACTERISTIC
/begin CHARACTERISTIC DSM_ClaDfp_FrmMngCANVerErr_C "Fehlerklasse fuer Fehlerpfad Dfp_FrmMngCANVerErr" VALUE 0x1CF355 Kw_Wu8 20.00 OneToOne 0.00 20.00 FORMAT "%5.2" EXTENDED_LIMITS 0.00 255.0 /end CHARACTERISTIC
/begin CHARACTERISTIC DSM_ClaDfp_FrmMngCCSel_C "Fehlerklasse fuer Fehlerpfad Dfp_FrmMngCCSel_C" VALUE 0x1CF356 Kw_Wu8 20.00 OneToOne 0.00 20.00 FORMAT "%5.2" EXTENDED_LIMITS 0.00 255.0 /end CHARACTERISTIC
/begin CHARACTERISTIC DSM_ClaDfp_FrmMngCCTLNpl_C "Fehlerklasse fuer Fehlerpfad Dfp_FrmMngCCTLNpl" VALUE 0x1CF357 Kw_Wu8 20.00 OneToOne 0.00 20.00 FORMAT "%5.2" EXTENDED_LIMITS 0.00 255.0 /end CHARACTERISTIC
/begin CHARACTERISTIC DSM_ClaDfp_FrmMngCCTLTO_C "Fehlerklasse fuer Fehlerpfad Dfp_FrmMngCCTLTO" VALUE 0x1CF358 Kw_Wu8 20.00 OneToOne 0.00 20.00 FORMAT "%5.2" EXTENDED_LIMITS 0.00 255.0 /end CHARACTERISTIC
/begin CHARACTERISTIC DSM_ClaDfp_FrmMngCHRGR1Npl_C "Fehlerklasse fuer Fehlerpfad Dfp_FrmMngCHRGR1Npl" VALUE 0x1CF359 Kw_Wu8 20.00 OneToOne 0.00 20.00 FORMAT "%5.2" EXTENDED_LIMITS 0.00 255.0 /end CHARACTERISTIC
/begin CHARACTERISTIC DSM_ClaDfp_FrmMngCHRGR1TO_C "Fehlerklasse fuer Fehlerpfad Dfp_FrmMngCHRGR1TO" VALUE 0x1CF35A Kw_Wu8 20.00 OneToOne 0.00 20.00 FORMAT "%5.2" EXTENDED_LIMITS 0.00 255.0 /end CHARACTERISTIC
/begin CHARACTERISTIC DSM_ClaDfp_FrmMngCHRGR2Npl_C "Fehlerklasse fuer Fehlerpfad Dfp_FrmMngCHRGR2Npl" VALUE 0x1CF35B Kw_Wu8 20.00 OneToOne 0.00 20.00 FORMAT "%5.2" EXTENDED_LIMITS 0.00 255.0 /end CHARACTERISTIC
/begin CHARACTERISTIC DSM_ClaDfp_FrmMngCHRGR2TO_C "Fehlerklasse fuer Fehlerpfad Dfp_FrmMngCHRGR2TO" VALUE 0x1CF35C Kw_Wu8 20.00 OneToOne 0.00 20.00 FORMAT "%5.2" EXTENDED_LIMITS 0.00 255.0 /end CHARACTERISTIC
/begin CHARACTERISTIC DSM_ClaDfp_FrmMngChrgr1A_C "Fehlerklasse fuer Fehlerpfad Dfp_FrmMngChrgr1A" VALUE 0x1CF35D Kw_Wu8 20.00 OneToOne 0.00 20.00 FORMAT "%5.2" EXTENDED_LIMITS 0.00 255.0 /end CHARACTERISTIC
/begin CHARACTERISTIC DSM_ClaDfp_FrmMngChrgr1C_C "Fehlerklasse fuer Fehlerpfad Dfp_FrmMngChrgr1C" VALUE 0x1CF35E Kw_Wu8 20.00 OneToOne 0.00 20.00 FORMAT "%5.2" EXTENDED_LIMITS 0.00 255.0 /end CHARACTERISTIC
/begin CHARACTERISTIC DSM_ClaDfp_FrmMngChrgr1N_C "Fehlerklasse fuer Fehlerpfad Dfp_FrmMngChrgr1N" VALUE 0x1CF35F Kw_Wu8 20.00 OneToOne 0.00 20.00 FORMAT "%5.2" EXTENDED_LIMITS 0.00 255.0 /end CHARACTERISTIC
/begin CHARACTERISTIC DSM_ClaDfp_FrmMngChrgr1T_C "Fehlerklasse fuer Fehlerpfad Dfp_FrmMngChrgr1T" VALUE 0x1CF360 Kw_Wu8 20.00 OneToOne 0.00 20.00 FORMAT "%5.2" EXTENDED_LIMITS 0.00 255.0 /end CHARACTERISTIC
/begin CHARACTERISTIC DSM_ClaDfp_FrmMngChrgr1V_C "Fehlerklasse fuer Fehlerpfad Dfp_FrmMngChrgr1V" VALUE 0x1CF361 Kw_Wu8 20.00 OneToOne 0.00 20.00 FORMAT "%5.2" EXTENDED_LIMITS 0.00 255.0 /end CHARACTERISTIC
/begin CHARACTERISTIC DSM_ClaDfp_FrmMngChrgr2A_C "Fehlerklasse fuer Fehlerpfad Dfp_FrmMngChrgr2A" VALUE 0x1CF362 Kw_Wu8 20.00 OneToOne 0.00 20.00 FORMAT "%5.2" EXTENDED_LIMITS 0.00 255.0 /end CHARACTERISTIC
/begin CHARACTERISTIC DSM_ClaDfp_FrmMngChrgr2C_C "Fehlerklasse fuer Fehlerpfad Dfp_FrmMngChrgr2C" VALUE 0x1CF363 Kw_Wu8 20.00 OneToOne 0.00 20.00 FORMAT "%5.2" EXTENDED_LIMITS 0.00 255.0 /end CHARACTERISTIC
/begin CHARACTERISTIC DSM_ClaDfp_FrmMngChrgr2N_C "Fehlerklasse fuer Fehlerpfad Dfp_FrmMngChrgr2N" VALUE 0x1CF364 Kw_Wu8 20.00 OneToOne 0.00 20.00 FORMAT "%5.2" EXTENDED_LIMITS 0.00 255.0 /end CHARACTERISTIC
/begin CHARACTERISTIC DSM_ClaDfp_FrmMngChrgr2T_C "Fehlerklasse fuer Fehlerpfad Dfp_FrmMngChrgr2T" VALUE 0x1CF365 Kw_Wu8 20.00 OneToOne 0.00 20.00 FORMAT "%5.2" EXTENDED_LIMITS 0.00 255.0 /end CHARACTERISTIC
/begin CHARACTERISTIC DSM_ClaDfp_FrmMngChrgr2V_C "Fehlerklasse fuer Fehlerpfad Dfp_FrmMngChrgr2V" VALUE 0x1CF366 Kw_Wu8 20.00 OneToOne 0.00 20.00 FORMAT "%5.2" EXTENDED_LIMITS 0.00 255.0 /end CHARACTERISTIC
/begin CHARACTERISTIC DSM_ClaDfp_FrmMngDIA1Npl_C "Fehlerklasse fuer Fehlerpfad Dfp_FrmMngDIA1Npl" VALUE 0x1CF367 Kw_Wu8 20.00 OneToOne 0.00 20.00 FORMAT "%5.2" EXTENDED_LIMITS 0.00 255.0 /end CHARACTERISTIC
/begin CHARACTERISTIC DSM_ClaDfp_FrmMngDIA1TO_C "Fehlerklasse fuer Fehlerpfad Dfp_FrmMngGW1TO" VALUE 0x1CF368 Kw_Wu8 20.00 OneToOne 0.00 20.00 FORMAT "%5.2" EXTENDED_LIMITS 0.00 255.0 /end CHARACTERISTIC
/begin CHARACTERISTIC DSM_ClaDfp_FrmMngDSP1Npl_C "Fehlerklasse fuer Fehlerpfad Dfp_FrmMngDSP1Npl" VALUE 0x1CF369 Kw_Wu8 20.00 OneToOne 0.00 20.00 FORMAT "%5.2" EXTENDED_LIMITS 0.00 255.0 /end CHARACTERISTIC
/begin CHARACTERISTIC DSM_ClaDfp_FrmMngDSP1TO_C "Fehlerklasse fuer Fehlerpfad Dfp_FrmMngDSP1TO" VALUE 0x1CF36A Kw_Wu8 20.00 OneToOne 0.00 20.00 FORMAT "%5.2" EXTENDED_LIMITS 0.00 255.0 /end CHARACTERISTIC
/begin CHARACTERISTIC DSM_ClaDfp_FrmMngDSP2Npl_C "Fehlerklasse fuer Fehlerpfad Dfp_FrmMngDSP2Npl" VALUE 0x1CF36B Kw_Wu8 20.00 OneToOne 0.00 20.00 FORMAT "%5.2" EXTENDED_LIMITS 0.00 255.0 /end CHARACTERISTIC
/begin CHARACTERISTIC DSM_ClaDfp_FrmMngDSP2TO_C "Fehlerklasse fuer Fehlerpfad Dfp_FrmMngDSP2TO" VALUE 0x1CF36C Kw_Wu8 20.00 OneToOne 0.00 20.00 FORMAT "%5.2" EXTENDED_LIMITS 0.00 255.0 /end CHARACTERISTIC
/begin CHARACTERISTIC DSM_ClaDfp_FrmMngDSP3Npl_C "Fehlerklasse fuer Fehlerpfad Dfp_FrmMngDSP3Npl" VALUE 0x1CF36D Kw_Wu8 20.00 OneToOne 0.00 20.00 FORMAT "%5.2" EXTENDED_LIMITS 0.00 255.0 /end CHARACTERISTIC
/begin CHARACTERISTIC DSM_ClaDfp_FrmMngDSP3TO_C "Fehlerklasse fuer Fehlerpfad Dfp_FrmMngDSP3TO" VALUE 0x1CF36E Kw_Wu8 20.00 OneToOne 0.00 20.00 FORMAT "%5.2" EXTENDED_LIMITS 0.00 255.0 /end CHARACTERISTIC
/begin CHARACTERISTIC DSM_ClaDfp_FrmMngEPB1Npl_C "Fehlerklasse fuer Fehlerpfad Dfp_FrmMngTSC1Npl" VALUE 0x1CF36F Kw_Wu8 20.00 OneToOne 0.00 20.00 FORMAT "%5.2" EXTENDED_LIMITS 0.00 255.0 /end CHARACTERISTIC
/begin CHARACTERISTIC DSM_ClaDfp_FrmMngEPB1TO_C "Fehlerklasse fuer Fehlerpfad Dfp_FrmMngEPB1TO" VALUE 0x1CF370 Kw_Wu8 20.00 OneToOne 0.00 20.00 FORMAT "%5.2" EXTENDED_LIMITS 0.00 255.0 /end CHARACTERISTIC
/begin CHARACTERISTIC DSM_ClaDfp_FrmMngESCUNpl_C "Fehlerklasse fuer Fehlerpfad Dfp_FrmMngESCUNpl" VALUE 0x1CF371 Kw_Wu8 20.00 OneToOne 0.00 20.00 FORMAT "%5.2" EXTENDED_LIMITS 0.00 255.0 /end CHARACTERISTIC
/begin CHARACTERISTIC DSM_ClaDfp_FrmMngESCUTO_C "Fehlerklasse fuer Fehlerpfad Dfp_FrmMngESCUTO" VALUE 0x1CF372 Kw_Wu8 20.00 OneToOne 0.00 20.00 FORMAT "%5.2" EXTENDED_LIMITS 0.00 255.0 /end CHARACTERISTIC
/begin CHARACTERISTIC DSM_ClaDfp_FrmMngGW1Npl_C "Fehlerklasse fuer Fehlerpfad Dfp_FrmMngGW1Npl" VALUE 0x1CF374 Kw_Wu8 20.00 OneToOne 0.00 20.00 FORMAT "%5.2" EXTENDED_LIMITS 0.00 255.0 /end CHARACTERISTIC
/begin CHARACTERISTIC DSM_ClaDfp_FrmMngGW1TO_C "Fehlerklasse fuer Fehlerpfad Dfp_FrmMngGW1TO" VALUE 0x1CF375 Kw_Wu8 20.00 OneToOne 0.00 20.00 FORMAT "%5.2" EXTENDED_LIMITS 0.00 255.0 /end CHARACTERISTIC
/begin CHARACTERISTIC DSM_ClaDfp_FrmMngILMNpl_C "Fehlerklasse fuer Fehlerpfad Dfp_FrmMngILMNpl" VALUE 0x1CF376 Kw_Wu8 20.00 OneToOne 0.00 20.00 FORMAT "%5.2" EXTENDED_LIMITS 0.00 255.0 /end CHARACTERISTIC
/begin CHARACTERISTIC DSM_ClaDfp_FrmMngILMTO_C "Fehlerklasse fuer Fehlerpfad Dfp_FrmMngILMTO" VALUE 0x1CF377 Kw_Wu8 20.00 OneToOne 0.00 20.00 FORMAT "%5.2" EXTENDED_LIMITS 0.00 255.0 /end CHARACTERISTIC
/begin CHARACTERISTIC DSM_ClaDfp_FrmMngLICHT2TO_C "Fehlerklasse fuer Fehlerpfad Dfp_FrmMngLICHT2TO" VALUE 0x1CF379 Kw_Wu8 20.00 OneToOne 0.00 20.00 FORMAT "%5.2" EXTENDED_LIMITS 0.00 255.0 /end CHARACTERISTIC
/begin CHARACTERISTIC DSM_ClaDfp_FrmMngNIV1WrngCod_C "Fehlerklasse fuer Fehlerpfad Dfp_FrmMngNIV1WrngCod" VALUE 0x1CF37A Kw_Wu8 20.00 OneToOne 0.00 20.00 FORMAT "%5.2" EXTENDED_LIMITS 0.00 255.0 /end CHARACTERISTIC
/begin CHARACTERISTIC DSM_ClaDfp_FrmMngNIVEAU1Npl_C "Fehlerklasse fuer Fehlerpfad Dfp_FrmMngNIVEAU1Npl" VALUE 0x1CF37B Kw_Wu8 20.00 OneToOne 0.00 20.00 FORMAT "%5.2" EXTENDED_LIMITS 0.00 255.0 /end CHARACTERISTIC
/begin CHARACTERISTIC DSM_ClaDfp_FrmMngNIVEAU1TO_C "Fehlerklasse fuer Fehlerpfad Dfp_FrmMngNIVEAU1TO" VALUE 0x1CF37C Kw_Wu8 20.00 OneToOne 0.00 20.00 FORMAT "%5.2" EXTENDED_LIMITS 0.00 255.0 /end CHARACTERISTIC
/begin CHARACTERISTIC DSM_ClaDfp_FrmMngSA1Npl_C "Fehlerklasse fuer Fehlerpfad Dfp_FrmMngSA1Npl" VALUE 0x1CF37D Kw_Wu8 20.00 OneToOne 0.00 20.00 FORMAT "%5.2" EXTENDED_LIMITS 0.00 255.0 /end CHARACTERISTIC
/begin CHARACTERISTIC DSM_ClaDfp_FrmMngSA1TO_C "Fehlerklasse fuer Fehlerpfad Dfp_FrmMngSA1TO" VALUE 0x1CF37E Kw_Wu8 20.00 OneToOne 0.00 20.00 FORMAT "%5.2" EXTENDED_LIMITS 0.00 255.0 /end CHARACTERISTIC
/begin CHARACTERISTIC DSM_ClaDfp_FrmMngSTIGNNpl_C "Fehlerklasse fuer Fehlerpfad Dfp_FrmMngSTIGNNpl" VALUE 0x1CF37F Kw_Wu8 20.00 OneToOne 0.00 20.00 FORMAT "%5.2" EXTENDED_LIMITS 0.00 255.0 /end CHARACTERISTIC
/begin CHARACTERISTIC DSM_ClaDfp_FrmMngStIgnTO_C "Fehlerklasse fuer Fehlerpfad Dfp_FrmMngStIgnTO" VALUE 0x1CF380 Kw_Wu8 20.00 OneToOne 0.00 20.00 FORMAT "%5.2" EXTENDED_LIMITS 0.00 255.0 /end CHARACTERISTIC
/begin CHARACTERISTIC DSM_ClaDfp_FrmMngTOSNpl_C "Fehlerklasse fuer Fehlerpfad Dfp_FrmMngTOSNpl" VALUE 0x1CF381 Kw_Wu8 20.00 OneToOne 0.00 20.00 FORMAT "%5.2" EXTENDED_LIMITS 0.00 255.0 /end CHARACTERISTIC
/begin CHARACTERISTIC DSM_ClaDfp_FrmMngTOSTO_C "Fehlerklasse fuer Fehlerpfad Dfp_FrmMngTOSTO" VALUE 0x1CF382 Kw_Wu8 20.00 OneToOne 0.00 20.00 FORMAT "%5.2" EXTENDED_LIMITS 0.00 255.0 /end CHARACTERISTIC
/begin CHARACTERISTIC DSM_ClaDfp_FrmMngTSC1Npl_C "Fehlerklasse fuer Fehlerpfad Dfp_FrmMngTSC1Npl" VALUE 0x1CF383 Kw_Wu8 20.00 OneToOne 0.00 20.00 FORMAT "%5.2" EXTENDED_LIMITS 0.00 255.0 /end CHARACTERISTIC
/begin CHARACTERISTIC DSM_ClaDfp_FrmMngTSC1TO_C "Fehlerklasse fuer Fehlerpfad Dfp_FrmMngTSC1TO" VALUE 0x1CF384 Kw_Wu8 20.00 OneToOne 0.00 20.00 FORMAT "%5.2" EXTENDED_LIMITS 0.00 255.0 /end CHARACTERISTIC
/begin CHARACTERISTIC DSM_ClaDfp_FrmMngTSC2Npl_C "Fehlerklasse fuer Fehlerpfad Dfp_FrmMngTSC2Npl" VALUE 0x1CF385 Kw_Wu8 20.00 OneToOne 0.00 20.00 FORMAT "%5.2" EXTENDED_LIMITS 0.00 255.0 /end CHARACTERISTIC
/begin CHARACTERISTIC DSM_ClaDfp_FrmMngTSC2TO_C "Fehlerklasse fuer Fehlerpfad Dfp_FrmMngTSC2TO" VALUE 0x1CF386 Kw_Wu8 20.00 OneToOne 0.00 20.00 FORMAT "%5.2" EXTENDED_LIMITS 0.00 255.0 /end CHARACTERISTIC
/begin CHARACTERISTIC DSM_ClaDfp_FrmMngTSC3Npl_C "Fehlerklasse fuer Fehlerpfad Dfp_FrmMngTSC3Npl" VALUE 0x1CF387 Kw_Wu8 20.00 OneToOne 0.00 20.00 FORMAT "%5.2" EXTENDED_LIMITS 0.00 255.0 /end CHARACTERISTIC
/begin CHARACTERISTIC DSM_ClaDfp_FrmMngTSC3TO_C "Fehlerklasse fuer Fehlerpfad Dfp_FrmMngTSC3TO" VALUE 0x1CF388 Kw_Wu8 20.00 OneToOne 0.00 20.00 FORMAT "%5.2" EXTENDED_LIMITS 0.00 255.0 /end CHARACTERISTIC
/begin CHARACTERISTIC DSM_ClaDfp_FrmMngTSC6Npl_C "Fehlerklasse fuer Fehlerpfad Dfp_FrmMngTSC6Npl" VALUE 0x1CF389 Kw_Wu8 20.00 OneToOne 0.00 20.00 FORMAT "%5.2" EXTENDED_LIMITS 0.00 255.0 /end CHARACTERISTIC
/begin CHARACTERISTIC DSM_ClaDfp_FrmMngTSC6TO_C "Fehlerklasse fuer Fehlerpfad Dfp_FrmMngTSC6TO" VALUE 0x1CF38A Kw_Wu8 20.00 OneToOne 0.00 20.00 FORMAT "%5.2" EXTENDED_LIMITS 0.00 255.0 /end CHARACTERISTIC
/begin CHARACTERISTIC DSM_ClaDfp_FrmMngTrbnSpdErr_C "Fehlerklasse fuer Fehlerpfad Dfp_FrmMngTrbnSpdErr" VALUE 0x1CF38B Kw_Wu8 20.00 OneToOne 0.00 20.00 FORMAT "%5.2" EXTENDED_LIMITS 0.00 255.0 /end CHARACTERISTIC
/begin CHARACTERISTIC DSM_ClaDfp_FrmMngWIPERTO_C "Fehlerklasse fuer Fehlerpfad Dfp_FrmMngWIPERTO" VALUE 0x1CF38C Kw_Wu8 20.00 OneToOne 0.00 20.00 FORMAT "%5.2" EXTENDED_LIMITS 0.00 255.0 /end CHARACTERISTIC
/begin CHARACTERISTIC DSM_ClaDfp_GbSSCD_C "Fehlerklasse für Fehlerpfad Dfp_GbSSCD" VALUE 0x1CF38D Kw_Wu8 20.00 OneToOne 0.00 20.00 FORMAT "%5.2" EXTENDED_LIMITS 0.00 255.0 /end CHARACTERISTIC
/begin CHARACTERISTIC DSM_ClaDfp_GbSSCD_HW_C "Fehlerklasse fuer Fehlerpfad Dfp_GbSSCD_HW" VALUE 0x1CF38E Kw_Wu8 20.00 OneToOne 0.00 20.00 FORMAT "%5.2" EXTENDED_LIMITS 0.00 255.0 /end CHARACTERISTIC
/begin CHARACTERISTIC DSM_ClaDfp_GearbxCVTnMax_C "Fehlerklasse fuer Fehlerpfad Dfp_GearbxCVTnMax_mp" VALUE 0x1CF38F Kw_Wu8 20.00 OneToOne 0.00 20.00 FORMAT "%5.2" EXTENDED_LIMITS 0.00 255.0 /end CHARACTERISTIC
/begin CHARACTERISTIC DSM_ClaDfp_GearbxClthPlaus_C "Fehlerklasse fuer Fehlerpfad Dfp_GearbxClthPlaus" VALUE 0x1CF390 Kw_Wu8 20.00 OneToOne 0.00 20.00 FORMAT "%5.2" EXTENDED_LIMITS 0.00 255.0 /end CHARACTERISTIC
/begin CHARACTERISTIC DSM_ClaDfp_GearbxINCCup_C "Fehlerklasse fuer Fehlerpfad Dfp_GearbxINCCup" VALUE 0x1CF391 Kw_Wu8 20.00 OneToOne 0.00 20.00 FORMAT "%5.2" EXTENDED_LIMITS 0.00 255.0 /end CHARACTERISTIC
/begin CHARACTERISTIC DSM_ClaDfp_GearbxNMinMon_C "Fehlerklasse fuer Fehlerpfad Dfp_GearbxNMinMon" VALUE 0x1CF392 Kw_Wu8 20.00 OneToOne 0.00 20.00 FORMAT "%5.2" EXTENDED_LIMITS 0.00 255.0 /end CHARACTERISTIC
/begin CHARACTERISTIC DSM_ClaDfp_GearbxTSC_C "Fehlerklasse fuer Fehlerpfad Dfp_GearbxTSC" VALUE 0x1CF393 Kw_Wu8 20.00 OneToOne 0.00 20.00 FORMAT "%5.2" EXTENDED_LIMITS 0.00 255.0 /end CHARACTERISTIC
/begin CHARACTERISTIC DSM_ClaDfp_GearbxTransConv_C "Fehlerklasse fuer Fehlerpfad  Dfp_GearbxTransConv" VALUE 0x1CF394 Kw_Wu8 20.00 OneToOne 0.00 20.00 FORMAT "%5.2" EXTENDED_LIMITS 0.00 255.0 /end CHARACTERISTIC
/begin CHARACTERISTIC DSM_ClaDfp_GearbxTypeMTErr_C "Fehlerklasse fuer Fehlerpfad Dfp_GearbxTypeMTErr" VALUE 0x1CF395 Kw_Wu8 20.00 OneToOne 0.00 20.00 FORMAT "%5.2" EXTENDED_LIMITS 0.00 255.0 /end CHARACTERISTIC
/begin CHARACTERISTIC DSM_ClaDfp_GlwCDDIAG_C "Fehlerklasse fuer Fehlerpfad Dfp_GlwCDDIAG" VALUE 0x1CF396 Kw_Wu8 20.00 OneToOne 0.00 20.00 FORMAT "%5.2" EXTENDED_LIMITS 0.00 255.0 /end CHARACTERISTIC
/begin CHARACTERISTIC DSM_ClaDfp_GlwCDErr1_C "Fehlerklasse fuer Fehlerpfad Dfp_GlwCDErr1" VALUE 0x1CF397 Kw_Wu8 20.00 OneToOne 0.00 20.00 FORMAT "%5.2" EXTENDED_LIMITS 0.00 255.0 /end CHARACTERISTIC
/begin CHARACTERISTIC DSM_ClaDfp_GlwCDErr2_C "Fehlerklasse fuer Fehlerpfad Dfp_GlwCDErr2" VALUE 0x1CF398 Kw_Wu8 20.00 OneToOne 0.00 20.00 FORMAT "%5.2" EXTENDED_LIMITS 0.00 255.0 /end CHARACTERISTIC
/begin CHARACTERISTIC DSM_ClaDfp_GlwCDEvalCod_C "Fehlerklasse fuer Fehlerpfad Dfp_GlwCDEvalCod" VALUE 0x1CF399 Kw_Wu8 20.00 OneToOne 0.00 20.00 FORMAT "%5.2" EXTENDED_LIMITS 0.00 255.0 /end CHARACTERISTIC
/begin CHARACTERISTIC DSM_ClaDfp_GlwCDGSK2_C "Fehlerklasse fuer Fehlerpfad Dfp_GlwCDGSK2" VALUE 0x1CF39A Kw_Wu8 20.00 OneToOne 0.00 20.00 FORMAT "%5.2" EXTENDED_LIMITS 0.00 255.0 /end CHARACTERISTIC
/begin CHARACTERISTIC DSM_ClaDfp_GlwCDGSK3_C "Fehlerklasse fuer Fehlerpfad Dfp_GlwCDGSK3" VALUE 0x1CF39B Kw_Wu8 20.00 OneToOne 0.00 20.00 FORMAT "%5.2" EXTENDED_LIMITS 0.00 255.0 /end CHARACTERISTIC
/begin CHARACTERISTIC DSM_ClaDfp_GlwCDLmp_C "Fehlerklasse fuer Fehlerpfad Dfp_GlwCDLmp" VALUE 0x1CF39C Kw_Wu8 20.00 OneToOne 0.00 20.00 FORMAT "%5.2" EXTENDED_LIMITS 0.00 255.0 /end CHARACTERISTIC
/begin CHARACTERISTIC DSM_ClaDfp_GlwCDPLUG0_C "Fehlerklasse fuer Fehlerpfad Dfp_GlwCDPLUG0" VALUE 0x1CF39D Kw_Wu8 20.00 OneToOne 0.00 20.00 FORMAT "%5.2" EXTENDED_LIMITS 0.00 255.0 /end CHARACTERISTIC
/begin CHARACTERISTIC DSM_ClaDfp_GlwCDPLUG1_C "Fehlerklasse fuer Fehlerpfad Dfp_GlwCDPLUG1" VALUE 0x1CF39E Kw_Wu8 20.00 OneToOne 0.00 20.00 FORMAT "%5.2" EXTENDED_LIMITS 0.00 255.0 /end CHARACTERISTIC
/begin CHARACTERISTIC DSM_ClaDfp_GlwCDPLUG2_C "Fehlerklasse fuer Fehlerpfad Dfp_GlwCDPLUG2" VALUE 0x1CF39F Kw_Wu8 20.00 OneToOne 0.00 20.00 FORMAT "%5.2" EXTENDED_LIMITS 0.00 255.0 /end CHARACTERISTIC
/begin CHARACTERISTIC DSM_ClaDfp_GlwCDPLUG3_C "Fehlerklasse fuer Fehlerpfad Dfp_GlwCDPLUG3" VALUE 0x1CF3A0 Kw_Wu8 20.00 OneToOne 0.00 20.00 FORMAT "%5.2" EXTENDED_LIMITS 0.00 255.0 /end CHARACTERISTIC
/begin CHARACTERISTIC DSM_ClaDfp_GlwCDPLUG4_C "Fehlerklasse fuer Fehlerpfad Dfp_GlwCDPLUG4" VALUE 0x1CF3A1 Kw_Wu8 20.00 OneToOne 0.00 20.00 FORMAT "%5.2" EXTENDED_LIMITS 0.00 255.0 /end CHARACTERISTIC
/begin CHARACTERISTIC DSM_ClaDfp_GlwCDPLUG5_C "Fehlerklasse fuer Fehlerpfad Dfp_GlwCDPLUG5" VALUE 0x1CF3A2 Kw_Wu8 20.00 OneToOne 0.00 20.00 FORMAT "%5.2" EXTENDED_LIMITS 0.00 255.0 /end CHARACTERISTIC
/begin CHARACTERISTIC DSM_ClaDfp_GlwCD_LampCan_C "Fehlerklasse fuer Fehlerpfad Dfp_GlwCD_LampCan" VALUE 0x1CF3A3 Kw_Wu8 20.00 OneToOne 0.00 20.00 FORMAT "%5.2" EXTENDED_LIMITS 0.00 255.0 /end CHARACTERISTIC
/begin CHARACTERISTIC DSM_ClaDfp_GlwCDsfd_C "Fehlerklasse fuer Fehlerpfad Dfp_GlwCDsfd" VALUE 0x1CF3A4 Kw_Wu8 20.00 OneToOne 0.00 20.00 FORMAT "%5.2" EXTENDED_LIMITS 0.00 255.0 /end CHARACTERISTIC
/begin CHARACTERISTIC DSM_ClaDfp_HDSCD_C "Fehlerklasse fuer Fehlerpfad Dfp_HDSCD" VALUE 0x1CF3A5 Kw_Wu8 20.00 OneToOne 0.00 20.00 FORMAT "%5.2" EXTENDED_LIMITS 0.00 255.0 /end CHARACTERISTIC
/begin CHARACTERISTIC DSM_ClaDfp_HWEMonCom_C "Fehlerklasse fuer Fehlerpfad Dfp_HWEMonCom" VALUE 0x1CF3A6 Kw_Wu8 20.00 OneToOne 0.00 20.00 FORMAT "%5.2" EXTENDED_LIMITS 0.00 255.0 /end CHARACTERISTIC
/begin CHARACTERISTIC DSM_ClaDfp_HWEMonEEPROM_C "Fehlerklasse fuer Fehlerpfad Dfp_HWEMonEEPROM" VALUE 0x1CF3A7 Kw_Wu8 20.00 OneToOne 0.00 20.00 FORMAT "%5.2" EXTENDED_LIMITS 0.00 255.0 /end CHARACTERISTIC
/begin CHARACTERISTIC DSM_ClaDfp_HWEMonRcyLocked_C "Fehlerklasse fuer Fehlerpfad Dfp_HWEMonRcyLocked" VALUE 0x1CF3A8 Kw_Wu8 20.00 OneToOne 0.00 20.00 FORMAT "%5.2" EXTENDED_LIMITS 0.00 255.0 /end CHARACTERISTIC
/begin CHARACTERISTIC DSM_ClaDfp_HWEMonRcySuppressed_C "Fehlerklasse fuer Fehlerpfad Dfp_HWEMonRcySuppressed" VALUE 0x1CF3A9 Kw_Wu8 20.00 OneToOne 0.00 20.00 FORMAT "%5.2" EXTENDED_LIMITS 0.00 255.0 /end CHARACTERISTIC
/begin CHARACTERISTIC DSM_ClaDfp_HWEMonRcyVisible_C "Fehlerklasse fuer Fehlerpfad Dfp_HWEMonRcyVisible" VALUE 0x1CF3AA Kw_Wu8 20.00 OneToOne 0.00 20.00 FORMAT "%5.2" EXTENDED_LIMITS 0.00 255.0 /end CHARACTERISTIC
/begin CHARACTERISTIC DSM_ClaDfp_HWEMonUMaxSupply_C "Fehlerklasse fuer Fehlerpfad Dfp_HWEMonUMaxSupply" VALUE 0x1CF3AB Kw_Wu8 20.00 OneToOne 0.00 20.00 FORMAT "%5.2" EXTENDED_LIMITS 0.00 255.0 /end CHARACTERISTIC
/begin CHARACTERISTIC DSM_ClaDfp_HWEMonUMinSupply_C "Fehlerklasse fuer Fehlerpfad Dfp_HWEMonUMinSupply" VALUE 0x1CF3AC Kw_Wu8 20.00 OneToOne 0.00 20.00 FORMAT "%5.2" EXTENDED_LIMITS 0.00 255.0 /end CHARACTERISTIC
/begin CHARACTERISTIC DSM_ClaDfp_IATSCD_C "Fehlerklasse fuer Fehlerpfad Dfp_IATSCD" VALUE 0x1CF3AD Kw_Wu8 20.00 OneToOne 0.00 20.00 FORMAT "%5.2" EXTENDED_LIMITS 0.00 255.0 /end CHARACTERISTIC
/begin CHARACTERISTIC DSM_ClaDfp_IFCD_C "Fehlerklasse fuer Fehlerpfad Dfp_IFCD" VALUE 0x1CF3AE Kw_Wu8 20.00 OneToOne 0.00 20.00 FORMAT "%5.2" EXTENDED_LIMITS 0.00 255.0 /end CHARACTERISTIC
/begin CHARACTERISTIC DSM_ClaDfp_ImmCtl_C "Fehlerklasse fuer Fehlerpfad Dfp_ImmCtl" VALUE 0x1CF3AF Kw_Wu8 20.00 OneToOne 0.00 20.00 FORMAT "%5.2" EXTENDED_LIMITS 0.00 255.0 /end CHARACTERISTIC
/begin CHARACTERISTIC DSM_ClaDfp_IndSysMonIntMnf_C "Fehlerklasse fuer Fehlerpfad Dfp_IndSysMonIntMnf" VALUE 0x1CF3B0 Kw_Wu8 20.00 OneToOne 0.00 20.00 FORMAT "%5.2" EXTENDED_LIMITS 0.00 255.0 /end CHARACTERISTIC
/begin CHARACTERISTIC DSM_ClaDfp_InjVlvBnk1A_C "Fehlerklasse fuer Fehlerpfad Dfp_InjVlvBnk1A" VALUE 0x1CF3B3 Kw_Wu8 20.00 OneToOne 0.00 20.00 FORMAT "%5.2" EXTENDED_LIMITS 0.00 255.0 /end CHARACTERISTIC
/begin CHARACTERISTIC DSM_ClaDfp_InjVlvBnk2A_C "Fehlerklasse fuer Fehlerpfad Dfp_InjVlvBnk2A" VALUE 0x1CF3B4 Kw_Wu8 20.00 OneToOne 0.00 20.00 FORMAT "%5.2" EXTENDED_LIMITS 0.00 255.0 /end CHARACTERISTIC
/begin CHARACTERISTIC DSM_ClaDfp_InjVlvCyl10A_C "Fehlerklasse fuer Fehlerpfad Dfp_InjVlvCyl10A" VALUE 0x1CF3B5 Kw_Wu8 20.00 OneToOne 0.00 20.00 FORMAT "%5.2" EXTENDED_LIMITS 0.00 255.0 /end CHARACTERISTIC
/begin CHARACTERISTIC DSM_ClaDfp_InjVlvCyl11A_C "Fehlerklasse fuer Fehlerpfad Dfp_InjVlvCyl11A" VALUE 0x1CF3B6 Kw_Wu8 20.00 OneToOne 0.00 20.00 FORMAT "%5.2" EXTENDED_LIMITS 0.00 255.0 /end CHARACTERISTIC
/begin CHARACTERISTIC DSM_ClaDfp_InjVlvCyl12A_C "Fehlerklasse fuer Fehlerpfad Dfp_InjVlvCyl12A" VALUE 0x1CF3B7 Kw_Wu8 20.00 OneToOne 0.00 20.00 FORMAT "%5.2" EXTENDED_LIMITS 0.00 255.0 /end CHARACTERISTIC
/begin CHARACTERISTIC DSM_ClaDfp_InjVlvCyl1A_C "Fehlerklasse fuer Fehlerpfad Dfp_InjVlvCyl1A" VALUE 0x1CF3B8 Kw_Wu8 20.00 OneToOne 0.00 20.00 FORMAT "%5.2" EXTENDED_LIMITS 0.00 255.0 /end CHARACTERISTIC
/begin CHARACTERISTIC DSM_ClaDfp_InjVlvCyl2A_C "Fehlerklasse fuer Fehlerpfad Dfp_InjVlvCyl2A" VALUE 0x1CF3B9 Kw_Wu8 20.00 OneToOne 0.00 20.00 FORMAT "%5.2" EXTENDED_LIMITS 0.00 255.0 /end CHARACTERISTIC
/begin CHARACTERISTIC DSM_ClaDfp_InjVlvCyl3A_C "Fehlerklasse fuer Fehlerpfad Dfp_InjVlvCyl3A" VALUE 0x1CF3BA Kw_Wu8 20.00 OneToOne 0.00 20.00 FORMAT "%5.2" EXTENDED_LIMITS 0.00 255.0 /end CHARACTERISTIC
/begin CHARACTERISTIC DSM_ClaDfp_InjVlvCyl4A_C "Fehlerklasse fuer Fehlerpfad Dfp_InjVlvCyl4A" VALUE 0x1CF3BB Kw_Wu8 20.00 OneToOne 0.00 20.00 FORMAT "%5.2" EXTENDED_LIMITS 0.00 255.0 /end CHARACTERISTIC
/begin CHARACTERISTIC DSM_ClaDfp_InjVlvCyl5A_C "Fehlerklasse fuer Fehlerpfad Dfp_InjVlvCyl5A" VALUE 0x1CF3BC Kw_Wu8 20.00 OneToOne 0.00 20.00 FORMAT "%5.2" EXTENDED_LIMITS 0.00 255.0 /end CHARACTERISTIC
/begin CHARACTERISTIC DSM_ClaDfp_InjVlvCyl6A_C "Fehlerklasse fuer Fehlerpfad Dfp_InjVlvCyl6A" VALUE 0x1CF3BD Kw_Wu8 20.00 OneToOne 0.00 20.00 FORMAT "%5.2" EXTENDED_LIMITS 0.00 255.0 /end CHARACTERISTIC
/begin CHARACTERISTIC DSM_ClaDfp_InjVlvCyl7A_C "Fehlerklasse fuer Fehlerpfad Dfp_InjVlvCyl7A" VALUE 0x1CF3BE Kw_Wu8 20.00 OneToOne 0.00 20.00 FORMAT "%5.2" EXTENDED_LIMITS 0.00 255.0 /end CHARACTERISTIC
/begin CHARACTERISTIC DSM_ClaDfp_InjVlvCyl8A_C "Fehlerklasse fuer Fehlerpfad Dfp_InjVlvCyl8A" VALUE 0x1CF3BF Kw_Wu8 20.00 OneToOne 0.00 20.00 FORMAT "%5.2" EXTENDED_LIMITS 0.00 255.0 /end CHARACTERISTIC
/begin CHARACTERISTIC DSM_ClaDfp_InjVlvCyl9A_C "Fehlerklasse fuer Fehlerpfad Dfp_InjVlvCyl9A" VALUE 0x1CF3C0 Kw_Wu8 20.00 OneToOne 0.00 20.00 FORMAT "%5.2" EXTENDED_LIMITS 0.00 255.0 /end CHARACTERISTIC
/begin CHARACTERISTIC DSM_ClaDfp_LASCD_C "Fehlerklasse fuer Fehlerpfad Dfp_LASCD" VALUE 0x1CF3C1 Kw_Wu8 20.00 OneToOne 0.00 20.00 FORMAT "%5.2" EXTENDED_LIMITS 0.00 255.0 /end CHARACTERISTIC
/begin CHARACTERISTIC DSM_ClaDfp_LSUCDCircNernst0_C "Fehlerklasse fuer Fehlerpfad Dfp_LSUCDCircNernst0" VALUE 0x1CF3C2 Kw_Wu8 20.00 OneToOne 0.00 20.00 FORMAT "%5.2" EXTENDED_LIMITS 0.00 255.0 /end CHARACTERISTIC
/begin CHARACTERISTIC DSM_ClaDfp_LSUCDCircPumpCur0_C "Fehlerklasse fuer Fehlerpfad Dfp_LSUCDCircPumpCur0" VALUE 0x1CF3C3 Kw_Wu8 20.00 OneToOne 0.00 20.00 FORMAT "%5.2" EXTENDED_LIMITS 0.00 255.0 /end CHARACTERISTIC
/begin CHARACTERISTIC DSM_ClaDfp_LSUCDCircVirtGnd0_C "Fehlerklasse fuer Fehlerpfad Dfp_LSUCDCircVirtGnd0" VALUE 0x1CF3C4 Kw_Wu8 20.00 OneToOne 0.00 20.00 FORMAT "%5.2" EXTENDED_LIMITS 0.00 255.0 /end CHARACTERISTIC
/begin CHARACTERISTIC DSM_ClaDfp_LSUCDHeater0_C "Fehlerklasse fuer Fehlerpfad Dfp_LSUCDHeater0" VALUE 0x1CF3C5 Kw_Wu8 20.00 OneToOne 0.00 20.00 FORMAT "%5.2" EXTENDED_LIMITS 0.00 255.0 /end CHARACTERISTIC
/begin CHARACTERISTIC DSM_ClaDfp_LSUCDHtCoup0_C "Fehlerklasse fuer Fehlerpfad Dfp_LSUCDHtCoup0" VALUE 0x1CF3C6 Kw_Wu8 20.00 OneToOne 0.00 20.00 FORMAT "%5.2" EXTENDED_LIMITS 0.00 255.0 /end CHARACTERISTIC
/begin CHARACTERISTIC DSM_ClaDfp_LSUCDO20_C "Fehlerklasse fuer Fehlerpfad Dfp_LSUCDO20" VALUE 0x1CF3C7 Kw_Wu8 20.00 OneToOne 0.00 20.00 FORMAT "%5.2" EXTENDED_LIMITS 0.00 255.0 /end CHARACTERISTIC
/begin CHARACTERISTIC DSM_ClaDfp_LSUCDO2Clb0_C "Fehlerklasse fuer Fehlerpfad Dfp_LSUCDO2Clb0" VALUE 0x1CF3C8 Kw_Wu8 20.00 OneToOne 0.00 20.00 FORMAT "%5.2" EXTENDED_LIMITS 0.00 255.0 /end CHARACTERISTIC
/begin CHARACTERISTIC DSM_ClaDfp_LSUCDRiClb0_C "Fehlerklasse fuer Fehlerpfad Dfp_LSUCDRiClb0" VALUE 0x1CF3C9 Kw_Wu8 20.00 OneToOne 0.00 20.00 FORMAT "%5.2" EXTENDED_LIMITS 0.00 255.0 /end CHARACTERISTIC
/begin CHARACTERISTIC DSM_ClaDfp_LSUCDSPI0_C "Fehlerklasse fuer Fehlerpfad Dfp_LSUCDSPI0" VALUE 0x1CF3CA Kw_Wu8 20.00 OneToOne 0.00 20.00 FORMAT "%5.2" EXTENDED_LIMITS 0.00 255.0 /end CHARACTERISTIC
/begin CHARACTERISTIC DSM_ClaDfp_LSUCDSPIBattLow0_C "Fehlerklasse fuer Fehlerpfad Dfp_LSUCDSPIBattLow0" VALUE 0x1CF3CB Kw_Wu8 20.00 OneToOne 0.00 20.00 FORMAT "%5.2" EXTENDED_LIMITS 0.00 255.0 /end CHARACTERISTIC
/begin CHARACTERISTIC DSM_ClaDfp_LSUCDWireIP0_C "Fehlerklasse fuer Fehlerpfad Dfp_LSUCDWireIP0" VALUE 0x1CF3CC Kw_Wu8 20.00 OneToOne 0.00 20.00 FORMAT "%5.2" EXTENDED_LIMITS 0.00 255.0 /end CHARACTERISTIC
/begin CHARACTERISTIC DSM_ClaDfp_LSUCtlRiExc0_C "Fehlerklasse fuer Fehlerpfad Dfp_LSUCtlRiExc0" VALUE 0x1CF3CD Kw_Wu8 20.00 OneToOne 0.00 20.00 FORMAT "%5.2" EXTENDED_LIMITS 0.00 255.0 /end CHARACTERISTIC
/begin CHARACTERISTIC DSM_ClaDfp_LSUMonDyn0_C "Fehlerklasse fuer Fehlerpfad Dfp_LSUMonDyn0" VALUE 0x1CF3CE Kw_Wu8 20.00 OneToOne 0.00 20.00 FORMAT "%5.2" EXTENDED_LIMITS 0.00 255.0 /end CHARACTERISTIC
/begin CHARACTERISTIC DSM_ClaDfp_LSUMonFullLd0_C "Fehlerklasse fuer Fehlerpfad Dfp_LSUMonFullLd0" VALUE 0x1CF3CF Kw_Wu8 20.00 OneToOne 0.00 20.00 FORMAT "%5.2" EXTENDED_LIMITS 0.00 255.0 /end CHARACTERISTIC
/begin CHARACTERISTIC DSM_ClaDfp_LSUMonOvrRun0_C "Fehlerklasse fuer Fehlerpfad Dfp_LSUMonOvrRun0" VALUE 0x1CF3D0 Kw_Wu8 20.00 OneToOne 0.00 20.00 FORMAT "%5.2" EXTENDED_LIMITS 0.00 255.0 /end CHARACTERISTIC
/begin CHARACTERISTIC DSM_ClaDfp_LSUMonPartLd0_C "Fehlerklasse fuer Fehlerpfad Dfp_LSUMonPartLd0" VALUE 0x1CF3D1 Kw_Wu8 20.00 OneToOne 0.00 20.00 FORMAT "%5.2" EXTENDED_LIMITS 0.00 255.0 /end CHARACTERISTIC
/begin CHARACTERISTIC DSM_ClaDfp_MIL_C "Fehlerklasse fuer Fehlerpfad Dfp_MIL" VALUE 0x1CF3D2 Kw_Wu8 20.00 OneToOne 0.00 20.00 FORMAT "%5.2" EXTENDED_LIMITS 0.00 255.0 /end CHARACTERISTIC
/begin CHARACTERISTIC DSM_ClaDfp_MRlyCD_C "Fehlerklasse fuer Fehlerpfad Dfp_MRlyCD" VALUE 0x1CF3D3 Kw_Wu8 20.00 OneToOne 0.00 20.00 FORMAT "%5.2" EXTENDED_LIMITS 0.00 255.0 /end CHARACTERISTIC
/begin CHARACTERISTIC DSM_ClaDfp_Montr_C "Fehlerklasse fuer Fehlerpfad Dfp_Montr" VALUE 0x1CF3D4 Kw_Wu8 20.00 OneToOne 0.00 20.00 FORMAT "%5.2" EXTENDED_LIMITS 0.00 255.0 /end CHARACTERISTIC
/begin CHARACTERISTIC DSM_ClaDfp_OTSCD_C "Fehlerklasse fuer Fehlerpfad Dfp_OTSCD" VALUE 0x1CF3D5 Kw_Wu8 20.00 OneToOne 0.00 20.00 FORMAT "%5.2" EXTENDED_LIMITS 0.00 255.0 /end CHARACTERISTIC
/begin CHARACTERISTIC DSM_ClaDfp_OTSCDCanInac_C "Fehlerklasse fuer Fehlerpfad Dfp_OTSCDCanInac" VALUE 0x1CF3D6 Kw_Wu8 20.00 OneToOne 0.00 20.00 FORMAT "%5.2" EXTENDED_LIMITS 0.00 255.0 /end CHARACTERISTIC
/begin CHARACTERISTIC DSM_ClaDfp_OTSCDCanSig_C "Fehlerklasse fuer Fehlerpfad Dfp_OTSCDCanSig" VALUE 0x1CF3D7 Kw_Wu8 20.00 OneToOne 0.00 20.00 FORMAT "%5.2" EXTENDED_LIMITS 0.00 255.0 /end CHARACTERISTIC
/begin CHARACTERISTIC DSM_ClaDfp_OvRMon_C "Fehlerklasse fuer Fehlerpfad Dfp_OvRMon" VALUE 0x1CF3D9 Kw_Wu8 20.00 OneToOne 0.00 20.00 FORMAT "%5.2" EXTENDED_LIMITS 0.00 255.0 /end CHARACTERISTIC
/begin CHARACTERISTIC DSM_ClaDfp_OvRMonCrCtlP_C "Fehlerklasse fuer Fehlerpfad Dfp_OvRMonCrCtlP" VALUE 0x1CF3DA Kw_Wu8 20.00 OneToOne 0.00 20.00 FORMAT "%5.2" EXTENDED_LIMITS 0.00 255.0 /end CHARACTERISTIC
/begin CHARACTERISTIC DSM_ClaDfp_OvRMonSigA_C "Fehlerklasse fuer Fehlerpfad Dfp_OvRMonSigA" VALUE 0x1CF3DB Kw_Wu8 20.00 OneToOne 0.00 20.00 FORMAT "%5.2" EXTENDED_LIMITS 0.00 255.0 /end CHARACTERISTIC
/begin CHARACTERISTIC DSM_ClaDfp_OxiCCDTPre_C "Fehlerklasse fuer Fehlerpfad Dfp_OxiCCDTPre" VALUE 0x1CF3DC Kw_Wu8 20.00 OneToOne 0.00 20.00 FORMAT "%5.2" EXTENDED_LIMITS 0.00 255.0 /end CHARACTERISTIC
/begin CHARACTERISTIC DSM_ClaDfp_OxiCCDTPre1_C "Fehlerklasse fuer Fehlerpfad Dfp_OxiCCDTPre1" VALUE 0x1CF3DD Kw_Wu8 20.00 OneToOne 0.00 20.00 FORMAT "%5.2" EXTENDED_LIMITS 0.00 255.0 /end CHARACTERISTIC
/begin CHARACTERISTIC DSM_ClaDfp_PCR_BalGovDev_C "Fehlerklasse fuer Fehlerpfad Dfp_PCR_BalGovDev" VALUE 0x1CF3DE Kw_Wu8 20.00 OneToOne 0.00 20.00 FORMAT "%5.2" EXTENDED_LIMITS 0.00 255.0 /end CHARACTERISTIC
/begin CHARACTERISTIC DSM_ClaDfp_PCR_GovDev_C "Fehlerklasse fuer Fehlerpfad Dfp_PCR_GovDev" VALUE 0x1CF3DF Kw_Wu8 20.00 OneToOne 0.00 20.00 FORMAT "%5.2" EXTENDED_LIMITS 0.00 255.0 /end CHARACTERISTIC
/begin CHARACTERISTIC DSM_ClaDfp_PFltAPSens_C "Fehlerklasse fuer Fehlerpfad Dfp_PFltAPSens" VALUE 0x1CF3E0 Kw_Wu8 20.00 OneToOne 0.00 20.00 FORMAT "%5.2" EXTENDED_LIMITS 0.00 255.0 /end CHARACTERISTIC
/begin CHARACTERISTIC DSM_ClaDfp_PFltCDHtg_C "Fehlerklasse fuer Fehlerpfad Dfp_PFltCDHtg" VALUE 0x1CF3E1 Kw_Wu8 20.00 OneToOne 0.00 20.00 FORMAT "%5.2" EXTENDED_LIMITS 0.00 255.0 /end CHARACTERISTIC
/begin CHARACTERISTIC DSM_ClaDfp_PFltCDHtg1_C "Fehlerklasse fuer Fehlerpfad Dfp_PFltCDHtg1" VALUE 0x1CF3E2 Kw_Wu8 20.00 OneToOne 0.00 20.00 FORMAT "%5.2" EXTENDED_LIMITS 0.00 255.0 /end CHARACTERISTIC
/begin CHARACTERISTIC DSM_ClaDfp_PFltCDPDiff_C "Fehlerklasse fuer Fehlerpfad Dfp_PFltCDPDiff" VALUE 0x1CF3E3 Kw_Wu8 20.00 OneToOne 0.00 20.00 FORMAT "%5.2" EXTENDED_LIMITS 0.00 255.0 /end CHARACTERISTIC
/begin CHARACTERISTIC DSM_ClaDfp_PFltCDTempPre_C "Fehlerklasse fuer Fehlerpfad Dfp_PFltCDTempPre" VALUE 0x1CF3E4 Kw_Wu8 20.00 OneToOne 0.00 20.00 FORMAT "%5.2" EXTENDED_LIMITS 0.00 255.0 /end CHARACTERISTIC
/begin CHARACTERISTIC DSM_ClaDfp_PFltCDTempPre1_C "Fehlerklasse fuer Fehlerpfad Dfp_PFltCDTempPre1" VALUE 0x1CF3E5 Kw_Wu8 20.00 OneToOne 0.00 20.00 FORMAT "%5.2" EXTENDED_LIMITS 0.00 255.0 /end CHARACTERISTIC
/begin CHARACTERISTIC DSM_ClaDfp_PFltCDTempPst_C "Fehlerklasse fuer Fehlerpfad Dfp_PFltCDTempPst" VALUE 0x1CF3E6 Kw_Wu8 20.00 OneToOne 0.00 20.00 FORMAT "%5.2" EXTENDED_LIMITS 0.00 255.0 /end CHARACTERISTIC
/begin CHARACTERISTIC DSM_ClaDfp_PFltChar_C "Fehlerklasse fuer Fehlerpfad Dfp_PFltChar" VALUE 0x1CF3E7 Kw_Wu8 20.00 OneToOne 0.00 20.00 FORMAT "%5.2" EXTENDED_LIMITS 0.00 255.0 /end CHARACTERISTIC
/begin CHARACTERISTIC DSM_ClaDfp_PFltEngPrt_C "Fehlerklasse fuer Fehlerpfad Dfp_PFltEngPrt" VALUE 0x1CF3E8 Kw_Wu8 20.00 OneToOne 0.00 20.00 FORMAT "%5.2" EXTENDED_LIMITS 0.00 255.0 /end CHARACTERISTIC
/begin CHARACTERISTIC DSM_ClaDfp_PFltPresDynPlaus_C "Fehlerklasse fuer Fehlerpfad Dfp_PFltPresDynPlaus" VALUE 0x1CF3E9 Kw_Wu8 20.00 OneToOne 0.00 20.00 FORMAT "%5.2" EXTENDED_LIMITS 0.00 255.0 /end CHARACTERISTIC
/begin CHARACTERISTIC DSM_ClaDfp_PFltPresHsChng_C "Fehlerklasse fuer Fehlerpfad Dfp_PFltPresHsChng" VALUE 0x1CF3EA Kw_Wu8 20.00 OneToOne 0.00 20.00 FORMAT "%5.2" EXTENDED_LIMITS 0.00 255.0 /end CHARACTERISTIC
/begin CHARACTERISTIC DSM_ClaDfp_PFltPresSens_C "Fehlerklasse fuer Fehlerpfad Dfp_PFltPresSens" VALUE 0x1CF3EB Kw_Wu8 20.00 OneToOne 0.00 20.00 FORMAT "%5.2" EXTENDED_LIMITS 0.00 255.0 /end CHARACTERISTIC
/begin CHARACTERISTIC DSM_ClaDfp_PFltPresSensFrz_C "Fehlerklasse fuer Fehlerpfad Dfp_PFltPresSensFrz" VALUE 0x1CF3EC Kw_Wu8 20.00 OneToOne 0.00 20.00 FORMAT "%5.2" EXTENDED_LIMITS 0.00 255.0 /end CHARACTERISTIC
/begin CHARACTERISTIC DSM_ClaDfp_PFltPresSensHsLn_C "Fehlerklasse fuer Fehlerpfad Dfp_PFltPresSensHsLn" VALUE 0x1CF3ED Kw_Wu8 20.00 OneToOne 0.00 20.00 FORMAT "%5.2" EXTENDED_LIMITS 0.00 255.0 /end CHARACTERISTIC
/begin CHARACTERISTIC DSM_ClaDfp_PFltPresSensSot_C "Fehlerklasse fuer Fehlerpfad Dfp_PFltPresSensSot" VALUE 0x1CF3EE Kw_Wu8 20.00 OneToOne 0.00 20.00 FORMAT "%5.2" EXTENDED_LIMITS 0.00 255.0 /end CHARACTERISTIC
/begin CHARACTERISTIC DSM_ClaDfp_PFltRgnLckPerm_C "Fehlerklasse fuer Fehlerpfad Dfp_PFltRgnLckPerm" VALUE 0x1CF3EF Kw_Wu8 20.00 OneToOne 0.00 20.00 FORMAT "%5.2" EXTENDED_LIMITS 0.00 255.0 /end CHARACTERISTIC
/begin CHARACTERISTIC DSM_ClaDfp_PFltRgnLckPermTstr_C "Fehlerklasse fuer Fehlerpfad Dfp_PFltRgnLckPermTstr" VALUE 0x1CF3F0 Kw_Wu8 20.00 OneToOne 0.00 20.00 FORMAT "%5.2" EXTENDED_LIMITS 0.00 255.0 /end CHARACTERISTIC
/begin CHARACTERISTIC DSM_ClaDfp_PFltRgnPerm_C "Fehlerklasse fuer Fehlerpfad Dfp_PFltRgnPerm" VALUE 0x1CF3F1 Kw_Wu8 20.00 OneToOne 0.00 20.00 FORMAT "%5.2" EXTENDED_LIMITS 0.00 255.0 /end CHARACTERISTIC
/begin CHARACTERISTIC DSM_ClaDfp_PFltSotSimPresPerm_C "Fehlerklasse fuer Fehlerpfad Dfp_PFltSotSimPresPerm" VALUE 0x1CF3F2 Kw_Wu8 20.00 OneToOne 0.00 20.00 FORMAT "%5.2" EXTENDED_LIMITS 0.00 255.0 /end CHARACTERISTIC
/begin CHARACTERISTIC DSM_ClaDfp_PFltTempDwnStrm_C "Fehlerklasse fuer Fehlerpfad Dfp_PFltTempDwnStrm" VALUE 0x1CF3F3 Kw_Wu8 20.00 OneToOne 0.00 20.00 FORMAT "%5.2" EXTENDED_LIMITS 0.00 255.0 /end CHARACTERISTIC
/begin CHARACTERISTIC DSM_ClaDfp_PFltTempDwnStrmMax_C "Fehlerklassen fuer Fehlerpfad Dfp_PFltTempDwnStrmMax" VALUE 0x1CF3F4 Kw_Wu8 20.00 OneToOne 0.00 20.00 FORMAT "%5.2" EXTENDED_LIMITS 0.00 255.0 /end CHARACTERISTIC
/begin CHARACTERISTIC DSM_ClaDfp_PFltTempDwnStrmMin_C "Fehlerklassen fuer Fehlerpfad Dfp_PFltTempDwnStrmMin" VALUE 0x1CF3F5 Kw_Wu8 20.00 OneToOne 0.00 20.00 FORMAT "%5.2" EXTENDED_LIMITS 0.00 255.0 /end CHARACTERISTIC
/begin CHARACTERISTIC DSM_ClaDfp_PFltTempPreOxiC_C "Fehlerklasse fuer Fehlerpfad Dfp_PFltTempPreOxiC" VALUE 0x1CF3F6 Kw_Wu8 20.00 OneToOne 0.00 20.00 FORMAT "%5.2" EXTENDED_LIMITS 0.00 255.0 /end CHARACTERISTIC
/begin CHARACTERISTIC DSM_ClaDfp_PFltTempPrePFlt_C "Fehlerklasse fuer Fehlerpfad Dfp_PFltTempPrePFlt" VALUE 0x1CF3F7 Kw_Wu8 20.00 OneToOne 0.00 20.00 FORMAT "%5.2" EXTENDED_LIMITS 0.00 255.0 /end CHARACTERISTIC
/begin CHARACTERISTIC DSM_ClaDfp_PFltTempPreTrbn_C "Fehlerklasse fuer Fehlerpfad Dfp_PFltTempPreTrbn" VALUE 0x1CF3F8 Kw_Wu8 20.00 OneToOne 0.00 20.00 FORMAT "%5.2" EXTENDED_LIMITS 0.00 255.0 /end CHARACTERISTIC
/begin CHARACTERISTIC DSM_ClaDfp_PFltTempPstPFlt_C "Fehlerklasse fuer Fehlerpfad Dfp_PFltTempPstPFlt" VALUE 0x1CF3FA Kw_Wu8 20.00 OneToOne 0.00 20.00 FORMAT "%5.2" EXTENDED_LIMITS 0.00 255.0 /end CHARACTERISTIC
/begin CHARACTERISTIC DSM_ClaDfp_PFltTempSens_C "Fehlerklasse fuer Fehlerpfad Dfp_PFltTempSens" VALUE 0x1CF3FB Kw_Wu8 20.00 OneToOne 0.00 20.00 FORMAT "%5.2" EXTENDED_LIMITS 0.00 255.0 /end CHARACTERISTIC
/begin CHARACTERISTIC DSM_ClaDfp_PFltTempSens2_C "Fehlerklasse fuer Fehlerpfad Dfp_PFltTempSens2" VALUE 0x1CF3FC Kw_Wu8 20.00 OneToOne 0.00 20.00 FORMAT "%5.2" EXTENDED_LIMITS 0.00 255.0 /end CHARACTERISTIC
/begin CHARACTERISTIC DSM_ClaDfp_PFltTempUpStrm_C "Fehlerklasse fuer Fehlerpfad Dfp_PFltTempUpStrm" VALUE 0x1CF3FD Kw_Wu8 20.00 OneToOne 0.00 20.00 FORMAT "%5.2" EXTENDED_LIMITS 0.00 255.0 /end CHARACTERISTIC
/begin CHARACTERISTIC DSM_ClaDfp_PFltTempUpStrmMax_C "Fehlerklassen fuer Fehlerpfad Dfp_PFltTempUpStrmMax" VALUE 0x1CF3FE Kw_Wu8 20.00 OneToOne 0.00 20.00 FORMAT "%5.2" EXTENDED_LIMITS 0.00 255.0 /end CHARACTERISTIC
/begin CHARACTERISTIC DSM_ClaDfp_PFltTempUpStrmMin_C "Fehlerklassen fuer Fehlerpfad Dfp_PFltTempUpStrmMin" VALUE 0x1CF3FF Kw_Wu8 20.00 OneToOne 0.00 20.00 FORMAT "%5.2" EXTENDED_LIMITS 0.00 255.0 /end CHARACTERISTIC
/begin CHARACTERISTIC DSM_ClaDfp_PSPCD_Actr_C "Fehlerklasse fuer Fehlerpfad Dfp_PSPCD_Actr" VALUE 0x1CF400 Kw_Wu8 20.00 OneToOne 0.00 20.00 FORMAT "%5.2" EXTENDED_LIMITS 0.00 255.0 /end CHARACTERISTIC
/begin CHARACTERISTIC DSM_ClaDfp_PrpCtlvLimErrPat_C "Fehlerklasse fuer Fehlerpfad Dfp_PrpCtlvLimErrPat" VALUE 0x1CF401 Kw_Wu8 20.00 OneToOne 0.00 20.00 FORMAT "%5.2" EXTENDED_LIMITS 0.00 255.0 /end CHARACTERISTIC
/begin CHARACTERISTIC DSM_ClaDfp_SOPTst_C "Fehlerklasse fuer Fehlerpfad Dfp_SOPTst" VALUE 0x1CF402 Kw_Wu8 20.00 OneToOne 0.00 20.00 FORMAT "%5.2" EXTENDED_LIMITS 0.00 255.0 /end CHARACTERISTIC
/begin CHARACTERISTIC DSM_ClaDfp_SSpMon1_C "Fehlerklasse fuer Fehlerpfad Dfp_SSpMon1" VALUE 0x1CF403 Kw_Wu8 20.00 OneToOne 0.00 20.00 FORMAT "%5.2" EXTENDED_LIMITS 0.00 255.0 /end CHARACTERISTIC
/begin CHARACTERISTIC DSM_ClaDfp_SSpMon2_C "Fehlerklasse fuer Fehlerpfad Dfp_SSpMon2" VALUE 0x1CF404 Kw_Wu8 20.00 OneToOne 0.00 20.00 FORMAT "%5.2" EXTENDED_LIMITS 0.00 255.0 /end CHARACTERISTIC
/begin CHARACTERISTIC DSM_ClaDfp_SSpMon3_C "Fehlerklasse fuer Fehlerpfad Dfp_SSpMon3" VALUE 0x1CF405 Kw_Wu8 20.00 OneToOne 0.00 20.00 FORMAT "%5.2" EXTENDED_LIMITS 0.00 255.0 /end CHARACTERISTIC
/begin CHARACTERISTIC DSM_ClaDfp_Shtrp_EGRBA_C "Fehlerklasse fuer Fehlerpfad Dfp_Shtrp_EGRBA" VALUE 0x1CF406 Kw_Wu8 20.00 OneToOne 0.00 20.00 FORMAT "%5.2" EXTENDED_LIMITS 0.00 255.0 /end CHARACTERISTIC
/begin CHARACTERISTIC DSM_ClaDfp_Shtrp_PCRBA_C "Fehlerklasse fuer Fehlerpfad Dfp_Shtrp_PCRBA" VALUE 0x1CF407 Kw_Wu8 20.00 OneToOne 0.00 20.00 FORMAT "%5.2" EXTENDED_LIMITS 0.00 255.0 /end CHARACTERISTIC
/begin CHARACTERISTIC DSM_ClaDfp_SrvPmpStSAEcu_C "Fehlerklasse fuer Fehlerpfad Dfp_SrvPmpStSAEcu" VALUE 0x1CF408 Kw_Wu8 20.00 OneToOne 0.00 20.00 FORMAT "%5.2" EXTENDED_LIMITS 0.00 255.0 /end CHARACTERISTIC
/begin CHARACTERISTIC DSM_ClaDfp_StSysCtlShCirBatt_C "Fehlerklasse fuer Fehlerpfad Dfp_StSysCtlShCirBatt" VALUE 0x1CF409 Kw_Wu8 20.00 OneToOne 0.00 20.00 FORMAT "%5.2" EXTENDED_LIMITS 0.00 255.0 /end CHARACTERISTIC
/begin CHARACTERISTIC DSM_ClaDfp_StrtCDOffRly_C "Fehlerklasse für Fehlerpfad Dfp_StrtCDOffRly" VALUE 0x1CF40A Kw_Wu8 20.00 OneToOne 0.00 20.00 FORMAT "%5.2" EXTENDED_LIMITS 0.00 255.0 /end CHARACTERISTIC
/begin CHARACTERISTIC DSM_ClaDfp_StrtCDOnRly_C "Fehlerklasse für Fehlerpfad Dfp_StrtCDOnRly" VALUE 0x1CF40B Kw_Wu8 20.00 OneToOne 0.00 20.00 FORMAT "%5.2" EXTENDED_LIMITS 0.00 255.0 /end CHARACTERISTIC
/begin CHARACTERISTIC DSM_ClaDfp_StrtCtlIlsNotPlaus_C "Fehlerklasse für Fehlerpfad Dfp_StrtCtlIlsNotPlaus" VALUE 0x1CF40C Kw_Wu8 20.00 OneToOne 0.00 20.00 FORMAT "%5.2" EXTENDED_LIMITS 0.00 255.0 /end CHARACTERISTIC
/begin CHARACTERISTIC DSM_ClaDfp_StrtCtlT50ROneRly1_C "Fehlerklasse fuer Fehlerpfad Dfp_StrtCtlT50ROneRly1" VALUE 0x1CF40D Kw_Wu8 20.00 OneToOne 0.00 20.00 FORMAT "%5.2" EXTENDED_LIMITS 0.00 255.0 /end CHARACTERISTIC
/begin CHARACTERISTIC DSM_ClaDfp_StrtCtlT50ROneRly2_C "Fehlerklasse fuer Fehlerpfad Dfp_StrtCtlT50ROneRly2" VALUE 0x1CF40E Kw_Wu8 20.00 OneToOne 0.00 20.00 FORMAT "%5.2" EXTENDED_LIMITS 0.00 255.0 /end CHARACTERISTIC
/begin CHARACTERISTIC DSM_ClaDfp_StrtCtlT50RZero_C "Fehlerklasse fuer Fehlerpfad Dfp_StrtCtlT50RZero" VALUE 0x1CF40F Kw_Wu8 20.00 OneToOne 0.00 20.00 FORMAT "%5.2" EXTENDED_LIMITS 0.00 255.0 /end CHARACTERISTIC
/begin CHARACTERISTIC DSM_ClaDfp_SysLamp_C "Fehlerklasse fuer Fehlerpfad Dfp_SysLamp" VALUE 0x1CF410 Kw_Wu8 20.00 OneToOne 0.00 20.00 FORMAT "%5.2" EXTENDED_LIMITS 0.00 255.0 /end CHARACTERISTIC
/begin CHARACTERISTIC DSM_ClaDfp_T15CD_C "Fehlerklasse fuer Fehlerpfad Dfp_T15CD" VALUE 0x1CF411 Kw_Wu8 20.00 OneToOne 0.00 20.00 FORMAT "%5.2" EXTENDED_LIMITS 0.00 255.0 /end CHARACTERISTIC
/begin CHARACTERISTIC DSM_ClaDfp_T50CD_C "Fehlerklasse fuer Fehlerpfad Dfp_T50CD" VALUE 0x1CF412 Kw_Wu8 20.00 OneToOne 0.00 20.00 FORMAT "%5.2" EXTENDED_LIMITS 0.00 255.0 /end CHARACTERISTIC
/begin CHARACTERISTIC DSM_ClaDfp_TPUMon_C "Fehlerklasse fuer Fehlerpfad Dfp_TPUMon" VALUE 0x1CF413 Kw_Wu8 20.00 OneToOne 0.00 20.00 FORMAT "%5.2" EXTENDED_LIMITS 0.00 255.0 /end CHARACTERISTIC
/begin CHARACTERISTIC DSM_ClaDfp_TVACD_Max_C "Fehlerklasse fuer Fehlerpfad Dfp_TVACD_Max" VALUE 0x1CF414 Kw_Wu8 20.00 OneToOne 0.00 20.00 FORMAT "%5.2" EXTENDED_LIMITS 0.00 255.0 /end CHARACTERISTIC
/begin CHARACTERISTIC DSM_ClaDfp_TVACD_Min_C "Fehlerklasse fuer Fehlerpfad Dfp_TVACD_Min" VALUE 0x1CF415 Kw_Wu8 20.00 OneToOne 0.00 20.00 FORMAT "%5.2" EXTENDED_LIMITS 0.00 255.0 /end CHARACTERISTIC
/begin CHARACTERISTIC DSM_ClaDfp_TVACD_Sig_C "Fehlerklasse fuer Fehlerpfad Dfp_TVACD_Sig" VALUE 0x1CF416 Kw_Wu8 20.00 OneToOne 0.00 20.00 FORMAT "%5.2" EXTENDED_LIMITS 0.00 255.0 /end CHARACTERISTIC
/begin CHARACTERISTIC DSM_ClaDfp_TVACD_SigNpl_C "Fehlerklasse fuer Fehlerpfad Dfp_TVACD_SigNpl" VALUE 0x1CF417 Kw_Wu8 20.00 OneToOne 0.00 20.00 FORMAT "%5.2" EXTENDED_LIMITS 0.00 255.0 /end CHARACTERISTIC
/begin CHARACTERISTIC DSM_ClaDfp_TVACD_stLineDef_C "Fehlerklasse fuer Fehlerpfad Dfp_TVACD_stLineDef" VALUE 0x1CF418 Kw_Wu8 20.00 OneToOne 0.00 20.00 FORMAT "%5.2" EXTENDED_LIMITS 0.00 255.0 /end CHARACTERISTIC
/begin CHARACTERISTIC DSM_ClaDfp_TVASCD_C "Fehlerklasse fuer Fehlerpfad Dfp_TVASCD" VALUE 0x1CF419 Kw_Wu8 20.00 OneToOne 0.00 20.00 FORMAT "%5.2" EXTENDED_LIMITS 0.00 255.0 /end CHARACTERISTIC
/begin CHARACTERISTIC DSM_ClaDfp_TVASCD_Drft_C "Fehlerklasse fuer Fehlerpfad Dfp_TVASCD_Drft" VALUE 0x1CF41A Kw_Wu8 20.00 OneToOne 0.00 20.00 FORMAT "%5.2" EXTENDED_LIMITS 0.00 255.0 /end CHARACTERISTIC
/begin CHARACTERISTIC DSM_ClaDfp_ThrVlvGvnrDvt_C "Fehlerklasse fuer Fehlerpfad Dfp_ThrVlvGvnrDvt" VALUE 0x1CF41B Kw_Wu8 20.00 OneToOne 0.00 20.00 FORMAT "%5.2" EXTENDED_LIMITS 0.00 255.0 /end CHARACTERISTIC
/begin CHARACTERISTIC DSM_ClaDfp_ThrVlvJamVlv_C "Fehlerklasse fuer Fehlerpfad Dfp_ThrVlvJamVlv" VALUE 0x1CF41C Kw_Wu8 20.00 OneToOne 0.00 20.00 FORMAT "%5.2" EXTENDED_LIMITS 0.00 255.0 /end CHARACTERISTIC
/begin CHARACTERISTIC DSM_ClaDfp_UAcc_CodeBitErr_C "Fehlerklasse fuer Fehlerpfad Dfp_UAcc_CodeBitErr" VALUE 0x1CF41D Kw_Wu8 20.00 OneToOne 0.00 20.00 FORMAT "%5.2" EXTENDED_LIMITS 0.00 255.0 /end CHARACTERISTIC
/begin CHARACTERISTIC DSM_ClaDfp_USAp_DataVariant_C "Fehlerklasse fuer Fehlerpfad Dfp_USAp_DataVariant" VALUE 0x1CF41E Kw_Wu8 20.00 OneToOne 0.00 20.00 FORMAT "%5.2" EXTENDED_LIMITS 0.00 255.0 /end CHARACTERISTIC
/begin CHARACTERISTIC DSM_ClaDfp_USAp_FuncCodeRead_C "Fehlerklasse fuer Fehlerpfad Dfp_USAp_FuncCodeRead" VALUE 0x1CF41F Kw_Wu8 20.00 OneToOne 0.00 20.00 FORMAT "%5.2" EXTENDED_LIMITS 0.00 255.0 /end CHARACTERISTIC
/begin CHARACTERISTIC DSM_ClaDfp_VSACD_Max_C "Fehlerklasse fuer Fehlerpfad Dfp_VSACD_Max" VALUE 0x1CF420 Kw_Wu8 20.00 OneToOne 0.00 20.00 FORMAT "%5.2" EXTENDED_LIMITS 0.00 255.0 /end CHARACTERISTIC
/begin CHARACTERISTIC DSM_ClaDfp_VSACD_Min_C "Fehlerklasse fuer Fehlerpfad Dfp_VSACD_Min" VALUE 0x1CF421 Kw_Wu8 20.00 OneToOne 0.00 20.00 FORMAT "%5.2" EXTENDED_LIMITS 0.00 255.0 /end CHARACTERISTIC
/begin CHARACTERISTIC DSM_ClaDfp_VSACD_SigNpl_C "Fehlerklasse fuer Fehlerpfad Dfp_VSACD_SigNpl" VALUE 0x1CF422 Kw_Wu8 20.00 OneToOne 0.00 20.00 FORMAT "%5.2" EXTENDED_LIMITS 0.00 255.0 /end CHARACTERISTIC
/begin CHARACTERISTIC DSM_ClaDfp_VSSCD_C "Fehlerklasse fuer Fehlerpfad Dfp_VSSCD" VALUE 0x1CF423 Kw_Wu8 20.00 OneToOne 0.00 20.00 FORMAT "%5.2" EXTENDED_LIMITS 0.00 255.0 /end CHARACTERISTIC
/begin CHARACTERISTIC DSM_ClaDfp_VSSCD1_C "Fehlerklasse fuer Fehlerpfad Dfp_VSSCD1" VALUE 0x1CF424 Kw_Wu8 20.00 OneToOne 0.00 20.00 FORMAT "%5.2" EXTENDED_LIMITS 0.00 255.0 /end CHARACTERISTIC
/begin CHARACTERISTIC DSM_ClaDfp_VSSCD2_C "Fehlerklasse fuer Fehlerpfad Dfp_VSSCD2" VALUE 0x1CF425 Kw_Wu8 20.00 OneToOne 0.00 20.00 FORMAT "%5.2" EXTENDED_LIMITS 0.00 255.0 /end CHARACTERISTIC
/begin CHARACTERISTIC DSM_ClaDfp_VSSCD4_C "Fehlerklasse fuer Fehlerpfad Dfp_VSSCD4" VALUE 0x1CF426 Kw_Wu8 20.00 OneToOne 0.00 20.00 FORMAT "%5.2" EXTENDED_LIMITS 0.00 255.0 /end CHARACTERISTIC
/begin CHARACTERISTIC DSM_ClaDfp_VSSCDBrkLowVltg_C "Fehlerklasse fuer Fehlerpfad Dfp_VSSCDBrkLowVltg" VALUE 0x1CF427 Kw_Wu8 20.00 OneToOne 0.00 20.00 FORMAT "%5.2" EXTENDED_LIMITS 0.00 255.0 /end CHARACTERISTIC
/begin CHARACTERISTIC DSM_ClaDfp_VSSCDCAN_C "Fehlerklasse fuer Fehlerpfad Dfp_VSSCDCAN" VALUE 0x1CF428 Kw_Wu8 20.00 OneToOne 0.00 20.00 FORMAT "%5.2" EXTENDED_LIMITS 0.00 255.0 /end CHARACTERISTIC
/begin CHARACTERISTIC DSM_ClaDfp_VSSCDNpl_C "Fehlerklasse fuer Fehlerpfad Dfp_VSSCDNpl" VALUE 0x1CF429 Kw_Wu8 20.00 OneToOne 0.00 20.00 FORMAT "%5.2" EXTENDED_LIMITS 0.00 255.0 /end CHARACTERISTIC
/begin CHARACTERISTIC DSM_ClaDfp_WdCom_C "Fehlerklasse fuer Fehlerpfad Dfp_WdCom" VALUE 0x1CF42B Kw_Wu8 20.00 OneToOne 0.00 20.00 FORMAT "%5.2" EXTENDED_LIMITS 0.00 255.0 /end CHARACTERISTIC
/begin CHARACTERISTIC DSM_Class1OutPriority_C "Ausgabe Priorität der Umweltbedingungen für Fehlerklasse 1" VALUE 0x1CD900 Kw_Wu8 255.0 OneToOne 0.00 255.0 FORMAT "%5.1" /end CHARACTERISTIC
/begin CHARACTERISTIC DSM_Class2OutPriority_C "Ausgabe Priorität der Umweltbedingungen für Fehlerklasse 2" VALUE 0x1CD901 Kw_Wu8 255.0 OneToOne 0.00 255.0 FORMAT "%5.1" /end CHARACTERISTIC
/begin CHARACTERISTIC DSM_Class3OutPriority_C "Ausgabe Priorität der Umweltbedingungen für Fehlerklasse 3" VALUE 0x1CD902 Kw_Wu8 255.0 OneToOne 0.00 255.0 FORMAT "%5.1" /end CHARACTERISTIC
/begin CHARACTERISTIC DSM_Class4OutPriority_C "Ausgabe Priorität der Umweltbedingungen für Fehlerklasse 4" VALUE 0x1CD903 Kw_Wu8 255.0 OneToOne 0.00 255.0 FORMAT "%5.1" /end CHARACTERISTIC
/begin CHARACTERISTIC DSM_Class5OutPriority_C "Ausgabe Priorität der Umweltbedingungen für Fehlerklasse 5" VALUE 0x1CD904 Kw_Wu8 255.0 OneToOne 0.00 255.0 FORMAT "%5.1" /end CHARACTERISTIC
/begin CHARACTERISTIC DSM_Class6OutPriority_C "Ausgabe Priorität der Umweltbedingungen für Fehlerklasse 6" VALUE 0x1CD905 Kw_Wu8 255.0 OneToOne 0.00 255.0 FORMAT "%5.1" /end CHARACTERISTIC
/begin CHARACTERISTIC DSM_Class7OutPriority_C "Ausgabe Priorität der Umweltbedingungen für Fehlerklasse 7" VALUE 0x1CD906 Kw_Wu8 255.0 OneToOne 0.00 255.0 FORMAT "%5.1" /end CHARACTERISTIC
/begin CHARACTERISTIC DSM_Class8OutPriority_C "Ausgabe Priorität der Umweltbedingungen für Fehlerklasse 8" VALUE 0x1CD907 Kw_Wu8 255.0 OneToOne 0.00 255.0 FORMAT "%5.1" /end CHARACTERISTIC
/begin CHARACTERISTIC DSM_Class9OutPriority_C "Ausgabe Priorität der Umweltbedingungen für Fehlerklasse 9" VALUE 0x1CD908 Kw_Wu8 255.0 OneToOne 0.00 255.0 FORMAT "%5.1" /end CHARACTERISTIC
/begin CHARACTERISTIC DSM_Class10OutPriority_C "Ausgabe Priorität der Umweltbedingungen für Fehlerklasse 10" VALUE 0x1CD909 Kw_Wu8 255.0 OneToOne 0.00 255.0 FORMAT "%5.1" /end CHARACTERISTIC
/begin CHARACTERISTIC DSM_Class11OutPriority_C "Ausgabe Priorität der Umweltbedingungen für Fehlerklasse 11" VALUE 0x1CD90A Kw_Wu8 255.0 OneToOne 0.00 255.0 FORMAT "%5.1" /end CHARACTERISTIC
/begin CHARACTERISTIC DSM_Class12OutPriority_C "Ausgabe Priorität der Umweltbedingungen für Fehlerklasse 12" VALUE 0x1CD90B Kw_Wu8 255.0 OneToOne 0.00 255.0 FORMAT "%5.1" /end CHARACTERISTIC
/begin CHARACTERISTIC DSM_Class13OutPriority_C "Ausgabe Priorität der Umweltbedingungen für Fehlerklasse 13" VALUE 0x1CD90C Kw_Wu8 255.0 OneToOne 0.00 255.0 FORMAT "%5.1" /end CHARACTERISTIC
/begin CHARACTERISTIC DSM_Class14OutPriority_C "Ausgabe Priorität der Umweltbedingungen für Fehlerklasse 14" VALUE 0x1CD90D Kw_Wu8 255.0 OneToOne 0.00 255.0 FORMAT "%5.1" /end CHARACTERISTIC
/begin CHARACTERISTIC DSM_Class15OutPriority_C "Ausgabe Priorität der Umweltbedingungen für Fehlerklasse 15" VALUE 0x1CD90E Kw_Wu8 255.0 OneToOne 0.00 255.0 FORMAT "%5.1" /end CHARACTERISTIC
/begin CHARACTERISTIC DSM_Class16OutPriority_C "Ausgabe Priorität der Umweltbedingungen für Fehlerklasse 16" VALUE 0x1CD90F Kw_Wu8 255.0 OneToOne 0.00 255.0 FORMAT "%5.1" /end CHARACTERISTIC
/begin CHARACTERISTIC DSM_Class17OutPriority_C "Ausgabe Priorität der Umweltbedingungen für Fehlerklasse 17" VALUE 0x1CD910 Kw_Wu8 255.0 OneToOne 0.00 255.0 FORMAT "%5.1" /end CHARACTERISTIC
/begin CHARACTERISTIC DSM_Class18OutPriority_C "Ausgabe Priorität der Umweltbedingungen für Fehlerklasse 18" VALUE 0x1CD911 Kw_Wu8 255.0 OneToOne 0.00 255.0 FORMAT "%5.1" /end CHARACTERISTIC
/begin CHARACTERISTIC DSM_Class19OutPriority_C "Ausgabe Priorität der Umweltbedingungen für Fehlerklasse 19" VALUE 0x1CD912 Kw_Wu8 255.0 OneToOne 0.00 255.0 FORMAT "%5.1" /end CHARACTERISTIC
/begin CHARACTERISTIC DSM_Class20OutPriority_C "Ausgabe Priorität der Umweltbedingungen für Fehlerklasse 20" VALUE 0x1CD913 Kw_Wu8 255.0 OneToOne 0.00 255.0 FORMAT "%5.1" /end CHARACTERISTIC
/begin CHARACTERISTIC DSM_Class21OutPriority_C "Ausgabe Priorität der Umweltbedingungen für Fehlerklasse 21" VALUE 0x1CD914 Kw_Wu8 255.0 OneToOne 0.00 255.0 FORMAT "%5.1" /end CHARACTERISTIC
/begin CHARACTERISTIC DSM_Class22OutPriority_C "Ausgabe Priorität der Umweltbedingungen für Fehlerklasse 22" VALUE 0x1CD915 Kw_Wu8 255.0 OneToOne 0.00 255.0 FORMAT "%5.1" /end CHARACTERISTIC
/begin CHARACTERISTIC DSM_Class23OutPriority_C "Ausgabe Priorität der Umweltbedingungen für Fehlerklasse 23" VALUE 0x1CD916 Kw_Wu8 255.0 OneToOne 0.00 255.0 FORMAT "%5.1" /end CHARACTERISTIC
/begin CHARACTERISTIC DSM_Class24OutPriority_C "Ausgabe Priorität der Umweltbedingungen für Fehlerklasse 24" VALUE 0x1CD917 Kw_Wu8 255.0 OneToOne 0.00 255.0 FORMAT "%5.1" /end CHARACTERISTIC
/begin CHARACTERISTIC DSM_Class25OutPriority_C "Ausgabe Priorität der Umweltbedingungen für Fehlerklasse 25" VALUE 0x1CD918 Kw_Wu8 255.0 OneToOne 0.00 255.0 FORMAT "%5.1" /end CHARACTERISTIC
/begin CHARACTERISTIC DSM_Class26OutPriority_C "Ausgabe Priorität der Umweltbedingungen für Fehlerklasse 26" VALUE 0x1CD919 Kw_Wu8 255.0 OneToOne 0.00 255.0 FORMAT "%5.1" /end CHARACTERISTIC
/begin COMPU_METHOD OneToOne "eins zu eins (physikalischer Wert ist gleich dem internen Wert)" RAT_FUNC "%6.2" "[-]" COEFFS 0 1 0 0 0 1 /end COMPU_METHOD
/begin RECORD_LAYOUT Kw_Wu16 FNC_VALUES 1 UWORD COLUMN_DIR DIRECT /end RECORD_LAYOUT
/begin RECORD_LAYOUT Kw_Wu8 FNC_VALUES 1 UBYTE COLUMN_DIR DIRECT /end RECORD_LAYOUT
/begin FUNCTION DSM_Cla "Configuration parameters for fault class for fault path"
 /begin DEF_CHARACTERISTIC DSM_ClaDfp_ACCCDBrkErr_C DSM_ClaDfp_ACCCDBrkNPL_C DSM_ClaDfp_ACCCDSensErr_C DSM_ClaDfp_ACCCDWrongCoded_C DSM_ClaDfp_ACCCD_C DSM_ClaDfp_ACCD_C DSM_ClaDfp_ACCD_PAC_C DSM_ClaDfp_ACCD_pCAN_C DSM_ClaDfp_ACCD_trqCAN_C DSM_ClaDfp_ACCIRevPanErr_C DSM_ClaDfp_ACCIRevShOff_C DSM_ClaDfp_ACCnotPlaus_C DSM_ClaDfp_ADCMon_C DSM_ClaDfp_AFSCD_PlOffsDrft_C DSM_ClaDfp_AFSCD_PlSetyDrft_C DSM_ClaDfp_AFSCD_SRCAirm_C DSM_ClaDfp_AFVCD_Actr_C DSM_ClaDfp_AOHtCDHt1_C DSM_ClaDfp_AOHtCDHt2_C DSM_ClaDfp_AOHtCDHt3_C DSM_ClaDfp_APP1_C DSM_ClaDfp_APP2_C DSM_ClaDfp_APPCD_KickDown_C DSM_ClaDfp_APPCD_PWGDrft_C DSM_ClaDfp_APPSync_C DSM_ClaDfp_APP_Npl_C DSM_ClaDfp_APSCD_C DSM_ClaDfp_AccPedPlausBrk_C DSM_ClaDfp_AirCtl_GovDevMax_C DSM_ClaDfp_AirCtl_GovDevMin_C DSM_ClaDfp_AirCtl_GovDevRgnMax_C DSM_ClaDfp_AirCtl_GovDevRgnMin_C DSM_ClaDfp_AirbCDCrashCrCtl_C DSM_ClaDfp_AirbCDCrashPSP_C DSM_ClaDfp_AirbCDCrash_C DSM_ClaDfp_AltCDExc_C DSM_ClaDfp_AltCD_Load_C DSM_ClaDfp_AltPwrCan_C DSM_ClaDfp_BIP01_C DSM_ClaDfp_BIP02_C DSM_ClaDfp_BIP03_C DSM_ClaDfp_BIP04_C DSM_ClaDfp_BIP05_C DSM_ClaDfp_BIP06_C DSM_ClaDfp_BIP07_C DSM_ClaDfp_BIP08_C DSM_ClaDfp_BIP09_C DSM_ClaDfp_BIP10_C DSM_ClaDfp_BIP11_C DSM_ClaDfp_BIP12_C DSM_ClaDfp_BIP_Con_C DSM_ClaDfp_BPACD_Max2_C DSM_ClaDfp_BPACD_Max_C DSM_ClaDfp_BPACD_Min2_C DSM_ClaDfp_BPACD_Min_C DSM_ClaDfp_BPACD_SigNpl2_C DSM_ClaDfp_BPACD_SigNpl_C DSM_ClaDfp_BPASCD_C DSM_ClaDfp_BPSCD_C DSM_ClaDfp_BattCD_C DSM_ClaDfp_BrkCDBPTInvld_C DSM_ClaDfp_BrkCD_C DSM_ClaDfp_BrkCDdynPl_C DSM_ClaDfp_CANA_C DSM_ClaDfp_CANB_C DSM_ClaDfp_CANBus1_C DSM_ClaDfp_CANBus2_C DSM_ClaDfp_CANBus3_C DSM_ClaDfp_CANC_C DSM_ClaDfp_CANErrActA_C DSM_ClaDfp_CANErrActB_C DSM_ClaDfp_CANErrActC_C DSM_ClaDfp_COTSCD_C DSM_ClaDfp_CTSCDCanInac_C DSM_ClaDfp_CTSCDCanSig_C DSM_ClaDfp_CTSCD_C DSM_ClaDfp_Clg_DynTst_C DSM_ClaDfp_CmbChbMisfire1_C DSM_ClaDfp_CmbChbMisfire2_C DSM_ClaDfp_CmbChbMisfire3_C DSM_ClaDfp_CmbChbMisfire4_C DSM_ClaDfp_CmbChbMisfire5_C DSM_ClaDfp_CmbChbMisfire6_C DSM_ClaDfp_CmbChbMisfireMul_C DSM_ClaDfp_CoVMDCSh_C DSM_ClaDfp_CoVMDCSp_C DSM_ClaDfp_CoVehLvl2_C DSM_ClaDfp_ConvCD_C DSM_ClaDfp_ConvCD_ConvErr_C DSM_ClaDfp_ConvCD_EPB1_C DSM_ClaDfp_CrCCDPanErrMSG_C DSM_ClaDfp_CrCCDPanErrSMLS_C DSM_ClaDfp_CrCCDPanMainSwtErr_C DSM_ClaDfp_CrCtlDsplNotPlaus_C DSM_ClaDfp_CrCtlPECDErr_C DSM_ClaDfp_CrCtlPLmpDef_C DSM_ClaDfp_CrCtlPShutOff_C DSM_ClaDfp_CrCtlPTlrDef_C DSM_ClaDfp_CtApCD_C DSM_ClaDfp_CtTCD_C DSM_ClaDfp_CtT_Mon_C DSM_ClaDfp_DifftrqLimErrPat_C DSM_ClaDfp_EATSCDCanInac_C DSM_ClaDfp_EATSCDCanSig_C DSM_ClaDfp_EATSCD_C DSM_ClaDfp_EEPCDVarMng_C DSM_ClaDfp_EGPpCDTPreTrbn_C DSM_ClaDfp_EGRCD_CBV_C DSM_ClaDfp_EGRCD_Max_C DSM_ClaDfp_EGRCD_Min_C DSM_ClaDfp_EGRCD_SigNpl_C DSM_ClaDfp_EGRCD_Sig_C DSM_ClaDfp_EGRSCD_C DSM_ClaDfp_EGRSCD_JamVlv_C DSM_ClaDfp_EGRSCD_LgTimeDrft_C DSM_ClaDfp_EGRSCD_ShTimeDrft_C DSM_ClaDfp_EGRVlvGvnrDvt_C DSM_ClaDfp_EGRVlv_JamVlv_C DSM_ClaDfp_EMCCD_MLS1_C DSM_ClaDfp_EngMBackUp_C DSM_ClaDfp_EngMCaS1_C DSM_ClaDfp_EngMCaSDrv_C DSM_ClaDfp_EngMCrS1_C DSM_ClaDfp_EngMOfsCaSCrS_C DSM_ClaDfp_EngMonIrrCmb_C DSM_ClaDfp_EngPrt_C DSM_ClaDfp_ErLpCDMILReqON_C DSM_ClaDfp_FMAErrMod_C DSM_ClaDfp_FMTC_NonMonotonMap_C DSM_ClaDfp_FQTSCD_C DSM_ClaDfp_FQlSCD_C DSM_ClaDfp_FTSCDNpl_C DSM_ClaDfp_FTSCD_C DSM_ClaDfp_FanCD_Fan1Ctlr1_C DSM_ClaDfp_FanCD_Fan1Ctlr2_C DSM_ClaDfp_FanCD_Fan2Ctlr1_C DSM_ClaDfp_FanCD_Fan2Ctlr2_C DSM_ClaDfp_FanCD_FanCtlr1_C DSM_ClaDfp_FanCD_FanCtlr2_C DSM_ClaDfp_FanCD_OutFanCtlr1_C DSM_ClaDfp_FanCD_OutFanCtlr2_C DSM_ClaDfp_FlPpCD_C DSM_ClaDfp_FlSCDT1_C DSM_ClaDfp_FrmMngAAGNpl_C DSM_ClaDfp_FrmMngAAGTO_C DSM_ClaDfp_FrmMngAC1Npl_C DSM_ClaDfp_FrmMngAC1TO_C DSM_ClaDfp_FrmMngACCNpl_C DSM_ClaDfp_FrmMngACCTO_C DSM_ClaDfp_FrmMngAIRBGNpl_C DSM_ClaDfp_FrmMngAIRBGTO_C DSM_ClaDfp_FrmMngAWD1Npl_C DSM_ClaDfp_FrmMngAWD1TO_C DSM_ClaDfp_FrmMngBEM1Npl_C DSM_ClaDfp_FrmMngBEM1TO_C DSM_ClaDfp_FrmMngBRK1Npl_C DSM_ClaDfp_FrmMngBRK1TO_C DSM_ClaDfp_FrmMngBRK2Npl_C DSM_ClaDfp_FrmMngBRK2TO_C DSM_ClaDfp_FrmMngBRK8Npl_C DSM_ClaDfp_FrmMngBRK8TO_C DSM_ClaDfp_FrmMngBSG3TO_C DSM_ClaDfp_FrmMngCANVerErr_C DSM_ClaDfp_FrmMngCCSel_C DSM_ClaDfp_FrmMngCCTLNpl_C DSM_ClaDfp_FrmMngCCTLTO_C DSM_ClaDfp_FrmMngCHRGR1Npl_C DSM_ClaDfp_FrmMngCHRGR1TO_C DSM_ClaDfp_FrmMngCHRGR2Npl_C DSM_ClaDfp_FrmMngCHRGR2TO_C DSM_ClaDfp_FrmMngChrgr1A_C DSM_ClaDfp_FrmMngChrgr1C_C DSM_ClaDfp_FrmMngChrgr1N_C DSM_ClaDfp_FrmMngChrgr1T_C DSM_ClaDfp_FrmMngChrgr1V_C DSM_ClaDfp_FrmMngChrgr2A_C DSM_ClaDfp_FrmMngChrgr2C_C DSM_ClaDfp_FrmMngChrgr2N_C DSM_ClaDfp_FrmMngChrgr2T_C DSM_ClaDfp_FrmMngChrgr2V_C DSM_ClaDfp_FrmMngDIA1Npl_C DSM_ClaDfp_FrmMngDIA1TO_C DSM_ClaDfp_FrmMngDSP1Npl_C DSM_ClaDfp_FrmMngDSP1TO_C DSM_ClaDfp_FrmMngDSP2Npl_C DSM_ClaDfp_FrmMngDSP2TO_C DSM_ClaDfp_FrmMngDSP3Npl_C DSM_ClaDfp_FrmMngDSP3TO_C DSM_ClaDfp_FrmMngEPB1Npl_C DSM_ClaDfp_FrmMngEPB1TO_C DSM_ClaDfp_FrmMngESCUNpl_C DSM_ClaDfp_FrmMngESCUTO_C DSM_ClaDfp_FrmMngGW1Npl_C DSM_ClaDfp_FrmMngGW1TO_C DSM_ClaDfp_FrmMngILMNpl_C DSM_ClaDfp_FrmMngILMTO_C DSM_ClaDfp_FrmMngLICHT2TO_C DSM_ClaDfp_FrmMngNIV1WrngCod_C DSM_ClaDfp_FrmMngNIVEAU1Npl_C DSM_ClaDfp_FrmMngNIVEAU1TO_C DSM_ClaDfp_FrmMngSA1Npl_C DSM_ClaDfp_FrmMngSA1TO_C DSM_ClaDfp_FrmMngSTIGNNpl_C DSM_ClaDfp_FrmMngStIgnTO_C DSM_ClaDfp_FrmMngTOSNpl_C DSM_ClaDfp_FrmMngTOSTO_C DSM_ClaDfp_FrmMngTSC1Npl_C DSM_ClaDfp_FrmMngTSC1TO_C DSM_ClaDfp_FrmMngTSC2Npl_C DSM_ClaDfp_FrmMngTSC2TO_C DSM_ClaDfp_FrmMngTSC3Npl_C DSM_ClaDfp_FrmMngTSC3TO_C DSM_ClaDfp_FrmMngTSC6Npl_C DSM_ClaDfp_FrmMngTSC6TO_C DSM_ClaDfp_FrmMngTrbnSpdErr_C DSM_ClaDfp_FrmMngWIPERTO_C DSM_ClaDfp_GbSSCD_C DSM_ClaDfp_GbSSCD_HW_C DSM_ClaDfp_GearbxCVTnMax_C DSM_ClaDfp_GearbxClthPlaus_C DSM_ClaDfp_GearbxINCCup_C DSM_ClaDfp_GearbxNMinMon_C DSM_ClaDfp_GearbxTSC_C DSM_ClaDfp_GearbxTransConv_C DSM_ClaDfp_GearbxTypeMTErr_C DSM_ClaDfp_GlwCDDIAG_C DSM_ClaDfp_GlwCDErr1_C DSM_ClaDfp_GlwCDErr2_C DSM_ClaDfp_GlwCDEvalCod_C DSM_ClaDfp_GlwCDGSK2_C DSM_ClaDfp_GlwCDGSK3_C DSM_ClaDfp_GlwCDLmp_C DSM_ClaDfp_GlwCDPLUG0_C DSM_ClaDfp_GlwCDPLUG1_C DSM_ClaDfp_GlwCDPLUG2_C DSM_ClaDfp_GlwCDPLUG3_C DSM_ClaDfp_GlwCDPLUG4_C DSM_ClaDfp_GlwCDPLUG5_C DSM_ClaDfp_GlwCD_LampCan_C DSM_ClaDfp_GlwCDsfd_C DSM_ClaDfp_HDSCD_C DSM_ClaDfp_HWEMonCom_C DSM_ClaDfp_HWEMonEEPROM_C DSM_ClaDfp_HWEMonRcyLocked_C DSM_ClaDfp_HWEMonRcySuppressed_C DSM_ClaDfp_HWEMonRcyVisible_C DSM_ClaDfp_HWEMonUMaxSupply_C DSM_ClaDfp_HWEMonUMinSupply_C DSM_ClaDfp_IATSCD_C DSM_ClaDfp_IFCD_C DSM_ClaDfp_ImmCtl_C DSM_ClaDfp_IndSysMonIntMnf_C DSM_ClaDfp_InjVlvBnk1A_C DSM_ClaDfp_InjVlvBnk2A_C DSM_ClaDfp_InjVlvCyl10A_C DSM_ClaDfp_InjVlvCyl11A_C DSM_ClaDfp_InjVlvCyl12A_C DSM_ClaDfp_InjVlvCyl1A_C DSM_ClaDfp_InjVlvCyl2A_C DSM_ClaDfp_InjVlvCyl3A_C DSM_ClaDfp_InjVlvCyl4A_C DSM_ClaDfp_InjVlvCyl5A_C DSM_ClaDfp_InjVlvCyl6A_C DSM_ClaDfp_InjVlvCyl7A_C DSM_ClaDfp_InjVlvCyl8A_C DSM_ClaDfp_InjVlvCyl9A_C DSM_ClaDfp_LASCD_C DSM_ClaDfp_LSUCDCircNernst0_C DSM_ClaDfp_LSUCDCircPumpCur0_C DSM_ClaDfp_LSUCDCircVirtGnd0_C DSM_ClaDfp_LSUCDHeater0_C DSM_ClaDfp_LSUCDHtCoup0_C DSM_ClaDfp_LSUCDO20_C DSM_ClaDfp_LSUCDO2Clb0_C DSM_ClaDfp_LSUCDRiClb0_C DSM_ClaDfp_LSUCDSPI0_C DSM_ClaDfp_LSUCDSPIBattLow0_C DSM_ClaDfp_LSUCDWireIP0_C DSM_ClaDfp_LSUCtlRiExc0_C DSM_ClaDfp_LSUMonDyn0_C DSM_ClaDfp_LSUMonFullLd0_C DSM_ClaDfp_LSUMonOvrRun0_C DSM_ClaDfp_LSUMonPartLd0_C DSM_ClaDfp_MIL_C DSM_ClaDfp_MRlyCD_C DSM_ClaDfp_Montr_C DSM_ClaDfp_OTSCDCanInac_C DSM_ClaDfp_OTSCDCanSig_C DSM_ClaDfp_OTSCD_C DSM_ClaDfp_OvRMonCrCtlP_C DSM_ClaDfp_OvRMonSigA_C DSM_ClaDfp_OvRMon_C DSM_ClaDfp_OxiCCDTPre1_C DSM_ClaDfp_OxiCCDTPre_C DSM_ClaDfp_PCR_BalGovDev_C DSM_ClaDfp_PCR_GovDev_C DSM_ClaDfp_PFltAPSens_C DSM_ClaDfp_PFltCDHtg1_C DSM_ClaDfp_PFltCDHtg_C DSM_ClaDfp_PFltCDPDiff_C DSM_ClaDfp_PFltCDTempPre1_C DSM_ClaDfp_PFltCDTempPre_C DSM_ClaDfp_PFltCDTempPst_C DSM_ClaDfp_PFltChar_C DSM_ClaDfp_PFltEngPrt_C DSM_ClaDfp_PFltPresDynPlaus_C DSM_ClaDfp_PFltPresHsChng_C DSM_ClaDfp_PFltPresSensFrz_C DSM_ClaDfp_PFltPresSensHsLn_C DSM_ClaDfp_PFltPresSensSot_C DSM_ClaDfp_PFltPresSens_C DSM_ClaDfp_PFltRgnLckPermTstr_C DSM_ClaDfp_PFltRgnLckPerm_C DSM_ClaDfp_PFltRgnPerm_C DSM_ClaDfp_PFltSotSimPresPerm_C DSM_ClaDfp_PFltTempDwnStrmMax_C DSM_ClaDfp_PFltTempDwnStrmMin_C DSM_ClaDfp_PFltTempDwnStrm_C DSM_ClaDfp_PFltTempPreOxiC_C DSM_ClaDfp_PFltTempPrePFlt_C DSM_ClaDfp_PFltTempPreTrbn_C DSM_ClaDfp_PFltTempPstPFlt_C DSM_ClaDfp_PFltTempSens2_C DSM_ClaDfp_PFltTempSens_C DSM_ClaDfp_PFltTempUpStrmMax_C DSM_ClaDfp_PFltTempUpStrmMin_C DSM_ClaDfp_PFltTempUpStrm_C DSM_ClaDfp_PSPCD_Actr_C DSM_ClaDfp_PrpCtlvLimErrPat_C DSM_ClaDfp_SOPTst_C DSM_ClaDfp_SSpMon1_C DSM_ClaDfp_SSpMon2_C DSM_ClaDfp_SSpMon3_C DSM_ClaDfp_Shtrp_EGRBA_C DSM_ClaDfp_Shtrp_PCRBA_C DSM_ClaDfp_SrvPmpStSAEcu_C DSM_ClaDfp_StSysCtlShCirBatt_C DSM_ClaDfp_StrtCDOffRly_C DSM_ClaDfp_StrtCDOnRly_C DSM_ClaDfp_StrtCtlIlsNotPlaus_C DSM_ClaDfp_StrtCtlT50ROneRly1_C DSM_ClaDfp_StrtCtlT50ROneRly2_C DSM_ClaDfp_StrtCtlT50RZero_C DSM_ClaDfp_SysLamp_C DSM_ClaDfp_T15CD_C DSM_ClaDfp_T50CD_C DSM_ClaDfp_TPUMon_C DSM_ClaDfp_TVACD_Max_C DSM_ClaDfp_TVACD_Min_C DSM_ClaDfp_TVACD_SigNpl_C DSM_ClaDfp_TVACD_Sig_C DSM_ClaDfp_TVACD_stLineDef_C DSM_ClaDfp_TVASCD_C DSM_ClaDfp_TVASCD_Drft_C DSM_ClaDfp_ThrVlvGvnrDvt_C DSM_ClaDfp_ThrVlvJamVlv_C DSM_ClaDfp_UAcc_CodeBitErr_C DSM_ClaDfp_USAp_DataVariant_C DSM_ClaDfp_USAp_FuncCodeRead_C DSM_ClaDfp_VSACD_Max_C DSM_ClaDfp_VSACD_Min_C DSM_ClaDfp_VSACD_SigNpl_C DSM_ClaDfp_VSSCD1_C DSM_ClaDfp_VSSCD2_C DSM_ClaDfp_VSSCD4_C DSM_ClaDfp_VSSCDBrkLowVltg_C DSM_ClaDfp_VSSCDCAN_C DSM_ClaDfp_VSSCDNpl_C DSM_ClaDfp_VSSCD_C DSM_ClaDfp_WdCom_C DSM_Class10OutPriority_C DSM_Class11OutPriority_C DSM_Class12OutPriority_C DSM_Class13OutPriority_C DSM_Class14OutPriority_C DSM_Class15OutPriority_C DSM_Class16OutPriority_C DSM_Class17OutPriority_C DSM_Class18OutPriority_C DSM_Class19OutPriority_C DSM_Class1OutPriority_C DSM_Class20OutPriority_C DSM_Class21OutPriority_C DSM_Class22OutPriority_C DSM_Class23OutPriority_C DSM_Class24OutPriority_C DSM_Class25OutPriority_C DSM_Class26OutPriority_C DSM_Class2OutPriority_C DSM_Class3OutPriority_C DSM_Class4OutPriority_C DSM_Class5OutPriority_C DSM_Class6OutPriority_C DSM_Class7OutPriority_C DSM_Class8OutPriority_C DSM_Class9OutPriority_C /end DEF_CHARACTERISTIC
/end FUNCTION
/begin FUNCTION DSM_Dur "Entfernungs- und Operations-Zeitzähler"
 /begin DEF_CHARACTERISTIC DSMDur_DfctDur1Mode_C DSMDur_DfctDur2Mode_C DSMDur_FcmDfctDur1Mode_C DSMDur_FcmDfctDur2Mode_C DSMDur_stDfctDur1Enable_C DSMDur_stDfctDur1Reset_C DSMDur_stDfctDur2Enable_C DSMDur_stDfctDur2Reset_C DSMDur_stFcmDfctDur1Enable_C DSMDur_stFcmDfctDur1Reset_C DSMDur_stFcmDfctDur2Enable_C DSMDur_stFcmDfctDur2Reset_C DSM_ctNoMILWUCThresh_C /end DEF_CHARACTERISTIC
/end FUNCTION
/end MODULE
/end PROJECT
